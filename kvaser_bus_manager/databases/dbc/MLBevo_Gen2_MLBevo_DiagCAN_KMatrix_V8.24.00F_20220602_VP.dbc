VERSION "HNNBNNNYNNNNNNNNNNNNNNNNNNNNNNNNNNNNNNNNNN/4/%%%/4/'%**4NNN///"

NS_ :

BS_:

BU_: Gateway Gateway_PAG Tester_MLBevo

BO_ 2549880614 DIA_AAU_Req: 8 Tester_MLBevo
 SG_ DIA_AAU_Req_Data : 0|64@1+ (1.0,0.0) [0.0|18446744073709551615] ""  Gateway,Gateway_PAG

BO_ 2550011686 DIA_AAU_Resp: 8 Gateway
 SG_ DIA_AAU_Resp_Data : 0|64@1+ (1.0,0.0) [0.0|18446744073709551615] ""  Tester_MLBevo

BO_ 2549880464 DIA_ASTA_Req: 8 Tester_MLBevo
 SG_ DIA_ASTA_Req_Data : 0|64@1+ (1.0,0.0) [0.0|18446744073709551615] ""  Gateway,Gateway_PAG

BO_ 2550011536 DIA_ASTA_Resp: 8 Gateway
 SG_ DIA_ASTA_Resp_Data : 0|64@1+ (1.0,0.0) [0.0|18446744073709551615] ""  Tester_MLBevo

BO_ 2549880567 DIA_ATFP_Req: 8 Tester_MLBevo
 SG_ DIA_ATFP_Req_Data : 0|64@1+ (1.0,0.0) [0.0|18446744073709551615] ""  Gateway,Gateway_PAG

BO_ 2550011639 DIA_ATFP_Resp: 8 Gateway
 SG_ DIA_ATFP_Resp_Data : 0|64@1+ (1.0,0.0) [0.0|18446744073709551615] ""  Tester_MLBevo

BO_ 2549880375 DIA_BDM_Req: 8 Tester_MLBevo
 SG_ DIA_BDM_Req_Data : 0|64@1+ (1.0,0.0) [0.0|18446744073709551615] ""  Gateway,Gateway_PAG

BO_ 2550011447 DIA_BDM_Resp: 8 Gateway
 SG_ DIA_BDM_Resp_Data : 0|64@1+ (1.0,0.0) [0.0|18446744073709551615] ""  Tester_MLBevo

BO_ 2549880528 DIA_BJB_Req: 8 Tester_MLBevo
 SG_ DIA_BJB_Req_Data : 0|64@1+ (1.0,0.0) [0.0|18446744073709551615] ""  Gateway,Gateway_PAG

BO_ 2550011600 DIA_BJB_Resp: 8 Gateway
 SG_ DIA_BJB_Resp_Data : 0|64@1+ (1.0,0.0) [0.0|18446744073709551615] ""  Tester_MLBevo

BO_ 2549880588 DIA_CCU_Req: 8 Tester_MLBevo
 SG_ DIA_CCU_Req_Data : 0|64@1+ (1.0,0.0) [0.0|18446744073709551615] ""  Gateway,Gateway_PAG

BO_ 2550011660 DIA_CCU_Resp: 8 Gateway
 SG_ DIA_CCU_Resp_Data : 0|64@1+ (1.0,0.0) [0.0|18446744073709551615] ""  Tester_MLBevo

BO_ 2549880529 DIA_CMC_01_Req: 8 Tester_MLBevo
 SG_ DIA_CMC_01_Req_Data : 0|64@1+ (1.0,0.0) [0.0|18446744073709551615] ""  Gateway,Gateway_PAG

BO_ 2550011601 DIA_CMC_01_Resp: 8 Gateway
 SG_ DIA_CMC_01_Resp_Data : 0|64@1+ (1.0,0.0) [0.0|18446744073709551615] ""  Tester_MLBevo

BO_ 2549880530 DIA_CMC_02_Req: 8 Tester_MLBevo
 SG_ DIA_CMC_02_Req_Data : 0|64@1+ (1.0,0.0) [0.0|18446744073709551615] ""  Gateway,Gateway_PAG

BO_ 2550011602 DIA_CMC_02_Resp: 8 Gateway
 SG_ DIA_CMC_02_Resp_Data : 0|64@1+ (1.0,0.0) [0.0|18446744073709551615] ""  Tester_MLBevo

BO_ 2549880531 DIA_CMC_03_Req: 8 Tester_MLBevo
 SG_ DIA_CMC_03_Req_Data : 0|64@1+ (1.0,0.0) [0.0|18446744073709551615] ""  Gateway,Gateway_PAG

BO_ 2550011603 DIA_CMC_03_Resp: 8 Gateway
 SG_ DIA_CMC_03_Resp_Data : 0|64@1+ (1.0,0.0) [0.0|18446744073709551615] ""  Tester_MLBevo

BO_ 2549880532 DIA_CMC_04_Req: 8 Tester_MLBevo
 SG_ DIA_CMC_04_Req_Data : 0|64@1+ (1.0,0.0) [0.0|18446744073709551615] ""  Gateway,Gateway_PAG

BO_ 2550011604 DIA_CMC_04_Resp: 8 Gateway
 SG_ DIA_CMC_04_Resp_Data : 0|64@1+ (1.0,0.0) [0.0|18446744073709551615] ""  Tester_MLBevo

BO_ 2549880533 DIA_CMC_05_Req: 8 Tester_MLBevo
 SG_ DIA_CMC_05_Req_Data : 0|64@1+ (1.0,0.0) [0.0|18446744073709551615] ""  Gateway,Gateway_PAG

BO_ 2550011605 DIA_CMC_05_Resp: 8 Gateway
 SG_ DIA_CMC_05_Resp_Data : 0|64@1+ (1.0,0.0) [0.0|18446744073709551615] ""  Tester_MLBevo

BO_ 2549880534 DIA_CMC_06_Req: 8 Tester_MLBevo
 SG_ DIA_CMC_06_Req_Data : 0|64@1+ (1.0,0.0) [0.0|18446744073709551615] ""  Gateway,Gateway_PAG

BO_ 2550011606 DIA_CMC_06_Resp: 8 Gateway
 SG_ DIA_CMC_06_Resp_Data : 0|64@1+ (1.0,0.0) [0.0|18446744073709551615] ""  Tester_MLBevo

BO_ 2549880535 DIA_CMC_07_Req: 8 Tester_MLBevo
 SG_ DIA_CMC_07_Req_Data : 0|64@1+ (1.0,0.0) [0.0|18446744073709551615] ""  Gateway,Gateway_PAG

BO_ 2550011607 DIA_CMC_07_Resp: 8 Gateway
 SG_ DIA_CMC_07_Resp_Data : 0|64@1+ (1.0,0.0) [0.0|18446744073709551615] ""  Tester_MLBevo

BO_ 2549880536 DIA_CMC_08_Req: 8 Tester_MLBevo
 SG_ DIA_CMC_08_Req_Data : 0|64@1+ (1.0,0.0) [0.0|18446744073709551615] ""  Gateway,Gateway_PAG

BO_ 2550011608 DIA_CMC_08_Resp: 8 Gateway
 SG_ DIA_CMC_08_Resp_Data : 0|64@1+ (1.0,0.0) [0.0|18446744073709551615] ""  Tester_MLBevo

BO_ 2549880537 DIA_CMC_09_Req: 8 Tester_MLBevo
 SG_ DIA_CMC_09_Req_Data : 0|64@1+ (1.0,0.0) [0.0|18446744073709551615] ""  Gateway,Gateway_PAG

BO_ 2550011609 DIA_CMC_09_Resp: 8 Gateway
 SG_ DIA_CMC_09_Resp_Data : 0|64@1+ (1.0,0.0) [0.0|18446744073709551615] ""  Tester_MLBevo

BO_ 2549880538 DIA_CMC_10_Req: 8 Tester_MLBevo
 SG_ DIA_CMC_10_Req_Data : 0|64@1+ (1.0,0.0) [0.0|18446744073709551615] ""  Gateway,Gateway_PAG

BO_ 2550011610 DIA_CMC_10_Resp: 8 Gateway
 SG_ DIA_CMC_10_Resp_Data : 0|64@1+ (1.0,0.0) [0.0|18446744073709551615] ""  Tester_MLBevo

BO_ 2549880539 DIA_CMC_11_Req: 8 Tester_MLBevo
 SG_ DIA_CMC_11_Req_Data : 0|64@1+ (1.0,0.0) [0.0|18446744073709551615] ""  Gateway,Gateway_PAG

BO_ 2550011611 DIA_CMC_11_Resp: 8 Gateway
 SG_ DIA_CMC_11_Resp_Data : 0|64@1+ (1.0,0.0) [0.0|18446744073709551615] ""  Tester_MLBevo

BO_ 2549880540 DIA_CMC_12_Req: 8 Tester_MLBevo
 SG_ DIA_CMC_12_Req_Data : 0|64@1+ (1.0,0.0) [0.0|18446744073709551615] ""  Gateway,Gateway_PAG

BO_ 2550011612 DIA_CMC_12_Resp: 8 Gateway
 SG_ DIA_CMC_12_Resp_Data : 0|64@1+ (1.0,0.0) [0.0|18446744073709551615] ""  Tester_MLBevo

BO_ 2549880561 DIA_CMC_13_Req: 8 Tester_MLBevo
 SG_ DIA_CMC_13_Req_Data : 0|64@1+ (1.0,0.0) [0.0|18446744073709551615] ""  Gateway,Gateway_PAG

BO_ 2550011633 DIA_CMC_13_Resp: 8 Gateway
 SG_ DIA_CMC_13_Resp_Data : 0|64@1+ (1.0,0.0) [0.0|18446744073709551615] ""  Tester_MLBevo

BO_ 2549880562 DIA_CMC_14_Req: 8 Tester_MLBevo
 SG_ DIA_CMC_14_Req_Data : 0|64@1+ (1.0,0.0) [0.0|18446744073709551615] ""  Gateway,Gateway_PAG

BO_ 2550011634 DIA_CMC_14_Resp: 8 Gateway
 SG_ DIA_CMC_14_Resp_Data : 0|64@1+ (1.0,0.0) [0.0|18446744073709551615] ""  Tester_MLBevo

BO_ 2549880563 DIA_CMC_15_Req: 8 Tester_MLBevo
 SG_ DIA_CMC_15_Req_Data : 0|64@1+ (1.0,0.0) [0.0|18446744073709551615] ""  Gateway,Gateway_PAG

BO_ 2550011635 DIA_CMC_15_Resp: 8 Gateway
 SG_ DIA_CMC_15_Resp_Data : 0|64@1+ (1.0,0.0) [0.0|18446744073709551615] ""  Tester_MLBevo

BO_ 2549880717 DIA_eBooster2_Req: 8 Tester_MLBevo
 SG_ DIA_eBooster2_Req_Data : 0|64@1+ (1.0,0.0) [0.0|18446744073709551615] ""  Gateway,Gateway_PAG

BO_ 2550011789 DIA_eBooster2_Resp: 8 Gateway
 SG_ DIA_eBooster2_Resp_Data : 0|64@1+ (1.0,0.0) [0.0|18446744073709551615] ""  Tester_MLBevo

BO_ 2549880589 DIA_eBooster_Req: 8 Tester_MLBevo
 SG_ DIA_eBooster_Req_Data : 0|64@1+ (1.0,0.0) [0.0|18446744073709551615] ""  Gateway,Gateway_PAG

BO_ 2550011661 DIA_eBooster_Resp: 8 Gateway
 SG_ DIA_eBooster_Resp_Data : 0|64@1+ (1.0,0.0) [0.0|18446744073709551615] ""  Tester_MLBevo

BO_ 2549880632 DIA_EGS_Req: 8 Tester_MLBevo
 SG_ DIA_EGS_Req_Data : 0|64@1+ (1.0,0.0) [0.0|18446744073709551615] ""  Gateway,Gateway_PAG

BO_ 2550011704 DIA_EGS_Resp: 8 Gateway
 SG_ DIA_EGS_Resp_Data : 0|64@1+ (1.0,0.0) [0.0|18446744073709551615] ""  Tester_MLBevo

BO_ 2549880644 DIA_EKAT_Req: 8 Tester_MLBevo
 SG_ DIA_EKAT_Req_Data : 0|64@1+ (1.0,0.0) [0.0|18446744073709551615] ""  Gateway,Gateway_PAG

BO_ 2550011716 DIA_EKAT_Resp: 8 Gateway
 SG_ DIA_EKAT_Resp_Data : 0|64@1+ (1.0,0.0) [0.0|18446744073709551615] ""  Tester_MLBevo

BO_ 2549880413 DIA_EKK_Req: 8 Tester_MLBevo
 SG_ DIA_EKK_Req_Data : 0|64@1+ (1.0,0.0) [0.0|18446744073709551615] ""  Gateway,Gateway_PAG

BO_ 2550011485 DIA_EKK_Resp: 8 Gateway
 SG_ DIA_EKK_Resp_Data : 0|64@1+ (1.0,0.0) [0.0|18446744073709551615] ""  Tester_MLBevo

BO_ 2549880393 DIA_EVLS_Req: 8 Tester_MLBevo
 SG_ DIA_EVLS_Req_Data : 0|64@1+ (1.0,0.0) [0.0|18446744073709551615] ""  Gateway,Gateway_PAG

BO_ 2550011465 DIA_EVLS_Resp: 8 Gateway
 SG_ DIA_EVLS_Resp_Data : 0|64@1+ (1.0,0.0) [0.0|18446744073709551615] ""  Tester_MLBevo

BO_ 2549880347 DIA_Geblaese_Req: 8 Tester_MLBevo
 SG_ DIA_Geblaese_Req_Data : 0|64@1+ (1.0,0.0) [0.0|18446744073709551615] ""  Gateway,Gateway_PAG

BO_ 2550011419 DIA_Geblaese_Resp: 8 Gateway
 SG_ DIA_Geblaese_Resp_Data : 0|64@1+ (1.0,0.0) [0.0|18446744073709551615] ""  Tester_MLBevo

BO_ 2549880340 DIA_gLW_LM_L_Req: 8 Tester_MLBevo
 SG_ DIA_gLW_LM_L_Req_Data : 0|64@1+ (1.0,0.0) [0.0|18446744073709551615] ""  Gateway,Gateway_PAG

BO_ 2550011412 DIA_gLW_LM_L_Resp: 8 Gateway
 SG_ DIA_gLW_LM_L_Resp_Data : 0|64@1+ (1.0,0.0) [0.0|18446744073709551615] ""  Tester_MLBevo

BO_ 2549880341 DIA_gLW_LM_R_Req: 8 Tester_MLBevo
 SG_ DIA_gLW_LM_R_Req_Data : 0|64@1+ (1.0,0.0) [0.0|18446744073709551615] ""  Gateway,Gateway_PAG

BO_ 2550011413 DIA_gLW_LM_R_Resp: 8 Gateway
 SG_ DIA_gLW_LM_R_Resp_Data : 0|64@1+ (1.0,0.0) [0.0|18446744073709551615] ""  Tester_MLBevo

BO_ 2549880471 DIA_GPM_Req: 8 Tester_MLBevo
 SG_ DIA_GPM_Req_Data : 0|64@1+ (1.0,0.0) [0.0|18446744073709551615] ""  Gateway,Gateway_PAG

BO_ 2550011543 DIA_GPM_Resp: 8 Gateway
 SG_ DIA_GPM_Resp_Data : 0|64@1+ (1.0,0.0) [0.0|18446744073709551615] ""  Tester_MLBevo

BO_ 2549880401 DIA_HSP_Req: 8 Tester_MLBevo
 SG_ DIA_HSP_Req_Data : 0|64@1+ (1.0,0.0) [0.0|18446744073709551615] ""  Gateway,Gateway_PAG

BO_ 2550011473 DIA_HSP_Resp: 8 Gateway
 SG_ DIA_HSP_Resp_Data : 0|64@1+ (1.0,0.0) [0.0|18446744073709551615] ""  Tester_MLBevo

BO_ 2549880512 DIA_HV_H2_Req: 8 Tester_MLBevo
 SG_ DIA_HV_H2_Req_Data : 0|64@1+ (1.0,0.0) [0.0|18446744073709551615] ""  Gateway,Gateway_PAG

BO_ 2550011584 DIA_HV_H2_Resp: 8 Gateway
 SG_ DIA_HV_H2_Resp_Data : 0|64@1+ (1.0,0.0) [0.0|18446744073709551615] ""  Tester_MLBevo

BO_ 2549880509 DIA_IVB1_BFS_Req: 8 Tester_MLBevo
 SG_ DIA_IVB1_BFS_Req_Data : 0|64@1+ (1.0,0.0) [0.0|18446744073709551615] ""  Gateway,Gateway_PAG

BO_ 2550011581 DIA_IVB1_BFS_Resp: 8 Gateway
 SG_ DIA_IVB1_BFS_Resp_Data : 0|64@1+ (1.0,0.0) [0.0|18446744073709551615] ""  Tester_MLBevo

BO_ 2549880505 DIA_IVB1_FS_Req: 8 Tester_MLBevo
 SG_ DIA_IVB1_FS_Req_Data : 0|64@1+ (1.0,0.0) [0.0|18446744073709551615] ""  Gateway,Gateway_PAG

BO_ 2550011577 DIA_IVB1_FS_Resp: 8 Gateway
 SG_ DIA_IVB1_FS_Resp_Data : 0|64@1+ (1.0,0.0) [0.0|18446744073709551615] ""  Tester_MLBevo

BO_ 2549880501 DIA_IVB1_HBFS_Req: 8 Tester_MLBevo
 SG_ DIA_IVB1_HBFS_Req_Data : 0|64@1+ (1.0,0.0) [0.0|18446744073709551615] ""  Gateway,Gateway_PAG

BO_ 2550011573 DIA_IVB1_HBFS_Resp: 8 Gateway
 SG_ DIA_IVB1_HBFS_Resp_Data : 0|64@1+ (1.0,0.0) [0.0|18446744073709551615] ""  Tester_MLBevo

BO_ 2549880497 DIA_IVB1_HFS_Req: 8 Tester_MLBevo
 SG_ DIA_IVB1_HFS_Req_Data : 0|64@1+ (1.0,0.0) [0.0|18446744073709551615] ""  Gateway,Gateway_PAG

BO_ 2550011569 DIA_IVB1_HFS_Resp: 8 Gateway
 SG_ DIA_IVB1_HFS_Resp_Data : 0|64@1+ (1.0,0.0) [0.0|18446744073709551615] ""  Tester_MLBevo

BO_ 2549880577 DIA_KBF_Req: 8 Tester_MLBevo
 SG_ DIA_KBF_Req_Data : 0|64@1+ (1.0,0.0) [0.0|18446744073709551615] ""  Gateway,Gateway_PAG

BO_ 2550011649 DIA_KBF_Resp: 8 Gateway
 SG_ DIA_KBF_Resp_Data : 0|64@1+ (1.0,0.0) [0.0|18446744073709551615] ""  Tester_MLBevo

BO_ 2549880638 DIA_KLR_Req: 8 Tester_MLBevo
 SG_ DIA_KLR_Req_Data : 0|64@1+ (1.0,0.0) [0.0|18446744073709551615] ""  Gateway,Gateway_PAG

BO_ 2550011710 DIA_KLR_Resp: 8 Gateway
 SG_ DIA_KLR_Resp_Data : 0|64@1+ (1.0,0.0) [0.0|18446744073709551615] ""  Tester_MLBevo

BO_ 2549880639 DIA_KPV_Req: 8 Tester_MLBevo
 SG_ DIA_KPV_Req_Data : 0|64@1+ (1.0,0.0) [0.0|18446744073709551615] ""  Gateway,Gateway_PAG

BO_ 2550011711 DIA_KPV_Resp: 8 Gateway
 SG_ DIA_KPV_Resp_Data : 0|64@1+ (1.0,0.0) [0.0|18446744073709551615] ""  Tester_MLBevo

BO_ 2549880459 DIA_KWS_Req: 8 Tester_MLBevo
 SG_ DIA_KWS_Req_Data : 0|64@1+ (1.0,0.0) [0.0|18446744073709551615] ""  Gateway,Gateway_PAG

BO_ 2550011531 DIA_KWS_Resp: 8 Gateway
 SG_ DIA_KWS_Resp_Data : 0|64@1+ (1.0,0.0) [0.0|18446744073709551615] ""  Tester_MLBevo

BO_ 2549880330 DIA_LED_LM_L_Req: 8 Tester_MLBevo
 SG_ DIA_LED_LM_L_Req_Data : 0|64@1+ (1.0,0.0) [0.0|18446744073709551615] ""  Gateway,Gateway_PAG

BO_ 2550011402 DIA_LED_LM_L_Resp: 8 Gateway
 SG_ DIA_LED_LM_L_Resp_Data : 0|64@1+ (1.0,0.0) [0.0|18446744073709551615] ""  Tester_MLBevo

BO_ 2549880331 DIA_LED_LM_R_Req: 8 Tester_MLBevo
 SG_ DIA_LED_LM_R_Req_Data : 0|64@1+ (1.0,0.0) [0.0|18446744073709551615] ""  Gateway,Gateway_PAG

BO_ 2550011403 DIA_LED_LM_R_Resp: 8 Gateway
 SG_ DIA_LED_LM_R_Resp_Data : 0|64@1+ (1.0,0.0) [0.0|18446744073709551615] ""  Tester_MLBevo

BO_ 2549880633 DIA_LIM_2_Req: 8 Tester_MLBevo
 SG_ DIA_LIM_2_Req_Data : 0|64@1+ (1.0,0.0) [0.0|18446744073709551615] ""  Gateway,Gateway_PAG

BO_ 2550011705 DIA_LIM_2_Resp: 8 Gateway
 SG_ DIA_LIM_2_Resp_Data : 0|64@1+ (1.0,0.0) [0.0|18446744073709551615] ""  Tester_MLBevo

BO_ 2549880350 DIA_LIM_Req: 8 Tester_MLBevo
 SG_ DIA_LIM_Req_Data : 0|64@1+ (1.0,0.0) [0.0|18446744073709551615] ""  Gateway,Gateway_PAG

BO_ 2550011422 DIA_LIM_Resp: 8 Gateway
 SG_ DIA_LIM_Resp_Data : 0|64@1+ (1.0,0.0) [0.0|18446744073709551615] ""  Tester_MLBevo

BO_ 2549880369 DIA_MFL_Req: 8 Tester_MLBevo
 SG_ DIA_MFL_Req_Data : 0|64@1+ (1.0,0.0) [0.0|18446744073709551615] ""  Gateway,Gateway_PAG

BO_ 2550011441 DIA_MFL_Resp: 8 Gateway
 SG_ DIA_MFL_Resp_Data : 0|64@1+ (1.0,0.0) [0.0|18446744073709551615] ""  Tester_MLBevo

BO_ 2549880568 DIA_MTFP_Req: 8 Tester_MLBevo
 SG_ DIA_MTFP_Req_Data : 0|64@1+ (1.0,0.0) [0.0|18446744073709551615] ""  Gateway,Gateway_PAG

BO_ 2550011640 DIA_MTFP_Resp: 8 Gateway
 SG_ DIA_MTFP_Resp_Data : 0|64@1+ (1.0,0.0) [0.0|18446744073709551615] ""  Tester_MLBevo

BO_ 2549880510 DIA_MVB1_BFS_Req: 8 Tester_MLBevo
 SG_ DIA_MVB1_BFS_Req_Data : 0|64@1+ (1.0,0.0) [0.0|18446744073709551615] ""  Gateway,Gateway_PAG

BO_ 2550011582 DIA_MVB1_BFS_Resp: 8 Gateway
 SG_ DIA_MVB1_BFS_Resp_Data : 0|64@1+ (1.0,0.0) [0.0|18446744073709551615] ""  Tester_MLBevo

BO_ 2549880506 DIA_MVB1_FS_Req: 8 Tester_MLBevo
 SG_ DIA_MVB1_FS_Req_Data : 0|64@1+ (1.0,0.0) [0.0|18446744073709551615] ""  Gateway,Gateway_PAG

BO_ 2550011578 DIA_MVB1_FS_Resp: 8 Gateway
 SG_ DIA_MVB1_FS_Resp_Data : 0|64@1+ (1.0,0.0) [0.0|18446744073709551615] ""  Tester_MLBevo

BO_ 2549880502 DIA_MVB1_HBFS_Req: 8 Tester_MLBevo
 SG_ DIA_MVB1_HBFS_Req_Data : 0|64@1+ (1.0,0.0) [0.0|18446744073709551615] ""  Gateway,Gateway_PAG

BO_ 2550011574 DIA_MVB1_HBFS_Resp: 8 Gateway
 SG_ DIA_MVB1_HBFS_Resp_Data : 0|64@1+ (1.0,0.0) [0.0|18446744073709551615] ""  Tester_MLBevo

BO_ 2549880498 DIA_MVB1_HFS_Req: 8 Tester_MLBevo
 SG_ DIA_MVB1_HFS_Req_Data : 0|64@1+ (1.0,0.0) [0.0|18446744073709551615] ""  Gateway,Gateway_PAG

BO_ 2550011570 DIA_MVB1_HFS_Resp: 8 Gateway
 SG_ DIA_MVB1_HFS_Resp_Data : 0|64@1+ (1.0,0.0) [0.0|18446744073709551615] ""  Tester_MLBevo

BO_ 2549880511 DIA_MVB2_BFS_Req: 8 Tester_MLBevo
 SG_ DIA_MVB2_BFS_Req_Data : 0|64@1+ (1.0,0.0) [0.0|18446744073709551615] ""  Gateway,Gateway_PAG

BO_ 2550011583 DIA_MVB2_BFS_Resp: 8 Gateway
 SG_ DIA_MVB2_BFS_Resp_Data : 0|64@1+ (1.0,0.0) [0.0|18446744073709551615] ""  Tester_MLBevo

BO_ 2549880507 DIA_MVB2_FS_Req: 8 Tester_MLBevo
 SG_ DIA_MVB2_FS_Req_Data : 0|64@1+ (1.0,0.0) [0.0|18446744073709551615] ""  Gateway,Gateway_PAG

BO_ 2550011579 DIA_MVB2_FS_Resp: 8 Gateway
 SG_ DIA_MVB2_FS_Resp_Data : 0|64@1+ (1.0,0.0) [0.0|18446744073709551615] ""  Tester_MLBevo

BO_ 2549880503 DIA_MVB2_HBFS_Req: 8 Tester_MLBevo
 SG_ DIA_MVB2_HBFS_Req_Data : 0|64@1+ (1.0,0.0) [0.0|18446744073709551615] ""  Gateway,Gateway_PAG

BO_ 2550011575 DIA_MVB2_HBFS_Resp: 8 Gateway
 SG_ DIA_MVB2_HBFS_Resp_Data : 0|64@1+ (1.0,0.0) [0.0|18446744073709551615] ""  Tester_MLBevo

BO_ 2549880499 DIA_MVB2_HFS_Req: 8 Tester_MLBevo
 SG_ DIA_MVB2_HFS_Req_Data : 0|64@1+ (1.0,0.0) [0.0|18446744073709551615] ""  Gateway,Gateway_PAG

BO_ 2550011571 DIA_MVB2_HFS_Resp: 8 Gateway
 SG_ DIA_MVB2_HFS_Resp_Data : 0|64@1+ (1.0,0.0) [0.0|18446744073709551615] ""  Tester_MLBevo

BO_ 2549880427 DIA_MXB_LM_L_Req: 8 Tester_MLBevo
 SG_ DIA_MXB_LM_L_Req_Data : 0|64@1+ (1.0,0.0) [0.0|18446744073709551615] ""  Gateway,Gateway_PAG

BO_ 2550011499 DIA_MXB_LM_L_Resp: 8 Gateway
 SG_ DIA_MXB_LM_L_Resp_Data : 0|64@1+ (1.0,0.0) [0.0|18446744073709551615] ""  Tester_MLBevo

BO_ 2549880428 DIA_MXB_LM_R_Req: 8 Tester_MLBevo
 SG_ DIA_MXB_LM_R_Req_Data : 0|64@1+ (1.0,0.0) [0.0|18446744073709551615] ""  Gateway,Gateway_PAG

BO_ 2550011500 DIA_MXB_LM_R_Resp: 8 Gateway
 SG_ DIA_MXB_LM_R_Resp_Data : 0|64@1+ (1.0,0.0) [0.0|18446744073709551615] ""  Tester_MLBevo

BO_ 2549880587 DIA_NFC_MiKo_Req: 8 Tester_MLBevo
 SG_ DIA_NFC_MiKo_Req_Data : 0|64@1+ (1.0,0.0) [0.0|18446744073709551615] ""  Gateway,Gateway_PAG

BO_ 2550011659 DIA_NFC_MiKo_Resp: 8 Gateway
 SG_ DIA_NFC_MiKo_Resp_Data : 0|64@1+ (1.0,0.0) [0.0|18446744073709551615] ""  Tester_MLBevo

BO_ 2549880555 DIA_NFC_TGS_Req: 8 Tester_MLBevo
 SG_ DIA_NFC_TGS_Req_Data : 0|64@1+ (1.0,0.0) [0.0|18446744073709551615] ""  Gateway,Gateway_PAG

BO_ 2550011627 DIA_NFC_TGS_Resp: 8 Gateway
 SG_ DIA_NFC_TGS_Resp_Data : 0|64@1+ (1.0,0.0) [0.0|18446744073709551615] ""  Tester_MLBevo

BO_ 2549880670 DIA_NS_VL_Req: 8 Tester_MLBevo
 SG_ DIA_NS_VL_Req_Data : 0|64@1+ (1.0,0.0) [0.0|18446744073709551615] ""  Gateway,Gateway_PAG

BO_ 2550011742 DIA_NS_VL_Resp: 8 Gateway
 SG_ DIA_NS_VL_Resp_Data : 0|64@1+ (1.0,0.0) [0.0|18446744073709551615] ""  Tester_MLBevo

BO_ 2549880671 DIA_NS_VR_Req: 8 Tester_MLBevo
 SG_ DIA_NS_VR_Req_Data : 0|64@1+ (1.0,0.0) [0.0|18446744073709551615] ""  Gateway,Gateway_PAG

BO_ 2550011743 DIA_NS_VR_Resp: 8 Gateway
 SG_ DIA_NS_VR_Resp_Data : 0|64@1+ (1.0,0.0) [0.0|18446744073709551615] ""  Tester_MLBevo

BO_ 2549880642 DIA_Parksperre_Req: 8 Tester_MLBevo
 SG_ DIA_Parksperre_Req_Data : 0|64@1+ (1.0,0.0) [0.0|18446744073709551615] ""  Gateway,Gateway_PAG

BO_ 2550011714 DIA_Parksperre_Resp: 8 Gateway
 SG_ DIA_Parksperre_Resp_Data : 0|64@1+ (1.0,0.0) [0.0|18446744073709551615] ""  Tester_MLBevo

BO_ 2549880714 DIA_PumpKM_2_Req: 8 Tester_MLBevo
 SG_ DIA_PumpKM_2_Req_Data : 0|64@1+ (1.0,0.0) [0.0|18446744073709551615] ""  Gateway

BO_ 2550011786 DIA_PumpKM_2_Resp: 8 Gateway
 SG_ DIA_PumpKM_2_Resp_Data : 0|64@1+ (1.0,0.0) [0.0|18446744073709551615] ""  Tester_MLBevo

BO_ 2549880570 DIA_PumpWSt_Req: 8 Tester_MLBevo
 SG_ DIA_PumpWSt_Req_Data : 0|64@1+ (1.0,0.0) [0.0|18446744073709551615] ""  Gateway

BO_ 2550011642 DIA_PumpWSt_Resp: 8 Gateway
 SG_ DIA_PumpWSt_Resp_Data : 0|64@1+ (1.0,0.0) [0.0|18446744073709551615] ""  Tester_MLBevo

BO_ 2549880747 DIA_SAAM_Req: 8 Tester_MLBevo
 SG_ DIA_SAAM_Req_Data : 0|64@1+ (1.0,0.0) [0.0|18446744073709551615] ""  Gateway,Gateway_PAG

BO_ 2550011819 DIA_SAAM_Resp: 8 Gateway
 SG_ DIA_SAAM_Resp_Data : 0|64@1+ (1.0,0.0) [0.0|18446744073709551615] ""  Tester_MLBevo

BO_ 2549880610 DIA_SCON1_Req: 8 Tester_MLBevo
 SG_ DIA_SCON1_Req_Data : 0|64@1+ (1.0,0.0) [0.0|18446744073709551615] ""  Gateway,Gateway_PAG

BO_ 2550011682 DIA_SCON1_Resp: 8 Gateway
 SG_ DIA_SCON1_Resp_Data : 0|64@1+ (1.0,0.0) [0.0|18446744073709551615] ""  Tester_MLBevo

BO_ 2549880611 DIA_SCON2_Req: 8 Tester_MLBevo
 SG_ DIA_SCON2_Req_Data : 0|64@1+ (1.0,0.0) [0.0|18446744073709551615] ""  Gateway,Gateway_PAG

BO_ 2550011683 DIA_SCON2_Resp: 8 Gateway
 SG_ DIA_SCON2_Resp_Data : 0|64@1+ (1.0,0.0) [0.0|18446744073709551615] ""  Tester_MLBevo

BO_ 2549880473 DIA_SD3_Req: 8 Tester_MLBevo
 SG_ DIA_SD3_Req_Data : 0|64@1+ (1.0,0.0) [0.0|18446744073709551615] ""  Gateway,Gateway_PAG

BO_ 2550011545 DIA_SD3_Resp: 8 Gateway
 SG_ DIA_SD3_Resp_Data : 0|64@1+ (1.0,0.0) [0.0|18446744073709551615] ""  Tester_MLBevo

BO_ 2549880474 DIA_SD4_Req: 8 Tester_MLBevo
 SG_ DIA_SD4_Req_Data : 0|64@1+ (1.0,0.0) [0.0|18446744073709551615] ""  Gateway,Gateway_PAG

BO_ 2550011546 DIA_SD4_Resp: 8 Gateway
 SG_ DIA_SD4_Resp_Data : 0|64@1+ (1.0,0.0) [0.0|18446744073709551615] ""  Tester_MLBevo

BO_ 2549880357 DIA_SHL_li1_Req: 8 Tester_MLBevo
 SG_ DIA_SHL_li1_Req_Data : 0|64@1+ (1.0,0.0) [0.0|18446744073709551615] ""  Gateway,Gateway_PAG

BO_ 2550011429 DIA_SHL_li1_Resp: 8 Gateway
 SG_ DIA_SHL_li1_Resp_Data : 0|64@1+ (1.0,0.0) [0.0|18446744073709551615] ""  Tester_MLBevo

BO_ 2549880590 DIA_SHL_li2_Req: 8 Tester_MLBevo
 SG_ DIA_SHL_li2_Req_Data : 0|64@1+ (1.0,0.0) [0.0|18446744073709551615] ""  Gateway,Gateway_PAG

BO_ 2550011662 DIA_SHL_li2_Resp: 8 Gateway
 SG_ DIA_SHL_li2_Resp_Data : 0|64@1+ (1.0,0.0) [0.0|18446744073709551615] ""  Tester_MLBevo

BO_ 2549880591 DIA_SHL_re1_Req: 8 Tester_MLBevo
 SG_ DIA_SHL_re1_Req_Data : 0|64@1+ (1.0,0.0) [0.0|18446744073709551615] ""  Gateway,Gateway_PAG

BO_ 2550011663 DIA_SHL_re1_Resp: 8 Gateway
 SG_ DIA_SHL_re1_Resp_Data : 0|64@1+ (1.0,0.0) [0.0|18446744073709551615] ""  Tester_MLBevo

BO_ 2549880592 DIA_SHL_re2_Req: 8 Tester_MLBevo
 SG_ DIA_SHL_re2_Req_Data : 0|64@1+ (1.0,0.0) [0.0|18446744073709551615] ""  Gateway,Gateway_PAG

BO_ 2550011664 DIA_SHL_re2_Resp: 8 Gateway
 SG_ DIA_SHL_re2_Resp_Data : 0|64@1+ (1.0,0.0) [0.0|18446744073709551615] ""  Tester_MLBevo

BO_ 2549880612 DIA_SWP_Req: 8 Tester_MLBevo
 SG_ DIA_SWP_Req_Data : 0|64@1+ (1.0,0.0) [0.0|18446744073709551615] ""  Gateway,Gateway_PAG

BO_ 2550011684 DIA_SWP_Resp: 8 Gateway
 SG_ DIA_SWP_Resp_Data : 0|64@1+ (1.0,0.0) [0.0|18446744073709551615] ""  Tester_MLBevo

BO_ 2549880787 DIA_TA_HBFS_Req: 8 Tester_MLBevo
 SG_ DIA_TA_HBFS_Req_Data : 0|64@1+ (1.0,0.0) [0.0|18446744073709551615] ""  Gateway,Gateway_PAG

BO_ 2550011859 DIA_TA_HBFS_Resp: 8 Gateway
 SG_ DIA_TA_HBFS_Resp_Data : 0|64@1+ (1.0,0.0) [0.0|18446744073709551615] ""  Tester_MLBevo

BO_ 2549880786 DIA_TA_HFS_Req: 8 Tester_MLBevo
 SG_ DIA_TA_HFS_Req_Data : 0|64@1+ (1.0,0.0) [0.0|18446744073709551615] ""  Gateway,Gateway_PAG

BO_ 2550011858 DIA_TA_HFS_Resp: 8 Gateway
 SG_ DIA_TA_HFS_Resp_Data : 0|64@1+ (1.0,0.0) [0.0|18446744073709551615] ""  Tester_MLBevo

BO_ 2549880324 DIA_UGDO_S_Req: 8 Tester_MLBevo
 SG_ DIA_UGDO_S_Req_Data : 0|64@1+ (1.0,0.0) [0.0|18446744073709551615] ""  Gateway,Gateway_PAG

BO_ 2550011396 DIA_UGDO_S_Resp: 8 Gateway
 SG_ DIA_UGDO_S_Resp_Data : 0|64@1+ (1.0,0.0) [0.0|18446744073709551615] ""  Tester_MLBevo

BO_ 2549880434 DIA_UHR_Req: 8 Tester_MLBevo
 SG_ DIA_UHR_Req_Data : 0|64@1+ (1.0,0.0) [0.0|18446744073709551615] ""  Gateway,Gateway_PAG

BO_ 2550011506 DIA_UHR_Resp: 8 Gateway
 SG_ DIA_UHR_Resp_Data : 0|64@1+ (1.0,0.0) [0.0|18446744073709551615] ""  Tester_MLBevo

BO_ 2549880679 DIA_WiBli_L_Req: 8 Tester_MLBevo
 SG_ DIA_WiBli_L_Req : 0|64@1+ (1.0,0.0) [0.0|18446744073709551615] ""  Gateway,Gateway_PAG

BO_ 2550011751 DIA_WiBli_L_Resp: 8 Gateway
 SG_ DIA_WiBli_L_Resp : 0|64@1+ (1.0,0.0) [0.0|18446744073709551615] ""  Tester_MLBevo

BO_ 2549880680 DIA_WiBli_R_Req: 8 Tester_MLBevo
 SG_ DIA_WiBli_R_Req : 0|64@1+ (1.0,0.0) [0.0|18446744073709551615] ""  Gateway,Gateway_PAG

BO_ 2550011752 DIA_WiBli_R_Resp: 8 Gateway
 SG_ DIA_WiBli_R_Resp : 0|64@1+ (1.0,0.0) [0.0|18446744073709551615] ""  Tester_MLBevo

BO_ 2549880321 DIA_WWS_Req: 8 Tester_MLBevo
 SG_ DIA_WWS_Req_Data : 0|64@1+ (1.0,0.0) [0.0|18446744073709551615] ""  Gateway,Gateway_PAG

BO_ 2550011393 DIA_WWS_Resp: 8 Gateway
 SG_ DIA_WWS_Resp_Data : 0|64@1+ (1.0,0.0) [0.0|18446744073709551615] ""  Tester_MLBevo

BO_ 1863 ISO_AAG_Req: 8 Tester_MLBevo
 SG_ ISO_AAG_Req_Data : 0|64@1+ (1.0,0.0) [0.0|18446744073709551615] ""  Gateway,Gateway_PAG

BO_ 1969 ISO_AAG_Resp: 8 Gateway
 SG_ ISO_AAG_Resp_Data : 0|64@1+ (1.0,0.0) [0.0|18446744073709551615] ""  Tester_MLBevo

BO_ 1811 ISO_ABS_Req: 8 Tester_MLBevo
 SG_ ISO_ABS_Req_Data : 0|64@1+ (1.0,0.0) [0.0|18446744073709551615] ""  Gateway,Gateway_PAG

BO_ 1917 ISO_ABS_Resp: 8 Gateway
 SG_ ISO_ABS_Resp_Data : 0|64@1+ (1.0,0.0) [0.0|18446744073709551615] ""  Tester_MLBevo

BO_ 1879 ISO_ACC_Req: 8 Tester_MLBevo
 SG_ ISO_ACC_Req_Data : 0|64@1+ (1.0,0.0) [0.0|18446744073709551615] ""  Gateway,Gateway_PAG

BO_ 1985 ISO_ACC_Resp: 8 Gateway
 SG_ ISO_ACC_Resp_Data : 0|64@1+ (1.0,0.0) [0.0|18446744073709551615] ""  Tester_MLBevo

BO_ 1838 ISO_AEM_Req: 8 Tester_MLBevo
 SG_ ISO_AEM_Req_Data : 0|64@1+ (1.0,0.0) [0.0|18446744073709551615] ""  Gateway,Gateway_PAG

BO_ 1944 ISO_AEM_Resp: 8 Gateway
 SG_ ISO_AEM_Resp_Data : 0|64@1+ (1.0,0.0) [0.0|18446744073709551615] ""  Tester_MLBevo

BO_ 1892 ISO_AGA_Req: 8 Tester_MLBevo
 SG_ ISO_AGA_Req_Data : 0|64@1+ (1.0,0.0) [0.0|18446744073709551615] ""  Gateway,Gateway_PAG

BO_ 1998 ISO_AGA_Resp: 8 Gateway
 SG_ ISO_AGA_Resp_Data : 0|64@1+ (1.0,0.0) [0.0|18446744073709551615] ""  Tester_MLBevo

BO_ 1813 ISO_Airbag_01_Req: 8 Tester_MLBevo
 SG_ ISO_Airbag_01_Req_Data : 0|64@1+ (1.0,0.0) [0.0|18446744073709551615] ""  Gateway,Gateway_PAG

BO_ 1919 ISO_Airbag_01_Resp: 8 Gateway
 SG_ ISO_Airbag_01_Resp_Data : 0|64@1+ (1.0,0.0) [0.0|18446744073709551615] ""  Tester_MLBevo

BO_ 1807 ISO_Allrad_Req: 8 Tester_MLBevo
 SG_ ISO_Allrad_Req_Data : 0|64@1+ (1.0,0.0) [0.0|18446744073709551615] ""  Gateway,Gateway_PAG

BO_ 1913 ISO_Allrad_Resp: 8 Gateway
 SG_ ISO_Allrad_Resp_Data : 0|64@1+ (1.0,0.0) [0.0|18446744073709551615] ""  Tester_MLBevo

BO_ 1903 ISO_AMP_Req: 8 Tester_MLBevo
 SG_ ISO_AMP_Req_Data : 0|64@1+ (1.0,0.0) [0.0|18446744073709551615] ""  Gateway,Gateway_PAG

BO_ 2009 ISO_AMP_Resp: 8 Gateway
 SG_ ISO_AMP_Resp_Data : 0|64@1+ (1.0,0.0) [0.0|18446744073709551615] ""  Tester_MLBevo

BO_ 1806 ISO_BCM1_Req: 8 Tester_MLBevo
 SG_ ISO_BCM1_Req_Data : 0|64@1+ (1.0,0.0) [0.0|18446744073709551615] ""  Gateway,Gateway_PAG

BO_ 1912 ISO_BCM1_Resp: 8 Gateway
 SG_ ISO_BCM1_Resp_Data : 0|64@1+ (1.0,0.0) [0.0|18446744073709551615] ""  Tester_MLBevo

BO_ 1857 ISO_DCDC_Req: 8 Tester_MLBevo
 SG_ ISO_DCDC_Req_Data : 0|64@1+ (1.0,0.0) [0.0|18446744073709551615] ""  Gateway,Gateway_PAG

BO_ 1963 ISO_DCDC_Resp: 8 Gateway
 SG_ ISO_DCDC_Resp_Data : 0|64@1+ (1.0,0.0) [0.0|18446744073709551615] ""  Tester_MLBevo

BO_ 1851 ISO_EBKV_Req: 8 Tester_MLBevo
 SG_ ISO_EBKV_Req_Data : 0|64@1+ (1.0,0.0) [0.0|18446744073709551615] ""  Gateway,Gateway_PAG

BO_ 1957 ISO_EBKV_Resp: 8 Gateway
 SG_ ISO_EBKV_Resp_Data : 0|64@1+ (1.0,0.0) [0.0|18446744073709551615] ""  Tester_MLBevo

BO_ 1895 ISO_eCall_Req: 8 Tester_MLBevo
 SG_ ISO_eCall_Req_Data : 0|64@1+ (1.0,0.0) [0.0|18446744073709551615] ""  Gateway,Gateway_PAG

BO_ 2001 ISO_eCall_Resp: 8 Gateway
 SG_ ISO_eCall_Resp_Data : 0|64@1+ (1.0,0.0) [0.0|18446744073709551615] ""  Tester_MLBevo

BO_ 1841 ISO_ELV_Req: 8 Tester_MLBevo
 SG_ ISO_ELV_Req_Data : 0|64@1+ (1.0,0.0) [0.0|18446744073709551615] ""  Gateway,Gateway_PAG

BO_ 1947 ISO_ELV_Resp: 8 Gateway
 SG_ ISO_ELV_Resp_Data : 0|64@1+ (1.0,0.0) [0.0|18446744073709551615] ""  Tester_MLBevo

BO_ 1859 ISO_EMotor_03_Req: 8 Tester_MLBevo
 SG_ ISO_EMotor_03_Req_Data : 0|64@1+ (1.0,0.0) [0.0|18446744073709551615] ""  Gateway,Gateway_PAG

BO_ 1965 ISO_EMotor_03_Resp: 8 Gateway
 SG_ ISO_EMotor_03_Resp_Data : 0|64@1+ (1.0,0.0) [0.0|18446744073709551615] ""  Tester_MLBevo

BO_ 1840 ISO_FLA_Req: 8 Tester_MLBevo
 SG_ ISO_FLA_Req_Data : 0|64@1+ (1.0,0.0) [0.0|18446744073709551615] ""  Gateway,Gateway_PAG

BO_ 1946 ISO_FLA_Resp: 8 Gateway
 SG_ ISO_FLA_Resp_Data : 0|64@1+ (1.0,0.0) [0.0|18446744073709551615] ""  Tester_MLBevo

BO_ 1795 ISO_Funktionaler_Req_Abgas: 8 Tester_MLBevo
 SG_ ISO_Funktionaler_Req_Abgas : 0|64@1+ (1.0,0.0) [0.0|18446744073709551615] ""  Gateway,Gateway_PAG

BO_ 1792 ISO_Funktionaler_Req_All: 8 Tester_MLBevo
 SG_ ISO_ALL_01_Req_Data : 0|64@1+ (1.0,0.0) [0.0|18446744073709551615] ""  Gateway,Gateway_PAG

BO_ 2015 ISO_Funktionaler_Req_OBD: 8 Tester_MLBevo
 SG_ ISO_OBD_Funktionaler_Req_Data : 0|64@1+ (1.0,0.0) [0.0|18446744073709551615] ""  Gateway,Gateway_PAG

BO_ 1808 ISO_Gateway_Req: 8 Tester_MLBevo
 SG_ ISO_Gateway_Req_Data : 0|64@1+ (1.0,0.0) [0.0|18446744073709551615] ""  Gateway,Gateway_PAG

BO_ 1914 ISO_Gateway_Resp: 8 Gateway
 SG_ ISO_Gateway_Resp_Data : 0|64@1+ (1.0,0.0) [0.0|18446744073709551615] ""  Tester_MLBevo

BO_ 2017 ISO_Getriebe_01_Req: 8 Tester_MLBevo
 SG_ ISO_Getriebe_01_Req_Data : 0|64@1+ (1.0,0.0) [0.0|18446744073709551615] ""  Gateway,Gateway_PAG

BO_ 2025 ISO_Getriebe_01_Resp: 8 Gateway
 SG_ ISO_Getriebe_01_Resp_Data : 0|64@1+ (1.0,0.0) [0.0|18446744073709551615] ""  Tester_MLBevo

BO_ 1891 ISO_Gurtmikro_Req: 8 Tester_MLBevo
 SG_ ISO_Gurtmikro_Req_Data : 0|64@1+ (1.0,0.0) [0.0|18446744073709551615] ""  Gateway,Gateway_PAG

BO_ 1997 ISO_Gurtmikro_Resp: 8 Gateway
 SG_ ISO_Gurtmikro_Resp_Data : 0|64@1+ (1.0,0.0) [0.0|18446744073709551615] ""  Tester_MLBevo

BO_TX_BU_ 2550011686 :Gateway,Gateway_PAG;
BO_TX_BU_ 2550011536 :Gateway,Gateway_PAG;
BO_TX_BU_ 2550011639 :Gateway,Gateway_PAG;
BO_TX_BU_ 2550011447 :Gateway,Gateway_PAG;
BO_TX_BU_ 2550011600 :Gateway,Gateway_PAG;
BO_TX_BU_ 2550011660 :Gateway,Gateway_PAG;
BO_TX_BU_ 2550011601 :Gateway,Gateway_PAG;
BO_TX_BU_ 2550011602 :Gateway,Gateway_PAG;
BO_TX_BU_ 2550011603 :Gateway,Gateway_PAG;
BO_TX_BU_ 2550011604 :Gateway,Gateway_PAG;
BO_TX_BU_ 2550011605 :Gateway,Gateway_PAG;
BO_TX_BU_ 2550011606 :Gateway,Gateway_PAG;
BO_TX_BU_ 2550011607 :Gateway,Gateway_PAG;
BO_TX_BU_ 2550011608 :Gateway,Gateway_PAG;
BO_TX_BU_ 2550011609 :Gateway,Gateway_PAG;
BO_TX_BU_ 2550011610 :Gateway,Gateway_PAG;
BO_TX_BU_ 2550011611 :Gateway,Gateway_PAG;
BO_TX_BU_ 2550011612 :Gateway,Gateway_PAG;
BO_TX_BU_ 2550011633 :Gateway,Gateway_PAG;
BO_TX_BU_ 2550011634 :Gateway,Gateway_PAG;
BO_TX_BU_ 2550011635 :Gateway,Gateway_PAG;
BO_TX_BU_ 2550011789 :Gateway,Gateway_PAG;
BO_TX_BU_ 2550011661 :Gateway,Gateway_PAG;
BO_TX_BU_ 2550011704 :Gateway,Gateway_PAG;
BO_TX_BU_ 2550011716 :Gateway,Gateway_PAG;
BO_TX_BU_ 2550011485 :Gateway,Gateway_PAG;
BO_TX_BU_ 2550011465 :Gateway,Gateway_PAG;
BO_TX_BU_ 2550011419 :Gateway,Gateway_PAG;
BO_TX_BU_ 2550011412 :Gateway,Gateway_PAG;
BO_TX_BU_ 2550011413 :Gateway,Gateway_PAG;
BO_TX_BU_ 2550011543 :Gateway,Gateway_PAG;
BO_TX_BU_ 2550011473 :Gateway,Gateway_PAG;
BO_TX_BU_ 2550011584 :Gateway,Gateway_PAG;
BO_TX_BU_ 2550011581 :Gateway,Gateway_PAG;
BO_TX_BU_ 2550011577 :Gateway,Gateway_PAG;
BO_TX_BU_ 2550011573 :Gateway,Gateway_PAG;
BO_TX_BU_ 2550011569 :Gateway,Gateway_PAG;
BO_TX_BU_ 2550011649 :Gateway,Gateway_PAG;
BO_TX_BU_ 2550011710 :Gateway,Gateway_PAG;
BO_TX_BU_ 2550011711 :Gateway,Gateway_PAG;
BO_TX_BU_ 2550011531 :Gateway,Gateway_PAG;
BO_TX_BU_ 2550011402 :Gateway,Gateway_PAG;
BO_TX_BU_ 2550011403 :Gateway,Gateway_PAG;
BO_TX_BU_ 2550011705 :Gateway,Gateway_PAG;
BO_TX_BU_ 2550011422 :Gateway,Gateway_PAG;
BO_TX_BU_ 2550011441 :Gateway,Gateway_PAG;
BO_TX_BU_ 2550011640 :Gateway,Gateway_PAG;
BO_TX_BU_ 2550011582 :Gateway,Gateway_PAG;
BO_TX_BU_ 2550011578 :Gateway,Gateway_PAG;
BO_TX_BU_ 2550011574 :Gateway,Gateway_PAG;
BO_TX_BU_ 2550011570 :Gateway,Gateway_PAG;
BO_TX_BU_ 2550011583 :Gateway,Gateway_PAG;
BO_TX_BU_ 2550011579 :Gateway,Gateway_PAG;
BO_TX_BU_ 2550011575 :Gateway,Gateway_PAG;
BO_TX_BU_ 2550011571 :Gateway,Gateway_PAG;
BO_TX_BU_ 2550011499 :Gateway,Gateway_PAG;
BO_TX_BU_ 2550011500 :Gateway,Gateway_PAG;
BO_TX_BU_ 2550011659 :Gateway,Gateway_PAG;
BO_TX_BU_ 2550011627 :Gateway,Gateway_PAG;
BO_TX_BU_ 2550011742 :Gateway,Gateway_PAG;
BO_TX_BU_ 2550011743 :Gateway,Gateway_PAG;
BO_TX_BU_ 2550011714 :Gateway,Gateway_PAG;
BO_TX_BU_ 2550011819 :Gateway,Gateway_PAG;
BO_TX_BU_ 2550011682 :Gateway,Gateway_PAG;
BO_TX_BU_ 2550011683 :Gateway,Gateway_PAG;
BO_TX_BU_ 2550011545 :Gateway,Gateway_PAG;
BO_TX_BU_ 2550011546 :Gateway,Gateway_PAG;
BO_TX_BU_ 2550011429 :Gateway,Gateway_PAG;
BO_TX_BU_ 2550011662 :Gateway,Gateway_PAG;
BO_TX_BU_ 2550011663 :Gateway,Gateway_PAG;
BO_TX_BU_ 2550011664 :Gateway,Gateway_PAG;
BO_TX_BU_ 2550011684 :Gateway,Gateway_PAG;
BO_TX_BU_ 2550011859 :Gateway,Gateway_PAG;
BO_TX_BU_ 2550011858 :Gateway,Gateway_PAG;
BO_TX_BU_ 2550011396 :Gateway,Gateway_PAG;
BO_TX_BU_ 2550011506 :Gateway,Gateway_PAG;
BO_TX_BU_ 2550011751 :Gateway,Gateway_PAG;
BO_TX_BU_ 2550011752 :Gateway,Gateway_PAG;
BO_TX_BU_ 2550011393 :Gateway,Gateway_PAG;
BO_TX_BU_ 1969 :Gateway,Gateway_PAG;
BO_TX_BU_ 1917 :Gateway,Gateway_PAG;
BO_TX_BU_ 1985 :Gateway,Gateway_PAG;
BO_TX_BU_ 1944 :Gateway,Gateway_PAG;
BO_TX_BU_ 1998 :Gateway,Gateway_PAG;
BO_TX_BU_ 1919 :Gateway,Gateway_PAG;
BO_TX_BU_ 1913 :Gateway,Gateway_PAG;
BO_TX_BU_ 2009 :Gateway,Gateway_PAG;
BO_TX_BU_ 1912 :Gateway,Gateway_PAG;
BO_TX_BU_ 1963 :Gateway,Gateway_PAG;
BO_TX_BU_ 1957 :Gateway,Gateway_PAG;
BO_TX_BU_ 2001 :Gateway,Gateway_PAG;
BO_TX_BU_ 1947 :Gateway,Gateway_PAG;
BO_TX_BU_ 1965 :Gateway,Gateway_PAG;
BO_TX_BU_ 1946 :Gateway,Gateway_PAG;
BO_TX_BU_ 1914 :Gateway,Gateway_PAG;
BO_TX_BU_ 2025 :Gateway,Gateway_PAG;
BO_TX_BU_ 1997 :Gateway,Gateway_PAG;

CM_ "MLBevo_DiagCAN_V8.24.00F Generated by BusNet_NG_Produktiv 9.24.4";
CM_ BU_ Gateway "MLBevo Diagnoseinterface für Datenbus

connected Gateway Version 2.0, Zulieferer Conti Markdorf
- e & e4

connected Gateway Version 3.1, Zulieferer ESR/Lear
- e, e2, e5, e6";
CM_ BU_ Gateway_PAG "Gateway-Variante für PAG - Absprungbasis Gateway 3.x";
CM_ BU_ Tester_MLBevo "Tester für MLBevo";

CM_ BO_ 2549880614 "LIN Flashen Active Aroma Unit (DK2F)";
CM_ BO_ 2550011686 "LIN Flashen Active Aroma Unit (DK2F)";
CM_ BO_ 2549880375 "LIN Flashen BDM (DK2F)";
CM_ BO_ 2550011447 "LIN Flashen BDM (DK2F)";
CM_ BO_ 2549880413 "LIN Flashen elektrischer Klimakompressor (DK2F)";
CM_ BO_ 2550011485 "LIN Flashen elektrischer Klimakompressor (DK2F)";
CM_ BO_ 2549880393 "LIN Flashen elektrisch verstellbare Lenksäule (DK2F)";
CM_ BO_ 2550011465 "LIN Flashen elektrisch verstellbare Lenksäule (DK2F)";
CM_ BO_ 2549880347 "LIN Flashen Blower (DK2F)";
CM_ BO_ 2550011419 "LIN Flashen Blower (DK2F)";
CM_ BO_ 2549880340 "Diagnosezugriff & Flashen Leistungsmodul gleitende Leuchtweite";
CM_ BO_ 2549880341 "Diagnosezugriff Leistungsmodul gleitende Leuchtweite";
CM_ BO_ 2549880401 "Diagnosezugriff & Flashen Heckspoiler";
CM_ BO_ 2550011473 "Diagnosezugriff & Flashen Heckspoiler";
CM_ BO_ 2549880577 "LIN Flashen Klimapanel hinten (DK2F)";
CM_ BO_ 2550011649 "LIN Flashen Klimapanel hinten (DK2F)";
CM_ BO_ 2549880638 "LIN Flashen kapazitives Lenkrad (DK2F)";
CM_ BO_ 2550011710 "LIN Flashen kapazitives Lenkrad (DK2F)";
CM_ BO_ 2549880639 "LIN Flashen KPV (DK2F)";
CM_ BO_ 2550011711 "LIN Flashen KBF (DK2F)";
CM_ BO_ 2549880459 "LIN Flashen KWS (DK2F)";
CM_ BO_ 2550011531 "LIN Flashen KWS (DK2F)";
CM_ BO_ 2549880330 "Diagnosezugriff Leistungsmodul LED";
CM_ BO_ 2549880331 "Diagnosezugriff Leistungsmodul LED";
CM_ BO_ 2549880633 "LIN Flashen Innenlichtmodul 2 (DK2F)";
CM_ BO_ 2550011705 "LIN Flashen Innenlichtmodul 2 (DK2F)";
CM_ BO_ 2549880350 "LIN Flashen Innenlichtmodul (DK2F)";
CM_ BO_ 2550011422 "LIN Flashen Innenlichtmodul (DK2F)";
CM_ BO_ 2549880427 "Diagnosezugriff Leistungsmodul Matrix Beam";
CM_ BO_ 2549880428 "Diagnosezugriff Leistungsmodul Matrix Beam";
CM_ BO_ 2549880670 "LIN Flashen Nässesensor VL";
CM_ BO_ 2550011742 "LIN Flashen Nässesensor VL";
CM_ BO_ 2549880671 "LIN Flashen Nässesensor VL";
CM_ BO_ 2550011743 "LIN Flashen Nässesensor VL";
CM_ BO_ 2549880714 "LIN Flashen Wasserpumpe für Kühlung Antriebsstrang 2 (WP_1b)
DFL-Kuerzel: PumpKM_2; DK2F";
CM_ BO_ 2550011786 "LIN Flashen Wasserpumpe für Kühlung Antriebsstrang 2 (WP_1b)
DFL-Kuerzel: PumpKM_2; DK2F";
CM_ BO_ 2549880747 "DK2F Flash Diagnosezugriff";
CM_ BO_ 2550011819 "DK2F Flash Diagnosezugriff";
CM_ BO_ 2549880610 "Drahtloses Bedienteil 1 für Multimediasystem Request Channel";
CM_ BO_ 2550011682 "Drahtloses Bedienteil 1 für Multimediasystem Response Channel";
CM_ BO_ 2549880611 "Drahtloses Bedienteil 2 für Multimediasystem Request Channel";
CM_ BO_ 2550011683 "Drahtloses Bedienteil 2 für Multimediasystem Response Channel";
CM_ BO_ 2549880473 "Anzeingeeinheit 3 für Multimediasystem Request Channel";
CM_ BO_ 2550011545 "Anzeingeeinheit 3 für Multimediasystem Response Channel";
CM_ BO_ 2549880474 "Anzeingeeinheit 4 für Multimediasystem Request Channel";
CM_ BO_ 2550011546 "Anzeingeeinheit 4 für Multimediasystem Response Channel";
CM_ BO_ 2549880324 "LIN Flashen Universal Garage Door Opener (DK2F)";
CM_ BO_ 2550011396 "LIN Flashen Universal Garage Door Opener (DK2F)";
CM_ BO_ 2549880434 "LIN Flashen UHR (DK2F)";
CM_ BO_ 2550011506 "LIN Flashen UHR (DK2F)";
CM_ BO_ 2549880321 "LIN Flashen Wischwinkelsteuerung (DK2F)";
CM_ BO_ 2550011393 "LIN Flashen Wischwinkelsteuerung (DK2F)";

CM_ SG_ 2549880614 DIA_AAU_Req_Data "Diagnose Request Flashen AAU";

CM_ SG_ 2550011686 DIA_AAU_Resp_Data "Diagnose Response Flashen AAU";

CM_ SG_ 2549880464 DIA_ASTA_Req_Data "Diagnose Request Flashen ASTA";

CM_ SG_ 2550011536 DIA_ASTA_Resp_Data "Diagnose Response Flashen ASTA";

CM_ SG_ 2549880567 DIA_ATFP_Req_Data "Diagnose Request Flashen ATFP";

CM_ SG_ 2550011639 DIA_ATFP_Resp_Data "Diagnose Response Flashen ATFP";

CM_ SG_ 2549880375 DIA_BDM_Req_Data "Diagnosezugriff & Flashen Batteriedatenmodul";

CM_ SG_ 2550011447 DIA_BDM_Resp_Data "Diagnosezugriff & Flashen Batteriedatenmodul";

CM_ SG_ 2549880528 DIA_BJB_Req_Data "Diagnose Request Flashen BJB";

CM_ SG_ 2550011600 DIA_BJB_Resp_Data "Diagnose Response Flashen BJB";

CM_ SG_ 2549880588 DIA_CCU_Req_Data "Diagnosezugriff & Flashen Clutch Control Unit";

CM_ SG_ 2550011660 DIA_CCU_Resp_Data "Diagnosezugriff & Flashen Clutch Control Unit";

CM_ SG_ 2549880529 DIA_CMC_01_Req_Data "Diagnosezugriff & Flashen Cell Module Controller";

CM_ SG_ 2550011601 DIA_CMC_01_Resp_Data "Diagnosezugriff & Flashen Cell Module Controller";

CM_ SG_ 2549880530 DIA_CMC_02_Req_Data "Diagnosezugriff & Flashen Cell Module Controller";

CM_ SG_ 2550011602 DIA_CMC_02_Resp_Data "Diagnosezugriff & Flashen Cell Module Controller";

CM_ SG_ 2549880531 DIA_CMC_03_Req_Data "Diagnosezugriff & Flashen Cell Module Controller";

CM_ SG_ 2550011603 DIA_CMC_03_Resp_Data "Diagnosezugriff & Flashen Cell Module Controller";

CM_ SG_ 2549880532 DIA_CMC_04_Req_Data "Diagnosezugriff & Flashen Cell Module Controller";

CM_ SG_ 2550011604 DIA_CMC_04_Resp_Data "Diagnosezugriff & Flashen Cell Module Controller";

CM_ SG_ 2549880533 DIA_CMC_05_Req_Data "Diagnosezugriff & Flashen Cell Module Controller";

CM_ SG_ 2550011605 DIA_CMC_05_Resp_Data "Diagnosezugriff & Flashen Cell Module Controller";

CM_ SG_ 2549880534 DIA_CMC_06_Req_Data "Diagnosezugriff & Flashen Cell Module Controller";

CM_ SG_ 2550011606 DIA_CMC_06_Resp_Data "Diagnosezugriff & Flashen Cell Module Controller";

CM_ SG_ 2549880535 DIA_CMC_07_Req_Data "Diagnosezugriff & Flashen Cell Module Controller";

CM_ SG_ 2550011607 DIA_CMC_07_Resp_Data "Diagnosezugriff & Flashen Cell Module Controller";

CM_ SG_ 2549880536 DIA_CMC_08_Req_Data "Diagnosezugriff & Flashen Cell Module Controller";

CM_ SG_ 2550011608 DIA_CMC_08_Resp_Data "Diagnosezugriff & Flashen Cell Module Controller";

CM_ SG_ 2549880537 DIA_CMC_09_Req_Data "Diagnosezugriff & Flashen Cell Module Controller";

CM_ SG_ 2550011609 DIA_CMC_09_Resp_Data "Diagnosezugriff & Flashen Cell Module Controller";

CM_ SG_ 2549880538 DIA_CMC_10_Req_Data "Diagnosezugriff & Flashen Cell Module Controller";

CM_ SG_ 2550011610 DIA_CMC_10_Resp_Data "Diagnosezugriff & Flashen Cell Module Controller";

CM_ SG_ 2549880539 DIA_CMC_11_Req_Data "Diagnosezugriff & Flashen Cell Module Controller";

CM_ SG_ 2550011611 DIA_CMC_11_Resp_Data "Diagnosezugriff & Flashen Cell Module Controller";

CM_ SG_ 2549880540 DIA_CMC_12_Req_Data "Diagnosezugriff & Flashen Cell Module Controller";

CM_ SG_ 2550011612 DIA_CMC_12_Resp_Data "Diagnosezugriff & Flashen Cell Module Controller";

CM_ SG_ 2549880561 DIA_CMC_13_Req_Data "Diagnosezugriff & Flashen Cell Module Controller";

CM_ SG_ 2550011633 DIA_CMC_13_Resp_Data "Diagnosezugriff & Flashen Cell Module Controller";

CM_ SG_ 2549880562 DIA_CMC_14_Req_Data "Diagnosezugriff & Flashen Cell Module Controller";

CM_ SG_ 2550011634 DIA_CMC_14_Resp_Data "Diagnosezugriff & Flashen Cell Module Controller";

CM_ SG_ 2549880563 DIA_CMC_15_Req_Data "Diagnosezugriff & Flashen Cell Module Controller";

CM_ SG_ 2550011635 DIA_CMC_15_Resp_Data "Diagnosezugriff & Flashen Cell Module Controller";

CM_ SG_ 2549880717 DIA_eBooster2_Req_Data "Diagnosezugriff & Flashen Turbolader mit HV-Elektroantrieb";

CM_ SG_ 2550011789 DIA_eBooster2_Resp_Data "Diagnosezugriff & Flashen Turbolader mit HV-Elektroantrieb";

CM_ SG_ 2549880589 DIA_eBooster_Req_Data "Diagnose Request Flashen <SG-Name>";

CM_ SG_ 2550011661 DIA_eBooster_Resp_Data "Diagnose Response Flashen <SG-Name>";

CM_ SG_ 2549880632 DIA_EGS_Req_Data "Diagnosezugriff & Flashen elektrischer Klimakompressor";

CM_ SG_ 2550011704 DIA_EGS_Resp_Data "Diagnosezugriff & Flashen elektrischer Klimakompressor";

CM_ SG_ 2549880644 DIA_EKAT_Req_Data "Diagnose Request Flashen EKAT";

CM_ SG_ 2550011716 DIA_EKAT_Resp_Data "Diagnose Response Flashen EKAT";

CM_ SG_ 2549880413 DIA_EKK_Req_Data "Diagnosezugriff & Flashen elektrischer Klimakompressor";

CM_ SG_ 2550011485 DIA_EKK_Resp_Data "Diagnosezugriff & Flashen elektrischer Klimakompressor";

CM_ SG_ 2549880393 DIA_EVLS_Req_Data "Diagnose Request Flashen EVLS";

CM_ SG_ 2550011465 DIA_EVLS_Resp_Data "Diagnose Response Flashen EVLS";

CM_ SG_ 2549880347 DIA_Geblaese_Req_Data "Diagnose Request Flashen Geblaese";

CM_ SG_ 2550011419 DIA_Geblaese_Resp_Data "Diagnose Response Flashen Geblaese";

CM_ SG_ 2549880340 DIA_gLW_LM_L_Req_Data "Diagnosezugriff & Flashen Leistungsmodule für gleitende Leuchtweite ";

CM_ SG_ 2550011412 DIA_gLW_LM_L_Resp_Data "Diagnosezugriff & Flashen Leistungsmodule für gleitende Leuchtweite ";

CM_ SG_ 2549880341 DIA_gLW_LM_R_Req_Data "Diagnosezugriff & Flashen Leistungsmodule für gleitende Leuchtweite ";

CM_ SG_ 2550011413 DIA_gLW_LM_R_Resp_Data "Diagnosezugriff & Flashen Leistungsmodule für gleitende Leuchtweite ";

CM_ SG_ 2549880471 DIA_GPM_Req_Data "Diagnosezugriff & Flashen Aktives Fahrpedal";

CM_ SG_ 2550011543 DIA_GPM_Resp_Data "Diagnosezugriff & Flashen Aktives Fahrpedal";

CM_ SG_ 2549880401 DIA_HSP_Req_Data "Diagnosezugriff & Flashen Heckspoiler";

CM_ SG_ 2550011473 DIA_HSP_Resp_Data "Diagnosezugriff & Flashen Heckspoiler
  ";

CM_ SG_ 2549880512 DIA_HV_H2_Req_Data "Diagnosezugriff & Flashen Hochvolt Wasserheizer";

CM_ SG_ 2550011584 DIA_HV_H2_Resp_Data "Diagnosezugriff & Flashen Hochvolt Wasserheizer";

CM_ SG_ 2549880509 DIA_IVB1_BFS_Req_Data "Diagnosezugriff & Flashen Cell Module Controller";

CM_ SG_ 2550011581 DIA_IVB1_BFS_Resp_Data "Diagnosezugriff & Flashen Cell Module Controller";

CM_ SG_ 2549880505 DIA_IVB1_FS_Req_Data "Diagnosezugriff & Flashen Cell Module Controller";

CM_ SG_ 2550011577 DIA_IVB1_FS_Resp_Data "Diagnosezugriff & Flashen Cell Module Controller";

CM_ SG_ 2549880501 DIA_IVB1_HBFS_Req_Data "Diagnosezugriff & Flashen Cell Module Controller";

CM_ SG_ 2550011573 DIA_IVB1_HBFS_Resp_Data "Diagnosezugriff & Flashen Cell Module Controller";

CM_ SG_ 2549880497 DIA_IVB1_HFS_Req_Data "Diagnosezugriff & Flashen Cell Module Controller";

CM_ SG_ 2550011569 DIA_IVB1_HFS_Resp_Data "Diagnosezugriff & Flashen Cell Module Controller";

CM_ SG_ 2549880577 DIA_KBF_Req_Data "Diagnose Request Flashen KBF";

CM_ SG_ 2550011649 DIA_KBF_Resp_Data "Diagnose Response Flashen KBF";

CM_ SG_ 2549880638 DIA_KLR_Req_Data "Diagnose Request Flashen KLR";

CM_ SG_ 2550011710 DIA_KLR_Resp_Data "Diagnose Response Flashen KLR";

CM_ SG_ 2549880639 DIA_KPV_Req_Data "Diagnosezugriff & Flashen Klimapanel vorne";

CM_ SG_ 2550011711 DIA_KPV_Resp_Data "Diagnosezugriff & Flashen Klimabedienteil vorne";

CM_ SG_ 2549880459 DIA_KWS_Req_Data "Diagnosezugriff & Flashen Knickwinkelsensor";

CM_ SG_ 2550011531 DIA_KWS_Resp_Data "Diagnosezugriff & Flashen Knickwinkelsensor";

CM_ SG_ 2549880330 DIA_LED_LM_L_Req_Data "Diagnosezugriff & Flashen LED Leistungsmodule";

CM_ SG_ 2550011402 DIA_LED_LM_L_Resp_Data "Diagnosezugriff & Flashen LED Leistungsmodule";

CM_ SG_ 2549880331 DIA_LED_LM_R_Req_Data "Diagnosezugriff & Flashen LED Leistungsmodule";

CM_ SG_ 2550011403 DIA_LED_LM_R_Resp_Data "Diagnosezugriff & Flashen LED Leistungsmodule";

CM_ SG_ 2549880633 DIA_LIM_2_Req_Data "Diagnose Request Flashen LIM_2";

CM_ SG_ 2550011705 DIA_LIM_2_Resp_Data "Diagnose Response Flashen LIM_2";

CM_ SG_ 2549880350 DIA_LIM_Req_Data "Diagnose Request Flashen LIM";

CM_ SG_ 2550011422 DIA_LIM_Resp_Data "Diagnose Response Flashen LIM";

CM_ SG_ 2549880369 DIA_MFL_Req_Data "DK2F Flash Diagnosezugriff";

CM_ SG_ 2550011441 DIA_MFL_Resp_Data "DK2F Diagnose Flashen";

CM_ SG_ 2549880568 DIA_MTFP_Req_Data "Diagnose Request Flashen MTFP";

CM_ SG_ 2550011640 DIA_MTFP_Resp_Data "Diagnose Response Flashen MTFP";

CM_ SG_ 2549880510 DIA_MVB1_BFS_Req_Data "Diagnosezugriff & Flashen Cell Module Controller";

CM_ SG_ 2550011582 DIA_MVB1_BFS_Resp_Data "Diagnosezugriff & Flashen Cell Module Controller";

CM_ SG_ 2549880506 DIA_MVB1_FS_Req_Data "Diagnosezugriff & Flashen Cell Module Controller";

CM_ SG_ 2550011578 DIA_MVB1_FS_Resp_Data "Diagnosezugriff & Flashen Cell Module Controller";

CM_ SG_ 2549880502 DIA_MVB1_HBFS_Req_Data "Diagnosezugriff & Flashen Cell Module Controller";

CM_ SG_ 2550011574 DIA_MVB1_HBFS_Resp_Data "Diagnosezugriff & Flashen Cell Module Controller";

CM_ SG_ 2549880498 DIA_MVB1_HFS_Req_Data "Diagnosezugriff & Flashen Cell Module Controller";

CM_ SG_ 2550011570 DIA_MVB1_HFS_Resp_Data "Diagnosezugriff & Flashen Cell Module Controller";

CM_ SG_ 2549880511 DIA_MVB2_BFS_Req_Data "Diagnosezugriff & Flashen Cell Module Controller";

CM_ SG_ 2550011583 DIA_MVB2_BFS_Resp_Data "Diagnosezugriff & Flashen Cell Module Controller";

CM_ SG_ 2549880507 DIA_MVB2_FS_Req_Data "Diagnosezugriff & Flashen Cell Module Controller";

CM_ SG_ 2550011579 DIA_MVB2_FS_Resp_Data "Diagnosezugriff & Flashen Cell Module Controller";

CM_ SG_ 2549880503 DIA_MVB2_HBFS_Req_Data "Diagnosezugriff & Flashen Cell Module Controller";

CM_ SG_ 2550011575 DIA_MVB2_HBFS_Resp_Data "Diagnosezugriff & Flashen Cell Module Controller";

CM_ SG_ 2549880499 DIA_MVB2_HFS_Req_Data "Diagnosezugriff & Flashen Cell Module Controller";

CM_ SG_ 2550011571 DIA_MVB2_HFS_Resp_Data "Diagnosezugriff & Flashen Cell Module Controller";

CM_ SG_ 2549880427 DIA_MXB_LM_L_Req_Data "Diagnosezugriff & Flashen Matrixbeam Leistungsmodule";

CM_ SG_ 2550011499 DIA_MXB_LM_L_Resp_Data "Diagnosezugriff & Flashen Matrixbeam Leistungsmodule";

CM_ SG_ 2549880428 DIA_MXB_LM_R_Req_Data "Diagnosezugriff & Flashen Matrixbeam Leistungsmodule";

CM_ SG_ 2550011500 DIA_MXB_LM_R_Resp_Data "Diagnosezugriff & Flashen Matrixbeam Leistungsmodule";

CM_ SG_ 2549880587 DIA_NFC_MiKo_Req_Data "Flashen NFC-Steuergerät in der Mittelkonsole";

CM_ SG_ 2550011659 DIA_NFC_MiKo_Resp_Data "Flashen NFC-Steuergerät in der Mittelkonsole";

CM_ SG_ 2549880555 DIA_NFC_TGS_Req_Data "Flashen Steuergerät im Türgriff";

CM_ SG_ 2550011627 DIA_NFC_TGS_Resp_Data "Flashen Steuergerät im Türgriff";

CM_ SG_ 2549880670 DIA_NS_VL_Req_Data "Diagnosezugriff & Flashen Nässesensor VL";

CM_ SG_ 2550011742 DIA_NS_VL_Resp_Data "Diagnosezugriff & Flashen Nässesensor VL";

CM_ SG_ 2549880671 DIA_NS_VR_Req_Data "Diagnosezugriff & Flashen Nässesensor VR";

CM_ SG_ 2550011743 DIA_NS_VR_Resp_Data "Diagnosezugriff & Flashen Nässesensor VR";

CM_ SG_ 2549880642 DIA_Parksperre_Req_Data "Diagnosezugriff & Flashen Parksperre";

CM_ SG_ 2550011714 DIA_Parksperre_Resp_Data "Diagnosezugriff & Flashen Parksperre";

CM_ SG_ 2549880714 DIA_PumpKM_2_Req_Data "Diagnosezugriff & Flashen Pumpe 2 für Kühlmittel";

CM_ SG_ 2550011786 DIA_PumpKM_2_Resp_Data "Diagnosezugriff & Flashen ActiveAromaUnit Wasserpumpe für Kühlung Antriebsstrang 2 (WP_1b)";

CM_ SG_ 2549880570 DIA_PumpWSt_Req_Data "Diagnosezugriff & Flashen Pumpe für Wasserstoff";

CM_ SG_ 2550011642 DIA_PumpWSt_Resp_Data "Diagnosezugriff & Flashen Pumpe für Wasserstoff";

CM_ SG_ 2549880747 DIA_SAAM_Req_Data "Diagnose Request Flashen SAAM";

CM_ SG_ 2550011819 DIA_SAAM_Resp_Data "Diagnose Response Flashen SAAM";

CM_ SG_ 2549880357 DIA_SHL_li1_Req_Data "SHL_li1 DK2F";

CM_ SG_ 2550011429 DIA_SHL_li1_Resp_Data "SHL_li1 DK2F";

CM_ SG_ 2549880590 DIA_SHL_li2_Req_Data "SHL_li2 DK2F";

CM_ SG_ 2550011662 DIA_SHL_li2_Resp_Data "SHL_li2 DK2F";

CM_ SG_ 2549880591 DIA_SHL_re1_Req_Data "SHL_re1 DK2F";

CM_ SG_ 2550011663 DIA_SHL_re1_Resp_Data "SHL_re1 DK2F";

CM_ SG_ 2549880592 DIA_SHL_re2_Req_Data "SHL_re2 DK2F";

CM_ SG_ 2550011664 DIA_SHL_re2_Resp_Data "SHL_re2 DK2F";

CM_ SG_ 2549880612 DIA_SWP_Req_Data "Diagnosezugriff & Flashen Automatic Transmission Fluid-Pumpe";

CM_ SG_ 2550011684 DIA_SWP_Resp_Data "Diagnosezugriff & Flashen Automatic Transmission Fluid-Pumpe";

CM_ SG_ 2549880787 DIA_TA_HBFS_Req_Data "Diagnose Request Flashen";

CM_ SG_ 2550011859 DIA_TA_HBFS_Resp_Data "Diagnose Response Flashen";

CM_ SG_ 2549880786 DIA_TA_HFS_Req_Data "Diagnose Request Flashen";

CM_ SG_ 2550011858 DIA_TA_HFS_Resp_Data "Diagnose Response Flashen";

CM_ SG_ 2549880324 DIA_UGDO_S_Req_Data "Diagnosezugriff & Flashen Garagentoröffner (Sender)";

CM_ SG_ 2550011396 DIA_UGDO_S_Resp_Data "Diagnosezugriff & Flashen Garagentoröffner (Sender)";

CM_ SG_ 2549880434 DIA_UHR_Req_Data "Diagnose Request Flashen UHR";

CM_ SG_ 2550011506 DIA_UHR_Resp_Data "Diagnose Response Flashen UHR";

CM_ SG_ 2549880679 DIA_WiBli_L_Req "DK2F Flash Diagnosezugriff";

CM_ SG_ 2550011751 DIA_WiBli_L_Resp "DK2F Flash Diagnosezugriff";

CM_ SG_ 2549880680 DIA_WiBli_R_Req "DK2F Flash Diagnosezugriff";

CM_ SG_ 2550011752 DIA_WiBli_R_Resp "DK2F Flash Diagnosezugriff";

CM_ SG_ 2549880321 DIA_WWS_Req_Data "Diagnosezugriff & Flashen Wischwinkelsteuerung";

CM_ SG_ 2550011393 DIA_WWS_Resp_Data "Diagnosezugriff & Flashen Wischwinkelsteuerung";

CM_ SG_ 1863 ISO_AAG_Req_Data "Diagnose Request Anhaengeranschlussgeraet";

CM_ SG_ 1969 ISO_AAG_Resp_Data "OffBoard Tester Diagnose Response AAG";

CM_ SG_ 1811 ISO_ABS_Req_Data "OffBoard Tester Diagnose Request ABS";

CM_ SG_ 1917 ISO_ABS_Resp_Data "Diagnose Response Bremsen-SG/Elektronisches Stabilitätsprogramm";

CM_ SG_ 1879 ISO_ACC_Req_Data "OffBoard Tester Diagnose Request ACC";

CM_ SG_ 1985 ISO_ACC_Resp_Data "Diagnose Response Adaptive Cruise Control";

CM_ SG_ 1838 ISO_AEM_Req_Data "OffBoard Tester Diagnose Request AEM";

CM_ SG_ 1944 ISO_AEM_Resp_Data "OffBoard Tester Diagnose Response AEM";

CM_ SG_ 1892 ISO_AGA_Req_Data "Diagnose Request Aussensoundaktuator";

CM_ SG_ 1998 ISO_AGA_Resp_Data "Diagnose Response Aussensoundaktuator";

CM_ SG_ 1813 ISO_Airbag_01_Req_Data "OffBoard Tester Diagnose Request Airbag_01";

CM_ SG_ 1919 ISO_Airbag_01_Resp_Data "OffBoard Tester Diagnose Response Airbag_01";

CM_ SG_ 1807 ISO_Allrad_Req_Data "Diagnose Request Allrad";

CM_ SG_ 1913 ISO_Allrad_Resp_Data "OffBoard Tester Diagnose Response Allrad";

CM_ SG_ 1903 ISO_AMP_Req_Data "OffBoard Tester Diagnose Request AMP";

CM_ SG_ 2009 ISO_AMP_Resp_Data "OffBoard Tester Diagnose Response AMP";

CM_ SG_ 1806 ISO_BCM1_Req_Data "OffBoard Tester Diagnose Request BCM1";

CM_ SG_ 1912 ISO_BCM1_Resp_Data "OffBoard Tester Diagnose Response BCM1";

CM_ SG_ 1857 ISO_DCDC_Req_Data "OffBoard Tester Diagnose Request DCDC";

CM_ SG_ 1963 ISO_DCDC_Resp_Data "OffBoard Tester Diagnose Response DCDC";

CM_ SG_ 1851 ISO_EBKV_Req_Data "Diagnose Request Elektronischer Bremskraftverstaerker";

CM_ SG_ 1957 ISO_EBKV_Resp_Data "Diagnose Response Elektronischer Bremskraftverstaerker";

CM_ SG_ 1895 ISO_eCall_Req_Data "OffBoard Tester Diagnose Request eCall";

CM_ SG_ 2001 ISO_eCall_Resp_Data "OffBoard Tester Diagnose Response eCall";

CM_ SG_ 1841 ISO_ELV_Req_Data "OffBoard Tester Diagnose Request ELV";

CM_ SG_ 1947 ISO_ELV_Resp_Data "OffBoard Tester Diagnose Response ELV";

CM_ SG_ 1859 ISO_EMotor_03_Req_Data "OffBoard Tester Diagnose Request EMotor_03";

CM_ SG_ 1965 ISO_EMotor_03_Resp_Data "OffBoard Tester Diagnose Response EMotor_03";

CM_ SG_ 1840 ISO_FLA_Req_Data "Diagnose Request Fernlichtassistent";

CM_ SG_ 1946 ISO_FLA_Resp_Data "Diagnose Response Fernlichtassistent";

CM_ SG_ 1795 ISO_Funktionaler_Req_Abgas "Funktionaler Request für abgasrelevante Steuergeraete";

CM_ SG_ 1792 ISO_ALL_01_Req_Data "Funktionaler Request ALL";

CM_ SG_ 2015 ISO_OBD_Funktionaler_Req_Data "Funktionaler Request für OBD relevante Steuergeraete";

CM_ SG_ 1808 ISO_Gateway_Req_Data "OffBoard Tester Diagnose Request Gateway";

CM_ SG_ 1914 ISO_Gateway_Resp_Data "OffBoard Tester Diagnose Response Gateway";

CM_ SG_ 2017 ISO_Getriebe_01_Req_Data "Diagnose Request Getriebe";

CM_ SG_ 2025 ISO_Getriebe_01_Resp_Data "OffBoard Tester Diagnose Response Getriebe_01";

CM_ SG_ 1891 ISO_Gurtmikro_Req_Data "Diagnose Request Gurtmicrophon";

CM_ SG_ 1997 ISO_Gurtmikro_Resp_Data "Diagnose Response Gurtmicrophon";

BA_DEF_  "DBName" STRING;
BA_DEF_  "GenNWMApBusSleep" STRING;
BA_DEF_  "GenNWMApCanNormal" STRING;
BA_DEF_  "GenNWMApCanOff" STRING;
BA_DEF_  "GenNWMApCanOn" STRING;
BA_DEF_  "GenNWMApCanSleep" STRING;
BA_DEF_  "GenNWMApCanWakeUp" STRING;
BA_DEF_  "GenNWMGotoMode_Awake" STRING;
BA_DEF_  "GenNWMGotoMode_BusSleep" STRING;
BA_DEF_  "GenNWMSleepTime" INT 0 1000000;
BA_DEF_  "GenNWMTalkNM" STRING;
BA_DEF_  "Manufacturer" STRING;
BA_DEF_  "NmType" STRING;
BA_DEF_  "VAGTP20_SetupMessageCount" INT 0 255;
BA_DEF_  "VAGTP20_SetupStartAddress" HEX 0 2047;
BA_DEF_  "VersionDay" INT 1 31;
BA_DEF_  "VersionMonth" INT 1 12;
BA_DEF_  "VersionWeek" INT 1 52;
BA_DEF_  "VersionYear" INT 0 99;
BA_DEF_  "VersionNumber" INT 0 65535;
BA_DEF_  "BusType" STRING;
BA_DEF_  "Baudrate" INT 1 1000000;
BA_DEF_  "SamplePointMin" INT 1 100;
BA_DEF_  "SamplePointMax" INT 1 100;
BA_DEF_  "SyncJumpWidthMin" INT 1 4;
BA_DEF_  "SyncJumpWidthMax" INT 1 4;
BA_DEF_  "NBTMin" INT 1 30;
BA_DEF_  "NBTMax" INT 1 30;
BA_DEF_ BU_  "GenNodAutoGenDsp" ENUM "No", "Yes";
BA_DEF_ BU_  "GenNodAutoGenSnd" ENUM "No", "Yes";
BA_DEF_ BU_  "GenNodSleepTime" INT 0 1000000;
BA_DEF_ BU_  "ILUsed" ENUM "No", "Yes";
BA_DEF_ BU_  "ECUVariantDefault" ENUM "No", "Yes";
BA_DEF_ BU_  "ECUVariantGroup" STRING;
BA_DEF_ BU_  "NodeLayerModules" STRING;
BA_DEF_ BU_  "NmhNode" ENUM "No", "Yes";
BA_DEF_ BU_  "NmNode" ENUM "No", "Yes";
BA_DEF_ BO_  "DiagRequest" ENUM "No", "Yes";
BA_DEF_ BO_  "DiagResponse" ENUM "No", "Yes";
BA_DEF_ BO_  "DiagState" ENUM "No", "Yes";
BA_DEF_ BO_  "GenMsgChkConstant" HEX 0 4095;
BA_DEF_ BO_  "GenMsgCycleTime" INT 0 65535;
BA_DEF_ BO_  "GenMsgILSupport" ENUM "No", "Yes";
BA_DEF_ BO_  "GenMsgSendType" ENUM "Cyclic", "not_used", "not_used", "not_used", "not_used", "not_used", "not_used", "IfActive", "NoMsgSendType";
BA_DEF_ BO_  "GenMsgStartDelayTime" INT 0 100000;
BA_DEF_ BO_  "NmMessage" ENUM "No", "Yes";
BA_DEF_ BO_  "NmhMessage" ENUM "No", "Yes";
BA_DEF_ BO_  "MsgType" ENUM "Application", "NM ", "NMH", "TP2.0", "ISO-TP ", "BAP", "EID", "KS", "XCP_PRE_CONFIGURED", "XCP_RUNTIME_CONFIGURED";
BA_DEF_ BO_  "VAGTP20_API" HEX 0 255;
BA_DEF_ BO_  "VAGTP20_DynConnection" ENUM "No", "Yes";
BA_DEF_ BO_  "VAGTP20_DynSetup" ENUM "No", "Yes";
BA_DEF_ BO_  "VAGTP20_StatConnection" ENUM "No", "Yes";
BA_DEF_ SG_  "GenSigActiveRepetitions" INT -2147483648 2147483647;
BA_DEF_ SG_  "GenSigSendType" ENUM "Cyclic", "OnWrite", "OnWriteWithRepetition", "OnChange", "OnChangeWithRepetition", "IfActive", "IfActiveWithRepetition", "NoSigSendType", "OnChangeAndIfActive", "OnChangeAndIfActiveWithRepetition";
BA_DEF_ SG_  "GenSigStartValue" INT -2147483648 2147483647;
BA_DEF_ SG_  "NWM-WakeupAllowed" ENUM "No", "Yes";
BA_DEF_ SG_  "GenSigFuncType" ENUM "NoFunction", "MsgCounter", "CRC-8", "XOR", "XOR-2", "DatedBit", "SW-Kl15", "CHK", "Constant", "Protocol", "CRC-8-SAE_J1850", "CRC-32", "DataLength", "DataID", "MsgCounter16", "SOK-Signatur", "Cluster";
BA_DEF_ SG_  "GenSigSwitchedByIgnition" ENUM "No", "Yes";
BA_DEF_ SG_  "Fehlerwert" HEX 0 2147483647;
BA_DEF_ SG_  "GenSigMissingSourceValue" HEX 0 2147483647;
BA_DEF_DEF_  "DBName" "";
BA_DEF_DEF_  "GenNWMApBusSleep" "";
BA_DEF_DEF_  "GenNWMApCanNormal" "";
BA_DEF_DEF_  "GenNWMApCanOff" "";
BA_DEF_DEF_  "GenNWMApCanOn" "";
BA_DEF_DEF_  "GenNWMApCanSleep" "";
BA_DEF_DEF_  "GenNWMApCanWakeUp" "";
BA_DEF_DEF_  "GenNWMGotoMode_Awake" "";
BA_DEF_DEF_  "GenNWMGotoMode_BusSleep" "";
BA_DEF_DEF_  "GenNWMSleepTime" 0;
BA_DEF_DEF_  "GenNWMTalkNM" "";
BA_DEF_DEF_  "Manufacturer" "";
BA_DEF_DEF_  "NmType" "None";
BA_DEF_DEF_  "VAGTP20_SetupMessageCount" 0;
BA_DEF_DEF_  "VAGTP20_SetupStartAddress" 0;
BA_DEF_DEF_  "VersionDay" 2;
BA_DEF_DEF_  "VersionMonth" 6;
BA_DEF_DEF_  "VersionWeek" 23;
BA_DEF_DEF_  "VersionYear" 22;
BA_DEF_DEF_  "VersionNumber" 0;
BA_DEF_DEF_  "BusType" "";
BA_DEF_DEF_  "Baudrate" 1;
BA_DEF_DEF_  "SamplePointMin" 1;
BA_DEF_DEF_  "SamplePointMax" 1;
BA_DEF_DEF_  "SyncJumpWidthMin" 1;
BA_DEF_DEF_  "SyncJumpWidthMax" 1;
BA_DEF_DEF_  "NBTMin" 10;
BA_DEF_DEF_  "NBTMax" 20;
BA_DEF_DEF_  "GenNodAutoGenDsp" "Yes";
BA_DEF_DEF_  "GenNodAutoGenSnd" "Yes";
BA_DEF_DEF_  "GenNodSleepTime" 0;
BA_DEF_DEF_  "ILUsed" "Yes";
BA_DEF_DEF_  "ECUVariantDefault" "Yes";
BA_DEF_DEF_  "ECUVariantGroup" "";
BA_DEF_DEF_  "NodeLayerModules" "";
BA_DEF_DEF_  "NmhNode" "Yes";
BA_DEF_DEF_  "NmNode" "No";
BA_DEF_DEF_  "DiagRequest" "No";
BA_DEF_DEF_  "DiagResponse" "No";
BA_DEF_DEF_  "DiagState" "No";
BA_DEF_DEF_  "GenMsgChkConstant" 0;
BA_DEF_DEF_  "GenMsgCycleTime" 0;
BA_DEF_DEF_  "GenMsgILSupport" "No";
BA_DEF_DEF_  "GenMsgSendType" "NoMsgSendType";
BA_DEF_DEF_  "GenMsgStartDelayTime" 0;
BA_DEF_DEF_  "NmMessage" "No";
BA_DEF_DEF_  "NmhMessage" "No";
BA_DEF_DEF_  "MsgType" "Application";
BA_DEF_DEF_  "VAGTP20_API" 0;
BA_DEF_DEF_  "VAGTP20_DynConnection" "No";
BA_DEF_DEF_  "VAGTP20_DynSetup" "No";
BA_DEF_DEF_  "VAGTP20_StatConnection" "No";
BA_DEF_DEF_  "GenSigActiveRepetitions" 0;
BA_DEF_DEF_  "GenSigSendType" "NoSigSendType";
BA_DEF_DEF_  "GenSigStartValue" 0;
BA_DEF_DEF_  "NWM-WakeupAllowed" "No";
BA_DEF_DEF_  "GenSigFuncType" "NoFunction";
BA_DEF_DEF_  "GenSigSwitchedByIgnition" "Yes";
BA_DEF_DEF_  "Fehlerwert" 0;
BA_DEF_DEF_  "GenSigMissingSourceValue" 0;
BA_  "DBName" "MLBevo_DiagCAN";
BA_  "GenNWMSleepTime" 4000;
BA_  "Manufacturer" "VAG";
BA_  "VAGTP20_SetupMessageCount" 128;
BA_  "VAGTP20_SetupStartAddress" 512;
BA_  "VersionNumber" 2400;
BA_  "BusType" "CAN";
BA_  "Baudrate" 500000;
BA_  "SamplePointMin" 80;
BA_  "SamplePointMax" 84;
BA_  "SyncJumpWidthMin" 2;
BA_  "SyncJumpWidthMax" 4;
BA_ "GenNodSleepTime" BU_ Gateway 4000;
BA_ "ECUVariantGroup" BU_ Gateway "Gateway";
BA_ "NmhNode" BU_ Gateway 0;
BA_ "GenNodSleepTime" BU_ Gateway_PAG 4000;
BA_ "ECUVariantDefault" BU_ Gateway_PAG 0;
BA_ "ECUVariantGroup" BU_ Gateway_PAG "Gateway";
BA_ "NmhNode" BU_ Gateway_PAG 0;
BA_ "GenNodSleepTime" BU_ Tester_MLBevo 4000;
BA_ "ECUVariantGroup" BU_ Tester_MLBevo "Tester_MLBevo";
BA_ "NmhNode" BU_ Tester_MLBevo 0;
BA_ "DiagRequest" BO_ 2549880614 1;
BA_ "MsgType" BO_ 2549880614 4;
BA_ "DiagResponse" BO_ 2550011686 1;
BA_ "MsgType" BO_ 2550011686 4;
BA_ "DiagRequest" BO_ 2549880464 1;
BA_ "MsgType" BO_ 2549880464 4;
BA_ "DiagResponse" BO_ 2550011536 1;
BA_ "MsgType" BO_ 2550011536 4;
BA_ "DiagRequest" BO_ 2549880567 1;
BA_ "MsgType" BO_ 2549880567 4;
BA_ "DiagResponse" BO_ 2550011639 1;
BA_ "MsgType" BO_ 2550011639 4;
BA_ "DiagRequest" BO_ 2549880375 1;
BA_ "MsgType" BO_ 2549880375 4;
BA_ "DiagResponse" BO_ 2550011447 1;
BA_ "MsgType" BO_ 2550011447 4;
BA_ "DiagRequest" BO_ 2549880528 1;
BA_ "MsgType" BO_ 2549880528 4;
BA_ "DiagResponse" BO_ 2550011600 1;
BA_ "MsgType" BO_ 2550011600 4;
BA_ "DiagRequest" BO_ 2549880588 1;
BA_ "MsgType" BO_ 2549880588 4;
BA_ "DiagResponse" BO_ 2550011660 1;
BA_ "MsgType" BO_ 2550011660 4;
BA_ "DiagRequest" BO_ 2549880529 1;
BA_ "MsgType" BO_ 2549880529 4;
BA_ "DiagResponse" BO_ 2550011601 1;
BA_ "MsgType" BO_ 2550011601 4;
BA_ "DiagRequest" BO_ 2549880530 1;
BA_ "MsgType" BO_ 2549880530 4;
BA_ "DiagResponse" BO_ 2550011602 1;
BA_ "MsgType" BO_ 2550011602 4;
BA_ "DiagRequest" BO_ 2549880531 1;
BA_ "MsgType" BO_ 2549880531 4;
BA_ "DiagResponse" BO_ 2550011603 1;
BA_ "MsgType" BO_ 2550011603 4;
BA_ "DiagRequest" BO_ 2549880532 1;
BA_ "MsgType" BO_ 2549880532 4;
BA_ "DiagResponse" BO_ 2550011604 1;
BA_ "MsgType" BO_ 2550011604 4;
BA_ "DiagRequest" BO_ 2549880533 1;
BA_ "MsgType" BO_ 2549880533 4;
BA_ "DiagResponse" BO_ 2550011605 1;
BA_ "MsgType" BO_ 2550011605 4;
BA_ "DiagRequest" BO_ 2549880534 1;
BA_ "MsgType" BO_ 2549880534 4;
BA_ "DiagResponse" BO_ 2550011606 1;
BA_ "MsgType" BO_ 2550011606 4;
BA_ "DiagRequest" BO_ 2549880535 1;
BA_ "MsgType" BO_ 2549880535 4;
BA_ "DiagResponse" BO_ 2550011607 1;
BA_ "MsgType" BO_ 2550011607 4;
BA_ "DiagRequest" BO_ 2549880536 1;
BA_ "MsgType" BO_ 2549880536 4;
BA_ "DiagResponse" BO_ 2550011608 1;
BA_ "MsgType" BO_ 2550011608 4;
BA_ "DiagRequest" BO_ 2549880537 1;
BA_ "MsgType" BO_ 2549880537 4;
BA_ "DiagResponse" BO_ 2550011609 1;
BA_ "MsgType" BO_ 2550011609 4;
BA_ "DiagRequest" BO_ 2549880538 1;
BA_ "MsgType" BO_ 2549880538 4;
BA_ "DiagResponse" BO_ 2550011610 1;
BA_ "MsgType" BO_ 2550011610 4;
BA_ "DiagRequest" BO_ 2549880539 1;
BA_ "MsgType" BO_ 2549880539 4;
BA_ "DiagResponse" BO_ 2550011611 1;
BA_ "MsgType" BO_ 2550011611 4;
BA_ "DiagRequest" BO_ 2549880540 1;
BA_ "MsgType" BO_ 2549880540 4;
BA_ "DiagResponse" BO_ 2550011612 1;
BA_ "MsgType" BO_ 2550011612 4;
BA_ "DiagRequest" BO_ 2549880561 1;
BA_ "MsgType" BO_ 2549880561 4;
BA_ "DiagResponse" BO_ 2550011633 1;
BA_ "MsgType" BO_ 2550011633 4;
BA_ "DiagRequest" BO_ 2549880562 1;
BA_ "MsgType" BO_ 2549880562 4;
BA_ "DiagResponse" BO_ 2550011634 1;
BA_ "MsgType" BO_ 2550011634 4;
BA_ "DiagRequest" BO_ 2549880563 1;
BA_ "MsgType" BO_ 2549880563 4;
BA_ "DiagResponse" BO_ 2550011635 1;
BA_ "MsgType" BO_ 2550011635 4;
BA_ "DiagRequest" BO_ 2549880717 1;
BA_ "MsgType" BO_ 2549880717 4;
BA_ "DiagResponse" BO_ 2550011789 1;
BA_ "MsgType" BO_ 2550011789 4;
BA_ "DiagRequest" BO_ 2549880589 1;
BA_ "MsgType" BO_ 2549880589 4;
BA_ "DiagResponse" BO_ 2550011661 1;
BA_ "MsgType" BO_ 2550011661 4;
BA_ "DiagRequest" BO_ 2549880632 1;
BA_ "MsgType" BO_ 2549880632 4;
BA_ "DiagResponse" BO_ 2550011704 1;
BA_ "MsgType" BO_ 2550011704 4;
BA_ "DiagRequest" BO_ 2549880644 1;
BA_ "MsgType" BO_ 2549880644 4;
BA_ "DiagResponse" BO_ 2550011716 1;
BA_ "MsgType" BO_ 2550011716 4;
BA_ "DiagRequest" BO_ 2549880413 1;
BA_ "MsgType" BO_ 2549880413 4;
BA_ "DiagResponse" BO_ 2550011485 1;
BA_ "MsgType" BO_ 2550011485 4;
BA_ "DiagRequest" BO_ 2549880393 1;
BA_ "MsgType" BO_ 2549880393 4;
BA_ "DiagResponse" BO_ 2550011465 1;
BA_ "MsgType" BO_ 2550011465 4;
BA_ "DiagRequest" BO_ 2549880347 1;
BA_ "MsgType" BO_ 2549880347 4;
BA_ "DiagResponse" BO_ 2550011419 1;
BA_ "MsgType" BO_ 2550011419 4;
BA_ "DiagRequest" BO_ 2549880340 1;
BA_ "MsgType" BO_ 2549880340 4;
BA_ "DiagResponse" BO_ 2550011412 1;
BA_ "MsgType" BO_ 2550011412 4;
BA_ "DiagRequest" BO_ 2549880341 1;
BA_ "MsgType" BO_ 2549880341 4;
BA_ "DiagResponse" BO_ 2550011413 1;
BA_ "MsgType" BO_ 2550011413 4;
BA_ "DiagRequest" BO_ 2549880471 1;
BA_ "MsgType" BO_ 2549880471 4;
BA_ "DiagResponse" BO_ 2550011543 1;
BA_ "MsgType" BO_ 2550011543 4;
BA_ "DiagRequest" BO_ 2549880401 1;
BA_ "MsgType" BO_ 2549880401 4;
BA_ "DiagResponse" BO_ 2550011473 1;
BA_ "MsgType" BO_ 2550011473 4;
BA_ "DiagRequest" BO_ 2549880512 1;
BA_ "MsgType" BO_ 2549880512 4;
BA_ "DiagResponse" BO_ 2550011584 1;
BA_ "MsgType" BO_ 2550011584 4;
BA_ "DiagRequest" BO_ 2549880509 1;
BA_ "MsgType" BO_ 2549880509 4;
BA_ "DiagResponse" BO_ 2550011581 1;
BA_ "MsgType" BO_ 2550011581 4;
BA_ "DiagRequest" BO_ 2549880505 1;
BA_ "MsgType" BO_ 2549880505 4;
BA_ "DiagResponse" BO_ 2550011577 1;
BA_ "MsgType" BO_ 2550011577 4;
BA_ "DiagRequest" BO_ 2549880501 1;
BA_ "MsgType" BO_ 2549880501 4;
BA_ "DiagResponse" BO_ 2550011573 1;
BA_ "MsgType" BO_ 2550011573 4;
BA_ "DiagRequest" BO_ 2549880497 1;
BA_ "MsgType" BO_ 2549880497 4;
BA_ "DiagResponse" BO_ 2550011569 1;
BA_ "MsgType" BO_ 2550011569 4;
BA_ "DiagRequest" BO_ 2549880577 1;
BA_ "MsgType" BO_ 2549880577 4;
BA_ "DiagResponse" BO_ 2550011649 1;
BA_ "MsgType" BO_ 2550011649 4;
BA_ "DiagRequest" BO_ 2549880638 1;
BA_ "MsgType" BO_ 2549880638 4;
BA_ "DiagResponse" BO_ 2550011710 1;
BA_ "MsgType" BO_ 2550011710 4;
BA_ "DiagRequest" BO_ 2549880639 1;
BA_ "MsgType" BO_ 2549880639 4;
BA_ "DiagResponse" BO_ 2550011711 1;
BA_ "MsgType" BO_ 2550011711 4;
BA_ "DiagRequest" BO_ 2549880459 1;
BA_ "MsgType" BO_ 2549880459 4;
BA_ "DiagResponse" BO_ 2550011531 1;
BA_ "MsgType" BO_ 2550011531 4;
BA_ "DiagRequest" BO_ 2549880330 1;
BA_ "MsgType" BO_ 2549880330 4;
BA_ "DiagResponse" BO_ 2550011402 1;
BA_ "MsgType" BO_ 2550011402 4;
BA_ "DiagRequest" BO_ 2549880331 1;
BA_ "MsgType" BO_ 2549880331 4;
BA_ "DiagResponse" BO_ 2550011403 1;
BA_ "MsgType" BO_ 2550011403 4;
BA_ "DiagRequest" BO_ 2549880633 1;
BA_ "MsgType" BO_ 2549880633 4;
BA_ "DiagResponse" BO_ 2550011705 1;
BA_ "MsgType" BO_ 2550011705 4;
BA_ "DiagRequest" BO_ 2549880350 1;
BA_ "MsgType" BO_ 2549880350 4;
BA_ "DiagResponse" BO_ 2550011422 1;
BA_ "MsgType" BO_ 2550011422 4;
BA_ "DiagRequest" BO_ 2549880369 1;
BA_ "MsgType" BO_ 2549880369 4;
BA_ "DiagResponse" BO_ 2550011441 1;
BA_ "MsgType" BO_ 2550011441 4;
BA_ "DiagRequest" BO_ 2549880568 1;
BA_ "MsgType" BO_ 2549880568 4;
BA_ "DiagResponse" BO_ 2550011640 1;
BA_ "MsgType" BO_ 2550011640 4;
BA_ "DiagRequest" BO_ 2549880510 1;
BA_ "MsgType" BO_ 2549880510 4;
BA_ "DiagResponse" BO_ 2550011582 1;
BA_ "MsgType" BO_ 2550011582 4;
BA_ "DiagRequest" BO_ 2549880506 1;
BA_ "MsgType" BO_ 2549880506 4;
BA_ "DiagResponse" BO_ 2550011578 1;
BA_ "MsgType" BO_ 2550011578 4;
BA_ "DiagRequest" BO_ 2549880502 1;
BA_ "MsgType" BO_ 2549880502 4;
BA_ "DiagResponse" BO_ 2550011574 1;
BA_ "MsgType" BO_ 2550011574 4;
BA_ "DiagRequest" BO_ 2549880498 1;
BA_ "MsgType" BO_ 2549880498 4;
BA_ "DiagResponse" BO_ 2550011570 1;
BA_ "MsgType" BO_ 2550011570 4;
BA_ "DiagRequest" BO_ 2549880511 1;
BA_ "MsgType" BO_ 2549880511 4;
BA_ "DiagResponse" BO_ 2550011583 1;
BA_ "MsgType" BO_ 2550011583 4;
BA_ "DiagRequest" BO_ 2549880507 1;
BA_ "MsgType" BO_ 2549880507 4;
BA_ "DiagResponse" BO_ 2550011579 1;
BA_ "MsgType" BO_ 2550011579 4;
BA_ "DiagRequest" BO_ 2549880503 1;
BA_ "MsgType" BO_ 2549880503 4;
BA_ "DiagResponse" BO_ 2550011575 1;
BA_ "MsgType" BO_ 2550011575 4;
BA_ "DiagRequest" BO_ 2549880499 1;
BA_ "MsgType" BO_ 2549880499 4;
BA_ "DiagResponse" BO_ 2550011571 1;
BA_ "MsgType" BO_ 2550011571 4;
BA_ "DiagRequest" BO_ 2549880427 1;
BA_ "MsgType" BO_ 2549880427 4;
BA_ "DiagResponse" BO_ 2550011499 1;
BA_ "MsgType" BO_ 2550011499 4;
BA_ "DiagRequest" BO_ 2549880428 1;
BA_ "MsgType" BO_ 2549880428 4;
BA_ "DiagResponse" BO_ 2550011500 1;
BA_ "MsgType" BO_ 2550011500 4;
BA_ "DiagRequest" BO_ 2549880587 1;
BA_ "MsgType" BO_ 2549880587 4;
BA_ "DiagResponse" BO_ 2550011659 1;
BA_ "MsgType" BO_ 2550011659 4;
BA_ "DiagRequest" BO_ 2549880555 1;
BA_ "MsgType" BO_ 2549880555 4;
BA_ "DiagResponse" BO_ 2550011627 1;
BA_ "MsgType" BO_ 2550011627 4;
BA_ "DiagRequest" BO_ 2549880670 1;
BA_ "MsgType" BO_ 2549880670 4;
BA_ "DiagResponse" BO_ 2550011742 1;
BA_ "MsgType" BO_ 2550011742 4;
BA_ "DiagRequest" BO_ 2549880671 1;
BA_ "MsgType" BO_ 2549880671 4;
BA_ "DiagResponse" BO_ 2550011743 1;
BA_ "MsgType" BO_ 2550011743 4;
BA_ "DiagRequest" BO_ 2549880642 1;
BA_ "MsgType" BO_ 2549880642 4;
BA_ "DiagResponse" BO_ 2550011714 1;
BA_ "MsgType" BO_ 2550011714 4;
BA_ "DiagRequest" BO_ 2549880714 1;
BA_ "MsgType" BO_ 2549880714 4;
BA_ "DiagResponse" BO_ 2550011786 1;
BA_ "MsgType" BO_ 2550011786 4;
BA_ "DiagRequest" BO_ 2549880570 1;
BA_ "MsgType" BO_ 2549880570 4;
BA_ "DiagResponse" BO_ 2550011642 1;
BA_ "MsgType" BO_ 2550011642 4;
BA_ "DiagRequest" BO_ 2549880747 1;
BA_ "MsgType" BO_ 2549880747 4;
BA_ "DiagResponse" BO_ 2550011819 1;
BA_ "MsgType" BO_ 2550011819 4;
BA_ "DiagRequest" BO_ 2549880610 1;
BA_ "MsgType" BO_ 2549880610 4;
BA_ "DiagResponse" BO_ 2550011682 1;
BA_ "MsgType" BO_ 2550011682 4;
BA_ "DiagRequest" BO_ 2549880611 1;
BA_ "MsgType" BO_ 2549880611 4;
BA_ "DiagResponse" BO_ 2550011683 1;
BA_ "MsgType" BO_ 2550011683 4;
BA_ "DiagRequest" BO_ 2549880473 1;
BA_ "MsgType" BO_ 2549880473 4;
BA_ "DiagResponse" BO_ 2550011545 1;
BA_ "MsgType" BO_ 2550011545 4;
BA_ "DiagRequest" BO_ 2549880474 1;
BA_ "MsgType" BO_ 2549880474 4;
BA_ "DiagResponse" BO_ 2550011546 1;
BA_ "MsgType" BO_ 2550011546 4;
BA_ "DiagRequest" BO_ 2549880357 1;
BA_ "MsgType" BO_ 2549880357 4;
BA_ "DiagResponse" BO_ 2550011429 1;
BA_ "MsgType" BO_ 2550011429 4;
BA_ "DiagRequest" BO_ 2549880590 1;
BA_ "MsgType" BO_ 2549880590 4;
BA_ "DiagResponse" BO_ 2550011662 1;
BA_ "MsgType" BO_ 2550011662 4;
BA_ "DiagRequest" BO_ 2549880591 1;
BA_ "MsgType" BO_ 2549880591 4;
BA_ "DiagResponse" BO_ 2550011663 1;
BA_ "MsgType" BO_ 2550011663 4;
BA_ "DiagRequest" BO_ 2549880592 1;
BA_ "MsgType" BO_ 2549880592 4;
BA_ "DiagResponse" BO_ 2550011664 1;
BA_ "MsgType" BO_ 2550011664 4;
BA_ "DiagRequest" BO_ 2549880612 1;
BA_ "MsgType" BO_ 2549880612 4;
BA_ "DiagResponse" BO_ 2550011684 1;
BA_ "MsgType" BO_ 2550011684 4;
BA_ "DiagRequest" BO_ 2549880787 1;
BA_ "MsgType" BO_ 2549880787 4;
BA_ "DiagResponse" BO_ 2550011859 1;
BA_ "MsgType" BO_ 2550011859 4;
BA_ "DiagRequest" BO_ 2549880786 1;
BA_ "MsgType" BO_ 2549880786 4;
BA_ "DiagResponse" BO_ 2550011858 1;
BA_ "MsgType" BO_ 2550011858 4;
BA_ "DiagRequest" BO_ 2549880324 1;
BA_ "MsgType" BO_ 2549880324 4;
BA_ "DiagResponse" BO_ 2550011396 1;
BA_ "MsgType" BO_ 2550011396 4;
BA_ "DiagRequest" BO_ 2549880434 1;
BA_ "MsgType" BO_ 2549880434 4;
BA_ "DiagResponse" BO_ 2550011506 1;
BA_ "MsgType" BO_ 2550011506 4;
BA_ "DiagRequest" BO_ 2549880679 1;
BA_ "MsgType" BO_ 2549880679 4;
BA_ "DiagResponse" BO_ 2550011751 1;
BA_ "MsgType" BO_ 2550011751 4;
BA_ "DiagRequest" BO_ 2549880680 1;
BA_ "MsgType" BO_ 2549880680 4;
BA_ "DiagResponse" BO_ 2550011752 1;
BA_ "MsgType" BO_ 2550011752 4;
BA_ "DiagRequest" BO_ 2549880321 1;
BA_ "MsgType" BO_ 2549880321 4;
BA_ "DiagResponse" BO_ 2550011393 1;
BA_ "MsgType" BO_ 2550011393 4;
BA_ "DiagRequest" BO_ 1863 1;
BA_ "MsgType" BO_ 1863 4;
BA_ "DiagResponse" BO_ 1969 1;
BA_ "MsgType" BO_ 1969 4;
BA_ "DiagRequest" BO_ 1811 1;
BA_ "MsgType" BO_ 1811 4;
BA_ "DiagResponse" BO_ 1917 1;
BA_ "MsgType" BO_ 1917 4;
BA_ "DiagRequest" BO_ 1879 1;
BA_ "MsgType" BO_ 1879 4;
BA_ "DiagResponse" BO_ 1985 1;
BA_ "MsgType" BO_ 1985 4;
BA_ "DiagRequest" BO_ 1838 1;
BA_ "MsgType" BO_ 1838 4;
BA_ "DiagResponse" BO_ 1944 1;
BA_ "MsgType" BO_ 1944 4;
BA_ "DiagRequest" BO_ 1892 1;
BA_ "MsgType" BO_ 1892 4;
BA_ "DiagResponse" BO_ 1998 1;
BA_ "MsgType" BO_ 1998 4;
BA_ "DiagRequest" BO_ 1813 1;
BA_ "MsgType" BO_ 1813 4;
BA_ "DiagResponse" BO_ 1919 1;
BA_ "MsgType" BO_ 1919 4;
BA_ "DiagRequest" BO_ 1807 1;
BA_ "MsgType" BO_ 1807 4;
BA_ "DiagResponse" BO_ 1913 1;
BA_ "MsgType" BO_ 1913 4;
BA_ "DiagRequest" BO_ 1903 1;
BA_ "MsgType" BO_ 1903 4;
BA_ "DiagResponse" BO_ 2009 1;
BA_ "MsgType" BO_ 2009 4;
BA_ "DiagRequest" BO_ 1806 1;
BA_ "MsgType" BO_ 1806 4;
BA_ "DiagResponse" BO_ 1912 1;
BA_ "MsgType" BO_ 1912 4;
BA_ "DiagRequest" BO_ 1857 1;
BA_ "MsgType" BO_ 1857 4;
BA_ "DiagResponse" BO_ 1963 1;
BA_ "MsgType" BO_ 1963 4;
BA_ "DiagRequest" BO_ 1851 1;
BA_ "MsgType" BO_ 1851 4;
BA_ "DiagResponse" BO_ 1957 1;
BA_ "MsgType" BO_ 1957 4;
BA_ "DiagRequest" BO_ 1895 1;
BA_ "MsgType" BO_ 1895 4;
BA_ "DiagResponse" BO_ 2001 1;
BA_ "MsgType" BO_ 2001 4;
BA_ "DiagRequest" BO_ 1841 1;
BA_ "MsgType" BO_ 1841 4;
BA_ "DiagResponse" BO_ 1947 1;
BA_ "MsgType" BO_ 1947 4;
BA_ "DiagRequest" BO_ 1859 1;
BA_ "MsgType" BO_ 1859 4;
BA_ "DiagResponse" BO_ 1965 1;
BA_ "MsgType" BO_ 1965 4;
BA_ "DiagRequest" BO_ 1840 1;
BA_ "MsgType" BO_ 1840 4;
BA_ "DiagResponse" BO_ 1946 1;
BA_ "MsgType" BO_ 1946 4;
BA_ "DiagState" BO_ 1795 1;
BA_ "MsgType" BO_ 1795 4;
BA_ "DiagState" BO_ 1792 1;
BA_ "MsgType" BO_ 1792 4;
BA_ "DiagState" BO_ 2015 1;
BA_ "MsgType" BO_ 2015 4;
BA_ "DiagRequest" BO_ 1808 1;
BA_ "MsgType" BO_ 1808 4;
BA_ "DiagResponse" BO_ 1914 1;
BA_ "MsgType" BO_ 1914 4;
BA_ "DiagRequest" BO_ 2017 1;
BA_ "MsgType" BO_ 2017 4;
BA_ "DiagResponse" BO_ 2025 1;
BA_ "MsgType" BO_ 2025 4;
BA_ "DiagRequest" BO_ 1891 1;
BA_ "MsgType" BO_ 1891 4;
BA_ "DiagResponse" BO_ 1997 1;
BA_ "MsgType" BO_ 1997 4;
BA_ "GenSigSendType" SG_ 2549880614 DIA_AAU_Req_Data 3;
BA_ "GenSigFuncType" SG_ 2549880614 DIA_AAU_Req_Data 9;
BA_ "GenSigSwitchedByIgnition" SG_ 2549880614 DIA_AAU_Req_Data 0;
BA_ "GenSigSendType" SG_ 2550011686 DIA_AAU_Resp_Data 3;
BA_ "GenSigFuncType" SG_ 2550011686 DIA_AAU_Resp_Data 9;
BA_ "GenSigSwitchedByIgnition" SG_ 2550011686 DIA_AAU_Resp_Data 0;
BA_ "GenSigSendType" SG_ 2549880464 DIA_ASTA_Req_Data 3;
BA_ "GenSigFuncType" SG_ 2549880464 DIA_ASTA_Req_Data 9;
BA_ "GenSigSwitchedByIgnition" SG_ 2549880464 DIA_ASTA_Req_Data 0;
BA_ "GenSigSendType" SG_ 2550011536 DIA_ASTA_Resp_Data 3;
BA_ "GenSigFuncType" SG_ 2550011536 DIA_ASTA_Resp_Data 9;
BA_ "GenSigSwitchedByIgnition" SG_ 2550011536 DIA_ASTA_Resp_Data 0;
BA_ "GenSigSendType" SG_ 2549880567 DIA_ATFP_Req_Data 3;
BA_ "GenSigFuncType" SG_ 2549880567 DIA_ATFP_Req_Data 9;
BA_ "GenSigSwitchedByIgnition" SG_ 2549880567 DIA_ATFP_Req_Data 0;
BA_ "GenSigSendType" SG_ 2550011639 DIA_ATFP_Resp_Data 3;
BA_ "GenSigFuncType" SG_ 2550011639 DIA_ATFP_Resp_Data 9;
BA_ "GenSigSwitchedByIgnition" SG_ 2550011639 DIA_ATFP_Resp_Data 0;
BA_ "GenSigSendType" SG_ 2549880375 DIA_BDM_Req_Data 3;
BA_ "GenSigFuncType" SG_ 2549880375 DIA_BDM_Req_Data 9;
BA_ "GenSigSwitchedByIgnition" SG_ 2549880375 DIA_BDM_Req_Data 0;
BA_ "GenSigSendType" SG_ 2550011447 DIA_BDM_Resp_Data 3;
BA_ "GenSigFuncType" SG_ 2550011447 DIA_BDM_Resp_Data 9;
BA_ "GenSigSwitchedByIgnition" SG_ 2550011447 DIA_BDM_Resp_Data 0;
BA_ "GenSigSendType" SG_ 2549880528 DIA_BJB_Req_Data 3;
BA_ "GenSigFuncType" SG_ 2549880528 DIA_BJB_Req_Data 9;
BA_ "GenSigSwitchedByIgnition" SG_ 2549880528 DIA_BJB_Req_Data 0;
BA_ "GenSigSendType" SG_ 2550011600 DIA_BJB_Resp_Data 3;
BA_ "GenSigFuncType" SG_ 2550011600 DIA_BJB_Resp_Data 9;
BA_ "GenSigSwitchedByIgnition" SG_ 2550011600 DIA_BJB_Resp_Data 0;
BA_ "GenSigSendType" SG_ 2549880588 DIA_CCU_Req_Data 3;
BA_ "GenSigFuncType" SG_ 2549880588 DIA_CCU_Req_Data 9;
BA_ "GenSigSwitchedByIgnition" SG_ 2549880588 DIA_CCU_Req_Data 0;
BA_ "GenSigSendType" SG_ 2550011660 DIA_CCU_Resp_Data 3;
BA_ "GenSigFuncType" SG_ 2550011660 DIA_CCU_Resp_Data 9;
BA_ "GenSigSwitchedByIgnition" SG_ 2550011660 DIA_CCU_Resp_Data 0;
BA_ "GenSigSendType" SG_ 2549880529 DIA_CMC_01_Req_Data 3;
BA_ "GenSigFuncType" SG_ 2549880529 DIA_CMC_01_Req_Data 9;
BA_ "GenSigSwitchedByIgnition" SG_ 2549880529 DIA_CMC_01_Req_Data 0;
BA_ "GenSigSendType" SG_ 2550011601 DIA_CMC_01_Resp_Data 3;
BA_ "GenSigFuncType" SG_ 2550011601 DIA_CMC_01_Resp_Data 9;
BA_ "GenSigSwitchedByIgnition" SG_ 2550011601 DIA_CMC_01_Resp_Data 0;
BA_ "GenSigSendType" SG_ 2549880530 DIA_CMC_02_Req_Data 3;
BA_ "GenSigFuncType" SG_ 2549880530 DIA_CMC_02_Req_Data 9;
BA_ "GenSigSwitchedByIgnition" SG_ 2549880530 DIA_CMC_02_Req_Data 0;
BA_ "GenSigSendType" SG_ 2550011602 DIA_CMC_02_Resp_Data 3;
BA_ "GenSigFuncType" SG_ 2550011602 DIA_CMC_02_Resp_Data 9;
BA_ "GenSigSwitchedByIgnition" SG_ 2550011602 DIA_CMC_02_Resp_Data 0;
BA_ "GenSigSendType" SG_ 2549880531 DIA_CMC_03_Req_Data 3;
BA_ "GenSigFuncType" SG_ 2549880531 DIA_CMC_03_Req_Data 9;
BA_ "GenSigSwitchedByIgnition" SG_ 2549880531 DIA_CMC_03_Req_Data 0;
BA_ "GenSigSendType" SG_ 2550011603 DIA_CMC_03_Resp_Data 3;
BA_ "GenSigFuncType" SG_ 2550011603 DIA_CMC_03_Resp_Data 9;
BA_ "GenSigSwitchedByIgnition" SG_ 2550011603 DIA_CMC_03_Resp_Data 0;
BA_ "GenSigSendType" SG_ 2549880532 DIA_CMC_04_Req_Data 3;
BA_ "GenSigFuncType" SG_ 2549880532 DIA_CMC_04_Req_Data 9;
BA_ "GenSigSwitchedByIgnition" SG_ 2549880532 DIA_CMC_04_Req_Data 0;
BA_ "GenSigSendType" SG_ 2550011604 DIA_CMC_04_Resp_Data 3;
BA_ "GenSigFuncType" SG_ 2550011604 DIA_CMC_04_Resp_Data 9;
BA_ "GenSigSwitchedByIgnition" SG_ 2550011604 DIA_CMC_04_Resp_Data 0;
BA_ "GenSigSendType" SG_ 2549880533 DIA_CMC_05_Req_Data 3;
BA_ "GenSigFuncType" SG_ 2549880533 DIA_CMC_05_Req_Data 9;
BA_ "GenSigSwitchedByIgnition" SG_ 2549880533 DIA_CMC_05_Req_Data 0;
BA_ "GenSigSendType" SG_ 2550011605 DIA_CMC_05_Resp_Data 3;
BA_ "GenSigFuncType" SG_ 2550011605 DIA_CMC_05_Resp_Data 9;
BA_ "GenSigSwitchedByIgnition" SG_ 2550011605 DIA_CMC_05_Resp_Data 0;
BA_ "GenSigSendType" SG_ 2549880534 DIA_CMC_06_Req_Data 3;
BA_ "GenSigFuncType" SG_ 2549880534 DIA_CMC_06_Req_Data 9;
BA_ "GenSigSwitchedByIgnition" SG_ 2549880534 DIA_CMC_06_Req_Data 0;
BA_ "GenSigSendType" SG_ 2550011606 DIA_CMC_06_Resp_Data 3;
BA_ "GenSigFuncType" SG_ 2550011606 DIA_CMC_06_Resp_Data 9;
BA_ "GenSigSwitchedByIgnition" SG_ 2550011606 DIA_CMC_06_Resp_Data 0;
BA_ "GenSigSendType" SG_ 2549880535 DIA_CMC_07_Req_Data 3;
BA_ "GenSigFuncType" SG_ 2549880535 DIA_CMC_07_Req_Data 9;
BA_ "GenSigSwitchedByIgnition" SG_ 2549880535 DIA_CMC_07_Req_Data 0;
BA_ "GenSigSendType" SG_ 2550011607 DIA_CMC_07_Resp_Data 3;
BA_ "GenSigFuncType" SG_ 2550011607 DIA_CMC_07_Resp_Data 9;
BA_ "GenSigSwitchedByIgnition" SG_ 2550011607 DIA_CMC_07_Resp_Data 0;
BA_ "GenSigSendType" SG_ 2549880536 DIA_CMC_08_Req_Data 3;
BA_ "GenSigFuncType" SG_ 2549880536 DIA_CMC_08_Req_Data 9;
BA_ "GenSigSwitchedByIgnition" SG_ 2549880536 DIA_CMC_08_Req_Data 0;
BA_ "GenSigSendType" SG_ 2550011608 DIA_CMC_08_Resp_Data 3;
BA_ "GenSigFuncType" SG_ 2550011608 DIA_CMC_08_Resp_Data 9;
BA_ "GenSigSwitchedByIgnition" SG_ 2550011608 DIA_CMC_08_Resp_Data 0;
BA_ "GenSigSendType" SG_ 2549880537 DIA_CMC_09_Req_Data 3;
BA_ "GenSigFuncType" SG_ 2549880537 DIA_CMC_09_Req_Data 9;
BA_ "GenSigSwitchedByIgnition" SG_ 2549880537 DIA_CMC_09_Req_Data 0;
BA_ "GenSigSendType" SG_ 2550011609 DIA_CMC_09_Resp_Data 3;
BA_ "GenSigFuncType" SG_ 2550011609 DIA_CMC_09_Resp_Data 9;
BA_ "GenSigSwitchedByIgnition" SG_ 2550011609 DIA_CMC_09_Resp_Data 0;
BA_ "GenSigSendType" SG_ 2549880538 DIA_CMC_10_Req_Data 3;
BA_ "GenSigFuncType" SG_ 2549880538 DIA_CMC_10_Req_Data 9;
BA_ "GenSigSwitchedByIgnition" SG_ 2549880538 DIA_CMC_10_Req_Data 0;
BA_ "GenSigSendType" SG_ 2550011610 DIA_CMC_10_Resp_Data 3;
BA_ "GenSigFuncType" SG_ 2550011610 DIA_CMC_10_Resp_Data 9;
BA_ "GenSigSwitchedByIgnition" SG_ 2550011610 DIA_CMC_10_Resp_Data 0;
BA_ "GenSigSendType" SG_ 2549880539 DIA_CMC_11_Req_Data 3;
BA_ "GenSigFuncType" SG_ 2549880539 DIA_CMC_11_Req_Data 9;
BA_ "GenSigSwitchedByIgnition" SG_ 2549880539 DIA_CMC_11_Req_Data 0;
BA_ "GenSigSendType" SG_ 2550011611 DIA_CMC_11_Resp_Data 3;
BA_ "GenSigFuncType" SG_ 2550011611 DIA_CMC_11_Resp_Data 9;
BA_ "GenSigSwitchedByIgnition" SG_ 2550011611 DIA_CMC_11_Resp_Data 0;
BA_ "GenSigSendType" SG_ 2549880540 DIA_CMC_12_Req_Data 3;
BA_ "GenSigFuncType" SG_ 2549880540 DIA_CMC_12_Req_Data 9;
BA_ "GenSigSwitchedByIgnition" SG_ 2549880540 DIA_CMC_12_Req_Data 0;
BA_ "GenSigSendType" SG_ 2550011612 DIA_CMC_12_Resp_Data 3;
BA_ "GenSigFuncType" SG_ 2550011612 DIA_CMC_12_Resp_Data 9;
BA_ "GenSigSwitchedByIgnition" SG_ 2550011612 DIA_CMC_12_Resp_Data 0;
BA_ "GenSigSendType" SG_ 2549880561 DIA_CMC_13_Req_Data 3;
BA_ "GenSigFuncType" SG_ 2549880561 DIA_CMC_13_Req_Data 9;
BA_ "GenSigSwitchedByIgnition" SG_ 2549880561 DIA_CMC_13_Req_Data 0;
BA_ "GenSigSendType" SG_ 2550011633 DIA_CMC_13_Resp_Data 3;
BA_ "GenSigFuncType" SG_ 2550011633 DIA_CMC_13_Resp_Data 9;
BA_ "GenSigSwitchedByIgnition" SG_ 2550011633 DIA_CMC_13_Resp_Data 0;
BA_ "GenSigSendType" SG_ 2549880562 DIA_CMC_14_Req_Data 3;
BA_ "GenSigFuncType" SG_ 2549880562 DIA_CMC_14_Req_Data 9;
BA_ "GenSigSwitchedByIgnition" SG_ 2549880562 DIA_CMC_14_Req_Data 0;
BA_ "GenSigSendType" SG_ 2550011634 DIA_CMC_14_Resp_Data 3;
BA_ "GenSigFuncType" SG_ 2550011634 DIA_CMC_14_Resp_Data 9;
BA_ "GenSigSwitchedByIgnition" SG_ 2550011634 DIA_CMC_14_Resp_Data 0;
BA_ "GenSigSendType" SG_ 2549880563 DIA_CMC_15_Req_Data 3;
BA_ "GenSigFuncType" SG_ 2549880563 DIA_CMC_15_Req_Data 9;
BA_ "GenSigSwitchedByIgnition" SG_ 2549880563 DIA_CMC_15_Req_Data 0;
BA_ "GenSigSendType" SG_ 2550011635 DIA_CMC_15_Resp_Data 3;
BA_ "GenSigFuncType" SG_ 2550011635 DIA_CMC_15_Resp_Data 9;
BA_ "GenSigSwitchedByIgnition" SG_ 2550011635 DIA_CMC_15_Resp_Data 0;
BA_ "GenSigSendType" SG_ 2549880717 DIA_eBooster2_Req_Data 3;
BA_ "GenSigFuncType" SG_ 2549880717 DIA_eBooster2_Req_Data 9;
BA_ "GenSigSwitchedByIgnition" SG_ 2549880717 DIA_eBooster2_Req_Data 0;
BA_ "GenSigSendType" SG_ 2550011789 DIA_eBooster2_Resp_Data 3;
BA_ "GenSigFuncType" SG_ 2550011789 DIA_eBooster2_Resp_Data 9;
BA_ "GenSigSwitchedByIgnition" SG_ 2550011789 DIA_eBooster2_Resp_Data 0;
BA_ "GenSigSendType" SG_ 2549880589 DIA_eBooster_Req_Data 3;
BA_ "GenSigFuncType" SG_ 2549880589 DIA_eBooster_Req_Data 9;
BA_ "GenSigSwitchedByIgnition" SG_ 2549880589 DIA_eBooster_Req_Data 0;
BA_ "GenSigSendType" SG_ 2550011661 DIA_eBooster_Resp_Data 3;
BA_ "GenSigFuncType" SG_ 2550011661 DIA_eBooster_Resp_Data 9;
BA_ "GenSigSwitchedByIgnition" SG_ 2550011661 DIA_eBooster_Resp_Data 0;
BA_ "GenSigSendType" SG_ 2549880632 DIA_EGS_Req_Data 3;
BA_ "GenSigFuncType" SG_ 2549880632 DIA_EGS_Req_Data 9;
BA_ "GenSigSwitchedByIgnition" SG_ 2549880632 DIA_EGS_Req_Data 0;
BA_ "GenSigSendType" SG_ 2550011704 DIA_EGS_Resp_Data 3;
BA_ "GenSigFuncType" SG_ 2550011704 DIA_EGS_Resp_Data 9;
BA_ "GenSigSwitchedByIgnition" SG_ 2550011704 DIA_EGS_Resp_Data 0;
BA_ "GenSigSendType" SG_ 2549880644 DIA_EKAT_Req_Data 3;
BA_ "GenSigFuncType" SG_ 2549880644 DIA_EKAT_Req_Data 9;
BA_ "GenSigSendType" SG_ 2550011716 DIA_EKAT_Resp_Data 3;
BA_ "GenSigFuncType" SG_ 2550011716 DIA_EKAT_Resp_Data 9;
BA_ "GenSigSendType" SG_ 2549880413 DIA_EKK_Req_Data 3;
BA_ "GenSigFuncType" SG_ 2549880413 DIA_EKK_Req_Data 9;
BA_ "GenSigSwitchedByIgnition" SG_ 2549880413 DIA_EKK_Req_Data 0;
BA_ "GenSigSendType" SG_ 2550011485 DIA_EKK_Resp_Data 3;
BA_ "GenSigFuncType" SG_ 2550011485 DIA_EKK_Resp_Data 9;
BA_ "GenSigSwitchedByIgnition" SG_ 2550011485 DIA_EKK_Resp_Data 0;
BA_ "GenSigSendType" SG_ 2549880393 DIA_EVLS_Req_Data 3;
BA_ "GenSigFuncType" SG_ 2549880393 DIA_EVLS_Req_Data 9;
BA_ "GenSigSwitchedByIgnition" SG_ 2549880393 DIA_EVLS_Req_Data 0;
BA_ "GenSigSendType" SG_ 2550011465 DIA_EVLS_Resp_Data 3;
BA_ "GenSigFuncType" SG_ 2550011465 DIA_EVLS_Resp_Data 9;
BA_ "GenSigSwitchedByIgnition" SG_ 2550011465 DIA_EVLS_Resp_Data 0;
BA_ "GenSigSendType" SG_ 2549880347 DIA_Geblaese_Req_Data 3;
BA_ "GenSigFuncType" SG_ 2549880347 DIA_Geblaese_Req_Data 9;
BA_ "GenSigSwitchedByIgnition" SG_ 2549880347 DIA_Geblaese_Req_Data 0;
BA_ "GenSigSendType" SG_ 2550011419 DIA_Geblaese_Resp_Data 3;
BA_ "GenSigFuncType" SG_ 2550011419 DIA_Geblaese_Resp_Data 9;
BA_ "GenSigSwitchedByIgnition" SG_ 2550011419 DIA_Geblaese_Resp_Data 0;
BA_ "GenSigSendType" SG_ 2549880340 DIA_gLW_LM_L_Req_Data 3;
BA_ "GenSigFuncType" SG_ 2549880340 DIA_gLW_LM_L_Req_Data 9;
BA_ "GenSigSwitchedByIgnition" SG_ 2549880340 DIA_gLW_LM_L_Req_Data 0;
BA_ "GenSigSendType" SG_ 2550011412 DIA_gLW_LM_L_Resp_Data 3;
BA_ "GenSigFuncType" SG_ 2550011412 DIA_gLW_LM_L_Resp_Data 9;
BA_ "GenSigSwitchedByIgnition" SG_ 2550011412 DIA_gLW_LM_L_Resp_Data 0;
BA_ "GenSigSendType" SG_ 2549880341 DIA_gLW_LM_R_Req_Data 3;
BA_ "GenSigFuncType" SG_ 2549880341 DIA_gLW_LM_R_Req_Data 9;
BA_ "GenSigSwitchedByIgnition" SG_ 2549880341 DIA_gLW_LM_R_Req_Data 0;
BA_ "GenSigSendType" SG_ 2550011413 DIA_gLW_LM_R_Resp_Data 3;
BA_ "GenSigFuncType" SG_ 2550011413 DIA_gLW_LM_R_Resp_Data 9;
BA_ "GenSigSwitchedByIgnition" SG_ 2550011413 DIA_gLW_LM_R_Resp_Data 0;
BA_ "GenSigSendType" SG_ 2549880471 DIA_GPM_Req_Data 3;
BA_ "GenSigFuncType" SG_ 2549880471 DIA_GPM_Req_Data 9;
BA_ "GenSigSendType" SG_ 2550011543 DIA_GPM_Resp_Data 3;
BA_ "GenSigFuncType" SG_ 2550011543 DIA_GPM_Resp_Data 9;
BA_ "GenSigSendType" SG_ 2549880401 DIA_HSP_Req_Data 3;
BA_ "GenSigFuncType" SG_ 2549880401 DIA_HSP_Req_Data 9;
BA_ "GenSigSwitchedByIgnition" SG_ 2549880401 DIA_HSP_Req_Data 0;
BA_ "GenSigSendType" SG_ 2550011473 DIA_HSP_Resp_Data 3;
BA_ "GenSigFuncType" SG_ 2550011473 DIA_HSP_Resp_Data 9;
BA_ "GenSigSwitchedByIgnition" SG_ 2550011473 DIA_HSP_Resp_Data 0;
BA_ "GenSigSendType" SG_ 2549880512 DIA_HV_H2_Req_Data 3;
BA_ "GenSigFuncType" SG_ 2549880512 DIA_HV_H2_Req_Data 9;
BA_ "GenSigSwitchedByIgnition" SG_ 2549880512 DIA_HV_H2_Req_Data 0;
BA_ "GenSigSendType" SG_ 2550011584 DIA_HV_H2_Resp_Data 3;
BA_ "GenSigFuncType" SG_ 2550011584 DIA_HV_H2_Resp_Data 9;
BA_ "GenSigSwitchedByIgnition" SG_ 2550011584 DIA_HV_H2_Resp_Data 0;
BA_ "GenSigSendType" SG_ 2549880509 DIA_IVB1_BFS_Req_Data 3;
BA_ "GenSigFuncType" SG_ 2549880509 DIA_IVB1_BFS_Req_Data 9;
BA_ "GenSigSwitchedByIgnition" SG_ 2549880509 DIA_IVB1_BFS_Req_Data 0;
BA_ "GenSigSendType" SG_ 2550011581 DIA_IVB1_BFS_Resp_Data 3;
BA_ "GenSigFuncType" SG_ 2550011581 DIA_IVB1_BFS_Resp_Data 9;
BA_ "GenSigSwitchedByIgnition" SG_ 2550011581 DIA_IVB1_BFS_Resp_Data 0;
BA_ "GenSigSendType" SG_ 2549880505 DIA_IVB1_FS_Req_Data 3;
BA_ "GenSigFuncType" SG_ 2549880505 DIA_IVB1_FS_Req_Data 9;
BA_ "GenSigSwitchedByIgnition" SG_ 2549880505 DIA_IVB1_FS_Req_Data 0;
BA_ "GenSigSendType" SG_ 2550011577 DIA_IVB1_FS_Resp_Data 3;
BA_ "GenSigFuncType" SG_ 2550011577 DIA_IVB1_FS_Resp_Data 9;
BA_ "GenSigSwitchedByIgnition" SG_ 2550011577 DIA_IVB1_FS_Resp_Data 0;
BA_ "GenSigSendType" SG_ 2549880501 DIA_IVB1_HBFS_Req_Data 3;
BA_ "GenSigFuncType" SG_ 2549880501 DIA_IVB1_HBFS_Req_Data 9;
BA_ "GenSigSwitchedByIgnition" SG_ 2549880501 DIA_IVB1_HBFS_Req_Data 0;
BA_ "GenSigSendType" SG_ 2550011573 DIA_IVB1_HBFS_Resp_Data 3;
BA_ "GenSigFuncType" SG_ 2550011573 DIA_IVB1_HBFS_Resp_Data 9;
BA_ "GenSigSwitchedByIgnition" SG_ 2550011573 DIA_IVB1_HBFS_Resp_Data 0;
BA_ "GenSigSendType" SG_ 2549880497 DIA_IVB1_HFS_Req_Data 3;
BA_ "GenSigFuncType" SG_ 2549880497 DIA_IVB1_HFS_Req_Data 9;
BA_ "GenSigSwitchedByIgnition" SG_ 2549880497 DIA_IVB1_HFS_Req_Data 0;
BA_ "GenSigSendType" SG_ 2550011569 DIA_IVB1_HFS_Resp_Data 3;
BA_ "GenSigFuncType" SG_ 2550011569 DIA_IVB1_HFS_Resp_Data 9;
BA_ "GenSigSwitchedByIgnition" SG_ 2550011569 DIA_IVB1_HFS_Resp_Data 0;
BA_ "GenSigSendType" SG_ 2549880577 DIA_KBF_Req_Data 3;
BA_ "GenSigFuncType" SG_ 2549880577 DIA_KBF_Req_Data 9;
BA_ "GenSigSwitchedByIgnition" SG_ 2549880577 DIA_KBF_Req_Data 0;
BA_ "GenSigSendType" SG_ 2550011649 DIA_KBF_Resp_Data 3;
BA_ "GenSigFuncType" SG_ 2550011649 DIA_KBF_Resp_Data 9;
BA_ "GenSigSwitchedByIgnition" SG_ 2550011649 DIA_KBF_Resp_Data 0;
BA_ "GenSigSendType" SG_ 2549880638 DIA_KLR_Req_Data 3;
BA_ "GenSigFuncType" SG_ 2549880638 DIA_KLR_Req_Data 9;
BA_ "GenSigSwitchedByIgnition" SG_ 2549880638 DIA_KLR_Req_Data 0;
BA_ "GenSigSendType" SG_ 2550011710 DIA_KLR_Resp_Data 3;
BA_ "GenSigFuncType" SG_ 2550011710 DIA_KLR_Resp_Data 9;
BA_ "GenSigSwitchedByIgnition" SG_ 2550011710 DIA_KLR_Resp_Data 0;
BA_ "GenSigSendType" SG_ 2549880639 DIA_KPV_Req_Data 3;
BA_ "GenSigFuncType" SG_ 2549880639 DIA_KPV_Req_Data 9;
BA_ "GenSigSwitchedByIgnition" SG_ 2549880639 DIA_KPV_Req_Data 0;
BA_ "GenSigSendType" SG_ 2550011711 DIA_KPV_Resp_Data 3;
BA_ "GenSigFuncType" SG_ 2550011711 DIA_KPV_Resp_Data 9;
BA_ "GenSigSwitchedByIgnition" SG_ 2550011711 DIA_KPV_Resp_Data 0;
BA_ "GenSigSendType" SG_ 2549880459 DIA_KWS_Req_Data 3;
BA_ "GenSigFuncType" SG_ 2549880459 DIA_KWS_Req_Data 9;
BA_ "GenSigSwitchedByIgnition" SG_ 2549880459 DIA_KWS_Req_Data 0;
BA_ "GenSigSendType" SG_ 2550011531 DIA_KWS_Resp_Data 3;
BA_ "GenSigFuncType" SG_ 2550011531 DIA_KWS_Resp_Data 9;
BA_ "GenSigSwitchedByIgnition" SG_ 2550011531 DIA_KWS_Resp_Data 0;
BA_ "GenSigSendType" SG_ 2549880330 DIA_LED_LM_L_Req_Data 3;
BA_ "GenSigFuncType" SG_ 2549880330 DIA_LED_LM_L_Req_Data 9;
BA_ "GenSigSwitchedByIgnition" SG_ 2549880330 DIA_LED_LM_L_Req_Data 0;
BA_ "GenSigSendType" SG_ 2550011402 DIA_LED_LM_L_Resp_Data 3;
BA_ "GenSigFuncType" SG_ 2550011402 DIA_LED_LM_L_Resp_Data 9;
BA_ "GenSigSwitchedByIgnition" SG_ 2550011402 DIA_LED_LM_L_Resp_Data 0;
BA_ "GenSigSendType" SG_ 2549880331 DIA_LED_LM_R_Req_Data 3;
BA_ "GenSigFuncType" SG_ 2549880331 DIA_LED_LM_R_Req_Data 9;
BA_ "GenSigSwitchedByIgnition" SG_ 2549880331 DIA_LED_LM_R_Req_Data 0;
BA_ "GenSigSendType" SG_ 2550011403 DIA_LED_LM_R_Resp_Data 3;
BA_ "GenSigFuncType" SG_ 2550011403 DIA_LED_LM_R_Resp_Data 9;
BA_ "GenSigSwitchedByIgnition" SG_ 2550011403 DIA_LED_LM_R_Resp_Data 0;
BA_ "GenSigSendType" SG_ 2549880633 DIA_LIM_2_Req_Data 3;
BA_ "GenSigFuncType" SG_ 2549880633 DIA_LIM_2_Req_Data 9;
BA_ "GenSigSwitchedByIgnition" SG_ 2549880633 DIA_LIM_2_Req_Data 0;
BA_ "GenSigSendType" SG_ 2550011705 DIA_LIM_2_Resp_Data 3;
BA_ "GenSigFuncType" SG_ 2550011705 DIA_LIM_2_Resp_Data 9;
BA_ "GenSigSwitchedByIgnition" SG_ 2550011705 DIA_LIM_2_Resp_Data 0;
BA_ "GenSigSendType" SG_ 2549880350 DIA_LIM_Req_Data 3;
BA_ "GenSigFuncType" SG_ 2549880350 DIA_LIM_Req_Data 9;
BA_ "GenSigSwitchedByIgnition" SG_ 2549880350 DIA_LIM_Req_Data 0;
BA_ "GenSigSendType" SG_ 2550011422 DIA_LIM_Resp_Data 3;
BA_ "GenSigFuncType" SG_ 2550011422 DIA_LIM_Resp_Data 9;
BA_ "GenSigSwitchedByIgnition" SG_ 2550011422 DIA_LIM_Resp_Data 0;
BA_ "GenSigSendType" SG_ 2549880369 DIA_MFL_Req_Data 3;
BA_ "GenSigFuncType" SG_ 2549880369 DIA_MFL_Req_Data 9;
BA_ "GenSigSwitchedByIgnition" SG_ 2549880369 DIA_MFL_Req_Data 0;
BA_ "GenSigSendType" SG_ 2550011441 DIA_MFL_Resp_Data 3;
BA_ "GenSigFuncType" SG_ 2550011441 DIA_MFL_Resp_Data 9;
BA_ "GenSigSwitchedByIgnition" SG_ 2550011441 DIA_MFL_Resp_Data 0;
BA_ "GenSigSendType" SG_ 2549880568 DIA_MTFP_Req_Data 3;
BA_ "GenSigFuncType" SG_ 2549880568 DIA_MTFP_Req_Data 9;
BA_ "GenSigSwitchedByIgnition" SG_ 2549880568 DIA_MTFP_Req_Data 0;
BA_ "GenSigSendType" SG_ 2550011640 DIA_MTFP_Resp_Data 3;
BA_ "GenSigFuncType" SG_ 2550011640 DIA_MTFP_Resp_Data 9;
BA_ "GenSigSwitchedByIgnition" SG_ 2550011640 DIA_MTFP_Resp_Data 0;
BA_ "GenSigSendType" SG_ 2549880510 DIA_MVB1_BFS_Req_Data 3;
BA_ "GenSigFuncType" SG_ 2549880510 DIA_MVB1_BFS_Req_Data 9;
BA_ "GenSigSwitchedByIgnition" SG_ 2549880510 DIA_MVB1_BFS_Req_Data 0;
BA_ "GenSigSendType" SG_ 2550011582 DIA_MVB1_BFS_Resp_Data 3;
BA_ "GenSigFuncType" SG_ 2550011582 DIA_MVB1_BFS_Resp_Data 9;
BA_ "GenSigSwitchedByIgnition" SG_ 2550011582 DIA_MVB1_BFS_Resp_Data 0;
BA_ "GenSigSendType" SG_ 2549880506 DIA_MVB1_FS_Req_Data 3;
BA_ "GenSigFuncType" SG_ 2549880506 DIA_MVB1_FS_Req_Data 9;
BA_ "GenSigSwitchedByIgnition" SG_ 2549880506 DIA_MVB1_FS_Req_Data 0;
BA_ "GenSigSendType" SG_ 2550011578 DIA_MVB1_FS_Resp_Data 3;
BA_ "GenSigFuncType" SG_ 2550011578 DIA_MVB1_FS_Resp_Data 9;
BA_ "GenSigSwitchedByIgnition" SG_ 2550011578 DIA_MVB1_FS_Resp_Data 0;
BA_ "GenSigSendType" SG_ 2549880502 DIA_MVB1_HBFS_Req_Data 3;
BA_ "GenSigFuncType" SG_ 2549880502 DIA_MVB1_HBFS_Req_Data 9;
BA_ "GenSigSwitchedByIgnition" SG_ 2549880502 DIA_MVB1_HBFS_Req_Data 0;
BA_ "GenSigSendType" SG_ 2550011574 DIA_MVB1_HBFS_Resp_Data 3;
BA_ "GenSigFuncType" SG_ 2550011574 DIA_MVB1_HBFS_Resp_Data 9;
BA_ "GenSigSwitchedByIgnition" SG_ 2550011574 DIA_MVB1_HBFS_Resp_Data 0;
BA_ "GenSigSendType" SG_ 2549880498 DIA_MVB1_HFS_Req_Data 3;
BA_ "GenSigFuncType" SG_ 2549880498 DIA_MVB1_HFS_Req_Data 9;
BA_ "GenSigSwitchedByIgnition" SG_ 2549880498 DIA_MVB1_HFS_Req_Data 0;
BA_ "GenSigSendType" SG_ 2550011570 DIA_MVB1_HFS_Resp_Data 3;
BA_ "GenSigFuncType" SG_ 2550011570 DIA_MVB1_HFS_Resp_Data 9;
BA_ "GenSigSwitchedByIgnition" SG_ 2550011570 DIA_MVB1_HFS_Resp_Data 0;
BA_ "GenSigSendType" SG_ 2549880511 DIA_MVB2_BFS_Req_Data 3;
BA_ "GenSigFuncType" SG_ 2549880511 DIA_MVB2_BFS_Req_Data 9;
BA_ "GenSigSwitchedByIgnition" SG_ 2549880511 DIA_MVB2_BFS_Req_Data 0;
BA_ "GenSigSendType" SG_ 2550011583 DIA_MVB2_BFS_Resp_Data 3;
BA_ "GenSigFuncType" SG_ 2550011583 DIA_MVB2_BFS_Resp_Data 9;
BA_ "GenSigSwitchedByIgnition" SG_ 2550011583 DIA_MVB2_BFS_Resp_Data 0;
BA_ "GenSigSendType" SG_ 2549880507 DIA_MVB2_FS_Req_Data 3;
BA_ "GenSigFuncType" SG_ 2549880507 DIA_MVB2_FS_Req_Data 9;
BA_ "GenSigSwitchedByIgnition" SG_ 2549880507 DIA_MVB2_FS_Req_Data 0;
BA_ "GenSigSendType" SG_ 2550011579 DIA_MVB2_FS_Resp_Data 3;
BA_ "GenSigFuncType" SG_ 2550011579 DIA_MVB2_FS_Resp_Data 9;
BA_ "GenSigSwitchedByIgnition" SG_ 2550011579 DIA_MVB2_FS_Resp_Data 0;
BA_ "GenSigSendType" SG_ 2549880503 DIA_MVB2_HBFS_Req_Data 3;
BA_ "GenSigFuncType" SG_ 2549880503 DIA_MVB2_HBFS_Req_Data 9;
BA_ "GenSigSwitchedByIgnition" SG_ 2549880503 DIA_MVB2_HBFS_Req_Data 0;
BA_ "GenSigSendType" SG_ 2550011575 DIA_MVB2_HBFS_Resp_Data 3;
BA_ "GenSigFuncType" SG_ 2550011575 DIA_MVB2_HBFS_Resp_Data 9;
BA_ "GenSigSwitchedByIgnition" SG_ 2550011575 DIA_MVB2_HBFS_Resp_Data 0;
BA_ "GenSigSendType" SG_ 2549880499 DIA_MVB2_HFS_Req_Data 3;
BA_ "GenSigFuncType" SG_ 2549880499 DIA_MVB2_HFS_Req_Data 9;
BA_ "GenSigSwitchedByIgnition" SG_ 2549880499 DIA_MVB2_HFS_Req_Data 0;
BA_ "GenSigSendType" SG_ 2550011571 DIA_MVB2_HFS_Resp_Data 3;
BA_ "GenSigFuncType" SG_ 2550011571 DIA_MVB2_HFS_Resp_Data 9;
BA_ "GenSigSwitchedByIgnition" SG_ 2550011571 DIA_MVB2_HFS_Resp_Data 0;
BA_ "GenSigSendType" SG_ 2549880427 DIA_MXB_LM_L_Req_Data 3;
BA_ "GenSigFuncType" SG_ 2549880427 DIA_MXB_LM_L_Req_Data 9;
BA_ "GenSigSwitchedByIgnition" SG_ 2549880427 DIA_MXB_LM_L_Req_Data 0;
BA_ "GenSigSendType" SG_ 2550011499 DIA_MXB_LM_L_Resp_Data 3;
BA_ "GenSigFuncType" SG_ 2550011499 DIA_MXB_LM_L_Resp_Data 9;
BA_ "GenSigSwitchedByIgnition" SG_ 2550011499 DIA_MXB_LM_L_Resp_Data 0;
BA_ "GenSigSendType" SG_ 2549880428 DIA_MXB_LM_R_Req_Data 3;
BA_ "GenSigFuncType" SG_ 2549880428 DIA_MXB_LM_R_Req_Data 9;
BA_ "GenSigSwitchedByIgnition" SG_ 2549880428 DIA_MXB_LM_R_Req_Data 0;
BA_ "GenSigSendType" SG_ 2550011500 DIA_MXB_LM_R_Resp_Data 3;
BA_ "GenSigFuncType" SG_ 2550011500 DIA_MXB_LM_R_Resp_Data 9;
BA_ "GenSigSwitchedByIgnition" SG_ 2550011500 DIA_MXB_LM_R_Resp_Data 0;
BA_ "GenSigSendType" SG_ 2549880587 DIA_NFC_MiKo_Req_Data 3;
BA_ "GenSigFuncType" SG_ 2549880587 DIA_NFC_MiKo_Req_Data 9;
BA_ "GenSigSwitchedByIgnition" SG_ 2549880587 DIA_NFC_MiKo_Req_Data 0;
BA_ "GenSigSendType" SG_ 2550011659 DIA_NFC_MiKo_Resp_Data 3;
BA_ "GenSigFuncType" SG_ 2550011659 DIA_NFC_MiKo_Resp_Data 9;
BA_ "GenSigSwitchedByIgnition" SG_ 2550011659 DIA_NFC_MiKo_Resp_Data 0;
BA_ "GenSigSendType" SG_ 2549880555 DIA_NFC_TGS_Req_Data 3;
BA_ "GenSigFuncType" SG_ 2549880555 DIA_NFC_TGS_Req_Data 9;
BA_ "GenSigSwitchedByIgnition" SG_ 2549880555 DIA_NFC_TGS_Req_Data 0;
BA_ "GenSigSendType" SG_ 2550011627 DIA_NFC_TGS_Resp_Data 3;
BA_ "GenSigFuncType" SG_ 2550011627 DIA_NFC_TGS_Resp_Data 9;
BA_ "GenSigSwitchedByIgnition" SG_ 2550011627 DIA_NFC_TGS_Resp_Data 0;
BA_ "GenSigSendType" SG_ 2549880670 DIA_NS_VL_Req_Data 3;
BA_ "GenSigFuncType" SG_ 2549880670 DIA_NS_VL_Req_Data 9;
BA_ "GenSigSwitchedByIgnition" SG_ 2549880670 DIA_NS_VL_Req_Data 0;
BA_ "GenSigSendType" SG_ 2550011742 DIA_NS_VL_Resp_Data 3;
BA_ "GenSigFuncType" SG_ 2550011742 DIA_NS_VL_Resp_Data 9;
BA_ "GenSigSwitchedByIgnition" SG_ 2550011742 DIA_NS_VL_Resp_Data 0;
BA_ "GenSigSendType" SG_ 2549880671 DIA_NS_VR_Req_Data 3;
BA_ "GenSigFuncType" SG_ 2549880671 DIA_NS_VR_Req_Data 9;
BA_ "GenSigSwitchedByIgnition" SG_ 2549880671 DIA_NS_VR_Req_Data 0;
BA_ "GenSigSendType" SG_ 2550011743 DIA_NS_VR_Resp_Data 3;
BA_ "GenSigFuncType" SG_ 2550011743 DIA_NS_VR_Resp_Data 9;
BA_ "GenSigSwitchedByIgnition" SG_ 2550011743 DIA_NS_VR_Resp_Data 0;
BA_ "GenSigSendType" SG_ 2549880642 DIA_Parksperre_Req_Data 3;
BA_ "GenSigFuncType" SG_ 2549880642 DIA_Parksperre_Req_Data 9;
BA_ "GenSigSwitchedByIgnition" SG_ 2549880642 DIA_Parksperre_Req_Data 0;
BA_ "GenSigSendType" SG_ 2550011714 DIA_Parksperre_Resp_Data 3;
BA_ "GenSigFuncType" SG_ 2550011714 DIA_Parksperre_Resp_Data 9;
BA_ "GenSigSwitchedByIgnition" SG_ 2550011714 DIA_Parksperre_Resp_Data 0;
BA_ "GenSigSendType" SG_ 2549880714 DIA_PumpKM_2_Req_Data 3;
BA_ "GenSigFuncType" SG_ 2549880714 DIA_PumpKM_2_Req_Data 9;
BA_ "GenSigSwitchedByIgnition" SG_ 2549880714 DIA_PumpKM_2_Req_Data 0;
BA_ "GenSigSendType" SG_ 2550011786 DIA_PumpKM_2_Resp_Data 3;
BA_ "GenSigFuncType" SG_ 2550011786 DIA_PumpKM_2_Resp_Data 9;
BA_ "GenSigSwitchedByIgnition" SG_ 2550011786 DIA_PumpKM_2_Resp_Data 0;
BA_ "GenSigSendType" SG_ 2549880570 DIA_PumpWSt_Req_Data 3;
BA_ "GenSigFuncType" SG_ 2549880570 DIA_PumpWSt_Req_Data 9;
BA_ "GenSigSwitchedByIgnition" SG_ 2549880570 DIA_PumpWSt_Req_Data 0;
BA_ "GenSigSendType" SG_ 2550011642 DIA_PumpWSt_Resp_Data 3;
BA_ "GenSigFuncType" SG_ 2550011642 DIA_PumpWSt_Resp_Data 9;
BA_ "GenSigSwitchedByIgnition" SG_ 2550011642 DIA_PumpWSt_Resp_Data 0;
BA_ "GenSigSendType" SG_ 2549880747 DIA_SAAM_Req_Data 3;
BA_ "GenSigFuncType" SG_ 2549880747 DIA_SAAM_Req_Data 9;
BA_ "GenSigSwitchedByIgnition" SG_ 2549880747 DIA_SAAM_Req_Data 0;
BA_ "GenSigSendType" SG_ 2550011819 DIA_SAAM_Resp_Data 3;
BA_ "GenSigFuncType" SG_ 2550011819 DIA_SAAM_Resp_Data 9;
BA_ "GenSigSwitchedByIgnition" SG_ 2550011819 DIA_SAAM_Resp_Data 0;
BA_ "GenSigSendType" SG_ 2549880610 DIA_SCON1_Req_Data 3;
BA_ "GenSigFuncType" SG_ 2549880610 DIA_SCON1_Req_Data 9;
BA_ "GenSigSwitchedByIgnition" SG_ 2549880610 DIA_SCON1_Req_Data 0;
BA_ "GenSigSendType" SG_ 2550011682 DIA_SCON1_Resp_Data 3;
BA_ "GenSigFuncType" SG_ 2550011682 DIA_SCON1_Resp_Data 9;
BA_ "GenSigSwitchedByIgnition" SG_ 2550011682 DIA_SCON1_Resp_Data 0;
BA_ "GenSigSendType" SG_ 2549880611 DIA_SCON2_Req_Data 3;
BA_ "GenSigFuncType" SG_ 2549880611 DIA_SCON2_Req_Data 9;
BA_ "GenSigSwitchedByIgnition" SG_ 2549880611 DIA_SCON2_Req_Data 0;
BA_ "GenSigSendType" SG_ 2550011683 DIA_SCON2_Resp_Data 3;
BA_ "GenSigFuncType" SG_ 2550011683 DIA_SCON2_Resp_Data 9;
BA_ "GenSigSwitchedByIgnition" SG_ 2550011683 DIA_SCON2_Resp_Data 0;
BA_ "GenSigSendType" SG_ 2549880473 DIA_SD3_Req_Data 3;
BA_ "GenSigFuncType" SG_ 2549880473 DIA_SD3_Req_Data 9;
BA_ "GenSigSwitchedByIgnition" SG_ 2549880473 DIA_SD3_Req_Data 0;
BA_ "GenSigSendType" SG_ 2550011545 DIA_SD3_Resp_Data 3;
BA_ "GenSigFuncType" SG_ 2550011545 DIA_SD3_Resp_Data 9;
BA_ "GenSigSwitchedByIgnition" SG_ 2550011545 DIA_SD3_Resp_Data 0;
BA_ "GenSigSendType" SG_ 2549880474 DIA_SD4_Req_Data 3;
BA_ "GenSigFuncType" SG_ 2549880474 DIA_SD4_Req_Data 9;
BA_ "GenSigSwitchedByIgnition" SG_ 2549880474 DIA_SD4_Req_Data 0;
BA_ "GenSigSendType" SG_ 2550011546 DIA_SD4_Resp_Data 3;
BA_ "GenSigFuncType" SG_ 2550011546 DIA_SD4_Resp_Data 9;
BA_ "GenSigSwitchedByIgnition" SG_ 2550011546 DIA_SD4_Resp_Data 0;
BA_ "GenSigSendType" SG_ 2549880357 DIA_SHL_li1_Req_Data 3;
BA_ "GenSigFuncType" SG_ 2549880357 DIA_SHL_li1_Req_Data 9;
BA_ "GenSigSendType" SG_ 2550011429 DIA_SHL_li1_Resp_Data 3;
BA_ "GenSigFuncType" SG_ 2550011429 DIA_SHL_li1_Resp_Data 9;
BA_ "GenSigSendType" SG_ 2549880590 DIA_SHL_li2_Req_Data 3;
BA_ "GenSigFuncType" SG_ 2549880590 DIA_SHL_li2_Req_Data 9;
BA_ "GenSigSendType" SG_ 2550011662 DIA_SHL_li2_Resp_Data 3;
BA_ "GenSigFuncType" SG_ 2550011662 DIA_SHL_li2_Resp_Data 9;
BA_ "GenSigSendType" SG_ 2549880591 DIA_SHL_re1_Req_Data 3;
BA_ "GenSigFuncType" SG_ 2549880591 DIA_SHL_re1_Req_Data 9;
BA_ "GenSigSendType" SG_ 2550011663 DIA_SHL_re1_Resp_Data 3;
BA_ "GenSigFuncType" SG_ 2550011663 DIA_SHL_re1_Resp_Data 9;
BA_ "GenSigSendType" SG_ 2549880592 DIA_SHL_re2_Req_Data 3;
BA_ "GenSigFuncType" SG_ 2549880592 DIA_SHL_re2_Req_Data 9;
BA_ "GenSigSendType" SG_ 2550011664 DIA_SHL_re2_Resp_Data 3;
BA_ "GenSigFuncType" SG_ 2550011664 DIA_SHL_re2_Resp_Data 9;
BA_ "GenSigSendType" SG_ 2549880612 DIA_SWP_Req_Data 3;
BA_ "GenSigFuncType" SG_ 2549880612 DIA_SWP_Req_Data 9;
BA_ "GenSigSwitchedByIgnition" SG_ 2549880612 DIA_SWP_Req_Data 0;
BA_ "GenSigSendType" SG_ 2550011684 DIA_SWP_Resp_Data 3;
BA_ "GenSigFuncType" SG_ 2550011684 DIA_SWP_Resp_Data 9;
BA_ "GenSigSwitchedByIgnition" SG_ 2550011684 DIA_SWP_Resp_Data 0;
BA_ "GenSigSendType" SG_ 2549880787 DIA_TA_HBFS_Req_Data 3;
BA_ "GenSigFuncType" SG_ 2549880787 DIA_TA_HBFS_Req_Data 9;
BA_ "GenSigSwitchedByIgnition" SG_ 2549880787 DIA_TA_HBFS_Req_Data 0;
BA_ "GenSigSendType" SG_ 2550011859 DIA_TA_HBFS_Resp_Data 3;
BA_ "GenSigFuncType" SG_ 2550011859 DIA_TA_HBFS_Resp_Data 9;
BA_ "GenSigSwitchedByIgnition" SG_ 2550011859 DIA_TA_HBFS_Resp_Data 0;
BA_ "GenSigSendType" SG_ 2549880786 DIA_TA_HFS_Req_Data 3;
BA_ "GenSigFuncType" SG_ 2549880786 DIA_TA_HFS_Req_Data 9;
BA_ "GenSigSwitchedByIgnition" SG_ 2549880786 DIA_TA_HFS_Req_Data 0;
BA_ "GenSigSendType" SG_ 2550011858 DIA_TA_HFS_Resp_Data 3;
BA_ "GenSigFuncType" SG_ 2550011858 DIA_TA_HFS_Resp_Data 9;
BA_ "GenSigSwitchedByIgnition" SG_ 2550011858 DIA_TA_HFS_Resp_Data 0;
BA_ "GenSigSendType" SG_ 2549880324 DIA_UGDO_S_Req_Data 3;
BA_ "GenSigFuncType" SG_ 2549880324 DIA_UGDO_S_Req_Data 9;
BA_ "GenSigSwitchedByIgnition" SG_ 2549880324 DIA_UGDO_S_Req_Data 0;
BA_ "GenSigSendType" SG_ 2550011396 DIA_UGDO_S_Resp_Data 3;
BA_ "GenSigFuncType" SG_ 2550011396 DIA_UGDO_S_Resp_Data 9;
BA_ "GenSigSwitchedByIgnition" SG_ 2550011396 DIA_UGDO_S_Resp_Data 0;
BA_ "GenSigSendType" SG_ 2549880434 DIA_UHR_Req_Data 3;
BA_ "GenSigFuncType" SG_ 2549880434 DIA_UHR_Req_Data 9;
BA_ "GenSigSwitchedByIgnition" SG_ 2549880434 DIA_UHR_Req_Data 0;
BA_ "GenSigSendType" SG_ 2550011506 DIA_UHR_Resp_Data 3;
BA_ "GenSigFuncType" SG_ 2550011506 DIA_UHR_Resp_Data 9;
BA_ "GenSigSwitchedByIgnition" SG_ 2550011506 DIA_UHR_Resp_Data 0;
BA_ "GenSigSendType" SG_ 2549880679 DIA_WiBli_L_Req 3;
BA_ "GenSigFuncType" SG_ 2549880679 DIA_WiBli_L_Req 9;
BA_ "GenSigSwitchedByIgnition" SG_ 2549880679 DIA_WiBli_L_Req 0;
BA_ "GenSigSendType" SG_ 2550011751 DIA_WiBli_L_Resp 3;
BA_ "GenSigFuncType" SG_ 2550011751 DIA_WiBli_L_Resp 9;
BA_ "GenSigSwitchedByIgnition" SG_ 2550011751 DIA_WiBli_L_Resp 0;
BA_ "GenSigSendType" SG_ 2549880680 DIA_WiBli_R_Req 3;
BA_ "GenSigFuncType" SG_ 2549880680 DIA_WiBli_R_Req 9;
BA_ "GenSigSwitchedByIgnition" SG_ 2549880680 DIA_WiBli_R_Req 0;
BA_ "GenSigSendType" SG_ 2550011752 DIA_WiBli_R_Resp 3;
BA_ "GenSigFuncType" SG_ 2550011752 DIA_WiBli_R_Resp 9;
BA_ "GenSigSwitchedByIgnition" SG_ 2550011752 DIA_WiBli_R_Resp 0;
BA_ "GenSigSendType" SG_ 2549880321 DIA_WWS_Req_Data 3;
BA_ "GenSigFuncType" SG_ 2549880321 DIA_WWS_Req_Data 9;
BA_ "GenSigSwitchedByIgnition" SG_ 2549880321 DIA_WWS_Req_Data 0;
BA_ "GenSigSendType" SG_ 2550011393 DIA_WWS_Resp_Data 3;
BA_ "GenSigFuncType" SG_ 2550011393 DIA_WWS_Resp_Data 9;
BA_ "GenSigSwitchedByIgnition" SG_ 2550011393 DIA_WWS_Resp_Data 0;
BA_ "GenSigSendType" SG_ 1863 ISO_AAG_Req_Data 3;
BA_ "GenSigFuncType" SG_ 1863 ISO_AAG_Req_Data 9;
BA_ "GenSigSwitchedByIgnition" SG_ 1863 ISO_AAG_Req_Data 0;
BA_ "GenSigSendType" SG_ 1969 ISO_AAG_Resp_Data 3;
BA_ "GenSigFuncType" SG_ 1969 ISO_AAG_Resp_Data 9;
BA_ "GenSigSwitchedByIgnition" SG_ 1969 ISO_AAG_Resp_Data 0;
BA_ "GenSigSendType" SG_ 1811 ISO_ABS_Req_Data 3;
BA_ "GenSigFuncType" SG_ 1811 ISO_ABS_Req_Data 9;
BA_ "GenSigSwitchedByIgnition" SG_ 1811 ISO_ABS_Req_Data 0;
BA_ "GenSigSendType" SG_ 1917 ISO_ABS_Resp_Data 3;
BA_ "GenSigFuncType" SG_ 1917 ISO_ABS_Resp_Data 9;
BA_ "GenSigSwitchedByIgnition" SG_ 1917 ISO_ABS_Resp_Data 0;
BA_ "GenSigSendType" SG_ 1879 ISO_ACC_Req_Data 3;
BA_ "GenSigFuncType" SG_ 1879 ISO_ACC_Req_Data 9;
BA_ "GenSigSwitchedByIgnition" SG_ 1879 ISO_ACC_Req_Data 0;
BA_ "GenSigSendType" SG_ 1985 ISO_ACC_Resp_Data 3;
BA_ "GenSigFuncType" SG_ 1985 ISO_ACC_Resp_Data 9;
BA_ "GenSigSwitchedByIgnition" SG_ 1985 ISO_ACC_Resp_Data 0;
BA_ "GenSigSendType" SG_ 1838 ISO_AEM_Req_Data 3;
BA_ "GenSigFuncType" SG_ 1838 ISO_AEM_Req_Data 9;
BA_ "GenSigSwitchedByIgnition" SG_ 1838 ISO_AEM_Req_Data 0;
BA_ "GenSigSendType" SG_ 1944 ISO_AEM_Resp_Data 3;
BA_ "GenSigFuncType" SG_ 1944 ISO_AEM_Resp_Data 9;
BA_ "GenSigSendType" SG_ 1892 ISO_AGA_Req_Data 3;
BA_ "GenSigFuncType" SG_ 1892 ISO_AGA_Req_Data 9;
BA_ "GenSigSendType" SG_ 1998 ISO_AGA_Resp_Data 3;
BA_ "GenSigFuncType" SG_ 1998 ISO_AGA_Resp_Data 9;
BA_ "GenSigSendType" SG_ 1813 ISO_Airbag_01_Req_Data 3;
BA_ "GenSigFuncType" SG_ 1813 ISO_Airbag_01_Req_Data 9;
BA_ "GenSigSwitchedByIgnition" SG_ 1813 ISO_Airbag_01_Req_Data 0;
BA_ "GenSigSendType" SG_ 1919 ISO_Airbag_01_Resp_Data 3;
BA_ "GenSigFuncType" SG_ 1919 ISO_Airbag_01_Resp_Data 9;
BA_ "GenSigSwitchedByIgnition" SG_ 1919 ISO_Airbag_01_Resp_Data 0;
BA_ "GenSigSendType" SG_ 1807 ISO_Allrad_Req_Data 3;
BA_ "GenSigFuncType" SG_ 1807 ISO_Allrad_Req_Data 9;
BA_ "GenSigSendType" SG_ 1913 ISO_Allrad_Resp_Data 3;
BA_ "GenSigFuncType" SG_ 1913 ISO_Allrad_Resp_Data 9;
BA_ "GenSigSendType" SG_ 1903 ISO_AMP_Req_Data 3;
BA_ "GenSigFuncType" SG_ 1903 ISO_AMP_Req_Data 9;
BA_ "GenSigSwitchedByIgnition" SG_ 1903 ISO_AMP_Req_Data 0;
BA_ "GenSigSendType" SG_ 2009 ISO_AMP_Resp_Data 3;
BA_ "GenSigFuncType" SG_ 2009 ISO_AMP_Resp_Data 9;
BA_ "GenSigSwitchedByIgnition" SG_ 2009 ISO_AMP_Resp_Data 0;
BA_ "GenSigSendType" SG_ 1806 ISO_BCM1_Req_Data 3;
BA_ "GenSigFuncType" SG_ 1806 ISO_BCM1_Req_Data 9;
BA_ "GenSigSwitchedByIgnition" SG_ 1806 ISO_BCM1_Req_Data 0;
BA_ "GenSigSendType" SG_ 1912 ISO_BCM1_Resp_Data 3;
BA_ "GenSigFuncType" SG_ 1912 ISO_BCM1_Resp_Data 9;
BA_ "GenSigSwitchedByIgnition" SG_ 1912 ISO_BCM1_Resp_Data 0;
BA_ "GenSigSendType" SG_ 1857 ISO_DCDC_Req_Data 3;
BA_ "GenSigFuncType" SG_ 1857 ISO_DCDC_Req_Data 9;
BA_ "GenSigSwitchedByIgnition" SG_ 1857 ISO_DCDC_Req_Data 0;
BA_ "GenSigSendType" SG_ 1963 ISO_DCDC_Resp_Data 3;
BA_ "GenSigFuncType" SG_ 1963 ISO_DCDC_Resp_Data 9;
BA_ "GenSigSwitchedByIgnition" SG_ 1963 ISO_DCDC_Resp_Data 0;
BA_ "GenSigSendType" SG_ 1851 ISO_EBKV_Req_Data 3;
BA_ "GenSigFuncType" SG_ 1851 ISO_EBKV_Req_Data 9;
BA_ "GenSigSwitchedByIgnition" SG_ 1851 ISO_EBKV_Req_Data 0;
BA_ "GenSigSendType" SG_ 1957 ISO_EBKV_Resp_Data 3;
BA_ "GenSigFuncType" SG_ 1957 ISO_EBKV_Resp_Data 9;
BA_ "GenSigSwitchedByIgnition" SG_ 1957 ISO_EBKV_Resp_Data 0;
BA_ "GenSigSendType" SG_ 1895 ISO_eCall_Req_Data 3;
BA_ "GenSigFuncType" SG_ 1895 ISO_eCall_Req_Data 9;
BA_ "GenSigSwitchedByIgnition" SG_ 1895 ISO_eCall_Req_Data 0;
BA_ "GenSigSendType" SG_ 2001 ISO_eCall_Resp_Data 3;
BA_ "GenSigFuncType" SG_ 2001 ISO_eCall_Resp_Data 9;
BA_ "GenSigSwitchedByIgnition" SG_ 2001 ISO_eCall_Resp_Data 0;
BA_ "GenSigSendType" SG_ 1841 ISO_ELV_Req_Data 3;
BA_ "GenSigFuncType" SG_ 1841 ISO_ELV_Req_Data 9;
BA_ "GenSigSwitchedByIgnition" SG_ 1841 ISO_ELV_Req_Data 0;
BA_ "GenSigSendType" SG_ 1947 ISO_ELV_Resp_Data 3;
BA_ "GenSigFuncType" SG_ 1947 ISO_ELV_Resp_Data 9;
BA_ "GenSigSwitchedByIgnition" SG_ 1947 ISO_ELV_Resp_Data 0;
BA_ "GenSigSendType" SG_ 1859 ISO_EMotor_03_Req_Data 3;
BA_ "GenSigFuncType" SG_ 1859 ISO_EMotor_03_Req_Data 9;
BA_ "GenSigSwitchedByIgnition" SG_ 1859 ISO_EMotor_03_Req_Data 0;
BA_ "GenSigSendType" SG_ 1965 ISO_EMotor_03_Resp_Data 3;
BA_ "GenSigFuncType" SG_ 1965 ISO_EMotor_03_Resp_Data 9;
BA_ "GenSigSwitchedByIgnition" SG_ 1965 ISO_EMotor_03_Resp_Data 0;
BA_ "GenSigSendType" SG_ 1840 ISO_FLA_Req_Data 3;
BA_ "GenSigFuncType" SG_ 1840 ISO_FLA_Req_Data 9;
BA_ "GenSigSendType" SG_ 1946 ISO_FLA_Resp_Data 3;
BA_ "GenSigFuncType" SG_ 1946 ISO_FLA_Resp_Data 9;
BA_ "GenSigSendType" SG_ 1795 ISO_Funktionaler_Req_Abgas 3;
BA_ "GenSigFuncType" SG_ 1795 ISO_Funktionaler_Req_Abgas 9;
BA_ "GenSigSwitchedByIgnition" SG_ 1795 ISO_Funktionaler_Req_Abgas 0;
BA_ "GenSigSendType" SG_ 1792 ISO_ALL_01_Req_Data 3;
BA_ "GenSigFuncType" SG_ 1792 ISO_ALL_01_Req_Data 9;
BA_ "GenSigSwitchedByIgnition" SG_ 1792 ISO_ALL_01_Req_Data 0;
BA_ "GenSigSendType" SG_ 2015 ISO_OBD_Funktionaler_Req_Data 3;
BA_ "GenSigFuncType" SG_ 2015 ISO_OBD_Funktionaler_Req_Data 9;
BA_ "GenSigSwitchedByIgnition" SG_ 2015 ISO_OBD_Funktionaler_Req_Data 0;
BA_ "GenSigSendType" SG_ 1808 ISO_Gateway_Req_Data 3;
BA_ "GenSigFuncType" SG_ 1808 ISO_Gateway_Req_Data 9;
BA_ "GenSigSwitchedByIgnition" SG_ 1808 ISO_Gateway_Req_Data 0;
BA_ "GenSigSendType" SG_ 1914 ISO_Gateway_Resp_Data 3;
BA_ "GenSigFuncType" SG_ 1914 ISO_Gateway_Resp_Data 9;
BA_ "GenSigSwitchedByIgnition" SG_ 1914 ISO_Gateway_Resp_Data 0;
BA_ "GenSigSendType" SG_ 2017 ISO_Getriebe_01_Req_Data 3;
BA_ "GenSigFuncType" SG_ 2017 ISO_Getriebe_01_Req_Data 9;
BA_ "GenSigSwitchedByIgnition" SG_ 2017 ISO_Getriebe_01_Req_Data 0;
BA_ "GenSigSendType" SG_ 2025 ISO_Getriebe_01_Resp_Data 3;
BA_ "GenSigFuncType" SG_ 2025 ISO_Getriebe_01_Resp_Data 9;
BA_ "GenSigSwitchedByIgnition" SG_ 2025 ISO_Getriebe_01_Resp_Data 0;
BA_ "GenSigSendType" SG_ 1891 ISO_Gurtmikro_Req_Data 3;
BA_ "GenSigFuncType" SG_ 1891 ISO_Gurtmikro_Req_Data 9;
BA_ "GenSigSendType" SG_ 1997 ISO_Gurtmikro_Resp_Data 3;
BA_ "GenSigFuncType" SG_ 1997 ISO_Gurtmikro_Resp_Data 9;
