VERSION "HNNBNNNYNNNNNNNNNNNNNNNNNNNNNNNNNNNNNNNNNN/4/%%%/4/'%**4NNN///"

NS_ :

BS_:

BU_: Gateway Gateway_PAG Tester_MLBevo

BO_ 1888 ISO_HAL_Master_Req: 8 Tester_MLBevo
 SG_ ISO_HAL_Master_Req_Data : 0|64@1+ (1.0,0.0) [0.0|18446744073709551615] ""  Gateway,Gateway_PAG

BO_ 1994 ISO_HAL_Master_Resp: 8 Gateway
 SG_ ISO_HAL_Master_Resp_Data : 0|64@1+ (1.0,0.0) [0.0|18446744073709551615] ""  Tester_MLBevo

BO_ 1889 ISO_HAL_Slave_Req: 8 Tester_MLBevo
 SG_ ISO_HAL_Slave_Req_Data : 0|64@1+ (1.0,0.0) [0.0|18446744073709551615] ""  Gateway,Gateway_PAG

BO_ 1995 ISO_HAL_Slave_Resp: 8 Gateway
 SG_ ISO_HAL_Slave_Resp_Data : 0|64@1+ (1.0,0.0) [0.0|18446744073709551615] ""  Tester_MLBevo

BO_ 1827 ISO_HDSG_Req: 8 Tester_MLBevo
 SG_ ISO_HDSG_Req_Data : 0|64@1+ (1.0,0.0) [0.0|18446744073709551615] ""  Gateway,Gateway_PAG

BO_ 1933 ISO_HDSG_Resp: 8 Gateway
 SG_ ISO_HDSG_Resp_Data : 0|64@1+ (1.0,0.0) [0.0|18446744073709551615] ""  Tester_MLBevo

BO_ 1819 ISO_HUD_Req: 8 Tester_MLBevo
 SG_ ISO_HUD_Req_Data : 0|64@1+ (1.0,0.0) [0.0|18446744073709551615] ""  Gateway,Gateway_PAG

BO_ 1925 ISO_HUD_Resp: 8 Gateway
 SG_ ISO_HUD_Resp_Data : 0|64@1+ (1.0,0.0) [0.0|18446744073709551615] ""  Tester_MLBevo

BO_ 1907 ISO_Info_El_Req: 8 Tester_MLBevo
 SG_ ISO_Info_El_Req_Data : 0|64@1+ (1.0,0.0) [0.0|18446744073709551615] ""  Gateway,Gateway_PAG

BO_ 2013 ISO_Info_El_Resp: 8 Gateway
 SG_ ISO_Info_El_Resp_Data : 0|64@1+ (1.0,0.0) [0.0|18446744073709551615] ""  Tester_MLBevo

BO_ 2549350438 ISO_ISOx_OTA_SWC_01_Req: 8 Tester_MLBevo
 SG_ ISO_ISOx_OTA_SWC_01_Req : 0|64@1+ (1,0) [0|18446744073709551615] ""  Gateway_PAG

BO_ 2549491200 ISO_ISOx_OTA_SWC_01_Resp: 8 Gateway_PAG
 SG_ ISO_ISOx_OTA_SWC_01_Resp : 0|64@1+ (1,0) [0|18446744073709551615] ""  Tester_MLBevo

BO_ 1871 ISO_Kamera_Req: 8 Tester_MLBevo
 SG_ ISO_Kamera_Req_Data : 0|64@1+ (1.0,0.0) [0.0|18446744073709551615] ""  Gateway,Gateway_PAG

BO_ 1977 ISO_Kamera_Resp: 8 Gateway
 SG_ ISO_Kamera_Resp_Data : 0|64@1+ (1.0,0.0) [0.0|18446744073709551615] ""  Tester_MLBevo

BO_ 1862 ISO_Klima_Req: 8 Tester_MLBevo
 SG_ ISO_Klima_Req_Data : 0|64@1+ (1.0,0.0) [0.0|18446744073709551615] ""  Gateway,Gateway_PAG

BO_ 1968 ISO_Klima_Resp: 8 Gateway
 SG_ ISO_Klima_Resp_Data : 0|64@1+ (1.0,0.0) [0.0|18446744073709551615] ""  Tester_MLBevo

BO_ 1812 ISO_Kombi_Req: 8 Tester_MLBevo
 SG_ ISO_Kombi_Req_Data : 0|64@1+ (1.0,0.0) [0.0|18446744073709551615] ""  Gateway,Gateway_PAG

BO_ 1918 ISO_Kombi_Resp: 8 Gateway
 SG_ ISO_Kombi_Resp_Data : 0|64@1+ (1.0,0.0) [0.0|18446744073709551615] ""  Tester_MLBevo

BO_ 1860 ISO_Ladegeraet_Req: 8 Tester_MLBevo
 SG_ ISO_Ladegeraet_Req_Data : 0|64@1+ (1.0,0.0) [0.0|18446744073709551615] ""  Gateway,Gateway_PAG

BO_ 1966 ISO_Ladegeraet_Resp: 8 Gateway
 SG_ ISO_Ladegeraet_Resp_Data : 0|64@1+ (1.0,0.0) [0.0|18446744073709551615] ""  Tester_MLBevo

BO_ 1904 ISO_Laufwerke_Req: 8 Tester_MLBevo
 SG_ ISO_Laufwerke_Req_Data : 0|64@1+ (1.0,0.0) [0.0|18446744073709551615] ""  Gateway,Gateway_PAG

BO_ 2010 ISO_Laufwerke_Resp: 8 Gateway
 SG_ ISO_Laufwerke_Resp_Data : 0|64@1+ (1.0,0.0) [0.0|18446744073709551615] ""  Tester_MLBevo

BO_ 1810 ISO_Lenkhilfe_Req: 8 Tester_MLBevo
 SG_ ISO_Lenkhilfe_Req_Data : 0|64@1+ (1.0,0.0) [0.0|18446744073709551615] ""  Gateway,Gateway_PAG

BO_ 1916 ISO_Lenkhilfe_Resp: 8 Gateway
 SG_ ISO_Lenkhilfe_Resp_Data : 0|64@1+ (1.0,0.0) [0.0|18446744073709551615] ""  Tester_MLBevo

BO_ 1881 ISO_Lift_Req: 8 Tester_MLBevo
 SG_ ISO_Lift_Req_Data : 0|64@1+ (1,0) [0|18446744073709551615] "Unit_None"  Gateway,Gateway_PAG

BO_ 1987 ISO_Lift_Resp: 8 Gateway
 SG_ ISO_Lift_Resp_Data : 0|64@1+ (1,0) [0|18446744073709551615] "Unit_None"  Tester_MLBevo

BO_ 1836 ISO_MFG_Req: 8 Tester_MLBevo
 SG_ ISO_MFG_Req_Data : 0|64@1+ (1.0,0.0) [0.0|18446744073709551615] ""  Gateway,Gateway_PAG

BO_ 1942 ISO_MFG_Resp: 8 Gateway
 SG_ ISO_MFG_Resp_Data : 0|64@1+ (1.0,0.0) [0.0|18446744073709551615] ""  Tester_MLBevo

BO_ 2016 ISO_MO_01_Req: 8 Tester_MLBevo
 SG_ ISO_MO_01_Req_Data : 0|64@1+ (1.0,0.0) [0.0|18446744073709551615] ""  Gateway,Gateway_PAG

BO_ 2024 ISO_MO_01_Resp: 8 Gateway
 SG_ ISO_MO_01_Resp_Data : 0|64@1+ (1.0,0.0) [0.0|18446744073709551615] ""  Tester_MLBevo

BO_ 1831 ISO_NightVision_Req: 8 Tester_MLBevo
 SG_ ISO_NightVision_Req_Data : 0|64@1+ (1.0,0.0) [0.0|18446744073709551615] ""  Gateway,Gateway_PAG

BO_ 1937 ISO_NightVision_Resp: 8 Gateway
 SG_ ISO_NightVision_Resp_Data : 0|64@1+ (1.0,0.0) [0.0|18446744073709551615] ""  Tester_MLBevo

BO_ 2018 ISO_OBD_01_Req: 8 Tester_MLBevo
 SG_ ISO_OBD_01_Req_Data : 0|64@1+ (1.0,0.0) [0.0|18446744073709551615] ""  Gateway,Gateway_PAG

BO_ 2026 ISO_OBD_01_Resp: 8 Gateway
 SG_ ISO_OBD_01_Resp_Data : 0|64@1+ (1.0,0.0) [0.0|18446744073709551615] ""  Tester_MLBevo

BO_ 2019 ISO_OBD_02_Req: 8 Tester_MLBevo
 SG_ ISO_OBD_02_Req_Data : 0|64@1+ (1.0,0.0) [0.0|18446744073709551615] ""  Gateway,Gateway_PAG

BO_ 2027 ISO_OBD_02_Resp: 8 Gateway
 SG_ ISO_OBD_02_Resp_Data : 0|64@1+ (1.0,0.0) [0.0|18446744073709551615] ""  Tester_MLBevo

BO_ 2020 ISO_OBD_03_Req: 8 Tester_MLBevo
 SG_ ISO_OBD_03_Req_Data : 0|64@1+ (1.0,0.0) [0.0|18446744073709551615] ""  Gateway,Gateway_PAG

BO_ 2028 ISO_OBD_03_Resp: 8 Gateway
 SG_ ISO_OBD_03_Resp_Data : 0|64@1+ (1.0,0.0) [0.0|18446744073709551615] ""  Tester_MLBevo

BO_ 2021 ISO_OBD_04_Req: 8 Tester_MLBevo
 SG_ ISO_OBD_04_Req_Data : 0|64@1+ (1.0,0.0) [0.0|18446744073709551615] ""  Gateway,Gateway_PAG

BO_ 2029 ISO_OBD_04_Resp: 8 Gateway
 SG_ ISO_OBD_04_Resp_Data : 0|64@1+ (1.0,0.0) [0.0|18446744073709551615] ""  Tester_MLBevo

BO_ 2022 ISO_OBD_05_Req: 8 Tester_MLBevo
 SG_ ISO_OBD_05_Req_Data : 0|64@1+ (1.0,0.0) [0.0|18446744073709551615] ""  Gateway,Gateway_PAG

BO_ 2030 ISO_OBD_05_Resp: 8 Gateway
 SG_ ISO_OBD_05_Resp_Data : 0|64@1+ (1.0,0.0) [0.0|18446744073709551615] ""  Tester_MLBevo

BO_ 2023 ISO_OBD_06_Req: 8 Tester_MLBevo
 SG_ ISO_OBD_06_Req_Data : 0|64@1+ (1.0,0.0) [0.0|18446744073709551615] ""  Gateway,Gateway_PAG

BO_ 2031 ISO_OBD_06_Resp: 8 Gateway
 SG_ ISO_OBD_06_Resp_Data : 0|64@1+ (1.0,0.0) [0.0|18446744073709551615] ""  Tester_MLBevo

BO_ 1822 ISO_Quersperre_Req: 8 Tester_MLBevo
 SG_ ISO_Quersperre_Req_Data : 0|64@1+ (1.0,0.0) [0.0|18446744073709551615] ""  Gateway,Gateway_PAG

BO_ 1928 ISO_Quersperre_Resp: 8 Gateway
 SG_ ISO_Quersperre_Resp_Data : 0|64@1+ (1.0,0.0) [0.0|18446744073709551615] ""  Tester_MLBevo

BO_ 1803 ISO_RDK_Req: 8 Tester_MLBevo
 SG_ ISO_RDK_Req_Data : 0|64@1+ (1.0,0.0) [0.0|18446744073709551615] ""  Gateway,Gateway_PAG

BO_ 1909 ISO_RDK_Resp: 8 Gateway
 SG_ ISO_RDK_Resp_Data : 0|64@1+ (1.0,0.0) [0.0|18446744073709551615] ""  Tester_MLBevo

BO_ 1897 ISO_Rearview_Req: 8 Tester_MLBevo
 SG_ ISO_Rearview_Req_Data : 0|64@1+ (1.0,0.0) [0.0|18446744073709551615] ""  Gateway,Gateway_PAG

BO_ 2003 ISO_Rearview_Resp: 8 Gateway
 SG_ ISO_Rearview_Resp_Data : 0|64@1+ (1.0,0.0) [0.0|18446744073709551615] ""  Tester_MLBevo

BO_ 1834 ISO_SCR_Req: 8 Tester_MLBevo
 SG_ ISO_SCR_Req_Data : 0|64@1+ (1.0,0.0) [0.0|18446744073709551615] ""  Gateway,Gateway_PAG

BO_ 1940 ISO_SCR_Resp: 8 Gateway
 SG_ ISO_SCR_Resp_Data : 0|64@1+ (1.0,0.0) [0.0|18446744073709551615] ""  Tester_MLBevo

BO_ 1814 ISO_SCU_Req: 8 Tester_MLBevo
 SG_ ISO_SCU_Req_Data : 0|64@1+ (1.0,0.0) [0.0|18446744073709551615] ""  Gateway,Gateway_PAG

BO_ 1920 ISO_SCU_Resp: 8 Gateway
 SG_ ISO_SCU_Resp_Data : 0|64@1+ (1.0,0.0) [0.0|18446744073709551615] ""  Tester_MLBevo

BO_ 1839 ISO_SFA_Req: 8 Tester_MLBevo
 SG_ ISO_SFA_Req_Data : 0|64@1+ (1.0,0.0) [0.0|18446744073709551615] ""  Gateway,Gateway_PAG

BO_ 1945 ISO_SFA_Resp: 8 Gateway
 SG_ ISO_SFA_Resp_Data : 0|64@1+ (1.0,0.0) [0.0|18446744073709551615] ""  Tester_MLBevo

BO_ 1869 ISO_Sitzmemo_BFS_Req: 8 Tester_MLBevo
 SG_ ISO_Sitzmemo_BFS_Req_Data : 0|64@1+ (1.0,0.0) [0.0|18446744073709551615] ""  Gateway,Gateway_PAG

BO_ 1975 ISO_Sitzmemo_BFS_Resp: 8 Gateway
 SG_ ISO_Sitzmemo_BFS_Resp_Data : 0|64@1+ (1.0,0.0) [0.0|18446744073709551615] ""  Tester_MLBevo

BO_ 1868 ISO_Sitzmemo_FS_Req: 8 Tester_MLBevo
 SG_ ISO_Sitzmemo_FS_Req_Data : 0|64@1+ (1.0,0.0) [0.0|18446744073709551615] ""  Gateway,Gateway_PAG

BO_ 1974 ISO_Sitzmemo_FS_Resp: 8 Gateway
 SG_ ISO_Sitzmemo_FS_Resp_Data : 0|64@1+ (1.0,0.0) [0.0|18446744073709551615] ""  Tester_MLBevo

BO_ 1804 ISO_SMLS_Req: 8 Tester_MLBevo
 SG_ ISO_SMLS_Req_Data : 0|64@1+ (1.0,0.0) [0.0|18446744073709551615] ""  Gateway,Gateway_PAG

BO_ 1910 ISO_SMLS_Resp: 8 Gateway
 SG_ ISO_SMLS_Resp_Data : 0|64@1+ (1.0,0.0) [0.0|18446744073709551615] ""  Tester_MLBevo

BO_ 1820 ISO_Soundaktor_Req: 8 Tester_MLBevo
 SG_ ISO_Soundaktor_Req_Data : 0|64@1+ (1.0,0.0) [0.0|18446744073709551615] ""  Gateway,Gateway_PAG

BO_ 1926 ISO_Soundaktor_Resp: 8 Gateway
 SG_ ISO_Soundaktor_Resp_Data : 0|64@1+ (1.0,0.0) [0.0|18446744073709551615] ""  Tester_MLBevo

BO_ 1828 ISO_SpoilerSG_Req: 8 Tester_MLBevo
 SG_ ISO_SpoilerSG_Req_Data : 0|64@1+ (1.0,0.0) [0.0|18446744073709551615] ""  Gateway,Gateway_PAG

BO_ 1934 ISO_SpoilerSG_Resp: 8 Gateway
 SG_ ISO_SpoilerSG_Resp_Data : 0|64@1+ (1.0,0.0) [0.0|18446744073709551615] ""  Tester_MLBevo

BO_ 1898 ISO_STH_Req: 8 Tester_MLBevo
 SG_ ISO_STH_Req_Data : 0|64@1+ (1.0,0.0) [0.0|18446744073709551615] ""  Gateway,Gateway_PAG

BO_ 2004 ISO_STH_Resp: 8 Gateway
 SG_ ISO_STH_Resp_Data : 0|64@1+ (1.0,0.0) [0.0|18446744073709551615] ""  Tester_MLBevo

BO_ 1835 ISO_STS_Req: 8 Tester_MLBevo
 SG_ ISO_STS_Req_Data : 0|64@1+ (1.0,0.0) [0.0|18446744073709551615] ""  Gateway,Gateway_PAG

BO_ 1941 ISO_STS_Resp: 8 Gateway
 SG_ ISO_STS_Resp_Data : 0|64@1+ (1.0,0.0) [0.0|18446744073709551615] ""  Tester_MLBevo

BO_ 1865 ISO_Sub_Gateway_Req: 8 Tester_MLBevo
 SG_ ISO_Sub_Gateway_Req_Data : 0|64@1+ (1.0,0.0) [0.0|18446744073709551615] ""  Gateway,Gateway_PAG

BO_ 1971 ISO_Sub_Gateway_Resp: 8 Gateway
 SG_ ISO_Sub_Gateway_Resp_Data : 0|64@1+ (1.0,0.0) [0.0|18446744073709551615] ""  Tester_MLBevo

BO_ 1870 ISO_SWA_Req: 8 Tester_MLBevo
 SG_ ISO_SWA_Req_Data : 0|64@1+ (1.0,0.0) [0.0|18446744073709551615] ""  Gateway,Gateway_PAG

BO_ 1976 ISO_SWA_Resp: 8 Gateway
 SG_ ISO_SWA_Resp_Data : 0|64@1+ (1.0,0.0) [0.0|18446744073709551615] ""  Tester_MLBevo

BO_ 1858 ISO_TME_Req: 8 Tester_MLBevo
 SG_ ISO_TME_Req_Data : 0|64@1+ (1.0,0.0) [0.0|18446744073709551615] ""  Gateway,Gateway_PAG

BO_ 1964 ISO_TME_Resp: 8 Gateway
 SG_ ISO_TME_Resp_Data : 0|64@1+ (1.0,0.0) [0.0|18446744073709551615] ""  Tester_MLBevo

BO_ 1867 ISO_TSG_BT_Req: 8 Tester_MLBevo
 SG_ ISO_TSG_BT_Req_Data : 0|64@1+ (1.0,0.0) [0.0|18446744073709551615] ""  Gateway,Gateway_PAG

BO_ 1973 ISO_TSG_BT_Resp: 8 Gateway
 SG_ ISO_TSG_BT_Resp_Data : 0|64@1+ (1.0,0.0) [0.0|18446744073709551615] ""  Tester_MLBevo

BO_ 1866 ISO_TSG_FT_Req: 8 Tester_MLBevo
 SG_ ISO_TSG_FT_Req_Data : 0|64@1+ (1.0,0.0) [0.0|18446744073709551615] ""  Gateway,Gateway_PAG

BO_ 1972 ISO_TSG_FT_Resp: 8 Gateway
 SG_ ISO_TSG_FT_Resp_Data : 0|64@1+ (1.0,0.0) [0.0|18446744073709551615] ""  Tester_MLBevo

BO_ 1855 ISO_TSG_HBFS_Req: 8 Tester_MLBevo
 SG_ ISO_TSG_HBFS_Req_Data : 0|64@1+ (1.0,0.0) [0.0|18446744073709551615] ""  Gateway,Gateway_PAG

BO_ 1961 ISO_TSG_HBFS_Resp: 8 Gateway
 SG_ ISO_TSG_HBFS_Resp_Data : 0|64@1+ (1.0,0.0) [0.0|18446744073709551615] ""  Tester_MLBevo

BO_ 1854 ISO_TSG_HFS_Req: 8 Tester_MLBevo
 SG_ ISO_TSG_HFS_Req_Data : 0|64@1+ (1.0,0.0) [0.0|18446744073709551615] ""  Gateway,Gateway_PAG

BO_ 1960 ISO_TSG_HFS_Resp: 8 Gateway
 SG_ ISO_TSG_HFS_Resp_Data : 0|64@1+ (1.0,0.0) [0.0|18446744073709551615] ""  Tester_MLBevo

BO_ 1901 ISO_TV_Tuner_Req: 8 Tester_MLBevo
 SG_ ISO_TV_Tuner_Req_Data : 0|64@1+ (1.0,0.0) [0.0|18446744073709551615] ""  Gateway,Gateway_PAG

BO_ 2007 ISO_TV_Tuner_Resp: 8 Gateway
 SG_ ISO_TV_Tuner_Resp_Data : 0|64@1+ (1.0,0.0) [0.0|18446744073709551615] ""  Tester_MLBevo

BO_ 1837 ISO_VSG_Req: 8 Tester_MLBevo
 SG_ ISO_VSG_Req_Data : 0|64@1+ (1.0,0.0) [0.0|18446744073709551615] ""  Gateway,Gateway_PAG

BO_ 1943 ISO_VSG_Resp: 8 Gateway
 SG_ ISO_VSG_Resp_Data : 0|64@1+ (1.0,0.0) [0.0|18446744073709551615] ""  Tester_MLBevo

BO_ 1883 ISO_WaCU_Req: 8 Tester_MLBevo
 SG_ ISO_WaCU_Req_Data : 0|64@1+ (1.0,0.0) [0.0|18446744073709551615] ""  Gateway,Gateway_PAG

BO_ 1989 ISO_WaCU_Resp: 8 Gateway
 SG_ ISO_WaCU_Resp_Data : 0|64@1+ (1.0,0.0) [0.0|18446744073709551615] ""  Tester_MLBevo

BO_ 1875 ISO_Waehlhebel_Req: 8 Tester_MLBevo
 SG_ ISO_Waehlhebel_Req_Data : 0|64@1+ (1.0,0.0) [0.0|18446744073709551615] ""  Gateway,Gateway_PAG

BO_ 1981 ISO_Waehlhebel_Resp: 8 Gateway
 SG_ ISO_Waehlhebel_Resp_Data : 0|64@1+ (1.0,0.0) [0.0|18446744073709551615] ""  Tester_MLBevo

BO_ 2549874831 ISOx_AWC_Req: 8 Tester_MLBevo
 SG_ ISOx_AWC_Req_Data : 0|64@1+ (1.0,0.0) [0.0|18446744073709551615] ""  Gateway,Gateway_PAG

BO_ 2550005903 ISOx_AWC_Resp: 8 Gateway
 SG_ ISOx_AWC_Resp_Data : 0|64@1+ (1.0,0.0) [0.0|18446744073709551615] ""  Tester_MLBevo

BO_ 2549874862 ISOx_BattRegelung_Req: 8 Tester_MLBevo
 SG_ ISOx_BattRegelung_Req_Data : 0|64@1+ (1.0,0.0) [0.0|18446744073709551615] ""  Gateway,Gateway_PAG

BO_ 2550005934 ISOx_BattRegelung_Resp: 8 Gateway
 SG_ ISOx_BattRegelung_Resp_Data : 0|64@1+ (1.0,0.0) [0.0|18446744073709551615] ""  Tester_MLBevo

BO_ 2549874827 ISOx_BCM2_Req: 8 Tester_MLBevo
 SG_ ISOx_BCM2_Req_Data : 0|64@1+ (1.0,0.0) [0.0|18446744073709551615] ""  Gateway,Gateway_PAG

BO_ 2550005899 ISOx_BCM2_Resp: 8 Gateway
 SG_ ISOx_BCM2_Resp_Data : 0|64@1+ (1.0,0.0) [0.0|18446744073709551615] ""  Tester_MLBevo

BO_ 2549874830 ISOx_BedienDisp_vo_Req: 8 Tester_MLBevo
 SG_ ISOx_BedienDisp_vo_Req_Data : 0|64@1+ (1.0,0.0) [0.0|18446744073709551615] ""  Gateway,Gateway_PAG

BO_ 2550005902 ISOx_BedienDisp_vo_Resp: 8 Gateway
 SG_ ISOx_BedienDisp_vo_Resp_Data : 0|64@1+ (1.0,0.0) [0.0|18446744073709551615] ""  Tester_MLBevo

BO_ 2549874835 ISOx_BedienSG_hi_Req: 8 Tester_MLBevo
 SG_ ISOx_BedienSG_hi_Req_Data : 0|64@1+ (1.0,0.0) [0.0|18446744073709551615] ""  Gateway,Gateway_PAG

BO_ 2550005907 ISOx_BedienSG_hi_Resp: 8 Gateway
 SG_ ISOx_BedienSG_hi_Resp_Data : 0|64@1+ (1.0,0.0) [0.0|18446744073709551615] ""  Tester_MLBevo

BO_ 2549874849 ISOx_Bedienteil_Req: 8 Tester_MLBevo
 SG_ ISOx_Bedienteil_Req_Data : 0|64@1+ (1.0,0.0) [0.0|18446744073709551615] ""  Gateway,Gateway_PAG

BO_ 2550005921 ISOx_Bedienteil_Resp: 8 Gateway
 SG_ ISOx_Bedienteil_Resp_Data : 0|64@1+ (1.0,0.0) [0.0|18446744073709551615] ""  Tester_MLBevo

BO_ 2549874844 ISOx_BMS_48V_Req: 8 Tester_MLBevo
 SG_ ISOx_BMS_48V_Req_Data : 0|64@1+ (1.0,0.0) [0.0|18446744073709551615] ""  Gateway,Gateway_PAG

BO_ 2550005916 ISOx_BMS_48V_Resp: 8 Gateway
 SG_ ISOx_BMS_48V_Resp_Data : 0|64@1+ (1.0,0.0) [0.0|18446744073709551615] ""  Tester_MLBevo

BO_ 2549874888 ISOx_BRS_BU_Req: 8 Tester_MLBevo
 SG_ ISO_BRS_BU_Req_Data : 0|64@1+ (1,0) [0|18446744073709551615] "Unit_None"  Gateway,Gateway_PAG

BO_ 2550005960 ISOx_BRS_BU_Resp: 8 Gateway
 SG_ ISO_BRS_BU_Resp_Data : 0|64@1+ (1,0) [0|18446744073709551615] "Unit_None"  Tester_MLBevo

BO_ 2549874887 ISOx_DCDC_HV_02_Req: 8 Tester_MLBevo
 SG_ ISOx_DCDC_HV_02_Req_Data : 0|64@1+ (1,0) [0|18446744073709551615] "Unit_None"  Gateway,Gateway_PAG

BO_ 2550005959 ISOx_DCDC_HV_02_Resp: 8 Gateway
 SG_ ISOx_DCDC_HV_02_Resp_Data : 0|64@1+ (1,0) [0|18446744073709551615] "Unit_None"  Tester_MLBevo

BO_ 2549874895 ISOx_DCDC_HV_03_Req: 8 Tester_MLBevo
 SG_ ISOx_DCDC_HV_03_Req_Data : 0|64@1+ (1.0,0.0) [0.0|18446744073709551615] ""  Gateway

BO_ 2550005967 ISOx_DCDC_HV_03_Resp: 8 Gateway
 SG_ ISOx_DCDC_HV_03_Resp_Data : 0|64@1+ (1.0,0.0) [0.0|18446744073709551615] ""  Tester_MLBevo

BO_ 2549874871 ISOx_DCDC_HV_Req: 8 Tester_MLBevo
 SG_ ISOx_DCDC_HV_Req_Data : 0|64@1+ (1.0,0.0) [0.0|18446744073709551615] ""  Gateway,Gateway_PAG

BO_ 2550005943 ISOx_DCDC_HV_Resp: 8 Gateway
 SG_ ISOx_DCDC_HV_Resp_Data : 0|64@1+ (1.0,0.0) [0.0|18446744073709551615] ""  Tester_MLBevo

BO_ 2549874874 ISOx_DDA_Req: 8 Tester_MLBevo
 SG_ ISOx_DDA_Req_Data : 0|64@1+ (1.0,0.0) [0.0|18446744073709551615] ""  Gateway,Gateway_PAG

BO_ 2550005946 ISOx_DDA_Resp: 8 Gateway
 SG_ ISOx_DDA_Resp_Data : 0|64@1+ (1.0,0.0) [0.0|18446744073709551615] ""  Tester_MLBevo

BO_ 2549874863 ISOx_DLM_BFS_Req: 8 Tester_MLBevo
 SG_ ISOx_DLM_BFS_Req_Data : 0|64@1+ (1.0,0.0) [0.0|18446744073709551615] ""  Gateway,Gateway_PAG

BO_ 2550005935 ISOx_DLM_BFS_Resp: 8 Gateway
 SG_ ISOx_DLM_BFS_Resp_Data : 0|64@1+ (1.0,0.0) [0.0|18446744073709551615] ""  Tester_MLBevo

BO_ 2549874861 ISOx_DLM_FS_Req: 8 Tester_MLBevo
 SG_ ISOx_DLM_FS_Req_Data : 0|64@1+ (1.0,0.0) [0.0|18446744073709551615] ""  Gateway,Gateway_PAG

BO_ 2550005933 ISOx_DLM_FS_Resp: 8 Gateway
 SG_ ISOx_DLM_FS_Resp_Data : 0|64@1+ (1.0,0.0) [0.0|18446744073709551615] ""  Tester_MLBevo

BO_ 2549874840 ISOx_DMD_L_Req: 8 Tester_MLBevo
 SG_ ISOx_DMD_L_Req_Data : 0|64@1+ (1.0,0.0) [0.0|18446744073709551615] ""  Gateway,Gateway_PAG

BO_ 2550005912 ISOx_DMD_L_Resp: 8 Gateway
 SG_ ISOx_DMD_L_Resp_Data : 0|64@1+ (1.0,0.0) [0.0|18446744073709551615] ""  Tester_MLBevo

BO_ 2549874841 ISOx_DMD_R_Req: 8 Tester_MLBevo
 SG_ ISOx_DMD_R_Req_Data : 0|64@1+ (1.0,0.0) [0.0|18446744073709551615] ""  Gateway,Gateway_PAG

BO_ 2550005913 ISOx_DMD_R_Resp: 8 Gateway
 SG_ ISOx_DMD_R_Resp_Data : 0|64@1+ (1.0,0.0) [0.0|18446744073709551615] ""  Tester_MLBevo

BO_ 2549874833 ISOx_eAWS1_Req: 8 Tester_MLBevo
 SG_ ISOx_eAWS_1_Req_Data : 0|64@1+ (1.0,0.0) [0.0|18446744073709551615] ""  Gateway,Gateway_PAG

BO_ 2550005905 ISOx_eAWS1_Resp: 8 Gateway
 SG_ ISOx_eAWS_1_Resp_Data : 0|64@1+ (1.0,0.0) [0.0|18446744073709551615] ""  Tester_MLBevo

BO_ 2549874834 ISOx_eAWS2_Req: 8 Tester_MLBevo
 SG_ ISOx_eAWS_2_Req_Data : 0|64@1+ (1.0,0.0) [0.0|18446744073709551615] ""  Gateway,Gateway_PAG

BO_ 2550005906 ISOx_eAWS2_Resp: 8 Gateway
 SG_ ISOx_eAWS_2_Resp_Data : 0|64@1+ (1.0,0.0) [0.0|18446744073709551615] ""  Tester_MLBevo

BO_ 2549874816 ISOx_EFP_Req: 8 Tester_MLBevo
 SG_ ISOx_EFP_Req_Data : 0|64@1+ (1.0,0.0) [0.0|18446744073709551615] ""  Gateway,Gateway_PAG

BO_ 2550005888 ISOx_EFP_Resp: 8 Gateway
 SG_ ISOx_EFP_Resp_Data : 0|64@1+ (1.0,0.0) [0.0|18446744073709551615] ""  Tester_MLBevo

BO_ 2549874812 ISOx_EMotor_01_Req: 8 Tester_MLBevo
 SG_ ISOx_EMotor_01_Req_Data : 0|64@1+ (1.0,0.0) [0.0|18446744073709551615] ""  Gateway,Gateway_PAG

BO_ 2550005884 ISOx_EMotor_01_Resp: 8 Gateway
 SG_ ISOx_EMotor_01_Resp_Data : 0|64@1+ (1.0,0.0) [0.0|18446744073709551615] ""  Tester_MLBevo

BO_ 2549874872 ISOx_EMotor_02_Req: 8 Tester_MLBevo
 SG_ ISOx_EMotor_02_Req_Data : 0|64@1+ (1.0,0.0) [0.0|18446744073709551615] ""  Gateway,Gateway_PAG

BO_ 2550005944 ISOx_EMotor_02_Resp: 8 Gateway
 SG_ ISOx_EMotor_02_Resp_Data : 0|64@1+ (1.0,0.0) [0.0|18446744073709551615] ""  Tester_MLBevo

BO_ 2549874869 ISOx_FCU_Req: 8 Tester_MLBevo
 SG_ ISOx_FCU_Req_Data : 0|64@1+ (1.0,0.0) [0.0|18446744073709551615] ""  Gateway

BO_ 2550005941 ISOx_FCU_Resp: 8 Gateway
 SG_ ISOx_FCU_Resp_Data : 0|64@1+ (1.0,0.0) [0.0|18446744073709551615] ""  Tester_MLBevo

BO_ 2549874845 ISOx_Fronteckradar1_Req: 8 Tester_MLBevo
 SG_ ISOx_Fronteckradar1_Req_Data : 0|64@1+ (1.0,0.0) [0.0|18446744073709551615] ""  Gateway,Gateway_PAG

BO_ 2550005917 ISOx_Fronteckradar1_Resp: 8 Gateway
 SG_ ISOx_Fronteckradar1_Resp_Data : 0|64@1+ (1.0,0.0) [0.0|18446744073709551615] ""  Tester_MLBevo

BO_ 2549874846 ISOx_Fronteckradar2_Req: 8 Tester_MLBevo
 SG_ ISOx_Fronteckradar2_Req_Data : 0|64@1+ (1.0,0.0) [0.0|18446744073709551615] ""  Gateway,Gateway_PAG

BO_ 2550005918 ISOx_Fronteckradar2_Resp: 8 Gateway
 SG_ ISOx_Fronteckradar2_Resp_Data : 0|64@1+ (1.0,0.0) [0.0|18446744073709551615] ""  Tester_MLBevo

BO_ 2549874811 ISOx_Hybrid_01_Req: 8 Tester_MLBevo
 SG_ ISOx_Hybrid_01_Req_Data : 0|64@1+ (1.0,0.0) [0.0|18446744073709551615] ""  Gateway,Gateway_PAG

BO_ 2550005883 ISOx_Hybrid_01_Resp: 8 Gateway
 SG_ ISOx_Hybrid_01_Resp_Data : 0|64@1+ (1.0,0.0) [0.0|18446744073709551615] ""  Tester_MLBevo

BO_ 2549874883 ISOx_KFS_Req: 8 Tester_MLBevo
 SG_ ISOx_KFS_Req_Data : 0|64@1+ (1.0,0.0) [0.0|18446744073709551615] ""  Gateway,Gateway_PAG

BO_ 2550005955 ISOx_KFS_Resp: 8 Gateway
 SG_ ISOx_KFS_Resp_Data : 0|64@1+ (1.0,0.0) [0.0|18446744073709551615] ""  Tester_MLBevo

BO_ 2549874886 ISOx_Ladegeraet_2_Req: 8 Tester_MLBevo
 SG_ ISOx_Ladegeraet_2_Req_Data : 0|64@1+ (1,0) [0|18446744073709551615] "Unit_None"  Gateway,Gateway_PAG

BO_ 2550005958 ISOx_Ladegeraet_2_Resp: 8 Gateway
 SG_ ISOx_Ladegeraet_2_Resp_Data : 0|64@1+ (1,0) [0|18446744073709551615] "Unit_None"  Tester_MLBevo

BO_ 2549874825 ISOx_Laserscanner_Req: 8 Tester_MLBevo
 SG_ ISOx_Laserscanner_Req_Data : 0|64@1+ (1.0,0.0) [0.0|18446744073709551615] ""  Gateway,Gateway_PAG

BO_ 2550005897 ISOx_Laserscanner_Resp: 8 Gateway
 SG_ ISOx_Laserscanner_Resp_Data : 0|64@1+ (1.0,0.0) [0.0|18446744073709551615] ""  Tester_MLBevo

BO_ 2549874818 ISOx_LCM_L_Req: 8 Tester_MLBevo
 SG_ ISOx_LCM_L_Req_Data : 0|64@1+ (1.0,0.0) [0.0|18446744073709551615] ""  Gateway,Gateway_PAG

BO_ 2550005890 ISOx_LCM_L_Resp: 8 Gateway
 SG_ ISOx_LCM_L_Resp_Data : 0|64@1+ (1.0,0.0) [0.0|18446744073709551615] ""  Tester_MLBevo

BO_ 2549874819 ISOx_LCM_R_Req: 8 Tester_MLBevo
 SG_ ISOx_LCM_R_Req_Data : 0|64@1+ (1.0,0.0) [0.0|18446744073709551615] ""  Gateway,Gateway_PAG

BO_ 2550005891 ISOx_LCM_R_Resp: 8 Gateway
 SG_ ISOx_LCM_R_Resp_Data : 0|64@1+ (1.0,0.0) [0.0|18446744073709551615] ""  Tester_MLBevo

BO_ 2549874838 ISOx_LED_LM_L_Req: 8 Tester_MLBevo
 SG_ ISOx_LED_LM_L_Req_Data : 0|64@1+ (1.0,0.0) [0.0|18446744073709551615] ""  Gateway,Gateway_PAG

BO_ 2550005910 ISOx_LED_LM_L_Resp: 8 Gateway
 SG_ ISOx_LED_LM_L_Resp_Data : 0|64@1+ (1.0,0.0) [0.0|18446744073709551615] ""  Tester_MLBevo

BO_ 2549874839 ISOx_LED_LM_R_Req: 8 Tester_MLBevo
 SG_ ISOx_LED_LM_R_Req_Data : 0|64@1+ (1.0,0.0) [0.0|18446744073709551615] ""  Gateway,Gateway_PAG

BO_ 2550005911 ISOx_LED_LM_R_Resp: 8 Gateway
 SG_ ISOx_LED_LM_R_Resp_Data : 0|64@1+ (1.0,0.0) [0.0|18446744073709551615] ""  Tester_MLBevo

BO_ 2549874808 ISOx_MOS_01_Req: 8 Tester_MLBevo
 SG_ ISOx_MOS_01_Req_Data : 0|64@1+ (1.0,0.0) [0.0|18446744073709551615] ""  Gateway,Gateway_PAG

BO_ 2550005880 ISOx_MOS_01_Resp: 8 Gateway
 SG_ ISOx_MOS_01_Resp_Data : 0|64@1+ (1.0,0.0) [0.0|18446744073709551615] ""  Tester_MLBevo

BO_ 2549874822 ISOx_OTA_FC_Req: 8 Tester_MLBevo
 SG_ ISOx_OTA_FC_Req_Data : 0|64@1+ (1,0) [0|18446744073709551615] "Unit_None"  Gateway_PAG

BO_ 2550005894 ISOx_OTA_FC_Resp: 8 Gateway_PAG
 SG_ ISOx_OTA_FC_Resp_Data : 0|64@1+ (1,0) [0|18446744073709551615] "Unit_None"  Tester_MLBevo

BO_ 2549874836 ISOx_PACC_Req: 8 Tester_MLBevo
 SG_ ISOx_PACC_Req_Data : 0|64@1+ (1.0,0.0) [0.0|18446744073709551615] ""  Gateway,Gateway_PAG

BO_ 2550005908 ISOx_PACC_Resp: 8 Gateway
 SG_ ISOx_PACC_Resp_Data : 0|64@1+ (1.0,0.0) [0.0|18446744073709551615] ""  Tester_MLBevo

BO_ 2549874842 ISOx_PADM_Req: 8 Tester_MLBevo
 SG_ ISOx_PADM_Req_Data : 0|64@1+ (1.0,0.0) [0.0|18446744073709551615] ""  Gateway,Gateway_PAG

BO_ 2550005914 ISOx_PADM_Resp: 8 Gateway
 SG_ ISOx_PADM_Resp_Data : 0|64@1+ (1.0,0.0) [0.0|18446744073709551615] ""  Tester_MLBevo

BO_ 2549874821 ISOx_RSG_Req: 8 Tester_MLBevo
 SG_ ISOx_RSG_Req_Data : 0|64@1+ (1.0,0.0) [0.0|18446744073709551615] ""  Gateway,Gateway_PAG

BO_ 2550005893 ISOx_RSG_Resp: 8 Gateway
 SG_ ISOx_RSG_Resp_Data : 0|64@1+ (1.0,0.0) [0.0|18446744073709551615] ""  Tester_MLBevo

BO_ 2549874848 ISOx_SAD2_Req: 8 Tester_MLBevo
 SG_ ISOx_SAD2_Req_Data : 0|64@1+ (1.0,0.0) [0.0|18446744073709551615] ""  Gateway,Gateway_PAG

BO_ 2550005920 ISOx_SAD2_Resp: 8 Gateway
 SG_ ISOx_SAD2_Resp_Data : 0|64@1+ (1.0,0.0) [0.0|18446744073709551615] ""  Tester_MLBevo

BO_ 2549874820 ISOx_SAD_Req: 8 Tester_MLBevo
 SG_ ISOx_SAD_Req_Data : 0|64@1+ (1.0,0.0) [0.0|18446744073709551615] ""  Gateway,Gateway_PAG

BO_ 2550005892 ISOx_SAD_Resp: 8 Gateway
 SG_ ISOx_SAD_Resp_Data : 0|64@1+ (1.0,0.0) [0.0|18446744073709551615] ""  Tester_MLBevo

BO_ 2549874858 ISOx_SCC1_Req: 8 Tester_MLBevo
 SG_ ISOx_SCC1_Req_Data : 0|64@1+ (1.0,0.0) [0.0|18446744073709551615] ""  Gateway,Gateway_PAG

BO_ 2550005930 ISOx_SCC1_Resp: 8 Gateway
 SG_ ISOx_SCC1_Resp_Data : 0|64@1+ (1.0,0.0) [0.0|18446744073709551615] ""  Tester_MLBevo

BO_ 2549874859 ISOx_SCC2_Req: 8 Tester_MLBevo
 SG_ ISOx_SCC2_Req_Data : 0|64@1+ (1.0,0.0) [0.0|18446744073709551615] ""  Gateway,Gateway_PAG

BO_ 2550005931 ISOx_SCC2_Resp: 8 Gateway
 SG_ ISOx_SCC2_Resp_Data : 0|64@1+ (1.0,0.0) [0.0|18446744073709551615] ""  Tester_MLBevo

BO_ 2549874855 ISOx_SDC1_Req: 8 Tester_MLBevo
 SG_ ISOx_SDC1_Req_Data : 0|64@1+ (1.0,0.0) [0.0|18446744073709551615] ""  Gateway,Gateway_PAG

BO_ 2550005927 ISOx_SDC1_Resp: 8 Gateway
 SG_ ISOx_SDC1_Resp_Data : 0|64@1+ (1.0,0.0) [0.0|18446744073709551615] ""  Tester_MLBevo

BO_ 2549874856 ISOx_SDC2_Req: 8 Tester_MLBevo
 SG_ ISOx_SDC2_Req_Data : 0|64@1+ (1.0,0.0) [0.0|18446744073709551615] ""  Gateway,Gateway_PAG

BO_ 2550005928 ISOx_SDC2_Resp: 8 Gateway
 SG_ ISOx_SDC2_Resp_Data : 0|64@1+ (1.0,0.0) [0.0|18446744073709551615] ""  Tester_MLBevo

BO_ 2549874824 ISOx_Sitzmemo_HBFS_Req: 8 Tester_MLBevo
 SG_ ISOx_Sitzmemo_HBFS_Req_Data : 0|64@1+ (1.0,0.0) [0.0|18446744073709551615] ""  Gateway,Gateway_PAG

BO_ 2550005896 ISOx_Sitzmemo_HBFS_Resp: 8 Gateway
 SG_ ISOx_Sitzmemo_HBFS_Resp_Data : 0|64@1+ (1.0,0.0) [0.0|18446744073709551615] ""  Tester_MLBevo

BO_ 2549874823 ISOx_Sitzmemo_HFS_Req: 8 Tester_MLBevo
 SG_ ISOx_Sitzmemo_HFS_Req_Data : 0|64@1+ (1.0,0.0) [0.0|18446744073709551615] ""  Gateway,Gateway_PAG

BO_ 2550005895 ISOx_Sitzmemo_HFS_Resp: 8 Gateway
 SG_ ISOx_Sitzmemo_HFS_Resp_Data : 0|64@1+ (1.0,0.0) [0.0|18446744073709551615] ""  Tester_MLBevo

BO_ 2549874837 ISOx_Sitzmemo_SR3_Req: 8 Tester_MLBevo
 SG_ ISOx_Sitzmemo_SR3_Req_Data : 0|64@1+ (1.0,0.0) [0.0|18446744073709551615] ""  Gateway,Gateway_PAG

BO_ 2550005909 ISOx_Sitzmemo_SR3_Resp: 8 Gateway
 SG_ ISOx_Sitzmemo_SR3_Resp_Data : 0|64@1+ (1.0,0.0) [0.0|18446744073709551615] ""  Tester_MLBevo

BO_ 2549874851 ISOx_SRAL_Req: 8 Tester_MLBevo
 SG_ ISOx_SRAL_Req_Data : 0|64@1+ (1.0,0.0) [0.0|18446744073709551615] ""  Gateway,Gateway_PAG

BO_ 2550005923 ISOx_SRAL_Resp: 8 Gateway
 SG_ ISOx_SRAL_Resp_Data : 0|64@1+ (1.0,0.0) [0.0|18446744073709551615] ""  Tester_MLBevo

BO_ 2549874860 ISOx_SRAR_Req: 8 Tester_MLBevo
 SG_ ISOx_SRAR_Req_Data : 0|64@1+ (1.0,0.0) [0.0|18446744073709551615] ""  Gateway,Gateway_PAG

BO_ 2550005932 ISOx_SRAR_Resp: 8 Gateway
 SG_ ISOx_SRAR_Resp_Data : 0|64@1+ (1.0,0.0) [0.0|18446744073709551615] ""  Tester_MLBevo

BO_ 2549874826 ISOx_SWA_2_Req: 8 Tester_MLBevo
 SG_ ISOx_SWA_2_Req_Data : 0|64@1+ (1.0,0.0) [0.0|18446744073709551615] ""  Gateway,Gateway_PAG

BO_ 2550005898 ISOx_SWA_2_Resp: 8 Gateway
 SG_ ISOx_SWA_2_Resp_Data : 0|64@1+ (1.0,0.0) [0.0|18446744073709551615] ""  Tester_MLBevo

BO_ 2549874868 ISOx_TelemetrieSG_Req: 8 Tester_MLBevo
 SG_ ISOx_TelemetrieSG_Req_Data : 0|64@1+ (1.0,0.0) [0.0|18446744073709551615] ""  Gateway,Gateway_PAG

BO_ 2550005940 ISOx_TelemetrieSG_Resp: 8 Gateway
 SG_ ISOx_TelemetrieSG_Resp_Data : 0|64@1+ (1.0,0.0) [0.0|18446744073709551615] ""  Tester_MLBevo

BO_ 2549874884 ISOx_VAS_L_Req: 8 Tester_MLBevo
 SG_ ISOx_VAS_L_Req_Data : 0|64@1+ (1.0,0.0) [0.0|18446744073709551615] ""  Gateway,Gateway_PAG

BO_ 2550005956 ISOx_VAS_L_Resp: 8 Gateway
 SG_ ISOx_VAS_L_Resp_Data : 0|64@1+ (1.0,0.0) [0.0|18446744073709551615] ""  Tester_MLBevo

BO_ 2549874885 ISOx_VAS_R_Req: 8 Tester_MLBevo
 SG_ ISOx_VAS_R_Req_Data : 0|64@1+ (1.0,0.0) [0.0|18446744073709551615] ""  Gateway,Gateway_PAG

BO_ 2550005957 ISOx_VAS_R_Resp: 8 Gateway
 SG_ ISOx_VAS_R_Resp_Data : 0|64@1+ (1.0,0.0) [0.0|18446744073709551615] ""  Tester_MLBevo

BO_ 2549874864 ISOx_WindowTrans_1_Req: 8 Tester_MLBevo
 SG_ ISOx_WindowTrans_1_Req_Data : 0|64@1+ (1.0,0.0) [0.0|18446744073709551615] ""  Gateway,Gateway_PAG

BO_ 2550005936 ISOx_WindowTrans_1_Resp: 8 Gateway
 SG_ ISOx_WindowTrans_1_Resp_Data : 0|64@1+ (1.0,0.0) [0.0|18446744073709551615] ""  Tester_MLBevo

BO_ 2549874853 ISOx_WLC1_Req: 8 Tester_MLBevo
 SG_ ISOx_WLC1_Req_Data : 0|64@1+ (1.0,0.0) [0.0|18446744073709551615] ""  Gateway,Gateway_PAG

BO_ 2550005925 ISOx_WLC1_Resp: 8 Gateway
 SG_ ISOx_WLC1_Resp_Data : 0|64@1+ (1.0,0.0) [0.0|18446744073709551615] ""  Tester_MLBevo

BO_ 2549874854 ISOx_WLC2_Req: 8 Tester_MLBevo
 SG_ ISOx_WLC2_Req_Data : 0|64@1+ (1.0,0.0) [0.0|18446744073709551615] ""  Gateway,Gateway_PAG

BO_ 2550005926 ISOx_WLC2_Resp: 8 Gateway
 SG_ ISOx_WLC2_Resp_Data : 0|64@1+ (1.0,0.0) [0.0|18446744073709551615] ""  Tester_MLBevo

BO_ 2549874843 ISOx_zDML_Req: 8 Tester_MLBevo
 SG_ ISOx_zDML_Req_Data : 0|64@1+ (1.0,0.0) [0.0|18446744073709551615] ""  Gateway,Gateway_PAG

BO_ 2550005915 ISOx_zDML_Resp: 8 Gateway
 SG_ ISOx_zDML_Resp_Data : 0|64@1+ (1.0,0.0) [0.0|18446744073709551615] ""  Tester_MLBevo

BO_ 2033 Request_Airbag_Deployment: 8 Tester_MLBevo
 SG_ Request_Airbag_Deployment : 0|64@1+ (1.0,0.0) [0.0|18446744073709551615] ""  Gateway,Gateway_PAG

BO_ 2041 Response_Airbag_Deployment: 8 Gateway
 SG_ Response_Airbag_Deployment : 0|64@1+ (1.0,0.0) [0.0|18446744073709551615] ""  Tester_MLBevo

BO_ 2566686208 XCP_Gateway_CRO_01: 8 Vector__XXX
 SG_ XCP_Gateway_CRO_01_Data : 0|64@1+ (1,0) [0|1] ""  Gateway,Gateway_PAG

BO_ 2566686209 XCP_Gateway_DTO_01: 8 Gateway
 SG_ XCP_Gateway_DTO_01_Data : 0|64@1+ (1,0) [0|1] ""  Vector__XXX

BO_TX_BU_ 1994 :Gateway,Gateway_PAG;
BO_TX_BU_ 1995 :Gateway,Gateway_PAG;
BO_TX_BU_ 1933 :Gateway,Gateway_PAG;
BO_TX_BU_ 1925 :Gateway,Gateway_PAG;
BO_TX_BU_ 2013 :Gateway,Gateway_PAG;
BO_TX_BU_ 1977 :Gateway,Gateway_PAG;
BO_TX_BU_ 1968 :Gateway,Gateway_PAG;
BO_TX_BU_ 1918 :Gateway,Gateway_PAG;
BO_TX_BU_ 1966 :Gateway,Gateway_PAG;
BO_TX_BU_ 2010 :Gateway,Gateway_PAG;
BO_TX_BU_ 1916 :Gateway,Gateway_PAG;
BO_TX_BU_ 1987 :Gateway,Gateway_PAG;
BO_TX_BU_ 1942 :Gateway,Gateway_PAG;
BO_TX_BU_ 2024 :Gateway,Gateway_PAG;
BO_TX_BU_ 1937 :Gateway,Gateway_PAG;
BO_TX_BU_ 2026 :Gateway,Gateway_PAG;
BO_TX_BU_ 2027 :Gateway,Gateway_PAG;
BO_TX_BU_ 2028 :Gateway,Gateway_PAG;
BO_TX_BU_ 2029 :Gateway,Gateway_PAG;
BO_TX_BU_ 2030 :Gateway,Gateway_PAG;
BO_TX_BU_ 2031 :Gateway,Gateway_PAG;
BO_TX_BU_ 1928 :Gateway,Gateway_PAG;
BO_TX_BU_ 1909 :Gateway,Gateway_PAG;
BO_TX_BU_ 2003 :Gateway,Gateway_PAG;
BO_TX_BU_ 1940 :Gateway,Gateway_PAG;
BO_TX_BU_ 1920 :Gateway,Gateway_PAG;
BO_TX_BU_ 1945 :Gateway,Gateway_PAG;
BO_TX_BU_ 1975 :Gateway,Gateway_PAG;
BO_TX_BU_ 1974 :Gateway,Gateway_PAG;
BO_TX_BU_ 1910 :Gateway,Gateway_PAG;
BO_TX_BU_ 1926 :Gateway,Gateway_PAG;
BO_TX_BU_ 1934 :Gateway,Gateway_PAG;
BO_TX_BU_ 2004 :Gateway,Gateway_PAG;
BO_TX_BU_ 1941 :Gateway,Gateway_PAG;
BO_TX_BU_ 1971 :Gateway,Gateway_PAG;
BO_TX_BU_ 1976 :Gateway,Gateway_PAG;
BO_TX_BU_ 1964 :Gateway,Gateway_PAG;
BO_TX_BU_ 1973 :Gateway,Gateway_PAG;
BO_TX_BU_ 1972 :Gateway,Gateway_PAG;
BO_TX_BU_ 1961 :Gateway,Gateway_PAG;
BO_TX_BU_ 1960 :Gateway,Gateway_PAG;
BO_TX_BU_ 2007 :Gateway,Gateway_PAG;
BO_TX_BU_ 1943 :Gateway,Gateway_PAG;
BO_TX_BU_ 1989 :Gateway,Gateway_PAG;
BO_TX_BU_ 1981 :Gateway,Gateway_PAG;
BO_TX_BU_ 2550005903 :Gateway,Gateway_PAG;
BO_TX_BU_ 2550005934 :Gateway,Gateway_PAG;
BO_TX_BU_ 2550005899 :Gateway,Gateway_PAG;
BO_TX_BU_ 2550005902 :Gateway,Gateway_PAG;
BO_TX_BU_ 2550005907 :Gateway,Gateway_PAG;
BO_TX_BU_ 2550005921 :Gateway,Gateway_PAG;
BO_TX_BU_ 2550005916 :Gateway,Gateway_PAG;
BO_TX_BU_ 2550005960 :Gateway,Gateway_PAG;
BO_TX_BU_ 2550005959 :Gateway,Gateway_PAG;
BO_TX_BU_ 2550005943 :Gateway,Gateway_PAG;
BO_TX_BU_ 2550005946 :Gateway,Gateway_PAG;
BO_TX_BU_ 2550005935 :Gateway,Gateway_PAG;
BO_TX_BU_ 2550005933 :Gateway,Gateway_PAG;
BO_TX_BU_ 2550005912 :Gateway,Gateway_PAG;
BO_TX_BU_ 2550005913 :Gateway,Gateway_PAG;
BO_TX_BU_ 2550005905 :Gateway,Gateway_PAG;
BO_TX_BU_ 2550005906 :Gateway,Gateway_PAG;
BO_TX_BU_ 2550005888 :Gateway,Gateway_PAG;
BO_TX_BU_ 2550005884 :Gateway,Gateway_PAG;
BO_TX_BU_ 2550005944 :Gateway,Gateway_PAG;
BO_TX_BU_ 2550005917 :Gateway,Gateway_PAG;
BO_TX_BU_ 2550005918 :Gateway,Gateway_PAG;
BO_TX_BU_ 2550005883 :Gateway,Gateway_PAG;
BO_TX_BU_ 2550005955 :Gateway,Gateway_PAG;
BO_TX_BU_ 2550005958 :Gateway,Gateway_PAG;
BO_TX_BU_ 2550005897 :Gateway,Gateway_PAG;
BO_TX_BU_ 2550005890 :Gateway,Gateway_PAG;
BO_TX_BU_ 2550005891 :Gateway,Gateway_PAG;
BO_TX_BU_ 2550005910 :Gateway,Gateway_PAG;
BO_TX_BU_ 2550005911 :Gateway,Gateway_PAG;
BO_TX_BU_ 2550005880 :Gateway,Gateway_PAG;
BO_TX_BU_ 2550005908 :Gateway,Gateway_PAG;
BO_TX_BU_ 2550005914 :Gateway,Gateway_PAG;
BO_TX_BU_ 2550005893 :Gateway,Gateway_PAG;
BO_TX_BU_ 2550005920 :Gateway,Gateway_PAG;
BO_TX_BU_ 2550005892 :Gateway,Gateway_PAG;
BO_TX_BU_ 2550005930 :Gateway,Gateway_PAG;
BO_TX_BU_ 2550005931 :Gateway,Gateway_PAG;
BO_TX_BU_ 2550005927 :Gateway,Gateway_PAG;
BO_TX_BU_ 2550005928 :Gateway,Gateway_PAG;
BO_TX_BU_ 2550005896 :Gateway,Gateway_PAG;
BO_TX_BU_ 2550005895 :Gateway,Gateway_PAG;
BO_TX_BU_ 2550005909 :Gateway,Gateway_PAG;
BO_TX_BU_ 2550005923 :Gateway,Gateway_PAG;
BO_TX_BU_ 2550005932 :Gateway,Gateway_PAG;
BO_TX_BU_ 2550005898 :Gateway,Gateway_PAG;
BO_TX_BU_ 2550005940 :Gateway,Gateway_PAG;
BO_TX_BU_ 2550005956 :Gateway,Gateway_PAG;
BO_TX_BU_ 2550005957 :Gateway,Gateway_PAG;
BO_TX_BU_ 2550005936 :Gateway,Gateway_PAG;
BO_TX_BU_ 2550005925 :Gateway,Gateway_PAG;
BO_TX_BU_ 2550005926 :Gateway,Gateway_PAG;
BO_TX_BU_ 2550005915 :Gateway,Gateway_PAG;
BO_TX_BU_ 2041 :Gateway,Gateway_PAG;
BO_TX_BU_ 2566686209 :Gateway,Gateway_PAG;
CM_ BO_ 2549874818 "Lichtsteuerung links am Frontlicht-CAN";
CM_ BO_ 2550005890 "Lichtsteuerung links am Frontlicht-CAN";
CM_ BO_ 2549874819 "Lichtsteuerung rechts am Frontlicht-CAN";
CM_ BO_ 2550005891 "Lichtsteuerung rechts am Frontlicht-CAN";
CM_ BO_ 2549874838 "Lichtsteuerung links am Frontlicht-CAN";
CM_ BO_ 2550005910 "Lichtsteuerung links am Frontlicht-CAN";
CM_ BO_ 2549874839 "Lichtsteuerung rechts am Frontlicht-CAN";
CM_ BO_ 2550005911 "Lichtsteuerung rechts am Frontlicht-CAN";

CM_ SG_ 1888 ISO_HAL_Master_Req_Data "OffBoard Tester Diagnose Request HAL_Master";

CM_ SG_ 1994 ISO_HAL_Master_Resp_Data "OffBoard Tester Diagnose Response HAL_Master";

CM_ SG_ 1889 ISO_HAL_Slave_Req_Data "OffBoard Tester Diagnose Request HAL_Slave";

CM_ SG_ 1995 ISO_HAL_Slave_Resp_Data "OffBoard Tester Diagnose Response HAL_Slave";

CM_ SG_ 1827 ISO_HDSG_Req_Data "Diagnose Request Heckdeckel-Steuergerät";

CM_ SG_ 1933 ISO_HDSG_Resp_Data "Diagnose Response Heckdeckel-Steuergerät";

CM_ SG_ 1819 ISO_HUD_Req_Data "OffBoard Tester Diagnose Request HUD";

CM_ SG_ 1925 ISO_HUD_Resp_Data "OffBoard Tester Diagnose Response HUD";

CM_ SG_ 1907 ISO_Info_El_Req_Data "OffBoard Tester Diagnose Request Info_El";

CM_ SG_ 2013 ISO_Info_El_Resp_Data "OffBoard Tester Diagnose Response Info_El";

CM_ SG_ 2549350438 ISO_ISOx_OTA_SWC_01_Req "Flashlink für zweiten OTA-Flashcontainer";

CM_ SG_ 2549491200 ISO_ISOx_OTA_SWC_01_Resp "Flashlink für zweiten OTA-Flashcontainer";

CM_ SG_ 1871 ISO_Kamera_Req_Data "Diagnose Request Kamerasteuergeraet";

CM_ SG_ 1977 ISO_Kamera_Resp_Data "Diagnose Response Kamerasteuergeraet";

CM_ SG_ 1862 ISO_Klima_Req_Data "Diagnose Request Klima Vorne";

CM_ SG_ 1968 ISO_Klima_Resp_Data "Diagnose Response Klima Vorne";

CM_ SG_ 1812 ISO_Kombi_Req_Data "Diagnose Request Kombiinstrument";

CM_ SG_ 1918 ISO_Kombi_Resp_Data "Diagnose Response Kombiinstrument";

CM_ SG_ 1860 ISO_Ladegeraet_Req_Data "OffBoard Tester Diagnose Request Ladegeraet";

CM_ SG_ 1966 ISO_Ladegeraet_Resp_Data "OffBoard Tester Diagnose Response Ladegeraet";

CM_ SG_ 1904 ISO_Laufwerke_Req_Data "Diagnose Request DVD-Wechsler";

CM_ SG_ 2010 ISO_Laufwerke_Resp_Data "Diagnose Response DVD-Wechsler";

CM_ SG_ 1810 ISO_Lenkhilfe_Req_Data "OffBoard Tester Diagnose Request Lenkhilfe";

CM_ SG_ 1916 ISO_Lenkhilfe_Resp_Data "OffBoard Tester Diagnose Response Lenkhilfe";

CM_ SG_ 1881 ISO_Lift_Req_Data "Diagnose Request Lift_VA";

CM_ SG_ 1987 ISO_Lift_Resp_Data "Diagnose Response Lift";

CM_ SG_ 1836 ISO_MFG_Req_Data "OffBoard Tester Diagnose Request MFG";

CM_ SG_ 1942 ISO_MFG_Resp_Data "OffBoard Tester Diagnose Response MFG";

CM_ SG_ 2016 ISO_MO_01_Req_Data "Diagnose Request Motorsteuergeraet";

CM_ SG_ 2024 ISO_MO_01_Resp_Data "Diagnose Response Motorsteuergeraet";

CM_ SG_ 1831 ISO_NightVision_Req_Data "Diagnose Request Nightvision Kamera";

CM_ SG_ 1937 ISO_NightVision_Resp_Data "Diagnose Response Nightvision Kamera";

CM_ SG_ 2018 ISO_OBD_01_Req_Data "Diagnose Request 01 für OBD relevante Steuergeraete
MLB: Motor-Slave
MLBevo: Motor-Slave";

CM_ SG_ 2026 ISO_OBD_01_Resp_Data "Diagnose Response 01 für OBD relevante Steuergeraete
MLB: Motor-Slave
MLBevo: Motor-Slave";

CM_ SG_ 2019 ISO_OBD_02_Req_Data "Diagnose Request 02 für OBD relevante Steuergeraete
MLBevo: EBKV
MQB: EBKV";

CM_ SG_ 2027 ISO_OBD_02_Resp_Data "Diagnose Response 02 für OBD relevante Steuergeraete
MLBevo: EBKV
MQB: EBKV";

CM_ SG_ 2020 ISO_OBD_03_Req_Data "Diagnose Request 03 für OBD relevante Steuergeraete
MLBevo: ESC
MQB: ESC";

CM_ SG_ 2028 ISO_OBD_03_Resp_Data "Diagnose Response 03 für OBD relevante Steuergeraete
MLBevo: ESC
MQB: ESC";

CM_ SG_ 2021 ISO_OBD_04_Req_Data "Diagnose Request 04 für OBD relevante Steuergeraete
MLB: BMS
MLBevo: BMS
MQB: BMC";

CM_ SG_ 2029 ISO_OBD_04_Resp_Data "Diagnose Response 04 für OBD relevante Steuergeraete
MLB: BMS
MLBevo: BMS
MQB: BMC";

CM_ SG_ 2022 ISO_OBD_05_Req_Data "Diagnose Request 05 für OBD relevante Steuergeraete
MLB: EMotor
MLBevo: EMotor
MQB: EMotor";

CM_ SG_ 2030 ISO_OBD_05_Resp_Data "Diagnose Response 05 für OBD relevante Steuergeraete
MLB: EMotor
MLBevo: EMotor
MQB: EMotor";

CM_ SG_ 2023 ISO_OBD_06_Req_Data "Diagnose Request 06 für OBD relevante Steuergeraete
MLBevo: TME
MQB: Klima-SG";

CM_ SG_ 2031 ISO_OBD_06_Resp_Data "Diagnose Response 06 für OBD relevante Steuergeraete
MLBevo: TME
MQB: Klima-SG";

CM_ SG_ 1822 ISO_Quersperre_Req_Data "Diagnose Request Quersperre";

CM_ SG_ 1928 ISO_Quersperre_Resp_Data "OffBoard Tester Diagnose Response Quersperre";

CM_ SG_ 1803 ISO_RDK_Req_Data "OffBoard Tester Diagnose Request RDK";

CM_ SG_ 1909 ISO_RDK_Resp_Data "OffBoard Tester Diagnose Response RDK";

CM_ SG_ 1897 ISO_Rearview_Req_Data "OffBoard Tester Diagnose Request Rearview";

CM_ SG_ 2003 ISO_Rearview_Resp_Data "OffBoard Tester Diagnose Response Rearview";

CM_ SG_ 1834 ISO_SCR_Req_Data "OffBoard Tester Diagnose Request SCR";

CM_ SG_ 1940 ISO_SCR_Resp_Data "OffBoard Tester Diagnose Response SCR";

CM_ SG_ 1814 ISO_SCU_Req_Data "Diagnose Request Aktive Lenkung oder Dynamiklenkung";

CM_ SG_ 1920 ISO_SCU_Resp_Data "Diagnose Response Aktive Lenkung oder Dynamiklenkung";

CM_ SG_ 1839 ISO_SFA_Req_Data "Diagnose Request SFA";

CM_ SG_ 1945 ISO_SFA_Resp_Data "Diagnose Response SFA";

CM_ SG_ 1869 ISO_Sitzmemo_BFS_Req_Data "OffBoard Tester Diagnose Request Sitzmemo_BFS";

CM_ SG_ 1975 ISO_Sitzmemo_BFS_Resp_Data "OffBoard Tester Diagnose Response Sitzmemo_BFS";

CM_ SG_ 1868 ISO_Sitzmemo_FS_Req_Data "OffBoard Tester Diagnose Request Sitzmemo_FS";

CM_ SG_ 1974 ISO_Sitzmemo_FS_Resp_Data "OffBoard Tester Diagnose Response Sitzmemo_FS";

CM_ SG_ 1804 ISO_SMLS_Req_Data "Diagnose Request Schaltermodul Lenksaeule";

CM_ SG_ 1910 ISO_SMLS_Resp_Data "OffBoard Tester Diagnose Response SMLS";

CM_ SG_ 1820 ISO_Soundaktor_Req_Data "Diagnose Request Soundaktuator innen";

CM_ SG_ 1926 ISO_Soundaktor_Resp_Data "Diagnose Response Soundaktuator innen";

CM_ SG_ 1828 ISO_SpoilerSG_Req_Data "Diagnose Request Spoilersteuergeraet";

CM_ SG_ 1934 ISO_SpoilerSG_Resp_Data "Diagnose Response Spoilersteuergeraet";

CM_ SG_ 1898 ISO_STH_Req_Data "Diagnose Request Standheizung";

CM_ SG_ 2004 ISO_STH_Resp_Data "OffBoard Tester Diagnose Response STH";

CM_ SG_ 1835 ISO_STS_Req_Data "Diagnose Request Schnittstellen-Tracking-System";

CM_ SG_ 1941 ISO_STS_Resp_Data "Diagnose Response Schnittstellen-Tracking-System";

CM_ SG_ 1865 ISO_Sub_Gateway_Req_Data "Diagnose Request Sub_Gateway";

CM_ SG_ 1971 ISO_Sub_Gateway_Resp_Data "Diagnose Response Sub_Gateway";

CM_ SG_ 1870 ISO_SWA_Req_Data "Diagnose Request Spurwechselassistent (Master)";

CM_ SG_ 1976 ISO_SWA_Resp_Data "Diagnose Response Spurwechselassistent (Master)";

CM_ SG_ 1858 ISO_TME_Req_Data "Diagnose Request TME";

CM_ SG_ 1964 ISO_TME_Resp_Data "Diagnose Response TME";

CM_ SG_ 1867 ISO_TSG_BT_Req_Data "OffBoard Tester Diagnose Request TSG_BT";

CM_ SG_ 1973 ISO_TSG_BT_Resp_Data "OffBoard Tester Diagnose Response TSG_BT";

CM_ SG_ 1866 ISO_TSG_FT_Req_Data "OffBoard Tester Diagnose Request TSG_FT";

CM_ SG_ 1972 ISO_TSG_FT_Resp_Data "OffBoard Tester Diagnose Response TSG_FT";

CM_ SG_ 1855 ISO_TSG_HBFS_Req_Data "OffBoard Tester Diagnose Request TSG_HBFS";

CM_ SG_ 1961 ISO_TSG_HBFS_Resp_Data "OffBoard Tester Diagnose Response TSG_HBFS";

CM_ SG_ 1854 ISO_TSG_HFS_Req_Data "OffBoard Tester Diagnose Request TSG_HFS";

CM_ SG_ 1960 ISO_TSG_HFS_Resp_Data "OffBoard Tester Diagnose Response TSG_HFS";

CM_ SG_ 1901 ISO_TV_Tuner_Req_Data "Diagnose Request TV-Tuner";

CM_ SG_ 2007 ISO_TV_Tuner_Resp_Data "Diagnose Response TV-Tuner";

CM_ SG_ 1837 ISO_VSG_Req_Data "OffBoard Tester Diagnose Request VSG";

CM_ SG_ 1943 ISO_VSG_Resp_Data "OffBoard Tester Diagnose Response VSG";

CM_ SG_ 1883 ISO_WaCU_Req_Data "OffBoard Tester Diagnose Request WaCU";

CM_ SG_ 1989 ISO_WaCU_Resp_Data "OffBoard Tester Diagnose Response WaCU";

CM_ SG_ 1875 ISO_Waehlhebel_Req_Data "OffBoard Tester Diagnose Request Waehlhebel";

CM_ SG_ 1981 ISO_Waehlhebel_Resp_Data "OffBoard Tester Diagnose Response Waehlhebel";

CM_ SG_ 2549874831 ISOx_AWC_Req_Data "OffBoard Tester Diagnose Request AWC";

CM_ SG_ 2550005903 ISOx_AWC_Resp_Data "OffBoard Tester Diagnose Response AWC";

CM_ SG_ 2549874862 ISOx_BattRegelung_Req_Data "Diagnose Request BattRegelung";

CM_ SG_ 2550005934 ISOx_BattRegelung_Resp_Data "Diagnose Response BattRegelung";

CM_ SG_ 2549874827 ISOx_BCM2_Req_Data "OffBoard Tester Diagnose Request BCM2";

CM_ SG_ 2550005899 ISOx_BCM2_Resp_Data "Diagnose Response BCM2";

CM_ SG_ 2549874849 ISOx_Bedienteil_Req_Data "Diagnose Request Bedienteil";

CM_ SG_ 2550005921 ISOx_Bedienteil_Resp_Data "Diagnose Response Bedienteil";

CM_ SG_ 2549874844 ISOx_BMS_48V_Req_Data "OffBoard Tester Diagnose Request BMS_48V";

CM_ SG_ 2550005916 ISOx_BMS_48V_Resp_Data "OffBoard Tester Diagnose Response BMS_48V";

CM_ SG_ 2549874888 ISO_BRS_BU_Req_Data "Diagnose Request Bremsenregelsystem Backup Unit";

CM_ SG_ 2550005960 ISO_BRS_BU_Resp_Data "Diagnose Response Bremsenregelsystem Backup Unit";

CM_ SG_ 2549874887 ISOx_DCDC_HV_02_Req_Data "Diagnose Request DCDC_HV_02";

CM_ SG_ 2550005959 ISOx_DCDC_HV_02_Resp_Data "Diagnose Request DCDC_HV_02";

CM_ SG_ 2549874895 ISOx_DCDC_HV_03_Req_Data "Diagnose Request";

CM_ SG_ 2550005967 ISOx_DCDC_HV_03_Resp_Data "Diagnose Response";

CM_ SG_ 2549874874 ISOx_DDA_Req_Data "Diagnose Request DDA";

CM_ SG_ 2550005946 ISOx_DDA_Resp_Data "Diagnose Response CAN HS";

CM_ SG_ 2549874863 ISOx_DLM_BFS_Req_Data "Diagnose Request Türverriegelung Beifahrerseite";

CM_ SG_ 2550005935 ISOx_DLM_BFS_Resp_Data "Diagnose Response Türverriegelung Beifahrerseite";

CM_ SG_ 2549874861 ISOx_DLM_FS_Req_Data "Diagnose Request Türverriegelung Fahrerseite";

CM_ SG_ 2550005933 ISOx_DLM_FS_Resp_Data "Diagnose Response Türverriegelung Fahrerseite";

CM_ SG_ 2549874840 ISOx_DMD_L_Req_Data "OffBoard Tester Diagnose Request DMD_L";

CM_ SG_ 2550005912 ISOx_DMD_L_Resp_Data "OffBoard Tester Diagnose Response DMD_L";

CM_ SG_ 2549874841 ISOx_DMD_R_Req_Data "OffBoard Tester Diagnose Request DMD_R";

CM_ SG_ 2550005913 ISOx_DMD_R_Resp_Data "OffBoard Tester Diagnose Response DMD_R";

CM_ SG_ 2549874834 ISOx_eAWS_2_Req_Data "Diagnose Request elektrisch aktive Wankstabilisierung 2";

CM_ SG_ 2550005906 ISOx_eAWS_2_Resp_Data "Diagnose Response elektrisch aktive Wankstabilisierung 2";

CM_ SG_ 2549874816 ISOx_EFP_Req_Data "Diagnose Request Elektronische Fahrwerks Plattform";

CM_ SG_ 2550005888 ISOx_EFP_Resp_Data "Diagnose Response Elektronische Fahrwerks Plattform";

CM_ SG_ 2549874812 ISOx_EMotor_01_Req_Data "Diagnose Request Leistungselektronik E-Maschine 1";

CM_ SG_ 2550005884 ISOx_EMotor_01_Resp_Data "Diagnose Response Leistungselektronik E-Maschine 1";

CM_ SG_ 2549874872 ISOx_EMotor_02_Req_Data "OffBoard Tester Diagnose Request EMotor_02";

CM_ SG_ 2550005944 ISOx_EMotor_02_Resp_Data "Diagnose Response Leistungselektronik E-Maschine 2";

CM_ SG_ 2549874869 ISOx_FCU_Req_Data "Diagnose Request";

CM_ SG_ 2550005941 ISOx_FCU_Resp_Data "Diagnose Response";

CM_ SG_ 2549874845 ISOx_Fronteckradar1_Req_Data "Diagnose Request Fronteckradar1";

CM_ SG_ 2550005917 ISOx_Fronteckradar1_Resp_Data "Diagnose Response Fronteckradar1";

CM_ SG_ 2549874846 ISOx_Fronteckradar2_Req_Data "Diagnose Request Fronteckradar2";

CM_ SG_ 2550005918 ISOx_Fronteckradar2_Resp_Data "Diagnose Response Fronteckradar2";

CM_ SG_ 2549874811 ISOx_Hybrid_01_Req_Data "OffBoard Tester Diagnose Request Hybrid_01";

CM_ SG_ 2550005883 ISOx_Hybrid_01_Resp_Data "OffBoard Tester Diagnose Response Hybrid_01";

CM_ SG_ 2549874883 ISOx_KFS_Req_Data "Diagnose Request Kuehlerfigursteller";

CM_ SG_ 2550005955 ISOx_KFS_Resp_Data "Diagnose Response Kuehlerfigursteller";

CM_ SG_ 2549874886 ISOx_Ladegeraet_2_Req_Data "Diagnose Request Ladegerät_2";

CM_ SG_ 2550005958 ISOx_Ladegeraet_2_Resp_Data "Diagnose Response Ladegerät_2";

CM_ SG_ 2549874825 ISOx_Laserscanner_Req_Data "Diagnose Request Laserscanner";

CM_ SG_ 2550005897 ISOx_Laserscanner_Resp_Data "Diagnose Response Laserscanner";

CM_ SG_ 2549874818 ISOx_LCM_L_Req_Data "Diagnose Request Light Control Module links";

CM_ SG_ 2550005890 ISOx_LCM_L_Resp_Data "OffBoard Tester Diagnose Response LCM_L";

CM_ SG_ 2549874819 ISOx_LCM_R_Req_Data "OffBoard Tester Diagnose Request LCM_R";

CM_ SG_ 2550005891 ISOx_LCM_R_Resp_Data "Diagnose Response Light Control Module rechts";

CM_ SG_ 2549874838 ISOx_LED_LM_L_Req_Data "Diagnose Resquest Steuergeraet für LED-Scheinwerfer links";

CM_ SG_ 2550005910 ISOx_LED_LM_L_Resp_Data "OffBoard Tester Diagnose Response LED_LM_L";

CM_ SG_ 2549874839 ISOx_LED_LM_R_Req_Data "Diagnose Request Steuergeraet für LED-Scheinwerfer rechts";

CM_ SG_ 2550005911 ISOx_LED_LM_R_Resp_Data "OffBoard Tester Diagnose Response LED_LM_R";

CM_ SG_ 2549874808 ISOx_MOS_01_Req_Data "Diagnose Request Motorsteuergeraet 2";

CM_ SG_ 2550005880 ISOx_MOS_01_Resp_Data "Diagnose Response Motorsteuergeraet 2";

CM_ SG_ 2549874822 ISOx_OTA_FC_Req_Data "Diagnose Request OTA-FC";

CM_ SG_ 2550005894 ISOx_OTA_FC_Resp_Data "Diagnose Response OTA FC";

CM_ SG_ 2549874836 ISOx_PACC_Req_Data "Diagnose Request Predictive ACC high";

CM_ SG_ 2550005908 ISOx_PACC_Resp_Data "Diagnose Response Predictive ACC high";

CM_ SG_ 2549874821 ISOx_RSG_Req_Data "OffBoard Tester Diagnose Request RSG";

CM_ SG_ 2550005893 ISOx_RSG_Resp_Data "OffBoard Tester Diagnose Response RSG";

CM_ SG_ 2549874848 ISOx_SAD2_Req_Data "Diagnose Request SAD2";

CM_ SG_ 2550005920 ISOx_SAD2_Resp_Data "OffBoard Tester Diagnose Response SAD2";

CM_ SG_ 2549874820 ISOx_SAD_Req_Data "Diagnose Request Schiebeausstelldach";

CM_ SG_ 2550005892 ISOx_SAD_Resp_Data "OffBoard Tester Diagnose Response SAD";

CM_ SG_ 2549874858 ISOx_SCC1_Req_Data "Diagnose Request SDC1";

CM_ SG_ 2550005930 ISOx_SCC1_Resp_Data "Diagnose Response SDC1";

CM_ SG_ 2549874859 ISOx_SCC2_Req_Data "Diagnose Request SDC1";

CM_ SG_ 2550005931 ISOx_SCC2_Resp_Data "Diagnose Response SDC1";

CM_ SG_ 2549874855 ISOx_SDC1_Req_Data "Diagnose Request SDC1";

CM_ SG_ 2550005927 ISOx_SDC1_Resp_Data "Diagnose Response SDC1";

CM_ SG_ 2549874856 ISOx_SDC2_Req_Data "Diagnosekanal SDC2";

CM_ SG_ 2550005928 ISOx_SDC2_Resp_Data "Diagnosekanal SDC2";

CM_ SG_ 2549874824 ISOx_Sitzmemo_HBFS_Req_Data "OffBoard Tester Diagnose Request Sitzmemo_HBFS";

CM_ SG_ 2550005896 ISOx_Sitzmemo_HBFS_Resp_Data "OffBoard Tester Diagnose Response Sitzmemo_HBFS";

CM_ SG_ 2549874823 ISOx_Sitzmemo_HFS_Req_Data "OffBoard Tester Diagnose Request Sitzmemo_HFS";

CM_ SG_ 2550005895 ISOx_Sitzmemo_HFS_Resp_Data "OffBoard Tester Diagnose Response Sitzmemo_HFS";

CM_ SG_ 2549874837 ISOx_Sitzmemo_SR3_Req_Data "OffBoard Tester Diagnose Request Sitzmemo_SR3";

CM_ SG_ 2550005909 ISOx_Sitzmemo_SR3_Resp_Data "OffBoard Tester Diagnose Response Sitzmemo_SR3";

CM_ SG_ 2549874851 ISOx_SRAL_Req_Data "Diagnose Request SRAL";

CM_ SG_ 2550005923 ISOx_SRAL_Resp_Data "Diagnose Response SRAL";

CM_ SG_ 2549874860 ISOx_SRAR_Req_Data "Diagnose Request SRAR";

CM_ SG_ 2550005932 ISOx_SRAR_Resp_Data "Diagnose Response SRAR";

CM_ SG_ 2549874826 ISOx_SWA_2_Req_Data "Diagnose Request Spurwechselassistent (Slave)";

CM_ SG_ 2550005898 ISOx_SWA_2_Resp_Data "Diagnose Response Spurwechselassistent (Slave)";

CM_ SG_ 2549874868 ISOx_TelemetrieSG_Req_Data "OffBoard Tester Diagnose Request TelemetrieSG";

CM_ SG_ 2550005940 ISOx_TelemetrieSG_Resp_Data "OffBoard Tester Diagnose Response TelemetrieSG";

CM_ SG_ 2549874884 ISOx_VAS_L_Req_Data "OffBoard Tester Diagnose Request VAS_L";

CM_ SG_ 2550005956 ISOx_VAS_L_Resp_Data "OffBoard Tester Diagnose Response VAS_L";

CM_ SG_ 2549874885 ISOx_VAS_R_Req_Data "OffBoard Tester Diagnose Request VAS_R";

CM_ SG_ 2550005957 ISOx_VAS_R_Resp_Data "OffBoard Tester Diagnose Response VAS_R";

CM_ SG_ 2549874864 ISOx_WindowTrans_1_Req_Data "Diagnose Request Steuergerät 1 für Scheibentönung";

CM_ SG_ 2550005936 ISOx_WindowTrans_1_Resp_Data "Diagnose Response Steuergerät 1 für Scheibentönung";

CM_ SG_ 2549874853 ISOx_WLC1_Req_Data "OffBoard Tester Diagnose Request WLC1";

CM_ SG_ 2550005925 ISOx_WLC1_Resp_Data "OffBoard Tester Diagnose Response WLC1";

CM_ SG_ 2549874854 ISOx_WLC2_Req_Data "OffBoard Tester Diagnose Request WLC2";

CM_ SG_ 2550005926 ISOx_WLC2_Resp_Data "OffBoard Tester Diagnose Response WLC2";

CM_ SG_ 2549874843 ISOx_zDML_Req_Data "Diagnose Request Zentrales Digitales Matrix Licht";

CM_ SG_ 2550005915 ISOx_zDML_Resp_Data "Diagnose Response Zentrales Digitales Matrix Licht";

CM_ SG_ 2033 Request_Airbag_Deployment "Request für die Disposal Diagnose (ISO26021)";

CM_ SG_ 2041 Response_Airbag_Deployment "Response für die Disposal Diagnose (ISO26021)";
BA_DEF_ BO_  "DiagRequest" ENUM "No", "Yes";
BA_DEF_ BO_  "DiagResponse" ENUM "No", "Yes";
BA_DEF_ BO_  "DiagState" ENUM "No", "Yes";
BA_DEF_ BO_  "GenMsgChkConstant" HEX 0 4095;
BA_DEF_ BO_  "GenMsgCycleTime" INT 0 65535;
BA_DEF_ BO_  "GenMsgILSupport" ENUM "No", "Yes";
BA_DEF_ BO_  "GenMsgSendType" ENUM "Cyclic", "not_used", "not_used", "not_used", "not_used", "not_used", "not_used", "IfActive", "NoMsgSendType";
BA_DEF_ BO_  "GenMsgStartDelayTime" INT 0 100000;
BA_DEF_ BO_  "NmMessage" ENUM "No", "Yes";
BA_DEF_ BO_  "NmhMessage" ENUM "No", "Yes";
BA_DEF_ BO_  "MsgType" ENUM "Application", "NM ", "NMH", "TP2.0", "ISO-TP ", "BAP", "EID", "KS", "XCP_PRE_CONFIGURED", "XCP_RUNTIME_CONFIGURED";
BA_DEF_ BO_  "VAGTP20_API" HEX 0 255;
BA_DEF_ BO_  "VAGTP20_DynConnection" ENUM "No", "Yes";
BA_DEF_ BO_  "VAGTP20_DynSetup" ENUM "No", "Yes";
BA_DEF_ BO_  "VAGTP20_StatConnection" ENUM "No", "Yes";
BA_DEF_ SG_  "GenSigActiveRepetitions" INT -2147483648 2147483647;
BA_DEF_ SG_  "GenSigSendType" ENUM "Cyclic", "OnWrite", "OnWriteWithRepetition", "OnChange", "OnChangeWithRepetition", "IfActive", "IfActiveWithRepetition", "NoSigSendType", "OnChangeAndIfActive", "OnChangeAndIfActiveWithRepetition";
BA_DEF_ SG_  "GenSigStartValue" INT -2147483648 2147483647;
BA_DEF_ SG_  "NWM-WakeupAllowed" ENUM "No", "Yes";
BA_DEF_ SG_  "GenSigFuncType" ENUM "NoFunction", "MsgCounter", "CRC-8", "XOR", "XOR-2", "DatedBit", "SW-Kl15", "CHK", "Constant", "Protocol", "CRC-8-SAE_J1850", "CRC-32", "DataLength", "DataID", "MsgCounter16", "SOK-Signatur", "Cluster";
BA_DEF_ SG_  "GenSigSwitchedByIgnition" ENUM "No", "Yes";
BA_DEF_ SG_  "Fehlerwert" HEX 0 2147483647;
BA_DEF_ SG_  "GenSigMissingSourceValue" HEX 0 2147483647;
BA_DEF_DEF_  "DiagRequest" "No";
BA_DEF_DEF_  "DiagResponse" "No";
BA_DEF_DEF_  "DiagState" "No";
BA_DEF_DEF_  "GenMsgChkConstant" 0;
BA_DEF_DEF_  "GenMsgCycleTime" 0;
BA_DEF_DEF_  "GenMsgILSupport" "No";
BA_DEF_DEF_  "GenMsgSendType" "NoMsgSendType";
BA_DEF_DEF_  "GenMsgStartDelayTime" 0;
BA_DEF_DEF_  "NmMessage" "No";
BA_DEF_DEF_  "NmhMessage" "No";
BA_DEF_DEF_  "MsgType" "Application";
BA_DEF_DEF_  "VAGTP20_API" 0;
BA_DEF_DEF_  "VAGTP20_DynConnection" "No";
BA_DEF_DEF_  "VAGTP20_DynSetup" "No";
BA_DEF_DEF_  "VAGTP20_StatConnection" "No";
BA_DEF_DEF_  "GenSigActiveRepetitions" 0;
BA_DEF_DEF_  "GenSigSendType" "NoSigSendType";
BA_DEF_DEF_  "GenSigStartValue" 0;
BA_DEF_DEF_  "NWM-WakeupAllowed" "No";
BA_DEF_DEF_  "GenSigFuncType" "NoFunction";
BA_DEF_DEF_  "GenSigSwitchedByIgnition" "Yes";
BA_DEF_DEF_  "Fehlerwert" 0;
BA_DEF_DEF_  "GenSigMissingSourceValue" 0;
BA_ "DiagRequest" BO_ 1888 1;
BA_ "MsgType" BO_ 1888 4;
BA_ "DiagResponse" BO_ 1994 1;
BA_ "MsgType" BO_ 1994 4;
BA_ "DiagRequest" BO_ 1889 1;
BA_ "MsgType" BO_ 1889 4;
BA_ "DiagResponse" BO_ 1995 1;
BA_ "MsgType" BO_ 1995 4;
BA_ "DiagRequest" BO_ 1827 1;
BA_ "MsgType" BO_ 1827 4;
BA_ "DiagResponse" BO_ 1933 1;
BA_ "MsgType" BO_ 1933 4;
BA_ "DiagRequest" BO_ 1819 1;
BA_ "MsgType" BO_ 1819 4;
BA_ "DiagResponse" BO_ 1925 1;
BA_ "MsgType" BO_ 1925 4;
BA_ "DiagRequest" BO_ 1907 1;
BA_ "MsgType" BO_ 1907 4;
BA_ "DiagResponse" BO_ 2013 1;
BA_ "MsgType" BO_ 2013 4;
BA_ "DiagRequest" BO_ 2549350438 1;
BA_ "MsgType" BO_ 2549350438 4;
BA_ "DiagResponse" BO_ 2549491200 1;
BA_ "MsgType" BO_ 2549491200 4;
BA_ "DiagRequest" BO_ 1871 1;
BA_ "MsgType" BO_ 1871 4;
BA_ "DiagResponse" BO_ 1977 1;
BA_ "MsgType" BO_ 1977 4;
BA_ "DiagRequest" BO_ 1862 1;
BA_ "MsgType" BO_ 1862 4;
BA_ "DiagResponse" BO_ 1968 1;
BA_ "MsgType" BO_ 1968 4;
BA_ "DiagRequest" BO_ 1812 1;
BA_ "MsgType" BO_ 1812 4;
BA_ "DiagResponse" BO_ 1918 1;
BA_ "MsgType" BO_ 1918 4;
BA_ "DiagRequest" BO_ 1860 1;
BA_ "MsgType" BO_ 1860 4;
BA_ "DiagResponse" BO_ 1966 1;
BA_ "MsgType" BO_ 1966 4;
BA_ "DiagRequest" BO_ 1904 1;
BA_ "MsgType" BO_ 1904 4;
BA_ "DiagResponse" BO_ 2010 1;
BA_ "MsgType" BO_ 2010 4;
BA_ "DiagRequest" BO_ 1810 1;
BA_ "MsgType" BO_ 1810 4;
BA_ "DiagResponse" BO_ 1916 1;
BA_ "MsgType" BO_ 1916 4;
BA_ "DiagRequest" BO_ 1881 1;
BA_ "MsgType" BO_ 1881 4;
BA_ "DiagResponse" BO_ 1987 1;
BA_ "MsgType" BO_ 1987 4;
BA_ "DiagRequest" BO_ 1836 1;
BA_ "MsgType" BO_ 1836 4;
BA_ "DiagResponse" BO_ 1942 1;
BA_ "MsgType" BO_ 1942 4;
BA_ "DiagRequest" BO_ 2016 1;
BA_ "MsgType" BO_ 2016 4;
BA_ "DiagResponse" BO_ 2024 1;
BA_ "MsgType" BO_ 2024 4;
BA_ "DiagRequest" BO_ 1831 1;
BA_ "MsgType" BO_ 1831 4;
BA_ "DiagResponse" BO_ 1937 1;
BA_ "MsgType" BO_ 1937 4;
BA_ "DiagRequest" BO_ 2018 1;
BA_ "MsgType" BO_ 2018 4;
BA_ "DiagResponse" BO_ 2026 1;
BA_ "MsgType" BO_ 2026 4;
BA_ "DiagRequest" BO_ 2019 1;
BA_ "MsgType" BO_ 2019 4;
BA_ "DiagResponse" BO_ 2027 1;
BA_ "MsgType" BO_ 2027 4;
BA_ "DiagRequest" BO_ 2020 1;
BA_ "MsgType" BO_ 2020 4;
BA_ "DiagResponse" BO_ 2028 1;
BA_ "MsgType" BO_ 2028 4;
BA_ "DiagRequest" BO_ 2021 1;
BA_ "MsgType" BO_ 2021 4;
BA_ "DiagResponse" BO_ 2029 1;
BA_ "MsgType" BO_ 2029 4;
BA_ "DiagRequest" BO_ 2022 1;
BA_ "MsgType" BO_ 2022 4;
BA_ "DiagResponse" BO_ 2030 1;
BA_ "MsgType" BO_ 2030 4;
BA_ "DiagRequest" BO_ 2023 1;
BA_ "MsgType" BO_ 2023 4;
BA_ "DiagResponse" BO_ 2031 1;
BA_ "MsgType" BO_ 2031 4;
BA_ "DiagRequest" BO_ 1822 1;
BA_ "MsgType" BO_ 1822 4;
BA_ "DiagResponse" BO_ 1928 1;
BA_ "MsgType" BO_ 1928 4;
BA_ "DiagRequest" BO_ 1803 1;
BA_ "MsgType" BO_ 1803 4;
BA_ "DiagResponse" BO_ 1909 1;
BA_ "MsgType" BO_ 1909 4;
BA_ "DiagRequest" BO_ 1897 1;
BA_ "MsgType" BO_ 1897 4;
BA_ "DiagResponse" BO_ 2003 1;
BA_ "MsgType" BO_ 2003 4;
BA_ "DiagRequest" BO_ 1834 1;
BA_ "MsgType" BO_ 1834 4;
BA_ "DiagResponse" BO_ 1940 1;
BA_ "MsgType" BO_ 1940 4;
BA_ "DiagRequest" BO_ 1814 1;
BA_ "MsgType" BO_ 1814 4;
BA_ "DiagResponse" BO_ 1920 1;
BA_ "MsgType" BO_ 1920 4;
BA_ "DiagRequest" BO_ 1839 1;
BA_ "MsgType" BO_ 1839 4;
BA_ "DiagResponse" BO_ 1945 1;
BA_ "MsgType" BO_ 1945 4;
BA_ "DiagRequest" BO_ 1869 1;
BA_ "MsgType" BO_ 1869 4;
BA_ "DiagResponse" BO_ 1975 1;
BA_ "MsgType" BO_ 1975 4;
BA_ "DiagRequest" BO_ 1868 1;
BA_ "MsgType" BO_ 1868 4;
BA_ "DiagResponse" BO_ 1974 1;
BA_ "MsgType" BO_ 1974 4;
BA_ "DiagRequest" BO_ 1804 1;
BA_ "MsgType" BO_ 1804 4;
BA_ "DiagResponse" BO_ 1910 1;
BA_ "MsgType" BO_ 1910 4;
BA_ "DiagRequest" BO_ 1820 1;
BA_ "MsgType" BO_ 1820 4;
BA_ "DiagResponse" BO_ 1926 1;
BA_ "MsgType" BO_ 1926 4;
BA_ "DiagRequest" BO_ 1828 1;
BA_ "MsgType" BO_ 1828 4;
BA_ "DiagResponse" BO_ 1934 1;
BA_ "MsgType" BO_ 1934 4;
BA_ "DiagRequest" BO_ 1898 1;
BA_ "MsgType" BO_ 1898 4;
BA_ "DiagResponse" BO_ 2004 1;
BA_ "MsgType" BO_ 2004 4;
BA_ "DiagRequest" BO_ 1835 1;
BA_ "MsgType" BO_ 1835 4;
BA_ "DiagResponse" BO_ 1941 1;
BA_ "MsgType" BO_ 1941 4;
BA_ "DiagRequest" BO_ 1865 1;
BA_ "MsgType" BO_ 1865 4;
BA_ "DiagResponse" BO_ 1971 1;
BA_ "MsgType" BO_ 1971 4;
BA_ "DiagRequest" BO_ 1870 1;
BA_ "MsgType" BO_ 1870 4;
BA_ "DiagResponse" BO_ 1976 1;
BA_ "MsgType" BO_ 1976 4;
BA_ "DiagRequest" BO_ 1858 1;
BA_ "MsgType" BO_ 1858 4;
BA_ "DiagResponse" BO_ 1964 1;
BA_ "MsgType" BO_ 1964 4;
BA_ "DiagRequest" BO_ 1867 1;
BA_ "MsgType" BO_ 1867 4;
BA_ "DiagResponse" BO_ 1973 1;
BA_ "MsgType" BO_ 1973 4;
BA_ "DiagRequest" BO_ 1866 1;
BA_ "MsgType" BO_ 1866 4;
BA_ "DiagResponse" BO_ 1972 1;
BA_ "MsgType" BO_ 1972 4;
BA_ "DiagRequest" BO_ 1855 1;
BA_ "MsgType" BO_ 1855 4;
BA_ "DiagResponse" BO_ 1961 1;
BA_ "MsgType" BO_ 1961 4;
BA_ "DiagRequest" BO_ 1854 1;
BA_ "MsgType" BO_ 1854 4;
BA_ "DiagResponse" BO_ 1960 1;
BA_ "MsgType" BO_ 1960 4;
BA_ "DiagRequest" BO_ 1901 1;
BA_ "MsgType" BO_ 1901 4;
BA_ "DiagResponse" BO_ 2007 1;
BA_ "MsgType" BO_ 2007 4;
BA_ "DiagRequest" BO_ 1837 1;
BA_ "MsgType" BO_ 1837 4;
BA_ "DiagResponse" BO_ 1943 1;
BA_ "MsgType" BO_ 1943 4;
BA_ "DiagRequest" BO_ 1883 1;
BA_ "MsgType" BO_ 1883 4;
BA_ "DiagResponse" BO_ 1989 1;
BA_ "MsgType" BO_ 1989 4;
BA_ "DiagRequest" BO_ 1875 1;
BA_ "MsgType" BO_ 1875 4;
BA_ "DiagResponse" BO_ 1981 1;
BA_ "MsgType" BO_ 1981 4;
BA_ "DiagRequest" BO_ 2549874831 1;
BA_ "MsgType" BO_ 2549874831 4;
BA_ "DiagResponse" BO_ 2550005903 1;
BA_ "MsgType" BO_ 2550005903 4;
BA_ "DiagRequest" BO_ 2549874862 1;
BA_ "MsgType" BO_ 2549874862 4;
BA_ "DiagResponse" BO_ 2550005934 1;
BA_ "MsgType" BO_ 2550005934 4;
BA_ "DiagRequest" BO_ 2549874827 1;
BA_ "MsgType" BO_ 2549874827 4;
BA_ "DiagResponse" BO_ 2550005899 1;
BA_ "MsgType" BO_ 2550005899 4;
BA_ "DiagRequest" BO_ 2549874830 1;
BA_ "MsgType" BO_ 2549874830 4;
BA_ "DiagResponse" BO_ 2550005902 1;
BA_ "MsgType" BO_ 2550005902 4;
BA_ "DiagRequest" BO_ 2549874835 1;
BA_ "MsgType" BO_ 2549874835 4;
BA_ "DiagResponse" BO_ 2550005907 1;
BA_ "MsgType" BO_ 2550005907 4;
BA_ "DiagRequest" BO_ 2549874849 1;
BA_ "MsgType" BO_ 2549874849 4;
BA_ "DiagResponse" BO_ 2550005921 1;
BA_ "MsgType" BO_ 2550005921 4;
BA_ "DiagRequest" BO_ 2549874844 1;
BA_ "MsgType" BO_ 2549874844 4;
BA_ "DiagResponse" BO_ 2550005916 1;
BA_ "MsgType" BO_ 2550005916 4;
BA_ "DiagRequest" BO_ 2549874888 1;
BA_ "MsgType" BO_ 2549874888 4;
BA_ "DiagResponse" BO_ 2550005960 1;
BA_ "MsgType" BO_ 2550005960 4;
BA_ "DiagRequest" BO_ 2549874887 1;
BA_ "MsgType" BO_ 2549874887 4;
BA_ "DiagResponse" BO_ 2550005959 1;
BA_ "MsgType" BO_ 2550005959 4;
BA_ "DiagRequest" BO_ 2549874895 1;
BA_ "MsgType" BO_ 2549874895 4;
BA_ "DiagResponse" BO_ 2550005967 1;
BA_ "MsgType" BO_ 2550005967 4;
BA_ "DiagRequest" BO_ 2549874871 1;
BA_ "MsgType" BO_ 2549874871 4;
BA_ "DiagResponse" BO_ 2550005943 1;
BA_ "MsgType" BO_ 2550005943 4;
BA_ "DiagRequest" BO_ 2549874874 1;
BA_ "MsgType" BO_ 2549874874 4;
BA_ "DiagResponse" BO_ 2550005946 1;
BA_ "MsgType" BO_ 2550005946 4;
BA_ "DiagRequest" BO_ 2549874863 1;
BA_ "MsgType" BO_ 2549874863 4;
BA_ "DiagResponse" BO_ 2550005935 1;
BA_ "MsgType" BO_ 2550005935 4;
BA_ "DiagRequest" BO_ 2549874861 1;
BA_ "MsgType" BO_ 2549874861 4;
BA_ "DiagResponse" BO_ 2550005933 1;
BA_ "MsgType" BO_ 2550005933 4;
BA_ "DiagRequest" BO_ 2549874840 1;
BA_ "MsgType" BO_ 2549874840 4;
BA_ "DiagResponse" BO_ 2550005912 1;
BA_ "MsgType" BO_ 2550005912 4;
BA_ "DiagRequest" BO_ 2549874841 1;
BA_ "MsgType" BO_ 2549874841 4;
BA_ "DiagResponse" BO_ 2550005913 1;
BA_ "MsgType" BO_ 2550005913 4;
BA_ "DiagRequest" BO_ 2549874833 1;
BA_ "MsgType" BO_ 2549874833 4;
BA_ "DiagResponse" BO_ 2550005905 1;
BA_ "MsgType" BO_ 2550005905 4;
BA_ "DiagRequest" BO_ 2549874834 1;
BA_ "MsgType" BO_ 2549874834 4;
BA_ "DiagResponse" BO_ 2550005906 1;
BA_ "MsgType" BO_ 2550005906 4;
BA_ "DiagRequest" BO_ 2549874816 1;
BA_ "MsgType" BO_ 2549874816 4;
BA_ "DiagResponse" BO_ 2550005888 1;
BA_ "MsgType" BO_ 2550005888 4;
BA_ "DiagRequest" BO_ 2549874812 1;
BA_ "MsgType" BO_ 2549874812 4;
BA_ "DiagResponse" BO_ 2550005884 1;
BA_ "MsgType" BO_ 2550005884 4;
BA_ "DiagRequest" BO_ 2549874872 1;
BA_ "MsgType" BO_ 2549874872 4;
BA_ "DiagResponse" BO_ 2550005944 1;
BA_ "MsgType" BO_ 2550005944 4;
BA_ "DiagRequest" BO_ 2549874869 1;
BA_ "MsgType" BO_ 2549874869 4;
BA_ "DiagResponse" BO_ 2550005941 1;
BA_ "MsgType" BO_ 2550005941 4;
BA_ "DiagRequest" BO_ 2549874845 1;
BA_ "MsgType" BO_ 2549874845 4;
BA_ "DiagResponse" BO_ 2550005917 1;
BA_ "MsgType" BO_ 2550005917 4;
BA_ "DiagRequest" BO_ 2549874846 1;
BA_ "MsgType" BO_ 2549874846 4;
BA_ "DiagResponse" BO_ 2550005918 1;
BA_ "MsgType" BO_ 2550005918 4;
BA_ "DiagRequest" BO_ 2549874811 1;
BA_ "MsgType" BO_ 2549874811 4;
BA_ "DiagResponse" BO_ 2550005883 1;
BA_ "MsgType" BO_ 2550005883 4;
BA_ "DiagRequest" BO_ 2549874883 1;
BA_ "MsgType" BO_ 2549874883 4;
BA_ "DiagResponse" BO_ 2550005955 1;
BA_ "MsgType" BO_ 2550005955 4;
BA_ "DiagRequest" BO_ 2549874886 1;
BA_ "MsgType" BO_ 2549874886 4;
BA_ "DiagResponse" BO_ 2550005958 1;
BA_ "MsgType" BO_ 2550005958 4;
BA_ "DiagRequest" BO_ 2549874825 1;
BA_ "MsgType" BO_ 2549874825 4;
BA_ "DiagResponse" BO_ 2550005897 1;
BA_ "MsgType" BO_ 2550005897 4;
BA_ "DiagRequest" BO_ 2549874818 1;
BA_ "MsgType" BO_ 2549874818 4;
BA_ "DiagResponse" BO_ 2550005890 1;
BA_ "MsgType" BO_ 2550005890 4;
BA_ "DiagRequest" BO_ 2549874819 1;
BA_ "MsgType" BO_ 2549874819 4;
BA_ "DiagResponse" BO_ 2550005891 1;
BA_ "MsgType" BO_ 2550005891 4;
BA_ "DiagRequest" BO_ 2549874838 1;
BA_ "MsgType" BO_ 2549874838 4;
BA_ "DiagResponse" BO_ 2550005910 1;
BA_ "MsgType" BO_ 2550005910 4;
BA_ "DiagRequest" BO_ 2549874839 1;
BA_ "MsgType" BO_ 2549874839 4;
BA_ "DiagResponse" BO_ 2550005911 1;
BA_ "MsgType" BO_ 2550005911 4;
BA_ "DiagRequest" BO_ 2549874808 1;
BA_ "MsgType" BO_ 2549874808 4;
BA_ "DiagResponse" BO_ 2550005880 1;
BA_ "MsgType" BO_ 2550005880 4;
BA_ "DiagRequest" BO_ 2549874822 1;
BA_ "MsgType" BO_ 2549874822 4;
BA_ "DiagResponse" BO_ 2550005894 1;
BA_ "MsgType" BO_ 2550005894 4;
BA_ "DiagRequest" BO_ 2549874836 1;
BA_ "MsgType" BO_ 2549874836 4;
BA_ "DiagResponse" BO_ 2550005908 1;
BA_ "MsgType" BO_ 2550005908 4;
BA_ "DiagRequest" BO_ 2549874842 1;
BA_ "MsgType" BO_ 2549874842 4;
BA_ "DiagResponse" BO_ 2550005914 1;
BA_ "MsgType" BO_ 2550005914 4;
BA_ "DiagRequest" BO_ 2549874821 1;
BA_ "MsgType" BO_ 2549874821 4;
BA_ "DiagResponse" BO_ 2550005893 1;
BA_ "MsgType" BO_ 2550005893 4;
BA_ "DiagRequest" BO_ 2549874848 1;
BA_ "MsgType" BO_ 2549874848 4;
BA_ "DiagResponse" BO_ 2550005920 1;
BA_ "MsgType" BO_ 2550005920 4;
BA_ "DiagRequest" BO_ 2549874820 1;
BA_ "MsgType" BO_ 2549874820 4;
BA_ "DiagResponse" BO_ 2550005892 1;
BA_ "MsgType" BO_ 2550005892 4;
BA_ "DiagRequest" BO_ 2549874858 1;
BA_ "MsgType" BO_ 2549874858 4;
BA_ "DiagResponse" BO_ 2550005930 1;
BA_ "MsgType" BO_ 2550005930 4;
BA_ "DiagRequest" BO_ 2549874859 1;
BA_ "MsgType" BO_ 2549874859 4;
BA_ "DiagResponse" BO_ 2550005931 1;
BA_ "MsgType" BO_ 2550005931 4;
BA_ "DiagRequest" BO_ 2549874855 1;
BA_ "MsgType" BO_ 2549874855 4;
BA_ "DiagResponse" BO_ 2550005927 1;
BA_ "MsgType" BO_ 2550005927 4;
BA_ "DiagRequest" BO_ 2549874856 1;
BA_ "MsgType" BO_ 2549874856 4;
BA_ "DiagResponse" BO_ 2550005928 1;
BA_ "MsgType" BO_ 2550005928 4;
BA_ "DiagRequest" BO_ 2549874824 1;
BA_ "MsgType" BO_ 2549874824 4;
BA_ "DiagResponse" BO_ 2550005896 1;
BA_ "MsgType" BO_ 2550005896 4;
BA_ "DiagRequest" BO_ 2549874823 1;
BA_ "MsgType" BO_ 2549874823 4;
BA_ "DiagResponse" BO_ 2550005895 1;
BA_ "MsgType" BO_ 2550005895 4;
BA_ "DiagRequest" BO_ 2549874837 1;
BA_ "MsgType" BO_ 2549874837 4;
BA_ "DiagResponse" BO_ 2550005909 1;
BA_ "MsgType" BO_ 2550005909 4;
BA_ "DiagRequest" BO_ 2549874851 1;
BA_ "MsgType" BO_ 2549874851 4;
BA_ "DiagResponse" BO_ 2550005923 1;
BA_ "MsgType" BO_ 2550005923 4;
BA_ "DiagRequest" BO_ 2549874860 1;
BA_ "MsgType" BO_ 2549874860 4;
BA_ "DiagResponse" BO_ 2550005932 1;
BA_ "MsgType" BO_ 2550005932 4;
BA_ "DiagRequest" BO_ 2549874826 1;
BA_ "MsgType" BO_ 2549874826 4;
BA_ "DiagResponse" BO_ 2550005898 1;
BA_ "MsgType" BO_ 2550005898 4;
BA_ "DiagRequest" BO_ 2549874868 1;
BA_ "MsgType" BO_ 2549874868 4;
BA_ "DiagResponse" BO_ 2550005940 1;
BA_ "MsgType" BO_ 2550005940 4;
BA_ "DiagRequest" BO_ 2549874884 1;
BA_ "MsgType" BO_ 2549874884 4;
BA_ "DiagResponse" BO_ 2550005956 1;
BA_ "MsgType" BO_ 2550005956 4;
BA_ "DiagRequest" BO_ 2549874885 1;
BA_ "MsgType" BO_ 2549874885 4;
BA_ "DiagResponse" BO_ 2550005957 1;
BA_ "MsgType" BO_ 2550005957 4;
BA_ "DiagRequest" BO_ 2549874864 1;
BA_ "MsgType" BO_ 2549874864 4;
BA_ "DiagResponse" BO_ 2550005936 1;
BA_ "MsgType" BO_ 2550005936 4;
BA_ "DiagRequest" BO_ 2549874853 1;
BA_ "MsgType" BO_ 2549874853 4;
BA_ "DiagResponse" BO_ 2550005925 1;
BA_ "MsgType" BO_ 2550005925 4;
BA_ "DiagRequest" BO_ 2549874854 1;
BA_ "MsgType" BO_ 2549874854 4;
BA_ "DiagResponse" BO_ 2550005926 1;
BA_ "MsgType" BO_ 2550005926 4;
BA_ "DiagRequest" BO_ 2549874843 1;
BA_ "MsgType" BO_ 2549874843 4;
BA_ "DiagResponse" BO_ 2550005915 1;
BA_ "MsgType" BO_ 2550005915 4;
BA_ "DiagRequest" BO_ 2033 1;
BA_ "MsgType" BO_ 2033 4;
BA_ "DiagResponse" BO_ 2041 1;
BA_ "MsgType" BO_ 2041 4;
BA_ "MsgType" BO_ 2566686208 6;
BA_ "MsgType" BO_ 2566686209 6;
BA_ "GenSigSendType" SG_ 1888 ISO_HAL_Master_Req_Data 3;
BA_ "GenSigFuncType" SG_ 1888 ISO_HAL_Master_Req_Data 9;
BA_ "GenSigSwitchedByIgnition" SG_ 1888 ISO_HAL_Master_Req_Data 0;
BA_ "GenSigSendType" SG_ 1994 ISO_HAL_Master_Resp_Data 3;
BA_ "GenSigFuncType" SG_ 1994 ISO_HAL_Master_Resp_Data 9;
BA_ "GenSigSwitchedByIgnition" SG_ 1994 ISO_HAL_Master_Resp_Data 0;
BA_ "GenSigSendType" SG_ 1889 ISO_HAL_Slave_Req_Data 3;
BA_ "GenSigFuncType" SG_ 1889 ISO_HAL_Slave_Req_Data 9;
BA_ "GenSigSwitchedByIgnition" SG_ 1889 ISO_HAL_Slave_Req_Data 0;
BA_ "GenSigSendType" SG_ 1995 ISO_HAL_Slave_Resp_Data 3;
BA_ "GenSigFuncType" SG_ 1995 ISO_HAL_Slave_Resp_Data 9;
BA_ "GenSigSwitchedByIgnition" SG_ 1995 ISO_HAL_Slave_Resp_Data 0;
BA_ "GenSigSendType" SG_ 1827 ISO_HDSG_Req_Data 3;
BA_ "GenSigFuncType" SG_ 1827 ISO_HDSG_Req_Data 9;
BA_ "GenSigSwitchedByIgnition" SG_ 1827 ISO_HDSG_Req_Data 0;
BA_ "GenSigSendType" SG_ 1933 ISO_HDSG_Resp_Data 3;
BA_ "GenSigFuncType" SG_ 1933 ISO_HDSG_Resp_Data 9;
BA_ "GenSigSwitchedByIgnition" SG_ 1933 ISO_HDSG_Resp_Data 0;
BA_ "GenSigSendType" SG_ 1819 ISO_HUD_Req_Data 3;
BA_ "GenSigFuncType" SG_ 1819 ISO_HUD_Req_Data 9;
BA_ "GenSigSwitchedByIgnition" SG_ 1819 ISO_HUD_Req_Data 0;
BA_ "GenSigSendType" SG_ 1925 ISO_HUD_Resp_Data 3;
BA_ "GenSigFuncType" SG_ 1925 ISO_HUD_Resp_Data 9;
BA_ "GenSigSwitchedByIgnition" SG_ 1925 ISO_HUD_Resp_Data 0;
BA_ "GenSigSendType" SG_ 1907 ISO_Info_El_Req_Data 3;
BA_ "GenSigFuncType" SG_ 1907 ISO_Info_El_Req_Data 9;
BA_ "GenSigSwitchedByIgnition" SG_ 1907 ISO_Info_El_Req_Data 0;
BA_ "GenSigSendType" SG_ 2013 ISO_Info_El_Resp_Data 3;
BA_ "GenSigFuncType" SG_ 2013 ISO_Info_El_Resp_Data 9;
BA_ "GenSigSwitchedByIgnition" SG_ 2013 ISO_Info_El_Resp_Data 0;
BA_ "GenSigSendType" SG_ 2549350438 ISO_ISOx_OTA_SWC_01_Req 3;
BA_ "GenSigFuncType" SG_ 2549350438 ISO_ISOx_OTA_SWC_01_Req 9;
BA_ "GenSigSwitchedByIgnition" SG_ 2549350438 ISO_ISOx_OTA_SWC_01_Req 0;
BA_ "GenSigSendType" SG_ 2549491200 ISO_ISOx_OTA_SWC_01_Resp 3;
BA_ "GenSigFuncType" SG_ 2549491200 ISO_ISOx_OTA_SWC_01_Resp 9;
BA_ "GenSigSwitchedByIgnition" SG_ 2549491200 ISO_ISOx_OTA_SWC_01_Resp 0;
BA_ "GenSigSendType" SG_ 1871 ISO_Kamera_Req_Data 3;
BA_ "GenSigFuncType" SG_ 1871 ISO_Kamera_Req_Data 9;
BA_ "GenSigSwitchedByIgnition" SG_ 1871 ISO_Kamera_Req_Data 0;
BA_ "GenSigSendType" SG_ 1977 ISO_Kamera_Resp_Data 3;
BA_ "GenSigFuncType" SG_ 1977 ISO_Kamera_Resp_Data 9;
BA_ "GenSigSwitchedByIgnition" SG_ 1977 ISO_Kamera_Resp_Data 0;
BA_ "GenSigSendType" SG_ 1862 ISO_Klima_Req_Data 3;
BA_ "GenSigFuncType" SG_ 1862 ISO_Klima_Req_Data 9;
BA_ "GenSigSwitchedByIgnition" SG_ 1862 ISO_Klima_Req_Data 0;
BA_ "GenSigSendType" SG_ 1968 ISO_Klima_Resp_Data 3;
BA_ "GenSigFuncType" SG_ 1968 ISO_Klima_Resp_Data 9;
BA_ "GenSigSwitchedByIgnition" SG_ 1968 ISO_Klima_Resp_Data 0;
BA_ "GenSigSendType" SG_ 1812 ISO_Kombi_Req_Data 3;
BA_ "GenSigFuncType" SG_ 1812 ISO_Kombi_Req_Data 9;
BA_ "GenSigSwitchedByIgnition" SG_ 1812 ISO_Kombi_Req_Data 0;
BA_ "GenSigSendType" SG_ 1918 ISO_Kombi_Resp_Data 3;
BA_ "GenSigFuncType" SG_ 1918 ISO_Kombi_Resp_Data 9;
BA_ "GenSigSwitchedByIgnition" SG_ 1918 ISO_Kombi_Resp_Data 0;
BA_ "GenSigSendType" SG_ 1860 ISO_Ladegeraet_Req_Data 3;
BA_ "GenSigFuncType" SG_ 1860 ISO_Ladegeraet_Req_Data 9;
BA_ "GenSigSwitchedByIgnition" SG_ 1860 ISO_Ladegeraet_Req_Data 0;
BA_ "GenSigSendType" SG_ 1966 ISO_Ladegeraet_Resp_Data 3;
BA_ "GenSigFuncType" SG_ 1966 ISO_Ladegeraet_Resp_Data 9;
BA_ "GenSigSwitchedByIgnition" SG_ 1966 ISO_Ladegeraet_Resp_Data 0;
BA_ "GenSigSendType" SG_ 1904 ISO_Laufwerke_Req_Data 3;
BA_ "GenSigFuncType" SG_ 1904 ISO_Laufwerke_Req_Data 9;
BA_ "GenSigSwitchedByIgnition" SG_ 1904 ISO_Laufwerke_Req_Data 0;
BA_ "GenSigSendType" SG_ 2010 ISO_Laufwerke_Resp_Data 3;
BA_ "GenSigFuncType" SG_ 2010 ISO_Laufwerke_Resp_Data 9;
BA_ "GenSigSwitchedByIgnition" SG_ 2010 ISO_Laufwerke_Resp_Data 0;
BA_ "GenSigSendType" SG_ 1810 ISO_Lenkhilfe_Req_Data 3;
BA_ "GenSigFuncType" SG_ 1810 ISO_Lenkhilfe_Req_Data 9;
BA_ "GenSigSwitchedByIgnition" SG_ 1810 ISO_Lenkhilfe_Req_Data 0;
BA_ "GenSigSendType" SG_ 1916 ISO_Lenkhilfe_Resp_Data 3;
BA_ "GenSigFuncType" SG_ 1916 ISO_Lenkhilfe_Resp_Data 9;
BA_ "GenSigSwitchedByIgnition" SG_ 1916 ISO_Lenkhilfe_Resp_Data 0;
BA_ "GenSigSendType" SG_ 1881 ISO_Lift_Req_Data 3;
BA_ "GenSigFuncType" SG_ 1881 ISO_Lift_Req_Data 9;
BA_ "GenSigSwitchedByIgnition" SG_ 1881 ISO_Lift_Req_Data 0;
BA_ "GenSigSendType" SG_ 1987 ISO_Lift_Resp_Data 3;
BA_ "GenSigFuncType" SG_ 1987 ISO_Lift_Resp_Data 9;
BA_ "GenSigSwitchedByIgnition" SG_ 1987 ISO_Lift_Resp_Data 0;
BA_ "GenSigSendType" SG_ 1836 ISO_MFG_Req_Data 3;
BA_ "GenSigFuncType" SG_ 1836 ISO_MFG_Req_Data 9;
BA_ "GenSigSwitchedByIgnition" SG_ 1836 ISO_MFG_Req_Data 0;
BA_ "GenSigSendType" SG_ 1942 ISO_MFG_Resp_Data 3;
BA_ "GenSigFuncType" SG_ 1942 ISO_MFG_Resp_Data 9;
BA_ "GenSigSwitchedByIgnition" SG_ 1942 ISO_MFG_Resp_Data 0;
BA_ "GenSigSendType" SG_ 2016 ISO_MO_01_Req_Data 3;
BA_ "GenSigFuncType" SG_ 2016 ISO_MO_01_Req_Data 9;
BA_ "GenSigSwitchedByIgnition" SG_ 2016 ISO_MO_01_Req_Data 0;
BA_ "GenSigSendType" SG_ 2024 ISO_MO_01_Resp_Data 3;
BA_ "GenSigFuncType" SG_ 2024 ISO_MO_01_Resp_Data 9;
BA_ "GenSigSwitchedByIgnition" SG_ 2024 ISO_MO_01_Resp_Data 0;
BA_ "GenSigSendType" SG_ 1831 ISO_NightVision_Req_Data 3;
BA_ "GenSigFuncType" SG_ 1831 ISO_NightVision_Req_Data 9;
BA_ "GenSigSendType" SG_ 1937 ISO_NightVision_Resp_Data 3;
BA_ "GenSigFuncType" SG_ 1937 ISO_NightVision_Resp_Data 9;
BA_ "GenSigSendType" SG_ 2018 ISO_OBD_01_Req_Data 3;
BA_ "GenSigFuncType" SG_ 2018 ISO_OBD_01_Req_Data 9;
BA_ "GenSigSwitchedByIgnition" SG_ 2018 ISO_OBD_01_Req_Data 0;
BA_ "GenSigSendType" SG_ 2026 ISO_OBD_01_Resp_Data 3;
BA_ "GenSigFuncType" SG_ 2026 ISO_OBD_01_Resp_Data 9;
BA_ "GenSigSwitchedByIgnition" SG_ 2026 ISO_OBD_01_Resp_Data 0;
BA_ "GenSigSendType" SG_ 2019 ISO_OBD_02_Req_Data 3;
BA_ "GenSigFuncType" SG_ 2019 ISO_OBD_02_Req_Data 9;
BA_ "GenSigSwitchedByIgnition" SG_ 2019 ISO_OBD_02_Req_Data 0;
BA_ "GenSigSendType" SG_ 2027 ISO_OBD_02_Resp_Data 3;
BA_ "GenSigFuncType" SG_ 2027 ISO_OBD_02_Resp_Data 9;
BA_ "GenSigSwitchedByIgnition" SG_ 2027 ISO_OBD_02_Resp_Data 0;
BA_ "GenSigSendType" SG_ 2020 ISO_OBD_03_Req_Data 3;
BA_ "GenSigFuncType" SG_ 2020 ISO_OBD_03_Req_Data 9;
BA_ "GenSigSwitchedByIgnition" SG_ 2020 ISO_OBD_03_Req_Data 0;
BA_ "GenSigSendType" SG_ 2028 ISO_OBD_03_Resp_Data 3;
BA_ "GenSigFuncType" SG_ 2028 ISO_OBD_03_Resp_Data 9;
BA_ "GenSigSwitchedByIgnition" SG_ 2028 ISO_OBD_03_Resp_Data 0;
BA_ "GenSigSendType" SG_ 2021 ISO_OBD_04_Req_Data 3;
BA_ "GenSigFuncType" SG_ 2021 ISO_OBD_04_Req_Data 9;
BA_ "GenSigSwitchedByIgnition" SG_ 2021 ISO_OBD_04_Req_Data 0;
BA_ "GenSigSendType" SG_ 2029 ISO_OBD_04_Resp_Data 3;
BA_ "GenSigFuncType" SG_ 2029 ISO_OBD_04_Resp_Data 9;
BA_ "GenSigSwitchedByIgnition" SG_ 2029 ISO_OBD_04_Resp_Data 0;
BA_ "GenSigSendType" SG_ 2022 ISO_OBD_05_Req_Data 3;
BA_ "GenSigFuncType" SG_ 2022 ISO_OBD_05_Req_Data 9;
BA_ "GenSigSwitchedByIgnition" SG_ 2022 ISO_OBD_05_Req_Data 0;
BA_ "GenSigSendType" SG_ 2030 ISO_OBD_05_Resp_Data 3;
BA_ "GenSigFuncType" SG_ 2030 ISO_OBD_05_Resp_Data 9;
BA_ "GenSigSwitchedByIgnition" SG_ 2030 ISO_OBD_05_Resp_Data 0;
BA_ "GenSigSendType" SG_ 2023 ISO_OBD_06_Req_Data 3;
BA_ "GenSigFuncType" SG_ 2023 ISO_OBD_06_Req_Data 9;
BA_ "GenSigSwitchedByIgnition" SG_ 2023 ISO_OBD_06_Req_Data 0;
BA_ "GenSigSendType" SG_ 2031 ISO_OBD_06_Resp_Data 3;
BA_ "GenSigFuncType" SG_ 2031 ISO_OBD_06_Resp_Data 9;
BA_ "GenSigSwitchedByIgnition" SG_ 2031 ISO_OBD_06_Resp_Data 0;
BA_ "GenSigSendType" SG_ 1822 ISO_Quersperre_Req_Data 3;
BA_ "GenSigFuncType" SG_ 1822 ISO_Quersperre_Req_Data 9;
BA_ "GenSigSwitchedByIgnition" SG_ 1822 ISO_Quersperre_Req_Data 0;
BA_ "GenSigSendType" SG_ 1928 ISO_Quersperre_Resp_Data 3;
BA_ "GenSigFuncType" SG_ 1928 ISO_Quersperre_Resp_Data 9;
BA_ "GenSigSwitchedByIgnition" SG_ 1928 ISO_Quersperre_Resp_Data 0;
BA_ "GenSigSendType" SG_ 1803 ISO_RDK_Req_Data 3;
BA_ "GenSigFuncType" SG_ 1803 ISO_RDK_Req_Data 9;
BA_ "GenSigSwitchedByIgnition" SG_ 1803 ISO_RDK_Req_Data 0;
BA_ "GenSigSendType" SG_ 1909 ISO_RDK_Resp_Data 3;
BA_ "GenSigFuncType" SG_ 1909 ISO_RDK_Resp_Data 9;
BA_ "GenSigSwitchedByIgnition" SG_ 1909 ISO_RDK_Resp_Data 0;
BA_ "GenSigSendType" SG_ 1897 ISO_Rearview_Req_Data 3;
BA_ "GenSigFuncType" SG_ 1897 ISO_Rearview_Req_Data 9;
BA_ "GenSigSwitchedByIgnition" SG_ 1897 ISO_Rearview_Req_Data 0;
BA_ "GenSigSendType" SG_ 2003 ISO_Rearview_Resp_Data 3;
BA_ "GenSigFuncType" SG_ 2003 ISO_Rearview_Resp_Data 9;
BA_ "GenSigSwitchedByIgnition" SG_ 2003 ISO_Rearview_Resp_Data 0;
BA_ "GenSigSendType" SG_ 1834 ISO_SCR_Req_Data 3;
BA_ "GenSigFuncType" SG_ 1834 ISO_SCR_Req_Data 9;
BA_ "GenSigSwitchedByIgnition" SG_ 1834 ISO_SCR_Req_Data 0;
BA_ "GenSigSendType" SG_ 1940 ISO_SCR_Resp_Data 3;
BA_ "GenSigFuncType" SG_ 1940 ISO_SCR_Resp_Data 9;
BA_ "GenSigSwitchedByIgnition" SG_ 1940 ISO_SCR_Resp_Data 0;
BA_ "GenSigSendType" SG_ 1814 ISO_SCU_Req_Data 3;
BA_ "GenSigFuncType" SG_ 1814 ISO_SCU_Req_Data 9;
BA_ "GenSigSendType" SG_ 1920 ISO_SCU_Resp_Data 3;
BA_ "GenSigFuncType" SG_ 1920 ISO_SCU_Resp_Data 9;
BA_ "GenSigSendType" SG_ 1839 ISO_SFA_Req_Data 3;
BA_ "GenSigFuncType" SG_ 1839 ISO_SFA_Req_Data 9;
BA_ "GenSigSwitchedByIgnition" SG_ 1839 ISO_SFA_Req_Data 0;
BA_ "GenSigSendType" SG_ 1945 ISO_SFA_Resp_Data 3;
BA_ "GenSigFuncType" SG_ 1945 ISO_SFA_Resp_Data 9;
BA_ "GenSigSwitchedByIgnition" SG_ 1945 ISO_SFA_Resp_Data 0;
BA_ "GenSigSendType" SG_ 1869 ISO_Sitzmemo_BFS_Req_Data 3;
BA_ "GenSigFuncType" SG_ 1869 ISO_Sitzmemo_BFS_Req_Data 9;
BA_ "GenSigSwitchedByIgnition" SG_ 1869 ISO_Sitzmemo_BFS_Req_Data 0;
BA_ "GenSigSendType" SG_ 1975 ISO_Sitzmemo_BFS_Resp_Data 3;
BA_ "GenSigFuncType" SG_ 1975 ISO_Sitzmemo_BFS_Resp_Data 9;
BA_ "GenSigSwitchedByIgnition" SG_ 1975 ISO_Sitzmemo_BFS_Resp_Data 0;
BA_ "GenSigSendType" SG_ 1868 ISO_Sitzmemo_FS_Req_Data 3;
BA_ "GenSigFuncType" SG_ 1868 ISO_Sitzmemo_FS_Req_Data 9;
BA_ "GenSigSwitchedByIgnition" SG_ 1868 ISO_Sitzmemo_FS_Req_Data 0;
BA_ "GenSigSendType" SG_ 1974 ISO_Sitzmemo_FS_Resp_Data 3;
BA_ "GenSigFuncType" SG_ 1974 ISO_Sitzmemo_FS_Resp_Data 9;
BA_ "GenSigSwitchedByIgnition" SG_ 1974 ISO_Sitzmemo_FS_Resp_Data 0;
BA_ "GenSigSendType" SG_ 1804 ISO_SMLS_Req_Data 3;
BA_ "GenSigFuncType" SG_ 1804 ISO_SMLS_Req_Data 9;
BA_ "GenSigSwitchedByIgnition" SG_ 1804 ISO_SMLS_Req_Data 0;
BA_ "GenSigSendType" SG_ 1910 ISO_SMLS_Resp_Data 3;
BA_ "GenSigFuncType" SG_ 1910 ISO_SMLS_Resp_Data 9;
BA_ "GenSigSwitchedByIgnition" SG_ 1910 ISO_SMLS_Resp_Data 0;
BA_ "GenSigSendType" SG_ 1820 ISO_Soundaktor_Req_Data 3;
BA_ "GenSigFuncType" SG_ 1820 ISO_Soundaktor_Req_Data 9;
BA_ "GenSigSendType" SG_ 1926 ISO_Soundaktor_Resp_Data 3;
BA_ "GenSigFuncType" SG_ 1926 ISO_Soundaktor_Resp_Data 9;
BA_ "GenSigSendType" SG_ 1828 ISO_SpoilerSG_Req_Data 3;
BA_ "GenSigFuncType" SG_ 1828 ISO_SpoilerSG_Req_Data 9;
BA_ "GenSigSwitchedByIgnition" SG_ 1828 ISO_SpoilerSG_Req_Data 0;
BA_ "GenSigSendType" SG_ 1934 ISO_SpoilerSG_Resp_Data 3;
BA_ "GenSigFuncType" SG_ 1934 ISO_SpoilerSG_Resp_Data 9;
BA_ "GenSigSwitchedByIgnition" SG_ 1934 ISO_SpoilerSG_Resp_Data 0;
BA_ "GenSigSendType" SG_ 1898 ISO_STH_Req_Data 3;
BA_ "GenSigFuncType" SG_ 1898 ISO_STH_Req_Data 9;
BA_ "GenSigSwitchedByIgnition" SG_ 1898 ISO_STH_Req_Data 0;
BA_ "GenSigSendType" SG_ 2004 ISO_STH_Resp_Data 3;
BA_ "GenSigFuncType" SG_ 2004 ISO_STH_Resp_Data 9;
BA_ "GenSigSwitchedByIgnition" SG_ 2004 ISO_STH_Resp_Data 0;
BA_ "GenSigSendType" SG_ 1835 ISO_STS_Req_Data 3;
BA_ "GenSigFuncType" SG_ 1835 ISO_STS_Req_Data 9;
BA_ "GenSigSwitchedByIgnition" SG_ 1835 ISO_STS_Req_Data 0;
BA_ "GenSigSendType" SG_ 1941 ISO_STS_Resp_Data 3;
BA_ "GenSigFuncType" SG_ 1941 ISO_STS_Resp_Data 9;
BA_ "GenSigSwitchedByIgnition" SG_ 1941 ISO_STS_Resp_Data 0;
BA_ "GenSigSendType" SG_ 1865 ISO_Sub_Gateway_Req_Data 3;
BA_ "GenSigFuncType" SG_ 1865 ISO_Sub_Gateway_Req_Data 9;
BA_ "GenSigSwitchedByIgnition" SG_ 1865 ISO_Sub_Gateway_Req_Data 0;
BA_ "GenSigSendType" SG_ 1971 ISO_Sub_Gateway_Resp_Data 3;
BA_ "GenSigFuncType" SG_ 1971 ISO_Sub_Gateway_Resp_Data 9;
BA_ "GenSigSwitchedByIgnition" SG_ 1971 ISO_Sub_Gateway_Resp_Data 0;
BA_ "GenSigSendType" SG_ 1870 ISO_SWA_Req_Data 3;
BA_ "GenSigFuncType" SG_ 1870 ISO_SWA_Req_Data 9;
BA_ "GenSigSwitchedByIgnition" SG_ 1870 ISO_SWA_Req_Data 0;
BA_ "GenSigSendType" SG_ 1976 ISO_SWA_Resp_Data 3;
BA_ "GenSigFuncType" SG_ 1976 ISO_SWA_Resp_Data 9;
BA_ "GenSigSwitchedByIgnition" SG_ 1976 ISO_SWA_Resp_Data 0;
BA_ "GenSigSendType" SG_ 1858 ISO_TME_Req_Data 3;
BA_ "GenSigFuncType" SG_ 1858 ISO_TME_Req_Data 9;
BA_ "GenSigSwitchedByIgnition" SG_ 1858 ISO_TME_Req_Data 0;
BA_ "GenSigSendType" SG_ 1964 ISO_TME_Resp_Data 3;
BA_ "GenSigFuncType" SG_ 1964 ISO_TME_Resp_Data 9;
BA_ "GenSigSwitchedByIgnition" SG_ 1964 ISO_TME_Resp_Data 0;
BA_ "GenSigSendType" SG_ 1867 ISO_TSG_BT_Req_Data 3;
BA_ "GenSigFuncType" SG_ 1867 ISO_TSG_BT_Req_Data 9;
BA_ "GenSigSwitchedByIgnition" SG_ 1867 ISO_TSG_BT_Req_Data 0;
BA_ "GenSigSendType" SG_ 1973 ISO_TSG_BT_Resp_Data 3;
BA_ "GenSigFuncType" SG_ 1973 ISO_TSG_BT_Resp_Data 9;
BA_ "GenSigSwitchedByIgnition" SG_ 1973 ISO_TSG_BT_Resp_Data 0;
BA_ "GenSigSendType" SG_ 1866 ISO_TSG_FT_Req_Data 3;
BA_ "GenSigFuncType" SG_ 1866 ISO_TSG_FT_Req_Data 9;
BA_ "GenSigSwitchedByIgnition" SG_ 1866 ISO_TSG_FT_Req_Data 0;
BA_ "GenSigSendType" SG_ 1972 ISO_TSG_FT_Resp_Data 3;
BA_ "GenSigFuncType" SG_ 1972 ISO_TSG_FT_Resp_Data 9;
BA_ "GenSigSwitchedByIgnition" SG_ 1972 ISO_TSG_FT_Resp_Data 0;
BA_ "GenSigSendType" SG_ 1855 ISO_TSG_HBFS_Req_Data 3;
BA_ "GenSigFuncType" SG_ 1855 ISO_TSG_HBFS_Req_Data 9;
BA_ "GenSigSwitchedByIgnition" SG_ 1855 ISO_TSG_HBFS_Req_Data 0;
BA_ "GenSigSendType" SG_ 1961 ISO_TSG_HBFS_Resp_Data 3;
BA_ "GenSigFuncType" SG_ 1961 ISO_TSG_HBFS_Resp_Data 9;
BA_ "GenSigSwitchedByIgnition" SG_ 1961 ISO_TSG_HBFS_Resp_Data 0;
BA_ "GenSigSendType" SG_ 1854 ISO_TSG_HFS_Req_Data 3;
BA_ "GenSigFuncType" SG_ 1854 ISO_TSG_HFS_Req_Data 9;
BA_ "GenSigSwitchedByIgnition" SG_ 1854 ISO_TSG_HFS_Req_Data 0;
BA_ "GenSigSendType" SG_ 1960 ISO_TSG_HFS_Resp_Data 3;
BA_ "GenSigFuncType" SG_ 1960 ISO_TSG_HFS_Resp_Data 9;
BA_ "GenSigSwitchedByIgnition" SG_ 1960 ISO_TSG_HFS_Resp_Data 0;
BA_ "GenSigSendType" SG_ 1901 ISO_TV_Tuner_Req_Data 3;
BA_ "GenSigFuncType" SG_ 1901 ISO_TV_Tuner_Req_Data 9;
BA_ "GenSigSwitchedByIgnition" SG_ 1901 ISO_TV_Tuner_Req_Data 0;
BA_ "GenSigSendType" SG_ 2007 ISO_TV_Tuner_Resp_Data 3;
BA_ "GenSigFuncType" SG_ 2007 ISO_TV_Tuner_Resp_Data 9;
BA_ "GenSigSwitchedByIgnition" SG_ 2007 ISO_TV_Tuner_Resp_Data 0;
BA_ "GenSigSendType" SG_ 1837 ISO_VSG_Req_Data 3;
BA_ "GenSigFuncType" SG_ 1837 ISO_VSG_Req_Data 9;
BA_ "GenSigSwitchedByIgnition" SG_ 1837 ISO_VSG_Req_Data 0;
BA_ "GenSigSendType" SG_ 1943 ISO_VSG_Resp_Data 3;
BA_ "GenSigFuncType" SG_ 1943 ISO_VSG_Resp_Data 9;
BA_ "GenSigSwitchedByIgnition" SG_ 1943 ISO_VSG_Resp_Data 0;
BA_ "GenSigSendType" SG_ 1883 ISO_WaCU_Req_Data 3;
BA_ "GenSigFuncType" SG_ 1883 ISO_WaCU_Req_Data 9;
BA_ "GenSigSwitchedByIgnition" SG_ 1883 ISO_WaCU_Req_Data 0;
BA_ "GenSigSendType" SG_ 1989 ISO_WaCU_Resp_Data 3;
BA_ "GenSigFuncType" SG_ 1989 ISO_WaCU_Resp_Data 9;
BA_ "GenSigSwitchedByIgnition" SG_ 1989 ISO_WaCU_Resp_Data 0;
BA_ "GenSigSendType" SG_ 1875 ISO_Waehlhebel_Req_Data 3;
BA_ "GenSigFuncType" SG_ 1875 ISO_Waehlhebel_Req_Data 9;
BA_ "GenSigSwitchedByIgnition" SG_ 1875 ISO_Waehlhebel_Req_Data 0;
BA_ "GenSigSendType" SG_ 1981 ISO_Waehlhebel_Resp_Data 3;
BA_ "GenSigFuncType" SG_ 1981 ISO_Waehlhebel_Resp_Data 9;
BA_ "GenSigSwitchedByIgnition" SG_ 1981 ISO_Waehlhebel_Resp_Data 0;
BA_ "GenSigSendType" SG_ 2549874831 ISOx_AWC_Req_Data 3;
BA_ "GenSigFuncType" SG_ 2549874831 ISOx_AWC_Req_Data 9;
BA_ "GenSigSwitchedByIgnition" SG_ 2549874831 ISOx_AWC_Req_Data 0;
BA_ "GenSigSendType" SG_ 2550005903 ISOx_AWC_Resp_Data 3;
BA_ "GenSigFuncType" SG_ 2550005903 ISOx_AWC_Resp_Data 9;
BA_ "GenSigSwitchedByIgnition" SG_ 2550005903 ISOx_AWC_Resp_Data 0;
BA_ "GenSigSendType" SG_ 2549874862 ISOx_BattRegelung_Req_Data 3;
BA_ "GenSigFuncType" SG_ 2549874862 ISOx_BattRegelung_Req_Data 9;
BA_ "GenSigSwitchedByIgnition" SG_ 2549874862 ISOx_BattRegelung_Req_Data 0;
BA_ "GenSigSendType" SG_ 2550005934 ISOx_BattRegelung_Resp_Data 3;
BA_ "GenSigFuncType" SG_ 2550005934 ISOx_BattRegelung_Resp_Data 9;
BA_ "GenSigSwitchedByIgnition" SG_ 2550005934 ISOx_BattRegelung_Resp_Data 0;
BA_ "GenSigSendType" SG_ 2549874827 ISOx_BCM2_Req_Data 3;
BA_ "GenSigFuncType" SG_ 2549874827 ISOx_BCM2_Req_Data 9;
BA_ "GenSigSwitchedByIgnition" SG_ 2549874827 ISOx_BCM2_Req_Data 0;
BA_ "GenSigSendType" SG_ 2550005899 ISOx_BCM2_Resp_Data 3;
BA_ "GenSigFuncType" SG_ 2550005899 ISOx_BCM2_Resp_Data 9;
BA_ "GenSigSwitchedByIgnition" SG_ 2550005899 ISOx_BCM2_Resp_Data 0;
BA_ "GenSigSendType" SG_ 2549874830 ISOx_BedienDisp_vo_Req_Data 3;
BA_ "GenSigFuncType" SG_ 2549874830 ISOx_BedienDisp_vo_Req_Data 9;
BA_ "GenSigSwitchedByIgnition" SG_ 2549874830 ISOx_BedienDisp_vo_Req_Data 0;
BA_ "GenSigSendType" SG_ 2550005902 ISOx_BedienDisp_vo_Resp_Data 3;
BA_ "GenSigFuncType" SG_ 2550005902 ISOx_BedienDisp_vo_Resp_Data 9;
BA_ "GenSigSwitchedByIgnition" SG_ 2550005902 ISOx_BedienDisp_vo_Resp_Data 0;
BA_ "GenSigSendType" SG_ 2549874835 ISOx_BedienSG_hi_Req_Data 3;
BA_ "GenSigFuncType" SG_ 2549874835 ISOx_BedienSG_hi_Req_Data 9;
BA_ "GenSigSwitchedByIgnition" SG_ 2549874835 ISOx_BedienSG_hi_Req_Data 0;
BA_ "GenSigSendType" SG_ 2550005907 ISOx_BedienSG_hi_Resp_Data 3;
BA_ "GenSigFuncType" SG_ 2550005907 ISOx_BedienSG_hi_Resp_Data 9;
BA_ "GenSigSwitchedByIgnition" SG_ 2550005907 ISOx_BedienSG_hi_Resp_Data 0;
BA_ "GenSigSendType" SG_ 2549874849 ISOx_Bedienteil_Req_Data 3;
BA_ "GenSigFuncType" SG_ 2549874849 ISOx_Bedienteil_Req_Data 9;
BA_ "GenSigSwitchedByIgnition" SG_ 2549874849 ISOx_Bedienteil_Req_Data 0;
BA_ "GenSigSendType" SG_ 2550005921 ISOx_Bedienteil_Resp_Data 3;
BA_ "GenSigFuncType" SG_ 2550005921 ISOx_Bedienteil_Resp_Data 9;
BA_ "GenSigSwitchedByIgnition" SG_ 2550005921 ISOx_Bedienteil_Resp_Data 0;
BA_ "GenSigSendType" SG_ 2549874844 ISOx_BMS_48V_Req_Data 3;
BA_ "GenSigFuncType" SG_ 2549874844 ISOx_BMS_48V_Req_Data 9;
BA_ "GenSigSwitchedByIgnition" SG_ 2549874844 ISOx_BMS_48V_Req_Data 0;
BA_ "GenSigSendType" SG_ 2550005916 ISOx_BMS_48V_Resp_Data 3;
BA_ "GenSigFuncType" SG_ 2550005916 ISOx_BMS_48V_Resp_Data 9;
BA_ "GenSigSwitchedByIgnition" SG_ 2550005916 ISOx_BMS_48V_Resp_Data 0;
BA_ "GenSigSendType" SG_ 2549874888 ISO_BRS_BU_Req_Data 3;
BA_ "GenSigFuncType" SG_ 2549874888 ISO_BRS_BU_Req_Data 9;
BA_ "GenSigSwitchedByIgnition" SG_ 2549874888 ISO_BRS_BU_Req_Data 0;
BA_ "GenSigSendType" SG_ 2550005960 ISO_BRS_BU_Resp_Data 3;
BA_ "GenSigFuncType" SG_ 2550005960 ISO_BRS_BU_Resp_Data 9;
BA_ "GenSigSwitchedByIgnition" SG_ 2550005960 ISO_BRS_BU_Resp_Data 0;
BA_ "GenSigSendType" SG_ 2549874887 ISOx_DCDC_HV_02_Req_Data 3;
BA_ "GenSigFuncType" SG_ 2549874887 ISOx_DCDC_HV_02_Req_Data 9;
BA_ "GenSigSwitchedByIgnition" SG_ 2549874887 ISOx_DCDC_HV_02_Req_Data 0;
BA_ "GenSigSendType" SG_ 2550005959 ISOx_DCDC_HV_02_Resp_Data 3;
BA_ "GenSigFuncType" SG_ 2550005959 ISOx_DCDC_HV_02_Resp_Data 9;
BA_ "GenSigSwitchedByIgnition" SG_ 2550005959 ISOx_DCDC_HV_02_Resp_Data 0;
BA_ "GenSigSendType" SG_ 2549874895 ISOx_DCDC_HV_03_Req_Data 3;
BA_ "GenSigSwitchedByIgnition" SG_ 2549874895 ISOx_DCDC_HV_03_Req_Data 0;
BA_ "GenSigSendType" SG_ 2550005967 ISOx_DCDC_HV_03_Resp_Data 3;
BA_ "GenSigSwitchedByIgnition" SG_ 2550005967 ISOx_DCDC_HV_03_Resp_Data 0;
BA_ "GenSigSendType" SG_ 2549874871 ISOx_DCDC_HV_Req_Data 3;
BA_ "GenSigFuncType" SG_ 2549874871 ISOx_DCDC_HV_Req_Data 9;
BA_ "GenSigSwitchedByIgnition" SG_ 2549874871 ISOx_DCDC_HV_Req_Data 0;
BA_ "GenSigSendType" SG_ 2550005943 ISOx_DCDC_HV_Resp_Data 3;
BA_ "GenSigFuncType" SG_ 2550005943 ISOx_DCDC_HV_Resp_Data 9;
BA_ "GenSigSwitchedByIgnition" SG_ 2550005943 ISOx_DCDC_HV_Resp_Data 0;
BA_ "GenSigSendType" SG_ 2549874874 ISOx_DDA_Req_Data 3;
BA_ "GenSigFuncType" SG_ 2549874874 ISOx_DDA_Req_Data 9;
BA_ "GenSigSwitchedByIgnition" SG_ 2549874874 ISOx_DDA_Req_Data 0;
BA_ "GenSigSendType" SG_ 2550005946 ISOx_DDA_Resp_Data 3;
BA_ "GenSigFuncType" SG_ 2550005946 ISOx_DDA_Resp_Data 9;
BA_ "GenSigSwitchedByIgnition" SG_ 2550005946 ISOx_DDA_Resp_Data 0;
BA_ "GenSigSendType" SG_ 2549874863 ISOx_DLM_BFS_Req_Data 3;
BA_ "GenSigFuncType" SG_ 2549874863 ISOx_DLM_BFS_Req_Data 9;
BA_ "GenSigSwitchedByIgnition" SG_ 2549874863 ISOx_DLM_BFS_Req_Data 0;
BA_ "GenSigSendType" SG_ 2550005935 ISOx_DLM_BFS_Resp_Data 3;
BA_ "GenSigFuncType" SG_ 2550005935 ISOx_DLM_BFS_Resp_Data 9;
BA_ "GenSigSwitchedByIgnition" SG_ 2550005935 ISOx_DLM_BFS_Resp_Data 0;
BA_ "GenSigSendType" SG_ 2549874861 ISOx_DLM_FS_Req_Data 3;
BA_ "GenSigFuncType" SG_ 2549874861 ISOx_DLM_FS_Req_Data 9;
BA_ "GenSigSwitchedByIgnition" SG_ 2549874861 ISOx_DLM_FS_Req_Data 0;
BA_ "GenSigSendType" SG_ 2550005933 ISOx_DLM_FS_Resp_Data 3;
BA_ "GenSigFuncType" SG_ 2550005933 ISOx_DLM_FS_Resp_Data 9;
BA_ "GenSigSwitchedByIgnition" SG_ 2550005933 ISOx_DLM_FS_Resp_Data 0;
BA_ "GenSigSendType" SG_ 2549874840 ISOx_DMD_L_Req_Data 3;
BA_ "GenSigFuncType" SG_ 2549874840 ISOx_DMD_L_Req_Data 9;
BA_ "GenSigSwitchedByIgnition" SG_ 2549874840 ISOx_DMD_L_Req_Data 0;
BA_ "GenSigSendType" SG_ 2550005912 ISOx_DMD_L_Resp_Data 3;
BA_ "GenSigFuncType" SG_ 2550005912 ISOx_DMD_L_Resp_Data 9;
BA_ "GenSigSwitchedByIgnition" SG_ 2550005912 ISOx_DMD_L_Resp_Data 0;
BA_ "GenSigSendType" SG_ 2549874841 ISOx_DMD_R_Req_Data 3;
BA_ "GenSigFuncType" SG_ 2549874841 ISOx_DMD_R_Req_Data 9;
BA_ "GenSigSwitchedByIgnition" SG_ 2549874841 ISOx_DMD_R_Req_Data 0;
BA_ "GenSigSendType" SG_ 2550005913 ISOx_DMD_R_Resp_Data 3;
BA_ "GenSigFuncType" SG_ 2550005913 ISOx_DMD_R_Resp_Data 9;
BA_ "GenSigSwitchedByIgnition" SG_ 2550005913 ISOx_DMD_R_Resp_Data 0;
BA_ "GenSigSendType" SG_ 2549874833 ISOx_eAWS_1_Req_Data 3;
BA_ "GenSigFuncType" SG_ 2549874833 ISOx_eAWS_1_Req_Data 9;
BA_ "GenSigSwitchedByIgnition" SG_ 2549874833 ISOx_eAWS_1_Req_Data 0;
BA_ "GenSigSendType" SG_ 2550005905 ISOx_eAWS_1_Resp_Data 3;
BA_ "GenSigFuncType" SG_ 2550005905 ISOx_eAWS_1_Resp_Data 9;
BA_ "GenSigSwitchedByIgnition" SG_ 2550005905 ISOx_eAWS_1_Resp_Data 0;
BA_ "GenSigSendType" SG_ 2549874834 ISOx_eAWS_2_Req_Data 3;
BA_ "GenSigFuncType" SG_ 2549874834 ISOx_eAWS_2_Req_Data 9;
BA_ "GenSigSwitchedByIgnition" SG_ 2549874834 ISOx_eAWS_2_Req_Data 0;
BA_ "GenSigSendType" SG_ 2550005906 ISOx_eAWS_2_Resp_Data 3;
BA_ "GenSigFuncType" SG_ 2550005906 ISOx_eAWS_2_Resp_Data 9;
BA_ "GenSigSwitchedByIgnition" SG_ 2550005906 ISOx_eAWS_2_Resp_Data 0;
BA_ "GenSigSendType" SG_ 2549874816 ISOx_EFP_Req_Data 3;
BA_ "GenSigFuncType" SG_ 2549874816 ISOx_EFP_Req_Data 9;
BA_ "GenSigSwitchedByIgnition" SG_ 2549874816 ISOx_EFP_Req_Data 0;
BA_ "GenSigSendType" SG_ 2550005888 ISOx_EFP_Resp_Data 3;
BA_ "GenSigFuncType" SG_ 2550005888 ISOx_EFP_Resp_Data 9;
BA_ "GenSigSwitchedByIgnition" SG_ 2550005888 ISOx_EFP_Resp_Data 0;
BA_ "GenSigSendType" SG_ 2549874812 ISOx_EMotor_01_Req_Data 3;
BA_ "GenSigFuncType" SG_ 2549874812 ISOx_EMotor_01_Req_Data 9;
BA_ "GenSigSwitchedByIgnition" SG_ 2549874812 ISOx_EMotor_01_Req_Data 0;
BA_ "GenSigSendType" SG_ 2550005884 ISOx_EMotor_01_Resp_Data 3;
BA_ "GenSigFuncType" SG_ 2550005884 ISOx_EMotor_01_Resp_Data 9;
BA_ "GenSigSwitchedByIgnition" SG_ 2550005884 ISOx_EMotor_01_Resp_Data 0;
BA_ "GenSigSendType" SG_ 2549874872 ISOx_EMotor_02_Req_Data 3;
BA_ "GenSigFuncType" SG_ 2549874872 ISOx_EMotor_02_Req_Data 9;
BA_ "GenSigSwitchedByIgnition" SG_ 2549874872 ISOx_EMotor_02_Req_Data 0;
BA_ "GenSigSendType" SG_ 2550005944 ISOx_EMotor_02_Resp_Data 3;
BA_ "GenSigFuncType" SG_ 2550005944 ISOx_EMotor_02_Resp_Data 9;
BA_ "GenSigSwitchedByIgnition" SG_ 2550005944 ISOx_EMotor_02_Resp_Data 0;
BA_ "GenSigSendType" SG_ 2549874869 ISOx_FCU_Req_Data 3;
BA_ "GenSigFuncType" SG_ 2549874869 ISOx_FCU_Req_Data 9;
BA_ "GenSigSwitchedByIgnition" SG_ 2549874869 ISOx_FCU_Req_Data 0;
BA_ "GenSigSendType" SG_ 2550005941 ISOx_FCU_Resp_Data 3;
BA_ "GenSigFuncType" SG_ 2550005941 ISOx_FCU_Resp_Data 9;
BA_ "GenSigSwitchedByIgnition" SG_ 2550005941 ISOx_FCU_Resp_Data 0;
BA_ "GenSigSendType" SG_ 2549874845 ISOx_Fronteckradar1_Req_Data 3;
BA_ "GenSigFuncType" SG_ 2549874845 ISOx_Fronteckradar1_Req_Data 9;
BA_ "GenSigSendType" SG_ 2550005917 ISOx_Fronteckradar1_Resp_Data 3;
BA_ "GenSigFuncType" SG_ 2550005917 ISOx_Fronteckradar1_Resp_Data 9;
BA_ "GenSigSendType" SG_ 2549874846 ISOx_Fronteckradar2_Req_Data 3;
BA_ "GenSigFuncType" SG_ 2549874846 ISOx_Fronteckradar2_Req_Data 9;
BA_ "GenSigSendType" SG_ 2550005918 ISOx_Fronteckradar2_Resp_Data 3;
BA_ "GenSigFuncType" SG_ 2550005918 ISOx_Fronteckradar2_Resp_Data 9;
BA_ "GenSigSendType" SG_ 2549874811 ISOx_Hybrid_01_Req_Data 3;
BA_ "GenSigFuncType" SG_ 2549874811 ISOx_Hybrid_01_Req_Data 9;
BA_ "GenSigSwitchedByIgnition" SG_ 2549874811 ISOx_Hybrid_01_Req_Data 0;
BA_ "GenSigSendType" SG_ 2550005883 ISOx_Hybrid_01_Resp_Data 3;
BA_ "GenSigFuncType" SG_ 2550005883 ISOx_Hybrid_01_Resp_Data 9;
BA_ "GenSigSwitchedByIgnition" SG_ 2550005883 ISOx_Hybrid_01_Resp_Data 0;
BA_ "GenSigSendType" SG_ 2549874883 ISOx_KFS_Req_Data 3;
BA_ "GenSigFuncType" SG_ 2549874883 ISOx_KFS_Req_Data 9;
BA_ "GenSigSwitchedByIgnition" SG_ 2549874883 ISOx_KFS_Req_Data 0;
BA_ "GenSigSendType" SG_ 2550005955 ISOx_KFS_Resp_Data 3;
BA_ "GenSigFuncType" SG_ 2550005955 ISOx_KFS_Resp_Data 9;
BA_ "GenSigSwitchedByIgnition" SG_ 2550005955 ISOx_KFS_Resp_Data 0;
BA_ "GenSigSendType" SG_ 2549874886 ISOx_Ladegeraet_2_Req_Data 3;
BA_ "GenSigFuncType" SG_ 2549874886 ISOx_Ladegeraet_2_Req_Data 9;
BA_ "GenSigSwitchedByIgnition" SG_ 2549874886 ISOx_Ladegeraet_2_Req_Data 0;
BA_ "GenSigSendType" SG_ 2550005958 ISOx_Ladegeraet_2_Resp_Data 3;
BA_ "GenSigFuncType" SG_ 2550005958 ISOx_Ladegeraet_2_Resp_Data 9;
BA_ "GenSigSwitchedByIgnition" SG_ 2550005958 ISOx_Ladegeraet_2_Resp_Data 0;
BA_ "GenSigSendType" SG_ 2549874825 ISOx_Laserscanner_Req_Data 3;
BA_ "GenSigFuncType" SG_ 2549874825 ISOx_Laserscanner_Req_Data 9;
BA_ "GenSigSwitchedByIgnition" SG_ 2549874825 ISOx_Laserscanner_Req_Data 0;
BA_ "GenSigSendType" SG_ 2550005897 ISOx_Laserscanner_Resp_Data 3;
BA_ "GenSigFuncType" SG_ 2550005897 ISOx_Laserscanner_Resp_Data 9;
BA_ "GenSigSwitchedByIgnition" SG_ 2550005897 ISOx_Laserscanner_Resp_Data 0;
BA_ "GenSigSendType" SG_ 2549874818 ISOx_LCM_L_Req_Data 3;
BA_ "GenSigFuncType" SG_ 2549874818 ISOx_LCM_L_Req_Data 9;
BA_ "GenSigSwitchedByIgnition" SG_ 2549874818 ISOx_LCM_L_Req_Data 0;
BA_ "GenSigSendType" SG_ 2550005890 ISOx_LCM_L_Resp_Data 3;
BA_ "GenSigFuncType" SG_ 2550005890 ISOx_LCM_L_Resp_Data 9;
BA_ "GenSigSwitchedByIgnition" SG_ 2550005890 ISOx_LCM_L_Resp_Data 0;
BA_ "GenSigSendType" SG_ 2549874819 ISOx_LCM_R_Req_Data 3;
BA_ "GenSigFuncType" SG_ 2549874819 ISOx_LCM_R_Req_Data 9;
BA_ "GenSigSwitchedByIgnition" SG_ 2549874819 ISOx_LCM_R_Req_Data 0;
BA_ "GenSigSendType" SG_ 2550005891 ISOx_LCM_R_Resp_Data 3;
BA_ "GenSigFuncType" SG_ 2550005891 ISOx_LCM_R_Resp_Data 9;
BA_ "GenSigSwitchedByIgnition" SG_ 2550005891 ISOx_LCM_R_Resp_Data 0;
BA_ "GenSigSendType" SG_ 2549874838 ISOx_LED_LM_L_Req_Data 3;
BA_ "GenSigFuncType" SG_ 2549874838 ISOx_LED_LM_L_Req_Data 9;
BA_ "GenSigSwitchedByIgnition" SG_ 2549874838 ISOx_LED_LM_L_Req_Data 0;
BA_ "GenSigSendType" SG_ 2550005910 ISOx_LED_LM_L_Resp_Data 3;
BA_ "GenSigFuncType" SG_ 2550005910 ISOx_LED_LM_L_Resp_Data 9;
BA_ "GenSigSwitchedByIgnition" SG_ 2550005910 ISOx_LED_LM_L_Resp_Data 0;
BA_ "GenSigSendType" SG_ 2549874839 ISOx_LED_LM_R_Req_Data 3;
BA_ "GenSigFuncType" SG_ 2549874839 ISOx_LED_LM_R_Req_Data 9;
BA_ "GenSigSwitchedByIgnition" SG_ 2549874839 ISOx_LED_LM_R_Req_Data 0;
BA_ "GenSigSendType" SG_ 2550005911 ISOx_LED_LM_R_Resp_Data 3;
BA_ "GenSigFuncType" SG_ 2550005911 ISOx_LED_LM_R_Resp_Data 9;
BA_ "GenSigSwitchedByIgnition" SG_ 2550005911 ISOx_LED_LM_R_Resp_Data 0;
BA_ "GenSigSendType" SG_ 2549874808 ISOx_MOS_01_Req_Data 3;
BA_ "GenSigFuncType" SG_ 2549874808 ISOx_MOS_01_Req_Data 9;
BA_ "GenSigSwitchedByIgnition" SG_ 2549874808 ISOx_MOS_01_Req_Data 0;
BA_ "GenSigSendType" SG_ 2550005880 ISOx_MOS_01_Resp_Data 3;
BA_ "GenSigFuncType" SG_ 2550005880 ISOx_MOS_01_Resp_Data 9;
BA_ "GenSigSwitchedByIgnition" SG_ 2550005880 ISOx_MOS_01_Resp_Data 0;
BA_ "GenSigSendType" SG_ 2549874822 ISOx_OTA_FC_Req_Data 3;
BA_ "GenSigFuncType" SG_ 2549874822 ISOx_OTA_FC_Req_Data 9;
BA_ "GenSigSwitchedByIgnition" SG_ 2549874822 ISOx_OTA_FC_Req_Data 0;
BA_ "GenSigSendType" SG_ 2550005894 ISOx_OTA_FC_Resp_Data 3;
BA_ "GenSigFuncType" SG_ 2550005894 ISOx_OTA_FC_Resp_Data 9;
BA_ "GenSigSwitchedByIgnition" SG_ 2550005894 ISOx_OTA_FC_Resp_Data 0;
BA_ "GenSigSendType" SG_ 2549874836 ISOx_PACC_Req_Data 3;
BA_ "GenSigFuncType" SG_ 2549874836 ISOx_PACC_Req_Data 9;
BA_ "GenSigSwitchedByIgnition" SG_ 2549874836 ISOx_PACC_Req_Data 0;
BA_ "GenSigSendType" SG_ 2550005908 ISOx_PACC_Resp_Data 3;
BA_ "GenSigFuncType" SG_ 2550005908 ISOx_PACC_Resp_Data 9;
BA_ "GenSigSwitchedByIgnition" SG_ 2550005908 ISOx_PACC_Resp_Data 0;
BA_ "GenSigSendType" SG_ 2549874842 ISOx_PADM_Req_Data 3;
BA_ "GenSigFuncType" SG_ 2549874842 ISOx_PADM_Req_Data 9;
BA_ "GenSigSwitchedByIgnition" SG_ 2549874842 ISOx_PADM_Req_Data 0;
BA_ "GenSigSendType" SG_ 2550005914 ISOx_PADM_Resp_Data 3;
BA_ "GenSigFuncType" SG_ 2550005914 ISOx_PADM_Resp_Data 9;
BA_ "GenSigSwitchedByIgnition" SG_ 2550005914 ISOx_PADM_Resp_Data 0;
BA_ "GenSigSendType" SG_ 2549874821 ISOx_RSG_Req_Data 3;
BA_ "GenSigFuncType" SG_ 2549874821 ISOx_RSG_Req_Data 9;
BA_ "GenSigSwitchedByIgnition" SG_ 2549874821 ISOx_RSG_Req_Data 0;
BA_ "GenSigSendType" SG_ 2550005893 ISOx_RSG_Resp_Data 3;
BA_ "GenSigFuncType" SG_ 2550005893 ISOx_RSG_Resp_Data 9;
BA_ "GenSigSwitchedByIgnition" SG_ 2550005893 ISOx_RSG_Resp_Data 0;
BA_ "GenSigSendType" SG_ 2549874848 ISOx_SAD2_Req_Data 3;
BA_ "GenSigFuncType" SG_ 2549874848 ISOx_SAD2_Req_Data 9;
BA_ "GenSigSwitchedByIgnition" SG_ 2549874848 ISOx_SAD2_Req_Data 0;
BA_ "GenSigSendType" SG_ 2550005920 ISOx_SAD2_Resp_Data 3;
BA_ "GenSigFuncType" SG_ 2550005920 ISOx_SAD2_Resp_Data 9;
BA_ "GenSigSwitchedByIgnition" SG_ 2550005920 ISOx_SAD2_Resp_Data 0;
BA_ "GenSigSendType" SG_ 2549874820 ISOx_SAD_Req_Data 3;
BA_ "GenSigFuncType" SG_ 2549874820 ISOx_SAD_Req_Data 9;
BA_ "GenSigSwitchedByIgnition" SG_ 2549874820 ISOx_SAD_Req_Data 0;
BA_ "GenSigSendType" SG_ 2550005892 ISOx_SAD_Resp_Data 3;
BA_ "GenSigFuncType" SG_ 2550005892 ISOx_SAD_Resp_Data 9;
BA_ "GenSigSwitchedByIgnition" SG_ 2550005892 ISOx_SAD_Resp_Data 0;
BA_ "GenSigSendType" SG_ 2549874858 ISOx_SCC1_Req_Data 3;
BA_ "GenSigFuncType" SG_ 2549874858 ISOx_SCC1_Req_Data 9;
BA_ "GenSigSwitchedByIgnition" SG_ 2549874858 ISOx_SCC1_Req_Data 0;
BA_ "GenSigSendType" SG_ 2550005930 ISOx_SCC1_Resp_Data 3;
BA_ "GenSigFuncType" SG_ 2550005930 ISOx_SCC1_Resp_Data 9;
BA_ "GenSigSwitchedByIgnition" SG_ 2550005930 ISOx_SCC1_Resp_Data 0;
BA_ "GenSigSendType" SG_ 2549874859 ISOx_SCC2_Req_Data 3;
BA_ "GenSigFuncType" SG_ 2549874859 ISOx_SCC2_Req_Data 9;
BA_ "GenSigSwitchedByIgnition" SG_ 2549874859 ISOx_SCC2_Req_Data 0;
BA_ "GenSigSendType" SG_ 2550005931 ISOx_SCC2_Resp_Data 3;
BA_ "GenSigFuncType" SG_ 2550005931 ISOx_SCC2_Resp_Data 9;
BA_ "GenSigSwitchedByIgnition" SG_ 2550005931 ISOx_SCC2_Resp_Data 0;
BA_ "GenSigSendType" SG_ 2549874855 ISOx_SDC1_Req_Data 3;
BA_ "GenSigFuncType" SG_ 2549874855 ISOx_SDC1_Req_Data 9;
BA_ "GenSigSwitchedByIgnition" SG_ 2549874855 ISOx_SDC1_Req_Data 0;
BA_ "GenSigSendType" SG_ 2550005927 ISOx_SDC1_Resp_Data 3;
BA_ "GenSigFuncType" SG_ 2550005927 ISOx_SDC1_Resp_Data 9;
BA_ "GenSigSwitchedByIgnition" SG_ 2550005927 ISOx_SDC1_Resp_Data 0;
BA_ "GenSigSendType" SG_ 2549874856 ISOx_SDC2_Req_Data 3;
BA_ "GenSigFuncType" SG_ 2549874856 ISOx_SDC2_Req_Data 9;
BA_ "GenSigSwitchedByIgnition" SG_ 2549874856 ISOx_SDC2_Req_Data 0;
BA_ "GenSigSendType" SG_ 2550005928 ISOx_SDC2_Resp_Data 3;
BA_ "GenSigFuncType" SG_ 2550005928 ISOx_SDC2_Resp_Data 9;
BA_ "GenSigSwitchedByIgnition" SG_ 2550005928 ISOx_SDC2_Resp_Data 0;
BA_ "GenSigSendType" SG_ 2549874824 ISOx_Sitzmemo_HBFS_Req_Data 3;
BA_ "GenSigFuncType" SG_ 2549874824 ISOx_Sitzmemo_HBFS_Req_Data 9;
BA_ "GenSigSwitchedByIgnition" SG_ 2549874824 ISOx_Sitzmemo_HBFS_Req_Data 0;
BA_ "GenSigSendType" SG_ 2550005896 ISOx_Sitzmemo_HBFS_Resp_Data 3;
BA_ "GenSigFuncType" SG_ 2550005896 ISOx_Sitzmemo_HBFS_Resp_Data 9;
BA_ "GenSigSwitchedByIgnition" SG_ 2550005896 ISOx_Sitzmemo_HBFS_Resp_Data 0;
BA_ "GenSigSendType" SG_ 2549874823 ISOx_Sitzmemo_HFS_Req_Data 3;
BA_ "GenSigFuncType" SG_ 2549874823 ISOx_Sitzmemo_HFS_Req_Data 9;
BA_ "GenSigSwitchedByIgnition" SG_ 2549874823 ISOx_Sitzmemo_HFS_Req_Data 0;
BA_ "GenSigSendType" SG_ 2550005895 ISOx_Sitzmemo_HFS_Resp_Data 3;
BA_ "GenSigFuncType" SG_ 2550005895 ISOx_Sitzmemo_HFS_Resp_Data 9;
BA_ "GenSigSwitchedByIgnition" SG_ 2550005895 ISOx_Sitzmemo_HFS_Resp_Data 0;
BA_ "GenSigSendType" SG_ 2549874837 ISOx_Sitzmemo_SR3_Req_Data 3;
BA_ "GenSigFuncType" SG_ 2549874837 ISOx_Sitzmemo_SR3_Req_Data 9;
BA_ "GenSigSwitchedByIgnition" SG_ 2549874837 ISOx_Sitzmemo_SR3_Req_Data 0;
BA_ "GenSigSendType" SG_ 2550005909 ISOx_Sitzmemo_SR3_Resp_Data 3;
BA_ "GenSigFuncType" SG_ 2550005909 ISOx_Sitzmemo_SR3_Resp_Data 9;
BA_ "GenSigSwitchedByIgnition" SG_ 2550005909 ISOx_Sitzmemo_SR3_Resp_Data 0;
BA_ "GenSigSendType" SG_ 2549874851 ISOx_SRAL_Req_Data 3;
BA_ "GenSigFuncType" SG_ 2549874851 ISOx_SRAL_Req_Data 9;
BA_ "GenSigSwitchedByIgnition" SG_ 2549874851 ISOx_SRAL_Req_Data 0;
BA_ "GenSigSendType" SG_ 2550005923 ISOx_SRAL_Resp_Data 3;
BA_ "GenSigFuncType" SG_ 2550005923 ISOx_SRAL_Resp_Data 9;
BA_ "GenSigSwitchedByIgnition" SG_ 2550005923 ISOx_SRAL_Resp_Data 0;
BA_ "GenSigSendType" SG_ 2549874860 ISOx_SRAR_Req_Data 3;
BA_ "GenSigFuncType" SG_ 2549874860 ISOx_SRAR_Req_Data 9;
BA_ "GenSigSwitchedByIgnition" SG_ 2549874860 ISOx_SRAR_Req_Data 0;
BA_ "GenSigSendType" SG_ 2550005932 ISOx_SRAR_Resp_Data 3;
BA_ "GenSigFuncType" SG_ 2550005932 ISOx_SRAR_Resp_Data 9;
BA_ "GenSigSwitchedByIgnition" SG_ 2550005932 ISOx_SRAR_Resp_Data 0;
BA_ "GenSigSendType" SG_ 2549874826 ISOx_SWA_2_Req_Data 3;
BA_ "GenSigFuncType" SG_ 2549874826 ISOx_SWA_2_Req_Data 9;
BA_ "GenSigSwitchedByIgnition" SG_ 2549874826 ISOx_SWA_2_Req_Data 0;
BA_ "GenSigSendType" SG_ 2550005898 ISOx_SWA_2_Resp_Data 3;
BA_ "GenSigFuncType" SG_ 2550005898 ISOx_SWA_2_Resp_Data 9;
BA_ "GenSigSwitchedByIgnition" SG_ 2550005898 ISOx_SWA_2_Resp_Data 0;
BA_ "GenSigSendType" SG_ 2549874868 ISOx_TelemetrieSG_Req_Data 3;
BA_ "GenSigFuncType" SG_ 2549874868 ISOx_TelemetrieSG_Req_Data 9;
BA_ "GenSigSwitchedByIgnition" SG_ 2549874868 ISOx_TelemetrieSG_Req_Data 0;
BA_ "GenSigSendType" SG_ 2550005940 ISOx_TelemetrieSG_Resp_Data 3;
BA_ "GenSigFuncType" SG_ 2550005940 ISOx_TelemetrieSG_Resp_Data 9;
BA_ "GenSigSwitchedByIgnition" SG_ 2550005940 ISOx_TelemetrieSG_Resp_Data 0;
BA_ "GenSigSendType" SG_ 2549874884 ISOx_VAS_L_Req_Data 3;
BA_ "GenSigFuncType" SG_ 2549874884 ISOx_VAS_L_Req_Data 9;
BA_ "GenSigSwitchedByIgnition" SG_ 2549874884 ISOx_VAS_L_Req_Data 0;
BA_ "GenSigSendType" SG_ 2550005956 ISOx_VAS_L_Resp_Data 3;
BA_ "GenSigFuncType" SG_ 2550005956 ISOx_VAS_L_Resp_Data 9;
BA_ "GenSigSwitchedByIgnition" SG_ 2550005956 ISOx_VAS_L_Resp_Data 0;
BA_ "GenSigSendType" SG_ 2549874885 ISOx_VAS_R_Req_Data 3;
BA_ "GenSigFuncType" SG_ 2549874885 ISOx_VAS_R_Req_Data 9;
BA_ "GenSigSwitchedByIgnition" SG_ 2549874885 ISOx_VAS_R_Req_Data 0;
BA_ "GenSigSendType" SG_ 2550005957 ISOx_VAS_R_Resp_Data 3;
BA_ "GenSigFuncType" SG_ 2550005957 ISOx_VAS_R_Resp_Data 9;
BA_ "GenSigSwitchedByIgnition" SG_ 2550005957 ISOx_VAS_R_Resp_Data 0;
BA_ "GenSigSendType" SG_ 2549874864 ISOx_WindowTrans_1_Req_Data 3;
BA_ "GenSigFuncType" SG_ 2549874864 ISOx_WindowTrans_1_Req_Data 9;
BA_ "GenSigSwitchedByIgnition" SG_ 2549874864 ISOx_WindowTrans_1_Req_Data 0;
BA_ "GenSigSendType" SG_ 2550005936 ISOx_WindowTrans_1_Resp_Data 3;
BA_ "GenSigFuncType" SG_ 2550005936 ISOx_WindowTrans_1_Resp_Data 9;
BA_ "GenSigSwitchedByIgnition" SG_ 2550005936 ISOx_WindowTrans_1_Resp_Data 0;
BA_ "GenSigSendType" SG_ 2549874853 ISOx_WLC1_Req_Data 3;
BA_ "GenSigFuncType" SG_ 2549874853 ISOx_WLC1_Req_Data 9;
BA_ "GenSigSwitchedByIgnition" SG_ 2549874853 ISOx_WLC1_Req_Data 0;
BA_ "GenSigSendType" SG_ 2550005925 ISOx_WLC1_Resp_Data 3;
BA_ "GenSigFuncType" SG_ 2550005925 ISOx_WLC1_Resp_Data 9;
BA_ "GenSigSwitchedByIgnition" SG_ 2550005925 ISOx_WLC1_Resp_Data 0;
BA_ "GenSigSendType" SG_ 2549874854 ISOx_WLC2_Req_Data 3;
BA_ "GenSigFuncType" SG_ 2549874854 ISOx_WLC2_Req_Data 9;
BA_ "GenSigSwitchedByIgnition" SG_ 2549874854 ISOx_WLC2_Req_Data 0;
BA_ "GenSigSendType" SG_ 2550005926 ISOx_WLC2_Resp_Data 3;
BA_ "GenSigFuncType" SG_ 2550005926 ISOx_WLC2_Resp_Data 9;
BA_ "GenSigSwitchedByIgnition" SG_ 2550005926 ISOx_WLC2_Resp_Data 0;
BA_ "GenSigSendType" SG_ 2549874843 ISOx_zDML_Req_Data 3;
BA_ "GenSigFuncType" SG_ 2549874843 ISOx_zDML_Req_Data 9;
BA_ "GenSigSwitchedByIgnition" SG_ 2549874843 ISOx_zDML_Req_Data 0;
BA_ "GenSigSendType" SG_ 2550005915 ISOx_zDML_Resp_Data 3;
BA_ "GenSigFuncType" SG_ 2550005915 ISOx_zDML_Resp_Data 9;
BA_ "GenSigSwitchedByIgnition" SG_ 2550005915 ISOx_zDML_Resp_Data 0;
BA_ "GenSigSendType" SG_ 2033 Request_Airbag_Deployment 3;
BA_ "GenSigSendType" SG_ 2041 Response_Airbag_Deployment 3;
BA_ "GenSigSwitchedByIgnition" SG_ 2566686208 XCP_Gateway_CRO_01_Data 0;
BA_ "GenSigSwitchedByIgnition" SG_ 2566686209 XCP_Gateway_DTO_01_Data 0;
