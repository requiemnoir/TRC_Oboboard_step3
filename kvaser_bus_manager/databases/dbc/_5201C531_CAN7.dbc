VERSION "HIPBNYYYYYYYYYYYYYYYYYYYYYYYYYYY"

BS_:

BU_: Logger _5201C531

BO_ 2041 DTODAQ1: 8 _5201C531
  SG_ PID1 M : 0|8@1+ (1,0) [0|0] "" Logger
  SG_ DFES_numDFC_27_ m48 : 24|16@1+ (1,0) [0|952] "NO" Logger
  SG_ DFES_numDFC_28_ m48 : 40|16@1+ (1,0) [0|952] "NO" Logger
  SG_ SEQ_ShiftSequenchiftSequencer_sm m48 : 56|8@1+ (1,0) [0|6] "" Logger
  SG_ DFES_numDFC_29_ m49 : 8|16@1+ (1,0) [0|952] "NO" Logger
  SG_ IOP_EngineSpeedDemanded m49 : 24|16@1+ (1,0) [0|12285] "RPM" Logger
  SG_ ENG_TargetEngineTorque m49 : 40|16@1+ (0.25,-500) [-500|1547.75] "Nm" Logger
  SG_ SEQ_ShiftSeque_1_iftSequencer_sm m49 : 56|8@1+ (1,0) [0|7] "" Logger
  SG_ SEQ_ShiftSeque_2_iftSequencer_sm m50 : 8|8@1+ (1,0) [0|7] "" Logger
  SG_ SEQ_TargetHybMode m50 : 16|8@1+ (1,0) [0|7] "" Logger
  SG_ SEQ_TargetGear m50 : 24|8@1+ (1,0) [0|11] "" Logger
  SG_ SEQ_K2Request m50 : 32|8@1+ (1,0) [0|7] "" Logger
  SG_ SEQ_K1Request m50 : 40|8@1+ (1,0) [0|7] "" Logger
  SG_ SEQ_Input2Request m50 : 48|8@1+ (1,0) [0|2] "" Logger
  SG_ SEQ_Input2Gear m50 : 56|8@1+ (1,0) [0|11] "" Logger
  SG_ SEQ_Input1Request m51 : 8|8@1+ (1,0) [0|2] "" Logger
  SG_ SEQ_Input1Gear m51 : 16|8@1+ (1,0) [0|11] "" Logger
  SG_ SEQ_HybRequest m51 : 24|8@1+ (1,0) [0|2] "" Logger
  SG_ SEQ_HybMode m51 : 32|8@1+ (1,0) [0|7] "" Logger
  SG_ SEQ_EngineRequest m51 : 40|8@1+ (1,0) [0|6] "" Logger
  SG_ SEQ_CurrentTorqueGear m51 : 48|8@1+ (1,0) [0|11] "" Logger
  SG_ SEQ_CurrentHybMode m51 : 56|8@1+ (1,0) [0|7] "" Logger
  SG_ PCL_PressureAvailable m52 : 8|8@1+ (1,0) [0|255] "" Logger
  SG_ MOT_MotorStatus m52 : 16|8@1+ (1,0) [0|3] "" Logger
  SG_ MOT_MotorState m52 : 24|8@1+ (1,0) [0|6] "" Logger
  SG_ IOP_TransmissionemperatureStatus m52 : 32|8@1+ (1,0) [0|255] "" Logger
  SG_ IOP_StatusSumpOilTemperature m52 : 40|8@1+ (1,0) [0|255] "" Logger
  SG_ IOP_StatusSpeedSensorOdd m52 : 48|8@1+ (1,0) [0|255] "" Logger
  SG_ IOP_StatusSpeedSensorGear37 m52 : 56|8@1+ (1,0) [0|255] "" Logger
  SG_ IOP_StatusSpeedSensorEven m53 : 8|8@1+ (1,0) [0|255] "" Logger
  SG_ IOP_StatusPosnSynchroF m53 : 16|8@1+ (1,0) [0|255] "" Logger
  SG_ IOP_StatusPosnSynchroD m53 : 24|8@1+ (1,0) [0|255] "" Logger
  SG_ IOP_StatusPosnSynchroC m53 : 32|8@1+ (1,0) [0|255] "" Logger
  SG_ IOP_StatusPosnSynchroB m53 : 40|8@1+ (1,0) [0|255] "" Logger
  SG_ IOP_StatusPosnSynchroA m53 : 48|8@1+ (1,0) [0|255] "" Logger
  SG_ IOP_SS6_Status m53 : 56|8@1+ (1,0) [0|255] "" Logger
  SG_ IOP_SS5_Status m54 : 8|8@1+ (1,0) [0|255] "" Logger
  SG_ IOP_SS4_Status m54 : 16|8@1+ (1,0) [0|255] "" Logger
  SG_ IOP_SS3_Status m54 : 24|8@1+ (1,0) [0|255] "" Logger
  SG_ IOP_SS2_Status m54 : 32|8@1+ (1,0) [0|255] "" Logger
  SG_ IOP_SS1_Status m54 : 40|8@1+ (1,0) [0|255] "" Logger
  SG_ IOP_ParkLockPosStatus m54 : 48|8@1+ (1,0) [0|255] "" Logger
  SG_ IOP_ParkButtonStatus m54 : 56|8@1+ (1,0) [0|255] "" Logger
  SG_ IOP_ParkButton m55 : 8|8@1+ (1,0) [0|255] "" Logger
  SG_ IOP_KL30_3_Status m55 : 16|8@1+ (1,0) [0|255] "" Logger
  SG_ IOP_KL30_2_Status m55 : 24|8@1+ (1,0) [0|255] "" Logger
  SG_ IOP_KL30_1_Status m55 : 32|8@1+ (1,0) [0|255] "" Logger
  SG_ IOP_KL15 m55 : 40|8@1+ (1,0) [0|255] "" Logger
  SG_ IOP_InternalOutputSpeedStatus m55 : 48|8@1+ (1,0) [0|255] "" Logger
  SG_ IOP_BrakeSwitch m55 : 56|8@1+ (1,0) [0|255] "" Logger
  SG_ IOP_DiagnosticResetBitfield m56 : 8|8@1+ (1,0) [0|7] "" Logger
  SG_ IOP_SpeedControlType m56 : 16|8@1+ (1,0) [0|11] "" Logger
  SG_ IOP_P2P3Config m56 : 24|8@1+ (1,0) [0|7] "" Logger
  SG_ IOP_MaxEngineTorqueEnabled m56 : 32|8@1+ (1,0) [0|255] "" Logger
  SG_ IOP_GearboxMILStatus m56 : 40|8@1+ (1,0) [0|255] "" Logger
  SG_ IOP_DrivingModeIst m56 : 48|8@1+ (1,0) [0|14] "" Logger
  SG_ IOP_DrivingModeDisplay m56 : 56|8@1+ (1,0) [0|13] "" Logger
  SG_ IOP_TransMode m57 : 8|8@1+ (1,0) [0|5] "" Logger
  SG_ IOP_ThrottlePedal m57 : 16|8@1+ (0.4,-0) [0|102] "" Logger
  SG_ IOP_LateralAcceleration m57 : 24|8@1- (0.01,-0) [-1.27|1.27] "" Logger
  SG_ IOP_KL50EngStart m57 : 32|8@1+ (1,0) [0|255] "" Logger
  SG_ IOP_DriveModeTrans m57 : 40|8@1+ (1,0) [0|15] "" Logger
  SG_ IOP_BLDCPumpVoltage m57 : 48|8@1+ (0.1,-0) [0|25.5] "" Logger
  SG_ GAC_MdHybEnga m57 : 56|8@1+ (1,0) [0|7] "" Logger
  SG_ GAC_Input2Gear m58 : 8|8@1+ (1,0) [0|254] "" Logger
  SG_ GAC_Input1Gear m58 : 16|8@1+ (1,0) [0|254] "" Logger
  SG_ GAC_CodeFailedHybridModeTableMsg m58 : 24|8@1+ (1,0) [0|255] "" Logger
  SG_ GAC_CodeFailedGearTableMsg m58 : 32|8@1+ (1,0) [0|255] "" Logger
  SG_ GAC_CodeFailStuckNMsg m58 : 40|8@1+ (1,0) [0|255] "" Logger
  SG_ GAC_CodeFailOutOfNNoShiftMsg m58 : 48|8@1+ (1,0) [0|255] "" Logger
  SG_ GAC_CodeFailOutOfNInShiftMsg m58 : 56|8@1+ (1,0) [0|255] "" Logger
  SG_ GAC_CodeFailGracToNMsg m59 : 8|8@1+ (1,0) [0|255] "" Logger
  SG_ DWC_K2Status m59 : 16|8@1+ (1,0) [0|3] "" Logger
  SG_ DWC_K2State m59 : 24|8@1+ (1,0) [0|7] "" Logger
  SG_ DWC_K1Status m59 : 32|8@1+ (1,0) [0|3] "" Logger
  SG_ DWC_K1State m59 : 40|8@1+ (1,0) [0|7] "" Logger
  SG_ DWC_DownshiftType m59 : 48|8@1+ (1,0) [0|1] "" Logger
  SG_ DST_PreselectGear m59 : 56|8@1+ (1,0) [0|11] "" Logger
  SG_ DST_HybridMode m60 : 8|8@1+ (1,0) [0|14] "" Logger
  SG_ DST_DemandGear m60 : 16|8@1+ (1,0) [0|11] "" Logger
  SG_ GAC_CodeFailStuckN m60 : 24|8@1+ (1,0) [0|255] "" Logger
  SG_ GAC_CodeFailOutOfNNoShift m60 : 32|8@1+ (1,0) [0|255] "" Logger
  SG_ GAC_CodeFailOutOfNInShift m60 : 40|8@1+ (1,0) [0|255] "" Logger
  SG_ GAC_CodeFailGracToN m60 : 48|8@1+ (1,0) [0|255] "" Logger
  SG_ DFES_stChk_00_ m60 : 56|8@1+ (1,0) [0|7] "NO" Logger
  SG_ DFES_stChk_01_ m61 : 8|8@1+ (1,0) [0|7] "NO" Logger
  SG_ DFES_stChk_02_ m61 : 16|8@1+ (1,0) [0|7] "NO" Logger
  SG_ DFES_stChk_03_ m61 : 24|8@1+ (1,0) [0|7] "NO" Logger
  SG_ DFES_stChk_04_ m61 : 32|8@1+ (1,0) [0|7] "NO" Logger
  SG_ DFES_stChk_05_ m61 : 40|8@1+ (1,0) [0|7] "NO" Logger
  SG_ DFES_stChk_06_ m61 : 48|8@1+ (1,0) [0|7] "NO" Logger
  SG_ DFES_stChk_07_ m61 : 56|8@1+ (1,0) [0|7] "NO" Logger
  SG_ DFES_stChk_08_ m62 : 8|8@1+ (1,0) [0|7] "NO" Logger
  SG_ DFES_stChk_09_ m62 : 16|8@1+ (1,0) [0|7] "NO" Logger
  SG_ DFES_stChk_10_ m62 : 24|8@1+ (1,0) [0|7] "NO" Logger
  SG_ DFES_stChk_11_ m62 : 32|8@1+ (1,0) [0|7] "NO" Logger
  SG_ DFES_stChk_12_ m62 : 40|8@1+ (1,0) [0|7] "NO" Logger
  SG_ DFES_stChk_13_ m62 : 48|8@1+ (1,0) [0|7] "NO" Logger
  SG_ DFES_stChk_14_ m62 : 56|8@1+ (1,0) [0|7] "NO" Logger
  SG_ DFES_stChk_15_ m63 : 8|8@1+ (1,0) [0|7] "NO" Logger
  SG_ DFES_stChk_16_ m63 : 16|8@1+ (1,0) [0|7] "NO" Logger
  SG_ DFES_stChk_17_ m63 : 24|8@1+ (1,0) [0|7] "NO" Logger
  SG_ DFES_stChk_18_ m63 : 32|8@1+ (1,0) [0|7] "NO" Logger
  SG_ DFES_stChk_19_ m63 : 40|8@1+ (1,0) [0|7] "NO" Logger
  SG_ DFES_stChk_20_ m63 : 48|8@1+ (1,0) [0|7] "NO" Logger
  SG_ DFES_stChk_21_ m63 : 56|8@1+ (1,0) [0|7] "NO" Logger
  SG_ DFES_stChk_22_ m64 : 8|8@1+ (1,0) [0|7] "NO" Logger
  SG_ DFES_stChk_23_ m64 : 16|8@1+ (1,0) [0|7] "NO" Logger
  SG_ DFES_stChk_24_ m64 : 24|8@1+ (1,0) [0|7] "NO" Logger
  SG_ DFES_stChk_25_ m64 : 32|8@1+ (1,0) [0|7] "NO" Logger
  SG_ DFES_stChk_26_ m64 : 40|8@1+ (1,0) [0|7] "NO" Logger
  SG_ DFES_stChk_27_ m64 : 48|8@1+ (1,0) [0|7] "NO" Logger
  SG_ DFES_stChk_28_ m64 : 56|8@1+ (1,0) [0|7] "NO" Logger
  SG_ DFES_stChk_29_ m65 : 8|8@1+ (1,0) [0|7] "NO" Logger
  SG_ IOP_DrivingMode m65 : 16|8@1+ (1,0) [0|15] "" Logger
  SG_ DST_DrivingMode m65 : 24|8@1+ (1,0) [0|11] "" Logger

BO_ 2033 DTO: 8 _5201C531

BO_ 2032 CRO: 8 Logger

BA_DEF_ BO_ "DTO_MESSAGE_HEADER_ENCODING_INFO" STRING ;
BA_DEF_ BO_ "DTO_MESSAGE_DAQ_LIST_INFO" STRING ;
BA_DEF_ BO_ "DTO_MESSAGE_DAQ_LIST_TIMES" STRING ;
BA_DEF_ BO_ "DTO_MESSAGE_DAQ_LIST_NAMES" STRING ;
BA_DEF_ BO_ "XCP_DATA0" STRING ;
BA_DEF_ BO_ "XCP_DATA1" STRING ;
BA_DEF_ BO_ "XCP_DATA2" STRING ;
BA_DEF_ BO_ "XCP_DATA3" STRING ;
BA_DEF_ BO_ "XCP_DATA4" STRING ;
BA_DEF_ BO_ "XCP_DATA5" STRING ;
BA_DEF_ BO_ "XCP_DATA6" STRING ;
BA_DEF_ BO_ "XCP_DATA7" STRING ;
BA_DEF_ BO_ "XCP_DATA8" STRING ;
BA_DEF_ BO_ "XCP_DATA9" STRING ;
BA_DEF_ BO_ "XCP_DATA10" STRING ;
BA_DEF_ BO_ "XCP_DATA11" STRING ;
BA_DEF_ BO_ "XCP_DATA12" STRING ;
BA_DEF_ BO_ "XCP_DATA13" STRING ;
BA_DEF_ BO_ "XCP_DATA14" STRING ;
BA_DEF_ BO_ "XCP_DATA15" STRING ;
BA_DEF_ BO_ "XCP_DATA16" STRING ;
BA_DEF_ BO_ "XCP_DATA17" STRING ;
BA_DEF_ BO_ "XCP_DATA18" STRING ;
BA_DEF_ BO_ "XCP_DATA19" STRING ;
BA_DEF_ BO_ "XCP_DATA20" STRING ;
BA_DEF_ BO_ "XCP_DATA21" STRING ;
BA_DEF_ BO_ "XCP_DATA22" STRING ;
BA_DEF_ BO_ "XCP_DATA23" STRING ;
BA_DEF_ BO_ "XCP_DATA24" STRING ;
BA_DEF_ BO_ "XCP_DATA25" STRING ;
BA_DEF_ BO_ "XCP_DATA26" STRING ;
BA_DEF_ BO_ "XCP_DATA27" STRING ;
BA_DEF_ BO_ "XCP_DATA28" STRING ;
BA_DEF_ BO_ "XCP_DATA29" STRING ;
BA_DEF_ BO_ "XCP_DATA30" STRING ;
BA_DEF_ SG_ "SignalLongName" STRING ;
BA_DEF_DEF_ "DTO_MESSAGE_HEADER_ENCODING_INFO" "";
BA_DEF_DEF_ "DTO_MESSAGE_DAQ_LIST_INFO" "";
BA_DEF_DEF_ "DTO_MESSAGE_DAQ_LIST_TIMES" "";
BA_DEF_DEF_ "DTO_MESSAGE_DAQ_LIST_NAMES" "";
BA_DEF_DEF_ "XCP_DATA0" "";
BA_DEF_DEF_ "XCP_DATA1" "";
BA_DEF_DEF_ "XCP_DATA2" "";
BA_DEF_DEF_ "XCP_DATA3" "";
BA_DEF_DEF_ "XCP_DATA4" "";
BA_DEF_DEF_ "XCP_DATA5" "";
BA_DEF_DEF_ "XCP_DATA6" "";
BA_DEF_DEF_ "XCP_DATA7" "";
BA_DEF_DEF_ "XCP_DATA8" "";
BA_DEF_DEF_ "XCP_DATA9" "";
BA_DEF_DEF_ "XCP_DATA10" "";
BA_DEF_DEF_ "XCP_DATA11" "";
BA_DEF_DEF_ "XCP_DATA12" "";
BA_DEF_DEF_ "XCP_DATA13" "";
BA_DEF_DEF_ "XCP_DATA14" "";
BA_DEF_DEF_ "XCP_DATA15" "";
BA_DEF_DEF_ "XCP_DATA16" "";
BA_DEF_DEF_ "XCP_DATA17" "";
BA_DEF_DEF_ "XCP_DATA18" "";
BA_DEF_DEF_ "XCP_DATA19" "";
BA_DEF_DEF_ "XCP_DATA20" "";
BA_DEF_DEF_ "XCP_DATA21" "";
BA_DEF_DEF_ "XCP_DATA22" "";
BA_DEF_DEF_ "XCP_DATA23" "";
BA_DEF_DEF_ "XCP_DATA24" "";
BA_DEF_DEF_ "XCP_DATA25" "";
BA_DEF_DEF_ "XCP_DATA26" "";
BA_DEF_DEF_ "XCP_DATA27" "";
BA_DEF_DEF_ "XCP_DATA28" "";
BA_DEF_DEF_ "XCP_DATA29" "";
BA_DEF_DEF_ "XCP_DATA30" "";
BA_DEF_DEF_ "SignalLongName" "";
BA_ "XCP_DATA0" BO_ 2033 "02D605D500020006D40000000106D40001004107D3000000000107D3000100000307D3000100010307D3000100020307D3000100030307D3000100040307D3000100050407D3000100060407D3000100070407D3000100080407D3000100090407D30001000A0407D30001000B0407D30001000C0407D30001000D04";
BA_ "XCP_DATA1" BO_ 2033 "07D30001000E0407D30001000F0407D3000100100407D3000100110407D3000100120407D3000100130407D3000100140407D3000100150407D3000100160407D3000100170407D3000100180407D3000100190407D30001001A0407D30001001B0407D30001001C0407D30001001D0407D30001001E0407D30001001F04";
BA_ "XCP_DATA2" BO_ 2033 "07D3000100200407D3000100210407D3000100220407D3000100230407D3000100240407D3000100250407D3000100260407D3000100270407D3000100280407D3000100290407D30001002A0407D30001002B0407D30001002C0407D30001002D0407D30001002E0407D30001002F0407D3000100300407D30001003107";
BA_ "XCP_DATA3" BO_ 2033 "07D3000100320707D3000100330707D3000100340707D3000100350707D3000100360707D3000100370707D3000100380707D3000100390707D30001003A0707D30001003B0707D30001003C0707D30001003D0707D30001003E0707D30001003F0707D3000100400307E2000000000009E1FF01008B2C0160";
BA_ "XCP_DATA4" BO_ 2033 "09E00000000200010607E2000100000009E1FF0400C0FC006009E1FF02007665006009E1FF0100D0BA006007E2FF0100010009E1FF0400D40C016009E1FF02007865006009E1FF0100CADE006007E2FF0100020009E1FF0400440D016009E1FF0200E69D006009E1FF0100CBDE006007E2FF0100030009E1FF0400C8550360";
BA_ "XCP_DATA5" BO_ 2033 "09E1FF0200BEDE006009E1FF0100CCDE006007E2FF0100040009E1FF0400D055036009E1FF02003AFD006009E1FF0100CDDE006007E2FF0100050009E1FF02003CFD006009E1FF02005CFD006009E1FF02005EFD006009E1FF01004CE0006007E2FF0100060009E1FF02009EFD006009E1FF02007AFE0060";
BA_ "XCP_DATA6" BO_ 2033 "09E1FF02007CFE006009E1FF01004DE0006007E2FF0100070009E1FF020082FE006009E1FF020084FE006009E1FF02007A01016009E1FF01004EE0006007E2FF0100080009E1FF0200B001016009E1FF02005E06016009E1FF02009406016009E1FF01004FE0006007E2FF0100090009E1FF0200A80D0160";
BA_ "XCP_DATA7" BO_ 2033 "09E1FF0200B20D016009E1FF0200C40D016009E1FF010050E0006007E2FF01000A0009E1FF0200300E016009E1FF0200AC0E016009E1FF0200B20E016009E1FF010051E0006007E2FF01000B0009E1FF0200C20E016009E1FF0200780F016009E1FF0200940F016009E1FF010052E0006007E2FF01000C00";
BA_ "XCP_DATA8" BO_ 2033 "09E1FF0200D619016009E1FF0200DA19016009E1FF0200DE19016009E1FF0100DFF2006007E2FF01000D0009E1FF0200E219016009E1FF0200E619016009E1FF02008238016009E1FF0100B9FA006007E2FF01000E0009E1FF0200D838016009E1FF02000039016009E1FF02000439016009E1FF0100C6FB0060";
BA_ "XCP_DATA9" BO_ 2033 "07E2FF01000F0009E1FF02000639016009E1FF0200743B016009E1FF02007C3B016009E1FF0100DEFD006007E2FF0100100009E1FF0200823B016009E1FF02008A3B016009E1FF0200923B016009E1FF0100DFFD006007E2FF0100110009E1FF0200F8A4016009E1FF020000A5016009E1FF020006A50160";
BA_ "XCP_DATA10" BO_ 2033 "09E1FF0100E1FD006007E2FF0100120009E1FF020010A5016009E1FF020012A5016009E1FF020058A5016009E1FF0100E2FD006007E2FF0100130009E1FF02005CA5016009E1FF020068A5016009E1FF02006AA5016009E1FF0100E4FD006007E2FF0100140009E1FF020070A5016009E1FF020074A50160";
BA_ "XCP_DATA11" BO_ 2033 "09E1FF02007AA5016009E1FF0100FDFD006007E2FF0100150009E1FF020080A5016009E1FF020086A5016009E1FF02008EA5016009E1FF01000CFE006007E2FF0100160009E1FF020090A5016009E1FF0200D0A5016009E1FF0200DAA5016009E1FF01001FFE006007E2FF0100170009E1FF0200ECA50160";
BA_ "XCP_DATA12" BO_ 2033 "09E1FF020000A6016009E1FF020006A6016009E1FF01002506016007E2FF0100180009E1FF020012A6016009E1FF020014A6016009E1FF02001EA6016009E1FF0100090B016007E2FF0100190009E1FF020046A6016009E1FF02004AA6016009E1FF02004CA6016009E1FF0100D80F016007E2FF01001A00";
BA_ "XCP_DATA13" BO_ 2033 "09E1FF02004EA6016009E1FF0200E0A6016009E1FF0200E4A6016009E1FF0100DF0F016007E2FF01001B0009E1FF0200E8A6016009E1FF0200ECA6016009E1FF0200F0A6016009E1FF0100E50F016007E2FF01001C0009E1FF0200F4A6016009E1FF0200F8A6016009E1FF0200FCA6016009E1FF01002B100160";
BA_ "XCP_DATA14" BO_ 2033 "07E2FF01001D0009E1FF020000A7016009E1FF020004A7016009E1FF020008A7016009E1FF0100D818016007E2FF01001E0009E1FF02000CA7016009E1FF020010A7016009E1FF02005EA9016009E1FF0100571A016007E2FF01001F0009E1FF020060A9016009E1FF020062A9016009E1FF020068A90160";
BA_ "XCP_DATA15" BO_ 2033 "09E1FF0100581A016007E2FF0100200009E1FF0200B4AB016009E1FF0200CAAB016009E1FF02008C3C026009E1FF0100591A016007E2FF0100210009E1FF02008E3C026009E1FF0200903C026009E1FF0200923C026009E1FF01005A1A016007E2FF0100220009E1FF02005C43036009E1FF02005E430360";
BA_ "XCP_DATA16" BO_ 2033 "09E1FF02007843036009E1FF01005B1A016007E2FF0100230009E1FF02007A43036009E1FF02002045036009E1FF02002645036009E1FF01005E1A016007E2FF0100240009E1FF02003645036009E1FF02003C45036009E1FF02004C45036009E1FF01005F1A016007E2FF0100250009E1FF020052450360";
BA_ "XCP_DATA17" BO_ 2033 "09E1FF02006245036009E1FF02007845036009E1FF01000C1D016007E2FF0100260009E1FF02007E45036009E1FF0200B879036009E1FF0200BA79036009E1FF01000D1D016007E2FF0100270009E1FF0200BC79036009E1FF0200BE79036009E1FF0200C079036009E1FF01000E1D016007E2FF01002800";
BA_ "XCP_DATA18" BO_ 2033 "09E1FF0200C279036009E1FF0200C479036009E1FF0200C679036009E1FF01000F1D016007E2FF0100290009E1FF0200C879036009E1FF0200CA79036009E1FF0200CC79036009E1FF0100101D016007E2FF01002A0009E1FF0200CE79036009E1FF0200D079036009E1FF0200D279036009E1FF01007F330160";
BA_ "XCP_DATA19" BO_ 2033 "07E2FF01002B0009E1FF0200D479036009E1FF0200D679036009E1FF0200D879036009E1FF0100143A016007E2FF01002C0009E1FF0200DA79036009E1FF0200DC79036009E1FF0200DE79036009E1FF0100153A016007E2FF01002D0009E1FF0200E079036009E1FF0200E279036009E1FF0200E4790360";
BA_ "XCP_DATA20" BO_ 2033 "09E1FF0100273A016007E2FF01002E0009E1FF0200E679036009E1FF0200E879036009E1FF0200EA79036009E1FF0100673B016007E2FF01002F0009E1FF0200EC79036009E1FF0200EE79036009E1FF0200F079036009E1FF0100DB41016007E2FF0100300009E1FF0200F279036009E1FF0200C8460070";
BA_ "XCP_DATA21" BO_ 2033 "09E1FF0200E446007009E1FF01004A42016007E2FF0100310009E1FF0100FA43016009E1FF010048E4016009E1FF010049E4016009E1FF010052E4016009E1FF010053E4016009E1FF010054E4016009E1FF010055E4016007E2FF0100320009E1FF010056E4016009E1FF010057E4016009E1FF01005BE40160";
BA_ "XCP_DATA22" BO_ 2033 "09E1FF01005CE4016009E1FF010060E4016009E1FF010062E4016009E1FF010063E4016007E2FF0100330009E1FF01006CE4016009E1FF010074E4016009E1FF010075E4016009E1FF010008E6016009E1FF010009E6016009E1FF01000CE6016009E1FF01000DE6016007E2FF0100340009E1FF01000EE60160";
BA_ "XCP_DATA23" BO_ 2033 "09E1FF01000FE6016009E1FF010010E6016009E1FF010011E6016009E1FF010012E6016009E1FF010013E6016009E1FF01001DE6016007E2FF0100350009E1FF01001EE6016009E1FF01001FE6016009E1FF010020E6016009E1FF010021E6016009E1FF010022E6016009E1FF010027E6016009E1FF010028E60160";
BA_ "XCP_DATA24" BO_ 2033 "07E2FF0100360009E1FF010029E6016009E1FF010030E6016009E1FF010031E6016009E1FF010032E6016009E1FF010034E6016009E1FF010037E6016009E1FF01004FE6016007E2FF0100370009E1FF0100A1E6016009E1FF0100ABE6016009E1FF0100B3E6016009E1FF0100B5E6016009E1FF0100BAE60160";
BA_ "XCP_DATA25" BO_ 2033 "09E1FF0100CCE6016009E1FF0100CDE6016007E2FF0100380009E1FF0100E0E6016009E1FF0100E2E6016009E1FF0100F7E6016009E1FF0100F9E6016009E1FF01001AE7016009E1FF010035E7016009E1FF0100EAE7016007E2FF0100390009E1FF0100EEE7016009E1FF0100F1E7016009E1FF010000E80160";
BA_ "XCP_DATA26" BO_ 2033 "09E1FF010001E8016009E1FF010002E8016009E1FF010003E8016009E1FF010004E8016007E2FF01003A0009E1FF010005E8016009E1FF010027E8016009E1FF010028E8016009E1FF010033E8016009E1FF010034E8016009E1FF010045E8016009E1FF01005DE8016007E2FF01003B0009E1FF010069E80160";
BA_ "XCP_DATA27" BO_ 2033 "09E1FF010075E8016009E1FF01000D3E026009E1FF01000E3E026009E1FF01000F3E026009E1FF0100103E026009E1FF01009A79036007E2FF01003C0009E1FF01009B79036009E1FF01009C79036009E1FF01009D79036009E1FF01009E79036009E1FF01009F79036009E1FF0100A079036009E1FF0100A1790360";
BA_ "XCP_DATA28" BO_ 2033 "07E2FF01003D0009E1FF0100A279036009E1FF0100A379036009E1FF0100A479036009E1FF0100A579036009E1FF0100A679036009E1FF0100A779036009E1FF0100A879036007E2FF01003E0009E1FF0100A979036009E1FF0100AA79036009E1FF0100AB79036009E1FF0100AC79036009E1FF0100AD790360";
BA_ "XCP_DATA29" BO_ 2033 "09E1FF0100AE79036009E1FF0100AF79036007E2FF01003F0009E1FF0100B079036009E1FF0100B179036009E1FF0100B279036009E1FF0100B379036009E1FF0100B479036009E1FF0100B579036009E1FF0100B679036007E2FF0100400009E1FF0100B779036009E1FF01008547007009E1FF01008F470070";
BA_ "XCP_DATA30" BO_ 2033 "09E00001000300010505DE02000005DE020100";
BA_ "DTO_MESSAGE_HEADER_ENCODING_INFO" BO_ 2033 "0 1 0 0 0 multiplication absolute";
BA_ "SignalLongName" SG_ 2041 DFES_numDFC_27_ "DFES_numDFC[27]";
BA_ "SignalLongName" SG_ 2041 DFES_numDFC_28_ "DFES_numDFC[28]";
BA_ "SignalLongName" SG_ 2041 SEQ_ShiftSequenchiftSequencer_sm "SEQ_ShiftSequencer.SEQ_ASGShiftSequencer.sm";
BA_ "SignalLongName" SG_ 2041 DFES_numDFC_29_ "DFES_numDFC[29]";
BA_ "SignalLongName" SG_ 2041 SEQ_ShiftSeque_1_iftSequencer_sm "SEQ_ShiftSequencer.SEQ_DCTShiftSequencer.sm";
BA_ "SignalLongName" SG_ 2041 SEQ_ShiftSeque_2_iftSequencer_sm "SEQ_ShiftSequencer.SEQ_P2P3ShiftSequencer.sm";
BA_ "SignalLongName" SG_ 2041 IOP_TransmissionemperatureStatus "IOP_TransmissionOilTemperatureStatus";
BA_ "SignalLongName" SG_ 2041 DFES_stChk_00_ "DFES_stChk[00]";
BA_ "SignalLongName" SG_ 2041 DFES_stChk_01_ "DFES_stChk[01]";
BA_ "SignalLongName" SG_ 2041 DFES_stChk_02_ "DFES_stChk[02]";
BA_ "SignalLongName" SG_ 2041 DFES_stChk_03_ "DFES_stChk[03]";
BA_ "SignalLongName" SG_ 2041 DFES_stChk_04_ "DFES_stChk[04]";
BA_ "SignalLongName" SG_ 2041 DFES_stChk_05_ "DFES_stChk[05]";
BA_ "SignalLongName" SG_ 2041 DFES_stChk_06_ "DFES_stChk[06]";
BA_ "SignalLongName" SG_ 2041 DFES_stChk_07_ "DFES_stChk[07]";
BA_ "SignalLongName" SG_ 2041 DFES_stChk_08_ "DFES_stChk[08]";
BA_ "SignalLongName" SG_ 2041 DFES_stChk_09_ "DFES_stChk[09]";
BA_ "SignalLongName" SG_ 2041 DFES_stChk_10_ "DFES_stChk[10]";
BA_ "SignalLongName" SG_ 2041 DFES_stChk_11_ "DFES_stChk[11]";
BA_ "SignalLongName" SG_ 2041 DFES_stChk_12_ "DFES_stChk[12]";
BA_ "SignalLongName" SG_ 2041 DFES_stChk_13_ "DFES_stChk[13]";
BA_ "SignalLongName" SG_ 2041 DFES_stChk_14_ "DFES_stChk[14]";
BA_ "SignalLongName" SG_ 2041 DFES_stChk_15_ "DFES_stChk[15]";
BA_ "SignalLongName" SG_ 2041 DFES_stChk_16_ "DFES_stChk[16]";
BA_ "SignalLongName" SG_ 2041 DFES_stChk_17_ "DFES_stChk[17]";
BA_ "SignalLongName" SG_ 2041 DFES_stChk_18_ "DFES_stChk[18]";
BA_ "SignalLongName" SG_ 2041 DFES_stChk_19_ "DFES_stChk[19]";
BA_ "SignalLongName" SG_ 2041 DFES_stChk_20_ "DFES_stChk[20]";
BA_ "SignalLongName" SG_ 2041 DFES_stChk_21_ "DFES_stChk[21]";
BA_ "SignalLongName" SG_ 2041 DFES_stChk_22_ "DFES_stChk[22]";
BA_ "SignalLongName" SG_ 2041 DFES_stChk_23_ "DFES_stChk[23]";
BA_ "SignalLongName" SG_ 2041 DFES_stChk_24_ "DFES_stChk[24]";
BA_ "SignalLongName" SG_ 2041 DFES_stChk_25_ "DFES_stChk[25]";
BA_ "SignalLongName" SG_ 2041 DFES_stChk_26_ "DFES_stChk[26]";
BA_ "SignalLongName" SG_ 2041 DFES_stChk_27_ "DFES_stChk[27]";
BA_ "SignalLongName" SG_ 2041 DFES_stChk_28_ "DFES_stChk[28]";
BA_ "SignalLongName" SG_ 2041 DFES_stChk_29_ "DFES_stChk[29]";
VAL_ 2041 DFES_numDFC_27_ 0 "DFC_Unused" 1 "DFC_DsmTest2" 2 "DFC_Can0Getriebe_01" 3 "DFC_Can0Motor_01_CHK" 4 "DFC_Can0Motor_01_CNT" 5 "DFC_Can0Motor_01_DLC" 6 "DFC_Can0Motor_02_CHK" 7 "DFC_Can0Motor_02_CNT" 8 "DFC_Can0Motor_02_DLC" 9 "DFC_Can0Motor_03_CHK" 10 "DFC_Can0Motor_03_CNT" 11 "DFC_Can0Motor_03_DLC" 12 "DFC_Can1BYPASS_TDG1_11_DLC" 13 "DFC_Can1BYPASS_TDG1_12_DLC" 14 "DFC_Can1BYPASS_TDG1_13_DLC" 15 "DFC_Can1BYPASS_TDG1_14_DLC" 16 "DFC_Can1BYPASS_TDG1_15_DLC" 17 "DFC_Can1BYPASS_TDG1_16_PlaceHolder_DLC" 18 "DFC_Can1BYPASS_TDG1_17_PlaceHolder_DLC" 19 "DFC_Can1BYPASS_TDG1_18_PlaceHolder_DLC" 20 "DFC_Can1BYPASS_TDG1_19_Placeholder_DLC" 21 "DFC_Can1BYPASS_TDG1_20_Placeholder_DLC" 22 "DFC_Can1BYPASS_TDG1_21_DLC" 23 "DFC_Can1BYPASS_TDG1_22_DLC" 24 "DFC_Can1BYPASS_TDG1_AA" 25 "DFC_Can1BYPASS_TDG1_AB" 26 "DFC_Can1BYPASS_TDG1_AC" 27 "DFC_Can1BYPASS_TDG1_AD" 28 "DFC_Can1BYPASS_TDG1_AE" 29 "DFC_Can1BYPASS_TDG1_AF" 30 "DFC_Can1BYPASS_TDG1_BA" 31 "DFC_Can1BYPASS_TDG1_BB" 32 "DFC_Can1BYPASS_TDG1_BC" 33 "DFC_Can1BYPASS_TDG1_BD" 34 "DFC_Can1BYPASS_TDG1_BE_PlaceHolder" 35 "DFC_Can1BYPASS_TDG1_BF_PlaceHolder" 36 "DFC_Can1BYPASS_TDG1_CA_PlaceHolder" 37 "DFC_Can1BYPASS_TDG1_CB_PlaceHolder" 38 "DFC_Can1BYPASS_TDG1_CC_PlaceHolder" 39 "DFC_Can1Cool_Act_Cmd" 40 "DFC_Can1Cool_Act_Sts_DLC" 41 "DFC_DsmTest1" 42 "DFC_FrAACC_06ISigGroup_ACC_06_CHK" 43 "DFC_FrAACC_06ISigGroup_ACC_06_CNT" 44 "DFC_FrAACC_07ISigGroup_ACC_07_CHK" 45 "DFC_FrAACC_07ISigGroup_ACC_07_CNT" 46 "DFC_FrAAirbag_01ISigGroup_Airbag_01_CHK" 47 "DFC_FrAAirbag_01ISigGroup_Airbag_01_CNT" 48 "DFC_FrAAirbag_02ISigGroup_Airbag_02_CHK" 49 "DFC_FrAAirbag_02ISigGroup_Airbag_02_CNT" 50 "DFC_FrABremse_EV_01ISigGroup_Bremse_EV_01_CHK" 51 "DFC_FrABremse_EV_01ISigGroup_Bremse_EV_01_CNT" 52 "DFC_FrABremse_EV_02ISigGroup_Bremse_EV_02_CHK" 53 "DFC_FrABremse_EV_02ISigGroup_Bremse_EV_02_CNT" 54 "DFC_FrAEBKV_01ISigGroup_EBKV_01_CHK" 55 "DFC_FrAEBKV_01ISigGroup_EBKV_01_CNT" 56 "DFC_FrAEM1_HYB_12ISigGroup_EM1_HYB_12_CHK" 57 "DFC_FrAEM1_HYB_12ISigGroup_EM1_HYB_12_CNT" 58 "DFC_FrAEPB_01ISigGroup_EPB_01_CHK" 59 "DFC_FrAEPB_01ISigGroup_EPB_01_CNT" 60 "DFC_FrAESP_03ISigGroup_ESP_03_CHK" 61 "DFC_FrAESP_03ISigGroup_ESP_03_CNT" 62 "DFC_FrAESP_05ISigGroup_ESP_05_CHK" 63 "DFC_FrAESP_05ISigGroup_ESP_05_CNT" 64 "DFC_FrAESP_07ISigGroup_ESP_07_CHK" 65 "DFC_FrAESP_07ISigGroup_ESP_07_CNT" 66 "DFC_FrAESP_08ISigGroup_ESP_08_CHK" 67 "DFC_FrAESP_08ISigGroup_ESP_08_CNT" 68 "DFC_FrAESP_15ISigGroup_ESP_15_CHK" 69 "DFC_FrAESP_15ISigGroup_ESP_15_CNT" 70 "DFC_FrAESP_20ISigGroup_ESP_20_CHK" 71 "DFC_FrAESP_20ISigGroup_ESP_20_CNT" 72 "DFC_FrAESP_21ISigGroup_ESP_21_CHK" 73 "DFC_FrAESP_21ISigGroup_ESP_21_CNT" 74 "DFC_FrAESP_22ISigGroup_ESP_22_CHK" 75 "DFC_FrAESP_22ISigGroup_ESP_22_CNT" 76 "DFC_FrAESP_23ISigGroup_ESP_23_CHK" 77 "DFC_FrAESP_23ISigGroup_ESP_23_CNT" 78 "DFC_FrAESP_24ISigGroup_ESP_24_CHK" 79 "DFC_FrAESP_24ISigGroup_ESP_24_CNT" 80 "DFC_FrAESP_28ISigGroup_ESP_28_CHK" 81 "DFC_FrAESP_28ISigGroup_ESP_28_CNT" 82 "DFC_FrAESP_31ISigGroup_ESP_31_CHK" 83 "DFC_FrAESP_31ISigGroup_ESP_31_CNT" 84 "DFC_FrAESP_32ISigGroup_ESP_32_CHK" 85 "DFC_FrAESP_32ISigGroup_ESP_32_CNT" 86 "DFC_FrAESP_33ISigGroup_ESP_33_CHK" 87 "DFC_FrAESP_33ISigGroup_ESP_33_CNT" 88 "DFC_FrAESP_41ISigGroup_ESP_41_CHK" 89 "DFC_FrAESP_41ISigGroup_ESP_41_CNT" 90 "DFC_FrAESP_44ISigGroup_ESP_44_CHK" 91 "DFC_FrAESP_44ISigGroup_ESP_44_CNT" 92 "DFC_FrAGetriebe_11" 93 "DFC_FrAGetriebe_12" 94 "DFC_FrAGetriebe_13" 95 "DFC_FrAGetriebe_14" 96 "DFC_FrAGetriebe_15" 97 "DFC_FrAGetriebe_16" 98 "DFC_FrAGetriebe_17" 99 "DFC_FrAGetriebe_18" 100 "DFC_FrAGetriebe_HYB_12" 101 "DFC_FrAKN_Getriebe" 102 "DFC_FrAKlemmen_Status_01ISigGroup_Klemmen_Status_01_CHK" 103 "DFC_FrAKlemmen_Status_01ISigGroup_Klemmen_Status_01_CNT" 104 "DFC_FrALCV_01ISigGroup_LCV_01_CHK" 105 "DFC_FrALCV_01ISigGroup_LCV_01_CNT" 106 "DFC_FrALWI_01ISigGroup_LWI_01_CHK" 107 "DFC_FrALWI_01ISigGroup_LWI_01_CNT" 108 "DFC_FrAMotor_11ISigGroup_Motor_11_CHK" 109 "DFC_FrAMotor_11ISigGroup_Motor_11_CNT" 110 "DFC_FrAMotor_12ISigGroup_Motor_12_CHK" 111 "DFC_FrAMotor_12ISigGroup_Motor_12_CNT" 112 "DFC_FrAMotor_14ISigGroup_Motor_14_CHK" 113 "DFC_FrAMotor_14ISigGroup_Motor_14_CNT" 114 "DFC_FrAMotor_20ISigGroup_Motor_20_CHK" 115 "DFC_FrAMotor_20ISigGroup_Motor_20_CNT" 116 "DFC_FrAMotor_27ISigGroup_Motor_27_CHK" 117 "DFC_FrAMotor_27ISigGroup_Motor_27_CNT" 118 "DFC_FrAMotor_28ISigGroup_Motor_28_CHK" 119 "DFC_FrAMotor_28ISigGroup_Motor_28_CNT" 120 "DFC_FrAMotor_Code_01ISigGroup_Motor_Code_01_CHK" 121 "DFC_FrAMotor_Code_01ISigGroup_Motor_Code_01_CNT" 122 "DFC_FrAMotor_TS_01ISigGroup_Motor_TS_01_CHK" 123 "DFC_FrAMotor_TS_01ISigGroup_Motor_TS_01_CNT" 124 "DFC_FrAMotor_TS_02ISigGroup_Motor_TS_02_CHK" 125 "DFC_FrAMotor_TS_02ISigGroup_Motor_TS_02_CNT" 126 "DFC_FrAMotor_TS_03ISigGroup_Motor_TS_03_CHK" 127 "DFC_FrAMotor_TS_03ISigGroup_Motor_TS_03_CNT" 128 "DFC_FrASARA_06ISigGroup_SARA_06_CHK" 129 "DFC_FrASARA_06ISigGroup_SARA_06_CNT" 130 "DFC_FrATSG_FT_02ISigGroup_TSG_FT_02_CHK" 131 "DFC_FrATSG_FT_02ISigGroup_TSG_FT_02_CNT" 132 "DFC_FrATSK_06ISigGroup_TSK_06_CHK" 133 "DFC_FrATSK_06ISigGroup_TSK_06_CNT" 134 "DFC_FrATSK_08ISigGroup_TSK_08_CHK" 135 "DFC_FrATSK_08ISigGroup_TSK_08_CNT" 136 "DFC_FrAWBA_03" 137 "DFC_AdcBkg" 138 "DFC_Adc_Rdnt_0" 139 "DFC_Adc_Rdnt_1" 140 "DFC_Adc_Rdnt_2" 141 "DFC_Adc_Rdnt_3" 142 "DFC_Adc_Rdnt_4" 143 "DFC_Adc_Rdnt_5" 144 "DFC_Adc_Rdnt_6" 145 "DFC_Adc_Rdnt_7" 146 "DFC_Adc_Rdnt_8" 147 "DFC_Adc_Rdnt_9" 148 "DFC_Adc_SB_0" 149 "DFC_Adc_SB_1" 150 "DFC_Adc_SB_2" 151 "DFC_Adc_SB_3" 152 "DFC_Adc_SB_4" 153 "DFC_Adc_SB_5" 154 "DFC_Adc_SB_6" 155 "DFC_Adc_SB_7" 156 "DFC_Adc_SB_8" 157 "DFC_Adc_SB_9" 158 "DFC_Adc_SG_0" 159 "DFC_Adc_SG_1" 160 "DFC_Adc_SG_2" 161 "DFC_Adc_SG_3" 162 "DFC_Adc_SG_4" 163 "DFC_Adc_SG_5" 164 "DFC_Adc_SG_6" 165 "DFC_Adc_SG_7" 166 "DFC_Adc_SG_8" 167 "DFC_Adc_SG_9" 168 "DFC_Adc_Unit" 169 "DFC_BattSply_UHi" 170 "DFC_BattSply_ULo" 171 "DFC_CpuTemp" 172 "DFC_CrntCtrl_Channel_0" 173 "DFC_CrntCtrl_Channel_1" 174 "DFC_CrntCtrl_Channel_2" 175 "DFC_CrntCtrl_Channel_3" 176 "DFC_CrntCtrl_Channel_4" 177 "DFC_CrntCtrl_Channel_5" 178 "DFC_CrntCtrl_Channel_6" 179 "DFC_CrntCtrl_Channel_7" 180 "DFC_CrntCtrl_Channel_8" 181 "DFC_CrntCtrl_Channel_9" 182 "DFC_CrntCtrl_Channel_10" 183 "DFC_CrntCtrl_Channel_11" 184 "DFC_CrntCtrl_Channel_12" 185 "DFC_CrntCtrl_Channel_13" 186 "DFC_CrntCtrl_Channel_14" 187 "DFC_CrntCtrl_Channel_15" 188 "DFC_CrntCtrl_Channel_16" 189 "DFC_CrntCtrl_Channel_17" 190 "DFC_CrntCtrl_Channel_18" 191 "DFC_CrntCtrl_Channel_19" 192 "DFC_CrntCtrl_CrntMon_0" 193 "DFC_CrntCtrl_CrntMon_1" 194 "DFC_CrntCtrl_CrntMon_2" 195 "DFC_CrntCtrl_CrntMon_3" 196 "DFC_CrntCtrl_CrntMon_4" 197 "DFC_CrntCtrl_CrntMon_5" 198 "DFC_CrntCtrl_CrntMon_6" 199 "DFC_CrntCtrl_CrntMon_7" 200 "DFC_CrntCtrl_CrntMon_8" 201 "DFC_CrntCtrl_CrntMon_9" 202 "DFC_CrntCtrl_CrntMon_10" 203 "DFC_CrntCtrl_CrntMon_11" 204 "DFC_CrntCtrl_CrntMon_12" 205 "DFC_CrntCtrl_CrntMon_13" 206 "DFC_CrntCtrl_CrntMon_14" 207 "DFC_CrntCtrl_CrntMon_15" 208 "DFC_CrntCtrl_CrntMon_16" 209 "DFC_CrntCtrl_CrntMon_17" 210 "DFC_CrntCtrl_CrntMon_18" 211 "DFC_CrntCtrl_CrntMon_19" 212 "DFC_CrntCtrl_OP_0" 213 "DFC_CrntCtrl_OP_1" 214 "DFC_CrntCtrl_OP_2" 215 "DFC_CrntCtrl_OP_3" 216 "DFC_CrntCtrl_OP_4" 217 "DFC_CrntCtrl_OP_5" 218 "DFC_CrntCtrl_OP_6" 219 "DFC_CrntCtrl_OP_7" 220 "DFC_CrntCtrl_OP_8" 221 "DFC_CrntCtrl_OP_9" 222 "DFC_CrntCtrl_OP_10" 223 "DFC_CrntCtrl_OP_11" 224 "DFC_CrntCtrl_OP_12" 225 "DFC_CrntCtrl_OP_13" 226 "DFC_CrntCtrl_OP_14" 227 "DFC_CrntCtrl_OP_15" 228 "DFC_CrntCtrl_OP_16" 229 "DFC_CrntCtrl_OP_17" 230 "DFC_CrntCtrl_OP_18" 231 "DFC_CrntCtrl_OP_19" 232 "DFC_CrntCtrl_SB_0" 233 "DFC_CrntCtrl_SB_1" 234 "DFC_CrntCtrl_SB_2" 235 "DFC_CrntCtrl_SB_3" 236 "DFC_CrntCtrl_SB_4" 237 "DFC_CrntCtrl_SB_5" 238 "DFC_CrntCtrl_SB_6" 239 "DFC_CrntCtrl_SB_7" 240 "DFC_CrntCtrl_SB_8" 241 "DFC_CrntCtrl_SB_9" 242 "DFC_CrntCtrl_SB_10" 243 "DFC_CrntCtrl_SB_11" 244 "DFC_CrntCtrl_SB_12" 245 "DFC_CrntCtrl_SB_13" 246 "DFC_CrntCtrl_SB_14" 247 "DFC_CrntCtrl_SB_15" 248 "DFC_CrntCtrl_SB_16" 249 "DFC_CrntCtrl_SB_17" 250 "DFC_CrntCtrl_SB_18" 251 "DFC_CrntCtrl_SB_19" 252 "DFC_CrntCtrl_SG_0" 253 "DFC_CrntCtrl_SG_1" 254 "DFC_CrntCtrl_SG_2" 255 "DFC_CrntCtrl_SG_3" 256 "DFC_CrntCtrl_SG_4" 257 "DFC_CrntCtrl_SG_5" 258 "DFC_CrntCtrl_SG_6" 259 "DFC_CrntCtrl_SG_7" 260 "DFC_CrntCtrl_SG_8" 261 "DFC_CrntCtrl_SG_9" 262 "DFC_CrntCtrl_SG_10" 263 "DFC_CrntCtrl_SG_11" 264 "DFC_CrntCtrl_SG_12" 265 "DFC_CrntCtrl_SG_13" 266 "DFC_CrntCtrl_SG_14" 267 "DFC_CrntCtrl_SG_15" 268 "DFC_CrntCtrl_SG_16" 269 "DFC_CrntCtrl_SG_17" 270 "DFC_CrntCtrl_SG_18" 271 "DFC_CrntCtrl_SG_19" 272 "DFC_CrntCtrl_Unit_0" 273 "DFC_CrntCtrl_Unit_1" 274 "DFC_CtrlMot_DNR_0" 275 "DFC_CtrlMot_DNR_1" 276 "DFC_CtrlMot_OC_0" 277 "DFC_CtrlMot_OC_1" 278 "DFC_CtrlMot_OL_0" 279 "DFC_CtrlMot_OL_1" 280 "DFC_CtrlMot_SB_0" 281 "DFC_CtrlMot_SB_1" 282 "DFC_CtrlMot_SG_0" 283 "DFC_CtrlMot_SG_1" 284 "DFC_Flx_AdcInUnit_0" 285 "DFC_Flx_AdcInUnit_1" 286 "DFC_Flx_AdcInUnit_2" 287 "DFC_Flx_RMeasUnit_0" 288 "DFC_Flx_RMeasUnit_1" 289 "DFC_Flx_SB_0" 290 "DFC_Flx_SB_1" 291 "DFC_Flx_SB_2" 292 "DFC_Flx_SB_3" 293 "DFC_Flx_SB_4" 294 "DFC_Flx_SB_5" 295 "DFC_Flx_SB_6" 296 "DFC_Flx_SB_7" 297 "DFC_Flx_SB_8" 298 "DFC_Flx_SB_9" 299 "DFC_Flx_SB_10" 300 "DFC_Flx_SB_11" 301 "DFC_Flx_SB_12" 302 "DFC_Flx_SB_13" 303 "DFC_Flx_SB_14" 304 "DFC_Flx_SB_15" 305 "DFC_Flx_SB_16" 306 "DFC_Flx_SB_17" 307 "DFC_Flx_SB_18" 308 "DFC_Flx_SB_19" 309 "DFC_Flx_SB_20" 310 "DFC_Flx_SB_21" 311 "DFC_Flx_SB_22" 312 "DFC_Flx_SB_23" 313 "DFC_Flx_SB_24" 314 "DFC_Flx_SB_25" 315 "DFC_Flx_SB_26" 316 "DFC_Flx_SG_0" 317 "DFC_Flx_SG_1" 318 "DFC_Flx_SG_2" 319 "DFC_Flx_SG_3" 320 "DFC_Flx_SG_4" 321 "DFC_Flx_SG_5" 322 "DFC_Flx_SG_6" 323 "DFC_Flx_SG_7" 324 "DFC_Flx_SG_8" 325 "DFC_Flx_SG_9" 326 "DFC_Flx_SG_10" 327 "DFC_Flx_SG_11" 328 "DFC_Flx_SG_12" 329 "DFC_Flx_SG_13" 330 "DFC_Flx_SG_14" 331 "DFC_Flx_SG_15" 332 "DFC_Flx_SG_16" 333 "DFC_Flx_SG_17" 334 "DFC_Flx_SG_18" 335 "DFC_Flx_SG_19" 336 "DFC_Flx_SG_20" 337 "DFC_Flx_SG_21" 338 "DFC_Flx_SG_22" 339 "DFC_Flx_SG_23" 340 "DFC_Flx_SG_24" 341 "DFC_Flx_SG_25" 342 "DFC_Flx_SG_26" 343 "DFC_Flx_Sig_0" 344 "DFC_Flx_Sig_1" 345 "DFC_Flx_Sig_2" 346 "DFC_Flx_Sig_3" 347 "DFC_Flx_Sig_4" 348 "DFC_Flx_Sig_5" 349 "DFC_Flx_Sig_6" 350 "DFC_Flx_Sig_7" 351 "DFC_Flx_Sig_8" 352 "DFC_Flx_Sig_9" 353 "DFC_Flx_Sig_10" 354 "DFC_Flx_Sig_11" 355 "DFC_Flx_Sig_12" 356 "DFC_Flx_Sig_13" 357 "DFC_Flx_Sig_14" 358 "DFC_Flx_Sig_15" 359 "DFC_Flx_Sig_16" 360 "DFC_Flx_Sig_17" 361 "DFC_Flx_Sig_18" 362 "DFC_Flx_Sig_19" 363 "DFC_Flx_Sig_20" 364 "DFC_Flx_Sig_21" 365 "DFC_Flx_Sig_22" 366 "DFC_Flx_Sig_23" 367 "DFC_Flx_Sig_24" 368 "DFC_Flx_Sig_25" 369 "DFC_Flx_Sig_26" 370 "DFC_Gtm_Clk" 371 "DFC_HiSide_OP_0" 372 "DFC_HiSide_OP_1" 373 "DFC_HiSide_OP_2" 374 "DFC_HiSide_OP_3" 375 "DFC_HiSide_OP_4" 376 "DFC_HiSide_OP_5" 377 "DFC_HiSide_SB_0" 378 "DFC_HiSide_SB_1" 379 "DFC_HiSide_SB_2" 380 "DFC_HiSide_SB_3" 381 "DFC_HiSide_SB_4" 382 "DFC_HiSide_SB_5" 383 "DFC_HiSide_SG_0" 384 "DFC_HiSide_SG_1" 385 "DFC_HiSide_SG_2" 386 "DFC_HiSide_SG_3" 387 "DFC_HiSide_SG_4" 388 "DFC_HiSide_SG_5" 389 "DFC_IntSply_0" 390 "DFC_IntSply_1" 391 "DFC_IntSply_2" 392 "DFC_IntSply_3" 393 "DFC_IntSply_4" 394 "DFC_IntSply_5" 395 "DFC_IntTemp" 396 "DFC_LssRly_OL" 397 "DFC_LssRly_SB" 398 "DFC_LssRly_SG" 399 "DFC_Lss_OL_0" 400 "DFC_Lss_OL_1" 401 "DFC_Lss_OL_2" 402 "DFC_Lss_OL_3" 403 "DFC_Lss_OL_4" 404 "DFC_Lss_OL_5" 405 "DFC_Lss_OL_6" 406 "DFC_Lss_OL_7" 407 "DFC_Lss_OL_8" 408 "DFC_Lss_OL_9" 409 "DFC_Lss_OL_10" 410 "DFC_Lss_OL_11" 411 "DFC_Lss_SB_0" 412 "DFC_Lss_SB_1" 413 "DFC_Lss_SB_2" 414 "DFC_Lss_SB_3" 415 "DFC_Lss_SB_4" 416 "DFC_Lss_SB_5" 417 "DFC_Lss_SB_6" 418 "DFC_Lss_SB_7" 419 "DFC_Lss_SB_8" 420 "DFC_Lss_SB_9" 421 "DFC_Lss_SB_10" 422 "DFC_Lss_SB_11" 423 "DFC_Lss_SG_0" 424 "DFC_Lss_SG_1" 425 "DFC_Lss_SG_2" 426 "DFC_Lss_SG_3" 427 "DFC_Lss_SG_4" 428 "DFC_Lss_SG_5" 429 "DFC_Lss_SG_6" 430 "DFC_Lss_SG_7" 431 "DFC_Lss_SG_8" 432 "DFC_Lss_SG_9" 433 "DFC_Lss_SG_10" 434 "DFC_Lss_SG_11" 435 "DFC_Lss_Unit" 436 "DFC_OsTmrMon" 437 "DFC_PwmIn_GtmTim_0" 438 "DFC_PwmIn_GtmTim_1" 439 "DFC_PwmIn_GtmTim_2" 440 "DFC_PwmIn_GtmTim_3" 441 "DFC_PwmIn_GtmTim_4" 442 "DFC_PwmIn_GtmTim_5" 443 "DFC_PwmIn_GtmTim_6" 444 "DFC_PwmIn_GtmTim_7" 445 "DFC_PwmIn_GtmTim_8" 446 "DFC_PwmIn_GtmTim_9" 447 "DFC_PwmIn_GtmTim_10" 448 "DFC_PwmIn_GtmTim_11" 449 "DFC_PwmIn_SB_0" 450 "DFC_PwmIn_SB_1" 451 "DFC_PwmIn_SB_2" 452 "DFC_PwmIn_SB_3" 453 "DFC_PwmIn_SB_4" 454 "DFC_PwmIn_SB_5" 455 "DFC_PwmIn_SB_6" 456 "DFC_PwmIn_SB_7" 457 "DFC_PwmIn_SB_8" 458 "DFC_PwmIn_SB_9" 459 "DFC_PwmIn_SB_10" 460 "DFC_PwmIn_SB_11" 461 "DFC_PwmIn_SG_0" 462 "DFC_PwmIn_SG_1" 463 "DFC_PwmIn_SG_2" 464 "DFC_PwmIn_SG_3" 465 "DFC_PwmIn_SG_4" 466 "DFC_PwmIn_SG_5" 467 "DFC_PwmIn_SG_6" 468 "DFC_PwmIn_SG_7" 469 "DFC_PwmIn_SG_8" 470 "DFC_PwmIn_SG_9" 471 "DFC_PwmIn_SG_10" 472 "DFC_PwmIn_SG_11" 473 "DFC_PwmIn_Sig_0" 474 "DFC_PwmIn_Sig_1" 475 "DFC_PwmIn_Sig_2" 476 "DFC_PwmIn_Sig_3" 477 "DFC_PwmIn_Sig_4" 478 "DFC_PwmIn_Sig_5" 479 "DFC_PwmIn_Sig_6" 480 "DFC_PwmIn_Sig_7" 481 "DFC_PwmIn_Sig_8" 482 "DFC_PwmIn_Sig_9" 483 "DFC_PwmIn_Sig_10" 484 "DFC_PwmIn_Sig_11" 485 "DFC_SafeSt_flgDn" 486 "DFC_SnsrSply_SB_0" 487 "DFC_SnsrSply_SB_1" 488 "DFC_SnsrSply_SB_2" 489 "DFC_SnsrSply_SB_3" 490 "DFC_SnsrSply_SB_4" 491 "DFC_SnsrSply_SB_5" 492 "DFC_SnsrSply_SG_0" 493 "DFC_SnsrSply_SG_1" 494 "DFC_SnsrSply_SG_2" 495 "DFC_SnsrSply_SG_3" 496 "DFC_SnsrSply_SG_4" 497 "DFC_SnsrSply_SG_5" 498 "DFC_Spd_NdPls_0" 499 "DFC_Spd_NdPls_1" 500 "DFC_Spd_NdPls_2" 501 "DFC_Spd_NdPls_3" 502 "DFC_Spd_NdPls_4" 503 "DFC_Spd_OP_0" 504 "DFC_Spd_OP_1" 505 "DFC_Spd_OP_2" 506 "DFC_Spd_OP_3" 507 "DFC_Spd_OP_4" 508 "DFC_Spd_Pls_0" 509 "DFC_Spd_Pls_1" 510 "DFC_Spd_Pls_2" 511 "DFC_Spd_Pls_3" 512 "DFC_Spd_Pls_4" 513 "DFC_Spd_SB_0" 514 "DFC_Spd_SB_1" 515 "DFC_Spd_SB_2" 516 "DFC_Spd_SB_3" 517 "DFC_Spd_SB_4" 518 "DFC_Spd_SG_0" 519 "DFC_Spd_SG_1" 520 "DFC_Spd_SG_2" 521 "DFC_Spd_SG_3" 522 "DFC_Spd_SG_4" 523 "DFC_Spd_Sig_0" 524 "DFC_Spd_Sig_1" 525 "DFC_Spd_Sig_2" 526 "DFC_Spd_Sig_3" 527 "DFC_Spd_Sig_4" 528 "DFC_Spd_Sync_0" 529 "DFC_Spd_Sync_1" 530 "DFC_Spd_Sync_2" 531 "DFC_Spd_Sync_3" 532 "DFC_Spd_Sync_4" 533 "DFC_WdgSys" 534 "DFC_WdgWd" 535 "DFC_AcceleratorPedalErrorRx" 536 "DFC_AccumulatorChargeFault" 537 "DFC_AltitudeErrorRx" 538 "DFC_BLDCPumpDerateRx" 539 "DFC_BLDCPumpErrorRx" 540 "DFC_BrakePressureErrorRx" 541 "DFC_BrakeSwitchErrorRx" 542 "DFC_BrakeSwitchImplausible1" 543 "DFC_BrakeSwitchImplausible2" 544 "DFC_BrakeSwitchRateHigh" 545 "DFC_BrakeSwitchSpare1" 546 "DFC_BrakeSwitchSpare2" 547 "DFC_ChargeValveStuck" 548 "DFC_Clutch1AdaptationFault" 549 "DFC_Clutch1OverPressure" 550 "DFC_Clutch1UnderPressure" 551 "DFC_Clutch2AdaptationFault" 552 "DFC_Clutch2OverPressure" 553 "DFC_Clutch2UnderPressure" 554 "DFC_ClutchCoolingValveFault" 555 "DFC_ClutchCoolingValveStuck" 556 "DFC_ClutchOverTempoerature" 557 "DFC_ClutchShutOffValveFault" 558 "DFC_CoolantTempErrorRx" 559 "DFC_CoolingPressureImplausible" 560 "DFC_CoolingPressureRateHigh" 561 "DFC_CoolingPressureTooHigh" 562 "DFC_CoolingPressureTooLow" 563 "DFC_CrntCtrl_Reg_1" 564 "DFC_CrntCtrl_Reg_10" 565 "DFC_CrntCtrl_Reg_11" 566 "DFC_CrntCtrl_Reg_12" 567 "DFC_CrntCtrl_Reg_16" 568 "DFC_CrntCtrl_Reg_17" 569 "DFC_CrntCtrl_Reg_18" 570 "DFC_CrntCtrl_Reg_19" 571 "DFC_CrntCtrl_Reg_2" 572 "DFC_CrntCtrl_Reg_3" 573 "DFC_CrntCtrl_Reg_6" 574 "DFC_CrntCtrl_Reg_7" 575 "DFC_CrntCtrl_Reg_9" 576 "DFC_DSTSpare1" 577 "DFC_DSTSpare2" 578 "DFC_DWCSpare1" 579 "DFC_DWCSpare2" 580 "DFC_DWCSpare3" 581 "DFC_DWCSpare4" 582 "DFC_DWCSpare5" 583 "DFC_DWCSpare6" 584 "DFC_DWCSpare7" 585 "DFC_DoorStatusErrorRx" 586 "DFC_DownSwImplausible" 587 "DFC_DownSwRateHigh" 588 "DFC_DownSwSpare1" 589 "DFC_DownSwSpare2" 590 "DFC_EM1SpeedErrorRx" 591 "DFC_ENGDriveTorqueImplausible" 592 "DFC_ENGEngineProblem" 593 "DFC_ENGIdiotStart" 594 "DFC_ENGSpare1" 595 "DFC_ENGSpare2" 596 "DFC_ESPStatusErrorRx" 597 "DFC_EngineOilTempErrorRx" 598 "DFC_EngineSpeedErrorRx" 599 "DFC_EngineSpeedPWMImplausible1" 600 "DFC_EngineSpeedPWMImplausible2" 601 "DFC_EngineSpeedPWMRateHigh" 602 "DFC_EngineSpeedPWMSpare1" 603 "DFC_EngineSpeedPWMSpare2" 604 "DFC_EngineTorqueErrorRx" 605 "DFC_ExternalTempErrorRx" 606 "DFC_FailStuckNFault" 607 "DFC_FrontLeftWheelSpeedErrorRx" 608 "DFC_FrontRightWheelSpeedErrorRx" 609 "DFC_GearCoolingValveStuck" 610 "DFC_K1PressureImplausible" 611 "DFC_K1PressureRateHigh" 612 "DFC_K1PressureSpare1" 613 "DFC_K1PressureSpare2" 614 "DFC_K1SpeedHigh" 615 "DFC_K1SpeedImplausible" 616 "DFC_K1SpeedSpare1" 617 "DFC_K1SpeedSpare2" 618 "DFC_K2PressureImplausible" 619 "DFC_K2PressureRateHigh" 620 "DFC_K2PressureSpare1" 621 "DFC_K2PressureSpare2" 622 "DFC_K2SpeedHigh" 623 "DFC_K2SpeedImplausible" 624 "DFC_K2SpeedSpare1" 625 "DFC_K2SpeedSpare2" 626 "DFC_L2ClutchPressureVsCurrentOdd" 627 "DFC_L2ClutchTorqueDirection" 628 "DFC_L2DoubleClutchEngagement" 629 "DFC_L2DoubleGearEven" 630 "DFC_L2EM1ShaftOverspeed" 631 "DFC_L2EPBWhenMoving" 632 "DFC_L2EvenClutchGradientInCreep" 633 "DFC_L2ForwardDriveEven" 634 "DFC_L2ForwardDriveOdd" 635 "DFC_L2ForwardGearAndMode" 636 "DFC_L2GearCombinationEM1Overspeed" 637 "DFC_L2GearCombinationRequest" 638 "DFC_L2InputShaftEngineOverspeed" 639 "DFC_L2InsufficientLubrication" 640 "DFC_L2InvalidDownshiftOdd" 641 "DFC_L2InvalidGearControl" 642 "DFC_L2LeaveNeutral" 643 "DFC_L2LeavePark" 644 "DFC_L2ModeDisplay" 645 "DFC_L2ModeSelection" 646 "DFC_L2MovementWithChargeCable" 647 "DFC_L2OddClutchGradientInCreep" 648 "DFC_L2OddShaftAccelerationImplausible" 649 "DFC_L2ParkFailNoEPB" 650 "DFC_L2ParkPosition" 651 "DFC_L2ParkValveOverride" 652 "DFC_L2ParkWhenMoving" 653 "DFC_L2ReferenceSpeedFail" 654 "DFC_L2ReverseDrive" 655 "DFC_L2ShaftOverSpeedFromIP" 656 "DFC_L2ShaftOverSpeedFromOP" 657 "DFC_L2Spare1" 658 "DFC_L2Spare2" 659 "DFC_L2TorqueNoShift" 660 "DFC_L2TorqueRequestCupOfFuel" 661 "DFC_L2VGPOverride" 662 "DFC_L2VKUGLOveride" 663 "DFC_L2VSS1Overirde" 664 "DFC_L2VSS2Overirde" 665 "DFC_LatAccErrorRx" 666 "DFC_LinePressureImplausible" 667 "DFC_LinePressureLeakageHigh" 668 "DFC_LinePressureRateHigh" 669 "DFC_LinePressureSpare1" 670 "DFC_LinePressureSpare2" 671 "DFC_LinePressureTooHigh" 672 "DFC_LinePressureTooLow" 673 "DFC_LongAccErrorRx" 674 "DFC_LubeOilOverTemperature" 675 "DFC_LubeTemperatureImplausible" 676 "DFC_LubeTemperatureRateHigh" 677 "DFC_LubeTemperatureSpare1" 678 "DFC_LubeTemperatureSpare2" 679 "DFC_MOTEngineProblem" 680 "DFC_MOTSpare1" 681 "DFC_MOTSpare2" 682 "DFC_ModeMSwImplausible" 683 "DFC_ModeMSwSpare1" 684 "DFC_ModeMSwSpare2" 685 "DFC_ModeMSwSwRateHigh" 686 "DFC_ModePSwImplausible" 687 "DFC_ModePSwSpare1" 688 "DFC_ModePSwSpare2" 689 "DFC_ModePSwSwRateHigh" 690 "DFC_ModeRSwImplausible" 691 "DFC_ModeRSwSpare1" 692 "DFC_ModeRSwSpare2" 693 "DFC_ModeRSwSwRateHigh" 694 "DFC_ParkLockDisengageFail" 695 "DFC_ParkLockEngageFail" 696 "DFC_ParkLockPosImplausible" 697 "DFC_ParkLockPosRateHigh" 698 "DFC_ParkLockPosSpare1" 699 "DFC_ParkLockPosSpare2" 700 "DFC_PumpResponseFault" 701 "DFC_PumpSpeedError" 702 "DFC_RearLeftWheelSpeedErrorRx" 703 "DFC_RearRightWheelSpeedErrorRx" 704 "DFC_RedSpeedHigh" 705 "DFC_RedSpeedImplausible" 706 "DFC_RedSpeedSpare1" 707 "DFC_RedSpeedSpare2" 708 "DFC_SEQSpare1" 709 "DFC_SEQSpare2" 710 "DFC_SEQTimeout" 711 "DFC_Spare_0" 712 "DFC_Spare_1" 713 "DFC_Spare_2" 714 "DFC_Spare_3" 715 "DFC_Spare_4" 716 "DFC_Spare_5" 717 "DFC_Spare_6" 718 "DFC_Spare_7" 719 "DFC_Spare_8" 720 "DFC_Spare_9" 721 "DFC_SumpOilOverTemperature" 722 "DFC_SumpTemperatureImplausible" 723 "DFC_SumpTemperatureRateHigh" 724 "DFC_SumpTemperatureSpare1" 725 "DFC_SumpTemperatureSpare2" 726 "DFC_SynchroA1EngageFault" 727 "DFC_SynchroA1SpitoutInShiftFault" 728 "DFC_SynchroA1SpitoutNoShiftFault" 729 "DFC_SynchroA1StuckFault" 730 "DFC_SynchroA2EngageFault" 731 "DFC_SynchroA2SpitoutInShiftFault" 732 "DFC_SynchroA2SpitoutNoShiftFault" 733 "DFC_SynchroA2StuckFault" 734 "DFC_SynchroAOutOfNInShiftFault" 735 "DFC_SynchroAOutOfNNoShiftFault" 736 "DFC_SynchroAPosImplausible" 737 "DFC_SynchroAPosRateHigh" 738 "DFC_SynchroAPosSpare1" 739 "DFC_SynchroAPosSpare2" 740 "DFC_SynchroB1EngageFault" 741 "DFC_SynchroB1SpitoutInShiftFault" 742 "DFC_SynchroB1SpitoutNoShiftFault" 743 "DFC_SynchroB1StuckFault" 744 "DFC_SynchroB2EngageFault" 745 "DFC_SynchroB2SpitoutInShiftFault" 746 "DFC_SynchroB2SpitoutNoShiftFault" 747 "DFC_SynchroB2StuckFault" 748 "DFC_SynchroBOutOfNInShiftFault" 749 "DFC_SynchroBOutOfNNoShiftFault" 750 "DFC_SynchroBPosImplausible" 751 "DFC_SynchroBPosRateHigh" 752 "DFC_SynchroBPosSpare1" 753 "DFC_SynchroBPosSpare2" 754 "DFC_SynchroC1EngageFault" 755 "DFC_SynchroC1SpitoutInShiftFault" 756 "DFC_SynchroC1SpitoutNoShiftFault" 757 "DFC_SynchroC1StuckFault" 758 "DFC_SynchroC2EngageFault" 759 "DFC_SynchroC2SpitoutInShiftFault" 760 "DFC_SynchroC2SpitoutNoShiftFault" 761 "DFC_SynchroC2StuckFault" 762 "DFC_SynchroCOutOfNInShiftFault" 763 "DFC_SynchroCOutOfNNoShiftFault" 764 "DFC_SynchroCPosImplausible" 765 "DFC_SynchroCPosRateHigh" 766 "DFC_SynchroCPosSpare1" 767 "DFC_SynchroCPosSpare2" 768 "DFC_SynchroD1EngageFault" 769 "DFC_SynchroD1SpitoutInShiftFault" 770 "DFC_SynchroD1SpitoutNoShiftFault" 771 "DFC_SynchroD1StuckFault" 772 "DFC_SynchroDOutOfNInShiftFault" 773 "DFC_SynchroDOutOfNNoShiftFault" 774 "DFC_SynchroDPosImplausible" 775 "DFC_SynchroDPosRateHigh" 776 "DFC_SynchroDPosSpare1" 777 "DFC_SynchroDPosSpare2" 778 "DFC_SynchroF1EngageFault" 779 "DFC_SynchroF1SpitoutInShiftFault" 780 "DFC_SynchroF1SpitoutNoShiftFault" 781 "DFC_SynchroF1StuckFault" 782 "DFC_SynchroF2EngageFault" 783 "DFC_SynchroF2SpitoutInShiftFault" 784 "DFC_SynchroF2SpitoutNoShiftFault" 785 "DFC_SynchroF2StuckFault" 786 "DFC_SynchroFOutOfNInShiftFault" 787 "DFC_SynchroFOutOfNNoShiftFault" 788 "DFC_SynchroFPosImplausible" 789 "DFC_SynchroFPosRateHigh" 790 "DFC_SynchroFPosSpare1" 791 "DFC_SynchroFPosSpare2" 792 "DFC_UpSwImplausible" 793 "DFC_UpSwRateHigh" 794 "DFC_UpSwSpare1" 795 "DFC_UpSwSpare2" 796 "DFC_VehicleSpeedErrorRx" 797 "DFC_WheelTorqueESPErrorRx" 798 "DFC_YawRateErrorRx" 799 "DFC_Can0Motor_01_TO" 800 "DFC_Can0Motor_02_TO" 801 "DFC_Can0Motor_03_TO" 802 "DFC_Can1BYPASS_TDG1_11_TO" 803 "DFC_Can1BYPASS_TDG1_12_TO" 804 "DFC_Can1BYPASS_TDG1_13_TO" 805 "DFC_Can1BYPASS_TDG1_14_TO" 806 "DFC_Can1BYPASS_TDG1_15_TO" 807 "DFC_Can1BYPASS_TDG1_16_PlaceHolder_TO" 808 "DFC_Can1BYPASS_TDG1_17_PlaceHolder_TO" 809 "DFC_Can1BYPASS_TDG1_18_PlaceHolder_TO" 810 "DFC_Can1BYPASS_TDG1_19_Placeholder_TO" 811 "DFC_Can1BYPASS_TDG1_20_Placeholder_TO" 812 "DFC_Can1BYPASS_TDG1_21_TO" 813 "DFC_Can1BYPASS_TDG1_22_TO" 814 "DFC_Can1Cool_Act_Sts_TO" 815 "DFC_DsmTest0" 816 "DFC_FrAACC_06ISigGroup_ACC_06_TO" 817 "DFC_FrAACC_06_TO" 818 "DFC_FrAACC_07ISigGroup_ACC_07_TO" 819 "DFC_FrAACC_07_TO" 820 "DFC_FrAAirbag_01ISigGroup_Airbag_01_TO" 821 "DFC_FrAAirbag_01_TO" 822 "DFC_FrAAirbag_02ISigGroup_Airbag_02_TO" 823 "DFC_FrAAirbag_02_TO" 824 "DFC_FrABCM_01_TO" 825 "DFC_FrABremse_EV_01ISigGroup_Bremse_EV_01_TO" 826 "DFC_FrABremse_EV_01_TO" 827 "DFC_FrABremse_EV_02ISigGroup_Bremse_EV_02_TO" 828 "DFC_FrABremse_EV_02_TO" 829 "DFC_FrACharisma_01_TO" 830 "DFC_FrADiagnose_01_TO" 831 "DFC_FrAEBKV_01ISigGroup_EBKV_01_TO" 832 "DFC_FrAEBKV_01_TO" 833 "DFC_FrAEM1_HYB_06_TO" 834 "DFC_FrAEM1_HYB_12ISigGroup_EM1_HYB_12_TO" 835 "DFC_FrAEM1_HYB_12_TO" 836 "DFC_FrAEPB_01ISigGroup_EPB_01_TO" 837 "DFC_FrAEPB_01_TO" 838 "DFC_FrAESP_03ISigGroup_ESP_03_TO" 839 "DFC_FrAESP_03_TO" 840 "DFC_FrAESP_05ISigGroup_ESP_05_TO" 841 "DFC_FrAESP_05_TO" 842 "DFC_FrAESP_07ISigGroup_ESP_07_TO" 843 "DFC_FrAESP_07_TO" 844 "DFC_FrAESP_08ISigGroup_ESP_08_TO" 845 "DFC_FrAESP_08_TO" 846 "DFC_FrAESP_15ISigGroup_ESP_15_TO" 847 "DFC_FrAESP_15_TO" 848 "DFC_FrAESP_20ISigGroup_ESP_20_TO" 849 "DFC_FrAESP_20_TO" 850 "DFC_FrAESP_21ISigGroup_ESP_21_TO" 851 "DFC_FrAESP_21_TO" 852 "DFC_FrAESP_22ISigGroup_ESP_22_TO" 853 "DFC_FrAESP_22_TO" 854 "DFC_FrAESP_23ISigGroup_ESP_23_TO" 855 "DFC_FrAESP_23_TO" 856 "DFC_FrAESP_24ISigGroup_ESP_24_TO" 857 "DFC_FrAESP_24_TO" 858 "DFC_FrAESP_26_TO" 859 "DFC_FrAESP_28ISigGroup_ESP_28_TO" 860 "DFC_FrAESP_28_TO" 861 "DFC_FrAESP_31ISigGroup_ESP_31_TO" 862 "DFC_FrAESP_31_TO" 863 "DFC_FrAESP_32ISigGroup_ESP_32_TO" 864 "DFC_FrAESP_32_TO" 865 "DFC_FrAESP_33ISigGroup_ESP_33_TO" 866 "DFC_FrAESP_33_TO" 867 "DFC_FrAESP_41ISigGroup_ESP_41_TO" 868 "DFC_FrAESP_41_TO" 869 "DFC_FrAESP_44ISigGroup_ESP_44_TO" 870 "DFC_FrAESP_44_TO" 871 "DFC_FrAKlemmen_Status_01ISigGroup_Klemmen_Status_01_TO" 872 "DFC_FrAKlemmen_Status_01_TO" 873 "DFC_FrAKlima_11_TO" 874 "DFC_FrAKombi_02_TO" 875 "DFC_FrALCV_01ISigGroup_LCV_01_TO" 876 "DFC_FrALCV_01_TO" 877 "DFC_FrALWI_01ISigGroup_LWI_01_TO" 878 "DFC_FrALWI_01_TO" 879 "DFC_FrAMFL_Tasten_01_TO" 880 "DFC_FrAMSG_EM1_18_TO" 881 "DFC_FrAMSG_EM1_29_TO" 882 "DFC_FrAMotor_07_TO" 883 "DFC_FrAMotor_11ISigGroup_Motor_11_TO" 884 "DFC_FrAMotor_11_TO" 885 "DFC_FrAMotor_12ISigGroup_Motor_12_TO" 886 "DFC_FrAMotor_12_TO" 887 "DFC_FrAMotor_14ISigGroup_Motor_14_TO" 888 "DFC_FrAMotor_14_TO" 889 "DFC_FrAMotor_16_TO" 890 "DFC_FrAMotor_17_TO" 891 "DFC_FrAMotor_18_TO" 892 "DFC_FrAMotor_20ISigGroup_Motor_20_TO" 893 "DFC_FrAMotor_20_TO" 894 "DFC_FrAMotor_27ISigGroup_Motor_27_TO" 895 "DFC_FrAMotor_27_TO" 896 "DFC_FrAMotor_28ISigGroup_Motor_28_TO" 897 "DFC_FrAMotor_28_TO" 898 "DFC_FrAMotor_35_TO" 899 "DFC_FrAMotor_38_LB_TO" 900 "DFC_FrAMotor_47_TO" 901 "DFC_FrAMotor_Code_01ISigGroup_Motor_Code_01_TO" 902 "DFC_FrAMotor_Code_01_TO" 903 "DFC_FrAMotor_Hybrid_11_TO" 904 "DFC_FrAMotor_TS_01ISigGroup_Motor_TS_01_TO" 905 "DFC_FrAMotor_TS_01_TO" 906 "DFC_FrAMotor_TS_02ISigGroup_Motor_TS_02_TO" 907 "DFC_FrAMotor_TS_02_TO" 908 "DFC_FrAMotor_TS_03ISigGroup_Motor_TS_03_TO" 909 "DFC_FrAMotor_TS_03_TO" 910 "DFC_FrANVEM_02_TO" 911 "DFC_FrANVEM_05_TO" 912 "DFC_FrAOBD_01_TO" 913 "DFC_FrAOBD_02_TO" 914 "DFC_FrASARA_06ISigGroup_SARA_06_TO" 915 "DFC_FrASARA_06_TO" 916 "DFC_FrASysteminfo_01_TO" 917 "DFC_FrATSG_FT_02ISigGroup_TSG_FT_02_TO" 918 "DFC_FrATSG_FT_02_TO" 919 "DFC_FrATSK_06ISigGroup_TSK_06_TO" 920 "DFC_FrATSK_06_TO" 921 "DFC_FrATSK_08ISigGroup_TSK_08_TO" 922 "DFC_FrATSK_08_TO" 923 "DFC_FrAVIN_01_0_TO" 924 "DFC_FrAVIN_01_1_TO" 925 "DFC_FrAVIN_01_2_TO" 926 "DFC_IPT" 927 "DFC_L3Error" 928 "DFC_SftyCfgMon" 929 "DFC_SftyShtOff" 930 "DFC_DsmTest4" 931 "DFC_BSWM_E_ACTION_FAILED" 932 "DFC_BSWM_E_INTRPTQUEUE_FULL" 933 "DFC_CANSM_E_BUS_OFF_NETWORK_0" 934 "DFC_CANSM_E_BUS_OFF_NETWORK_1" 935 "DFC_CANSM_E_BUS_OFF_NETWORK_2" 936 "DFC_CANSM_E_BUS_OFF_NETWORK_3" 937 "DFC_FRSM_E_CLUSTER_STARTUP" 938 "DFC_FRTRCV_E_NO_TRCV_CONTROL_0" 939 "DFC_FR_E_ACCESS" 940 "DFC_RBA_IOEXTLIB_KEEPALIVE_DRV" 941 "DFC_RBA_IOEXTLIB_KEEPALIVE_INI" 942 "DFC_rba_MultiStackTrace_Threshold" 943 "DFC_CAN_E_TIMEOUT" 944 "DFC_FRSM_E_CLUSTER_SYNC_LOSS" 945 "DFC_PDUR_E_INIT_FAILED" 946 "DFC_PDUR_E_PDU_INSTANCE_LOST" 947 "DFC_rba_IoSigRtc_StopCounter" 948 "DFC_rba_T15_Diag_ComInVld_Event" 949 "DFC_rba_T15_Diag_ComOff_HwOn_Event" 950 "DFC_rba_T15_Diag_ComOn_HwOff_Event" 951 "DFC_DSMDummy" 952 "DFC_DsmTest3";
VAL_ 2041 DFES_numDFC_28_ 0 "DFC_Unused" 1 "DFC_DsmTest2" 2 "DFC_Can0Getriebe_01" 3 "DFC_Can0Motor_01_CHK" 4 "DFC_Can0Motor_01_CNT" 5 "DFC_Can0Motor_01_DLC" 6 "DFC_Can0Motor_02_CHK" 7 "DFC_Can0Motor_02_CNT" 8 "DFC_Can0Motor_02_DLC" 9 "DFC_Can0Motor_03_CHK" 10 "DFC_Can0Motor_03_CNT" 11 "DFC_Can0Motor_03_DLC" 12 "DFC_Can1BYPASS_TDG1_11_DLC" 13 "DFC_Can1BYPASS_TDG1_12_DLC" 14 "DFC_Can1BYPASS_TDG1_13_DLC" 15 "DFC_Can1BYPASS_TDG1_14_DLC" 16 "DFC_Can1BYPASS_TDG1_15_DLC" 17 "DFC_Can1BYPASS_TDG1_16_PlaceHolder_DLC" 18 "DFC_Can1BYPASS_TDG1_17_PlaceHolder_DLC" 19 "DFC_Can1BYPASS_TDG1_18_PlaceHolder_DLC" 20 "DFC_Can1BYPASS_TDG1_19_Placeholder_DLC" 21 "DFC_Can1BYPASS_TDG1_20_Placeholder_DLC" 22 "DFC_Can1BYPASS_TDG1_21_DLC" 23 "DFC_Can1BYPASS_TDG1_22_DLC" 24 "DFC_Can1BYPASS_TDG1_AA" 25 "DFC_Can1BYPASS_TDG1_AB" 26 "DFC_Can1BYPASS_TDG1_AC" 27 "DFC_Can1BYPASS_TDG1_AD" 28 "DFC_Can1BYPASS_TDG1_AE" 29 "DFC_Can1BYPASS_TDG1_AF" 30 "DFC_Can1BYPASS_TDG1_BA" 31 "DFC_Can1BYPASS_TDG1_BB" 32 "DFC_Can1BYPASS_TDG1_BC" 33 "DFC_Can1BYPASS_TDG1_BD" 34 "DFC_Can1BYPASS_TDG1_BE_PlaceHolder" 35 "DFC_Can1BYPASS_TDG1_BF_PlaceHolder" 36 "DFC_Can1BYPASS_TDG1_CA_PlaceHolder" 37 "DFC_Can1BYPASS_TDG1_CB_PlaceHolder" 38 "DFC_Can1BYPASS_TDG1_CC_PlaceHolder" 39 "DFC_Can1Cool_Act_Cmd" 40 "DFC_Can1Cool_Act_Sts_DLC" 41 "DFC_DsmTest1" 42 "DFC_FrAACC_06ISigGroup_ACC_06_CHK" 43 "DFC_FrAACC_06ISigGroup_ACC_06_CNT" 44 "DFC_FrAACC_07ISigGroup_ACC_07_CHK" 45 "DFC_FrAACC_07ISigGroup_ACC_07_CNT" 46 "DFC_FrAAirbag_01ISigGroup_Airbag_01_CHK" 47 "DFC_FrAAirbag_01ISigGroup_Airbag_01_CNT" 48 "DFC_FrAAirbag_02ISigGroup_Airbag_02_CHK" 49 "DFC_FrAAirbag_02ISigGroup_Airbag_02_CNT" 50 "DFC_FrABremse_EV_01ISigGroup_Bremse_EV_01_CHK" 51 "DFC_FrABremse_EV_01ISigGroup_Bremse_EV_01_CNT" 52 "DFC_FrABremse_EV_02ISigGroup_Bremse_EV_02_CHK" 53 "DFC_FrABremse_EV_02ISigGroup_Bremse_EV_02_CNT" 54 "DFC_FrAEBKV_01ISigGroup_EBKV_01_CHK" 55 "DFC_FrAEBKV_01ISigGroup_EBKV_01_CNT" 56 "DFC_FrAEM1_HYB_12ISigGroup_EM1_HYB_12_CHK" 57 "DFC_FrAEM1_HYB_12ISigGroup_EM1_HYB_12_CNT" 58 "DFC_FrAEPB_01ISigGroup_EPB_01_CHK" 59 "DFC_FrAEPB_01ISigGroup_EPB_01_CNT" 60 "DFC_FrAESP_03ISigGroup_ESP_03_CHK" 61 "DFC_FrAESP_03ISigGroup_ESP_03_CNT" 62 "DFC_FrAESP_05ISigGroup_ESP_05_CHK" 63 "DFC_FrAESP_05ISigGroup_ESP_05_CNT" 64 "DFC_FrAESP_07ISigGroup_ESP_07_CHK" 65 "DFC_FrAESP_07ISigGroup_ESP_07_CNT" 66 "DFC_FrAESP_08ISigGroup_ESP_08_CHK" 67 "DFC_FrAESP_08ISigGroup_ESP_08_CNT" 68 "DFC_FrAESP_15ISigGroup_ESP_15_CHK" 69 "DFC_FrAESP_15ISigGroup_ESP_15_CNT" 70 "DFC_FrAESP_20ISigGroup_ESP_20_CHK" 71 "DFC_FrAESP_20ISigGroup_ESP_20_CNT" 72 "DFC_FrAESP_21ISigGroup_ESP_21_CHK" 73 "DFC_FrAESP_21ISigGroup_ESP_21_CNT" 74 "DFC_FrAESP_22ISigGroup_ESP_22_CHK" 75 "DFC_FrAESP_22ISigGroup_ESP_22_CNT" 76 "DFC_FrAESP_23ISigGroup_ESP_23_CHK" 77 "DFC_FrAESP_23ISigGroup_ESP_23_CNT" 78 "DFC_FrAESP_24ISigGroup_ESP_24_CHK" 79 "DFC_FrAESP_24ISigGroup_ESP_24_CNT" 80 "DFC_FrAESP_28ISigGroup_ESP_28_CHK" 81 "DFC_FrAESP_28ISigGroup_ESP_28_CNT" 82 "DFC_FrAESP_31ISigGroup_ESP_31_CHK" 83 "DFC_FrAESP_31ISigGroup_ESP_31_CNT" 84 "DFC_FrAESP_32ISigGroup_ESP_32_CHK" 85 "DFC_FrAESP_32ISigGroup_ESP_32_CNT" 86 "DFC_FrAESP_33ISigGroup_ESP_33_CHK" 87 "DFC_FrAESP_33ISigGroup_ESP_33_CNT" 88 "DFC_FrAESP_41ISigGroup_ESP_41_CHK" 89 "DFC_FrAESP_41ISigGroup_ESP_41_CNT" 90 "DFC_FrAESP_44ISigGroup_ESP_44_CHK" 91 "DFC_FrAESP_44ISigGroup_ESP_44_CNT" 92 "DFC_FrAGetriebe_11" 93 "DFC_FrAGetriebe_12" 94 "DFC_FrAGetriebe_13" 95 "DFC_FrAGetriebe_14" 96 "DFC_FrAGetriebe_15" 97 "DFC_FrAGetriebe_16" 98 "DFC_FrAGetriebe_17" 99 "DFC_FrAGetriebe_18" 100 "DFC_FrAGetriebe_HYB_12" 101 "DFC_FrAKN_Getriebe" 102 "DFC_FrAKlemmen_Status_01ISigGroup_Klemmen_Status_01_CHK" 103 "DFC_FrAKlemmen_Status_01ISigGroup_Klemmen_Status_01_CNT" 104 "DFC_FrALCV_01ISigGroup_LCV_01_CHK" 105 "DFC_FrALCV_01ISigGroup_LCV_01_CNT" 106 "DFC_FrALWI_01ISigGroup_LWI_01_CHK" 107 "DFC_FrALWI_01ISigGroup_LWI_01_CNT" 108 "DFC_FrAMotor_11ISigGroup_Motor_11_CHK" 109 "DFC_FrAMotor_11ISigGroup_Motor_11_CNT" 110 "DFC_FrAMotor_12ISigGroup_Motor_12_CHK" 111 "DFC_FrAMotor_12ISigGroup_Motor_12_CNT" 112 "DFC_FrAMotor_14ISigGroup_Motor_14_CHK" 113 "DFC_FrAMotor_14ISigGroup_Motor_14_CNT" 114 "DFC_FrAMotor_20ISigGroup_Motor_20_CHK" 115 "DFC_FrAMotor_20ISigGroup_Motor_20_CNT" 116 "DFC_FrAMotor_27ISigGroup_Motor_27_CHK" 117 "DFC_FrAMotor_27ISigGroup_Motor_27_CNT" 118 "DFC_FrAMotor_28ISigGroup_Motor_28_CHK" 119 "DFC_FrAMotor_28ISigGroup_Motor_28_CNT" 120 "DFC_FrAMotor_Code_01ISigGroup_Motor_Code_01_CHK" 121 "DFC_FrAMotor_Code_01ISigGroup_Motor_Code_01_CNT" 122 "DFC_FrAMotor_TS_01ISigGroup_Motor_TS_01_CHK" 123 "DFC_FrAMotor_TS_01ISigGroup_Motor_TS_01_CNT" 124 "DFC_FrAMotor_TS_02ISigGroup_Motor_TS_02_CHK" 125 "DFC_FrAMotor_TS_02ISigGroup_Motor_TS_02_CNT" 126 "DFC_FrAMotor_TS_03ISigGroup_Motor_TS_03_CHK" 127 "DFC_FrAMotor_TS_03ISigGroup_Motor_TS_03_CNT" 128 "DFC_FrASARA_06ISigGroup_SARA_06_CHK" 129 "DFC_FrASARA_06ISigGroup_SARA_06_CNT" 130 "DFC_FrATSG_FT_02ISigGroup_TSG_FT_02_CHK" 131 "DFC_FrATSG_FT_02ISigGroup_TSG_FT_02_CNT" 132 "DFC_FrATSK_06ISigGroup_TSK_06_CHK" 133 "DFC_FrATSK_06ISigGroup_TSK_06_CNT" 134 "DFC_FrATSK_08ISigGroup_TSK_08_CHK" 135 "DFC_FrATSK_08ISigGroup_TSK_08_CNT" 136 "DFC_FrAWBA_03" 137 "DFC_AdcBkg" 138 "DFC_Adc_Rdnt_0" 139 "DFC_Adc_Rdnt_1" 140 "DFC_Adc_Rdnt_2" 141 "DFC_Adc_Rdnt_3" 142 "DFC_Adc_Rdnt_4" 143 "DFC_Adc_Rdnt_5" 144 "DFC_Adc_Rdnt_6" 145 "DFC_Adc_Rdnt_7" 146 "DFC_Adc_Rdnt_8" 147 "DFC_Adc_Rdnt_9" 148 "DFC_Adc_SB_0" 149 "DFC_Adc_SB_1" 150 "DFC_Adc_SB_2" 151 "DFC_Adc_SB_3" 152 "DFC_Adc_SB_4" 153 "DFC_Adc_SB_5" 154 "DFC_Adc_SB_6" 155 "DFC_Adc_SB_7" 156 "DFC_Adc_SB_8" 157 "DFC_Adc_SB_9" 158 "DFC_Adc_SG_0" 159 "DFC_Adc_SG_1" 160 "DFC_Adc_SG_2" 161 "DFC_Adc_SG_3" 162 "DFC_Adc_SG_4" 163 "DFC_Adc_SG_5" 164 "DFC_Adc_SG_6" 165 "DFC_Adc_SG_7" 166 "DFC_Adc_SG_8" 167 "DFC_Adc_SG_9" 168 "DFC_Adc_Unit" 169 "DFC_BattSply_UHi" 170 "DFC_BattSply_ULo" 171 "DFC_CpuTemp" 172 "DFC_CrntCtrl_Channel_0" 173 "DFC_CrntCtrl_Channel_1" 174 "DFC_CrntCtrl_Channel_2" 175 "DFC_CrntCtrl_Channel_3" 176 "DFC_CrntCtrl_Channel_4" 177 "DFC_CrntCtrl_Channel_5" 178 "DFC_CrntCtrl_Channel_6" 179 "DFC_CrntCtrl_Channel_7" 180 "DFC_CrntCtrl_Channel_8" 181 "DFC_CrntCtrl_Channel_9" 182 "DFC_CrntCtrl_Channel_10" 183 "DFC_CrntCtrl_Channel_11" 184 "DFC_CrntCtrl_Channel_12" 185 "DFC_CrntCtrl_Channel_13" 186 "DFC_CrntCtrl_Channel_14" 187 "DFC_CrntCtrl_Channel_15" 188 "DFC_CrntCtrl_Channel_16" 189 "DFC_CrntCtrl_Channel_17" 190 "DFC_CrntCtrl_Channel_18" 191 "DFC_CrntCtrl_Channel_19" 192 "DFC_CrntCtrl_CrntMon_0" 193 "DFC_CrntCtrl_CrntMon_1" 194 "DFC_CrntCtrl_CrntMon_2" 195 "DFC_CrntCtrl_CrntMon_3" 196 "DFC_CrntCtrl_CrntMon_4" 197 "DFC_CrntCtrl_CrntMon_5" 198 "DFC_CrntCtrl_CrntMon_6" 199 "DFC_CrntCtrl_CrntMon_7" 200 "DFC_CrntCtrl_CrntMon_8" 201 "DFC_CrntCtrl_CrntMon_9" 202 "DFC_CrntCtrl_CrntMon_10" 203 "DFC_CrntCtrl_CrntMon_11" 204 "DFC_CrntCtrl_CrntMon_12" 205 "DFC_CrntCtrl_CrntMon_13" 206 "DFC_CrntCtrl_CrntMon_14" 207 "DFC_CrntCtrl_CrntMon_15" 208 "DFC_CrntCtrl_CrntMon_16" 209 "DFC_CrntCtrl_CrntMon_17" 210 "DFC_CrntCtrl_CrntMon_18" 211 "DFC_CrntCtrl_CrntMon_19" 212 "DFC_CrntCtrl_OP_0" 213 "DFC_CrntCtrl_OP_1" 214 "DFC_CrntCtrl_OP_2" 215 "DFC_CrntCtrl_OP_3" 216 "DFC_CrntCtrl_OP_4" 217 "DFC_CrntCtrl_OP_5" 218 "DFC_CrntCtrl_OP_6" 219 "DFC_CrntCtrl_OP_7" 220 "DFC_CrntCtrl_OP_8" 221 "DFC_CrntCtrl_OP_9" 222 "DFC_CrntCtrl_OP_10" 223 "DFC_CrntCtrl_OP_11" 224 "DFC_CrntCtrl_OP_12" 225 "DFC_CrntCtrl_OP_13" 226 "DFC_CrntCtrl_OP_14" 227 "DFC_CrntCtrl_OP_15" 228 "DFC_CrntCtrl_OP_16" 229 "DFC_CrntCtrl_OP_17" 230 "DFC_CrntCtrl_OP_18" 231 "DFC_CrntCtrl_OP_19" 232 "DFC_CrntCtrl_SB_0" 233 "DFC_CrntCtrl_SB_1" 234 "DFC_CrntCtrl_SB_2" 235 "DFC_CrntCtrl_SB_3" 236 "DFC_CrntCtrl_SB_4" 237 "DFC_CrntCtrl_SB_5" 238 "DFC_CrntCtrl_SB_6" 239 "DFC_CrntCtrl_SB_7" 240 "DFC_CrntCtrl_SB_8" 241 "DFC_CrntCtrl_SB_9" 242 "DFC_CrntCtrl_SB_10" 243 "DFC_CrntCtrl_SB_11" 244 "DFC_CrntCtrl_SB_12" 245 "DFC_CrntCtrl_SB_13" 246 "DFC_CrntCtrl_SB_14" 247 "DFC_CrntCtrl_SB_15" 248 "DFC_CrntCtrl_SB_16" 249 "DFC_CrntCtrl_SB_17" 250 "DFC_CrntCtrl_SB_18" 251 "DFC_CrntCtrl_SB_19" 252 "DFC_CrntCtrl_SG_0" 253 "DFC_CrntCtrl_SG_1" 254 "DFC_CrntCtrl_SG_2" 255 "DFC_CrntCtrl_SG_3" 256 "DFC_CrntCtrl_SG_4" 257 "DFC_CrntCtrl_SG_5" 258 "DFC_CrntCtrl_SG_6" 259 "DFC_CrntCtrl_SG_7" 260 "DFC_CrntCtrl_SG_8" 261 "DFC_CrntCtrl_SG_9" 262 "DFC_CrntCtrl_SG_10" 263 "DFC_CrntCtrl_SG_11" 264 "DFC_CrntCtrl_SG_12" 265 "DFC_CrntCtrl_SG_13" 266 "DFC_CrntCtrl_SG_14" 267 "DFC_CrntCtrl_SG_15" 268 "DFC_CrntCtrl_SG_16" 269 "DFC_CrntCtrl_SG_17" 270 "DFC_CrntCtrl_SG_18" 271 "DFC_CrntCtrl_SG_19" 272 "DFC_CrntCtrl_Unit_0" 273 "DFC_CrntCtrl_Unit_1" 274 "DFC_CtrlMot_DNR_0" 275 "DFC_CtrlMot_DNR_1" 276 "DFC_CtrlMot_OC_0" 277 "DFC_CtrlMot_OC_1" 278 "DFC_CtrlMot_OL_0" 279 "DFC_CtrlMot_OL_1" 280 "DFC_CtrlMot_SB_0" 281 "DFC_CtrlMot_SB_1" 282 "DFC_CtrlMot_SG_0" 283 "DFC_CtrlMot_SG_1" 284 "DFC_Flx_AdcInUnit_0" 285 "DFC_Flx_AdcInUnit_1" 286 "DFC_Flx_AdcInUnit_2" 287 "DFC_Flx_RMeasUnit_0" 288 "DFC_Flx_RMeasUnit_1" 289 "DFC_Flx_SB_0" 290 "DFC_Flx_SB_1" 291 "DFC_Flx_SB_2" 292 "DFC_Flx_SB_3" 293 "DFC_Flx_SB_4" 294 "DFC_Flx_SB_5" 295 "DFC_Flx_SB_6" 296 "DFC_Flx_SB_7" 297 "DFC_Flx_SB_8" 298 "DFC_Flx_SB_9" 299 "DFC_Flx_SB_10" 300 "DFC_Flx_SB_11" 301 "DFC_Flx_SB_12" 302 "DFC_Flx_SB_13" 303 "DFC_Flx_SB_14" 304 "DFC_Flx_SB_15" 305 "DFC_Flx_SB_16" 306 "DFC_Flx_SB_17" 307 "DFC_Flx_SB_18" 308 "DFC_Flx_SB_19" 309 "DFC_Flx_SB_20" 310 "DFC_Flx_SB_21" 311 "DFC_Flx_SB_22" 312 "DFC_Flx_SB_23" 313 "DFC_Flx_SB_24" 314 "DFC_Flx_SB_25" 315 "DFC_Flx_SB_26" 316 "DFC_Flx_SG_0" 317 "DFC_Flx_SG_1" 318 "DFC_Flx_SG_2" 319 "DFC_Flx_SG_3" 320 "DFC_Flx_SG_4" 321 "DFC_Flx_SG_5" 322 "DFC_Flx_SG_6" 323 "DFC_Flx_SG_7" 324 "DFC_Flx_SG_8" 325 "DFC_Flx_SG_9" 326 "DFC_Flx_SG_10" 327 "DFC_Flx_SG_11" 328 "DFC_Flx_SG_12" 329 "DFC_Flx_SG_13" 330 "DFC_Flx_SG_14" 331 "DFC_Flx_SG_15" 332 "DFC_Flx_SG_16" 333 "DFC_Flx_SG_17" 334 "DFC_Flx_SG_18" 335 "DFC_Flx_SG_19" 336 "DFC_Flx_SG_20" 337 "DFC_Flx_SG_21" 338 "DFC_Flx_SG_22" 339 "DFC_Flx_SG_23" 340 "DFC_Flx_SG_24" 341 "DFC_Flx_SG_25" 342 "DFC_Flx_SG_26" 343 "DFC_Flx_Sig_0" 344 "DFC_Flx_Sig_1" 345 "DFC_Flx_Sig_2" 346 "DFC_Flx_Sig_3" 347 "DFC_Flx_Sig_4" 348 "DFC_Flx_Sig_5" 349 "DFC_Flx_Sig_6" 350 "DFC_Flx_Sig_7" 351 "DFC_Flx_Sig_8" 352 "DFC_Flx_Sig_9" 353 "DFC_Flx_Sig_10" 354 "DFC_Flx_Sig_11" 355 "DFC_Flx_Sig_12" 356 "DFC_Flx_Sig_13" 357 "DFC_Flx_Sig_14" 358 "DFC_Flx_Sig_15" 359 "DFC_Flx_Sig_16" 360 "DFC_Flx_Sig_17" 361 "DFC_Flx_Sig_18" 362 "DFC_Flx_Sig_19" 363 "DFC_Flx_Sig_20" 364 "DFC_Flx_Sig_21" 365 "DFC_Flx_Sig_22" 366 "DFC_Flx_Sig_23" 367 "DFC_Flx_Sig_24" 368 "DFC_Flx_Sig_25" 369 "DFC_Flx_Sig_26" 370 "DFC_Gtm_Clk" 371 "DFC_HiSide_OP_0" 372 "DFC_HiSide_OP_1" 373 "DFC_HiSide_OP_2" 374 "DFC_HiSide_OP_3" 375 "DFC_HiSide_OP_4" 376 "DFC_HiSide_OP_5" 377 "DFC_HiSide_SB_0" 378 "DFC_HiSide_SB_1" 379 "DFC_HiSide_SB_2" 380 "DFC_HiSide_SB_3" 381 "DFC_HiSide_SB_4" 382 "DFC_HiSide_SB_5" 383 "DFC_HiSide_SG_0" 384 "DFC_HiSide_SG_1" 385 "DFC_HiSide_SG_2" 386 "DFC_HiSide_SG_3" 387 "DFC_HiSide_SG_4" 388 "DFC_HiSide_SG_5" 389 "DFC_IntSply_0" 390 "DFC_IntSply_1" 391 "DFC_IntSply_2" 392 "DFC_IntSply_3" 393 "DFC_IntSply_4" 394 "DFC_IntSply_5" 395 "DFC_IntTemp" 396 "DFC_LssRly_OL" 397 "DFC_LssRly_SB" 398 "DFC_LssRly_SG" 399 "DFC_Lss_OL_0" 400 "DFC_Lss_OL_1" 401 "DFC_Lss_OL_2" 402 "DFC_Lss_OL_3" 403 "DFC_Lss_OL_4" 404 "DFC_Lss_OL_5" 405 "DFC_Lss_OL_6" 406 "DFC_Lss_OL_7" 407 "DFC_Lss_OL_8" 408 "DFC_Lss_OL_9" 409 "DFC_Lss_OL_10" 410 "DFC_Lss_OL_11" 411 "DFC_Lss_SB_0" 412 "DFC_Lss_SB_1" 413 "DFC_Lss_SB_2" 414 "DFC_Lss_SB_3" 415 "DFC_Lss_SB_4" 416 "DFC_Lss_SB_5" 417 "DFC_Lss_SB_6" 418 "DFC_Lss_SB_7" 419 "DFC_Lss_SB_8" 420 "DFC_Lss_SB_9" 421 "DFC_Lss_SB_10" 422 "DFC_Lss_SB_11" 423 "DFC_Lss_SG_0" 424 "DFC_Lss_SG_1" 425 "DFC_Lss_SG_2" 426 "DFC_Lss_SG_3" 427 "DFC_Lss_SG_4" 428 "DFC_Lss_SG_5" 429 "DFC_Lss_SG_6" 430 "DFC_Lss_SG_7" 431 "DFC_Lss_SG_8" 432 "DFC_Lss_SG_9" 433 "DFC_Lss_SG_10" 434 "DFC_Lss_SG_11" 435 "DFC_Lss_Unit" 436 "DFC_OsTmrMon" 437 "DFC_PwmIn_GtmTim_0" 438 "DFC_PwmIn_GtmTim_1" 439 "DFC_PwmIn_GtmTim_2" 440 "DFC_PwmIn_GtmTim_3" 441 "DFC_PwmIn_GtmTim_4" 442 "DFC_PwmIn_GtmTim_5" 443 "DFC_PwmIn_GtmTim_6" 444 "DFC_PwmIn_GtmTim_7" 445 "DFC_PwmIn_GtmTim_8" 446 "DFC_PwmIn_GtmTim_9" 447 "DFC_PwmIn_GtmTim_10" 448 "DFC_PwmIn_GtmTim_11" 449 "DFC_PwmIn_SB_0" 450 "DFC_PwmIn_SB_1" 451 "DFC_PwmIn_SB_2" 452 "DFC_PwmIn_SB_3" 453 "DFC_PwmIn_SB_4" 454 "DFC_PwmIn_SB_5" 455 "DFC_PwmIn_SB_6" 456 "DFC_PwmIn_SB_7" 457 "DFC_PwmIn_SB_8" 458 "DFC_PwmIn_SB_9" 459 "DFC_PwmIn_SB_10" 460 "DFC_PwmIn_SB_11" 461 "DFC_PwmIn_SG_0" 462 "DFC_PwmIn_SG_1" 463 "DFC_PwmIn_SG_2" 464 "DFC_PwmIn_SG_3" 465 "DFC_PwmIn_SG_4" 466 "DFC_PwmIn_SG_5" 467 "DFC_PwmIn_SG_6" 468 "DFC_PwmIn_SG_7" 469 "DFC_PwmIn_SG_8" 470 "DFC_PwmIn_SG_9" 471 "DFC_PwmIn_SG_10" 472 "DFC_PwmIn_SG_11" 473 "DFC_PwmIn_Sig_0" 474 "DFC_PwmIn_Sig_1" 475 "DFC_PwmIn_Sig_2" 476 "DFC_PwmIn_Sig_3" 477 "DFC_PwmIn_Sig_4" 478 "DFC_PwmIn_Sig_5" 479 "DFC_PwmIn_Sig_6" 480 "DFC_PwmIn_Sig_7" 481 "DFC_PwmIn_Sig_8" 482 "DFC_PwmIn_Sig_9" 483 "DFC_PwmIn_Sig_10" 484 "DFC_PwmIn_Sig_11" 485 "DFC_SafeSt_flgDn" 486 "DFC_SnsrSply_SB_0" 487 "DFC_SnsrSply_SB_1" 488 "DFC_SnsrSply_SB_2" 489 "DFC_SnsrSply_SB_3" 490 "DFC_SnsrSply_SB_4" 491 "DFC_SnsrSply_SB_5" 492 "DFC_SnsrSply_SG_0" 493 "DFC_SnsrSply_SG_1" 494 "DFC_SnsrSply_SG_2" 495 "DFC_SnsrSply_SG_3" 496 "DFC_SnsrSply_SG_4" 497 "DFC_SnsrSply_SG_5" 498 "DFC_Spd_NdPls_0" 499 "DFC_Spd_NdPls_1" 500 "DFC_Spd_NdPls_2" 501 "DFC_Spd_NdPls_3" 502 "DFC_Spd_NdPls_4" 503 "DFC_Spd_OP_0" 504 "DFC_Spd_OP_1" 505 "DFC_Spd_OP_2" 506 "DFC_Spd_OP_3" 507 "DFC_Spd_OP_4" 508 "DFC_Spd_Pls_0" 509 "DFC_Spd_Pls_1" 510 "DFC_Spd_Pls_2" 511 "DFC_Spd_Pls_3" 512 "DFC_Spd_Pls_4" 513 "DFC_Spd_SB_0" 514 "DFC_Spd_SB_1" 515 "DFC_Spd_SB_2" 516 "DFC_Spd_SB_3" 517 "DFC_Spd_SB_4" 518 "DFC_Spd_SG_0" 519 "DFC_Spd_SG_1" 520 "DFC_Spd_SG_2" 521 "DFC_Spd_SG_3" 522 "DFC_Spd_SG_4" 523 "DFC_Spd_Sig_0" 524 "DFC_Spd_Sig_1" 525 "DFC_Spd_Sig_2" 526 "DFC_Spd_Sig_3" 527 "DFC_Spd_Sig_4" 528 "DFC_Spd_Sync_0" 529 "DFC_Spd_Sync_1" 530 "DFC_Spd_Sync_2" 531 "DFC_Spd_Sync_3" 532 "DFC_Spd_Sync_4" 533 "DFC_WdgSys" 534 "DFC_WdgWd" 535 "DFC_AcceleratorPedalErrorRx" 536 "DFC_AccumulatorChargeFault" 537 "DFC_AltitudeErrorRx" 538 "DFC_BLDCPumpDerateRx" 539 "DFC_BLDCPumpErrorRx" 540 "DFC_BrakePressureErrorRx" 541 "DFC_BrakeSwitchErrorRx" 542 "DFC_BrakeSwitchImplausible1" 543 "DFC_BrakeSwitchImplausible2" 544 "DFC_BrakeSwitchRateHigh" 545 "DFC_BrakeSwitchSpare1" 546 "DFC_BrakeSwitchSpare2" 547 "DFC_ChargeValveStuck" 548 "DFC_Clutch1AdaptationFault" 549 "DFC_Clutch1OverPressure" 550 "DFC_Clutch1UnderPressure" 551 "DFC_Clutch2AdaptationFault" 552 "DFC_Clutch2OverPressure" 553 "DFC_Clutch2UnderPressure" 554 "DFC_ClutchCoolingValveFault" 555 "DFC_ClutchCoolingValveStuck" 556 "DFC_ClutchOverTempoerature" 557 "DFC_ClutchShutOffValveFault" 558 "DFC_CoolantTempErrorRx" 559 "DFC_CoolingPressureImplausible" 560 "DFC_CoolingPressureRateHigh" 561 "DFC_CoolingPressureTooHigh" 562 "DFC_CoolingPressureTooLow" 563 "DFC_CrntCtrl_Reg_1" 564 "DFC_CrntCtrl_Reg_10" 565 "DFC_CrntCtrl_Reg_11" 566 "DFC_CrntCtrl_Reg_12" 567 "DFC_CrntCtrl_Reg_16" 568 "DFC_CrntCtrl_Reg_17" 569 "DFC_CrntCtrl_Reg_18" 570 "DFC_CrntCtrl_Reg_19" 571 "DFC_CrntCtrl_Reg_2" 572 "DFC_CrntCtrl_Reg_3" 573 "DFC_CrntCtrl_Reg_6" 574 "DFC_CrntCtrl_Reg_7" 575 "DFC_CrntCtrl_Reg_9" 576 "DFC_DSTSpare1" 577 "DFC_DSTSpare2" 578 "DFC_DWCSpare1" 579 "DFC_DWCSpare2" 580 "DFC_DWCSpare3" 581 "DFC_DWCSpare4" 582 "DFC_DWCSpare5" 583 "DFC_DWCSpare6" 584 "DFC_DWCSpare7" 585 "DFC_DoorStatusErrorRx" 586 "DFC_DownSwImplausible" 587 "DFC_DownSwRateHigh" 588 "DFC_DownSwSpare1" 589 "DFC_DownSwSpare2" 590 "DFC_EM1SpeedErrorRx" 591 "DFC_ENGDriveTorqueImplausible" 592 "DFC_ENGEngineProblem" 593 "DFC_ENGIdiotStart" 594 "DFC_ENGSpare1" 595 "DFC_ENGSpare2" 596 "DFC_ESPStatusErrorRx" 597 "DFC_EngineOilTempErrorRx" 598 "DFC_EngineSpeedErrorRx" 599 "DFC_EngineSpeedPWMImplausible1" 600 "DFC_EngineSpeedPWMImplausible2" 601 "DFC_EngineSpeedPWMRateHigh" 602 "DFC_EngineSpeedPWMSpare1" 603 "DFC_EngineSpeedPWMSpare2" 604 "DFC_EngineTorqueErrorRx" 605 "DFC_ExternalTempErrorRx" 606 "DFC_FailStuckNFault" 607 "DFC_FrontLeftWheelSpeedErrorRx" 608 "DFC_FrontRightWheelSpeedErrorRx" 609 "DFC_GearCoolingValveStuck" 610 "DFC_K1PressureImplausible" 611 "DFC_K1PressureRateHigh" 612 "DFC_K1PressureSpare1" 613 "DFC_K1PressureSpare2" 614 "DFC_K1SpeedHigh" 615 "DFC_K1SpeedImplausible" 616 "DFC_K1SpeedSpare1" 617 "DFC_K1SpeedSpare2" 618 "DFC_K2PressureImplausible" 619 "DFC_K2PressureRateHigh" 620 "DFC_K2PressureSpare1" 621 "DFC_K2PressureSpare2" 622 "DFC_K2SpeedHigh" 623 "DFC_K2SpeedImplausible" 624 "DFC_K2SpeedSpare1" 625 "DFC_K2SpeedSpare2" 626 "DFC_L2ClutchPressureVsCurrentOdd" 627 "DFC_L2ClutchTorqueDirection" 628 "DFC_L2DoubleClutchEngagement" 629 "DFC_L2DoubleGearEven" 630 "DFC_L2EM1ShaftOverspeed" 631 "DFC_L2EPBWhenMoving" 632 "DFC_L2EvenClutchGradientInCreep" 633 "DFC_L2ForwardDriveEven" 634 "DFC_L2ForwardDriveOdd" 635 "DFC_L2ForwardGearAndMode" 636 "DFC_L2GearCombinationEM1Overspeed" 637 "DFC_L2GearCombinationRequest" 638 "DFC_L2InputShaftEngineOverspeed" 639 "DFC_L2InsufficientLubrication" 640 "DFC_L2InvalidDownshiftOdd" 641 "DFC_L2InvalidGearControl" 642 "DFC_L2LeaveNeutral" 643 "DFC_L2LeavePark" 644 "DFC_L2ModeDisplay" 645 "DFC_L2ModeSelection" 646 "DFC_L2MovementWithChargeCable" 647 "DFC_L2OddClutchGradientInCreep" 648 "DFC_L2OddShaftAccelerationImplausible" 649 "DFC_L2ParkFailNoEPB" 650 "DFC_L2ParkPosition" 651 "DFC_L2ParkValveOverride" 652 "DFC_L2ParkWhenMoving" 653 "DFC_L2ReferenceSpeedFail" 654 "DFC_L2ReverseDrive" 655 "DFC_L2ShaftOverSpeedFromIP" 656 "DFC_L2ShaftOverSpeedFromOP" 657 "DFC_L2Spare1" 658 "DFC_L2Spare2" 659 "DFC_L2TorqueNoShift" 660 "DFC_L2TorqueRequestCupOfFuel" 661 "DFC_L2VGPOverride" 662 "DFC_L2VKUGLOveride" 663 "DFC_L2VSS1Overirde" 664 "DFC_L2VSS2Overirde" 665 "DFC_LatAccErrorRx" 666 "DFC_LinePressureImplausible" 667 "DFC_LinePressureLeakageHigh" 668 "DFC_LinePressureRateHigh" 669 "DFC_LinePressureSpare1" 670 "DFC_LinePressureSpare2" 671 "DFC_LinePressureTooHigh" 672 "DFC_LinePressureTooLow" 673 "DFC_LongAccErrorRx" 674 "DFC_LubeOilOverTemperature" 675 "DFC_LubeTemperatureImplausible" 676 "DFC_LubeTemperatureRateHigh" 677 "DFC_LubeTemperatureSpare1" 678 "DFC_LubeTemperatureSpare2" 679 "DFC_MOTEngineProblem" 680 "DFC_MOTSpare1" 681 "DFC_MOTSpare2" 682 "DFC_ModeMSwImplausible" 683 "DFC_ModeMSwSpare1" 684 "DFC_ModeMSwSpare2" 685 "DFC_ModeMSwSwRateHigh" 686 "DFC_ModePSwImplausible" 687 "DFC_ModePSwSpare1" 688 "DFC_ModePSwSpare2" 689 "DFC_ModePSwSwRateHigh" 690 "DFC_ModeRSwImplausible" 691 "DFC_ModeRSwSpare1" 692 "DFC_ModeRSwSpare2" 693 "DFC_ModeRSwSwRateHigh" 694 "DFC_ParkLockDisengageFail" 695 "DFC_ParkLockEngageFail" 696 "DFC_ParkLockPosImplausible" 697 "DFC_ParkLockPosRateHigh" 698 "DFC_ParkLockPosSpare1" 699 "DFC_ParkLockPosSpare2" 700 "DFC_PumpResponseFault" 701 "DFC_PumpSpeedError" 702 "DFC_RearLeftWheelSpeedErrorRx" 703 "DFC_RearRightWheelSpeedErrorRx" 704 "DFC_RedSpeedHigh" 705 "DFC_RedSpeedImplausible" 706 "DFC_RedSpeedSpare1" 707 "DFC_RedSpeedSpare2" 708 "DFC_SEQSpare1" 709 "DFC_SEQSpare2" 710 "DFC_SEQTimeout" 711 "DFC_Spare_0" 712 "DFC_Spare_1" 713 "DFC_Spare_2" 714 "DFC_Spare_3" 715 "DFC_Spare_4" 716 "DFC_Spare_5" 717 "DFC_Spare_6" 718 "DFC_Spare_7" 719 "DFC_Spare_8" 720 "DFC_Spare_9" 721 "DFC_SumpOilOverTemperature" 722 "DFC_SumpTemperatureImplausible" 723 "DFC_SumpTemperatureRateHigh" 724 "DFC_SumpTemperatureSpare1" 725 "DFC_SumpTemperatureSpare2" 726 "DFC_SynchroA1EngageFault" 727 "DFC_SynchroA1SpitoutInShiftFault" 728 "DFC_SynchroA1SpitoutNoShiftFault" 729 "DFC_SynchroA1StuckFault" 730 "DFC_SynchroA2EngageFault" 731 "DFC_SynchroA2SpitoutInShiftFault" 732 "DFC_SynchroA2SpitoutNoShiftFault" 733 "DFC_SynchroA2StuckFault" 734 "DFC_SynchroAOutOfNInShiftFault" 735 "DFC_SynchroAOutOfNNoShiftFault" 736 "DFC_SynchroAPosImplausible" 737 "DFC_SynchroAPosRateHigh" 738 "DFC_SynchroAPosSpare1" 739 "DFC_SynchroAPosSpare2" 740 "DFC_SynchroB1EngageFault" 741 "DFC_SynchroB1SpitoutInShiftFault" 742 "DFC_SynchroB1SpitoutNoShiftFault" 743 "DFC_SynchroB1StuckFault" 744 "DFC_SynchroB2EngageFault" 745 "DFC_SynchroB2SpitoutInShiftFault" 746 "DFC_SynchroB2SpitoutNoShiftFault" 747 "DFC_SynchroB2StuckFault" 748 "DFC_SynchroBOutOfNInShiftFault" 749 "DFC_SynchroBOutOfNNoShiftFault" 750 "DFC_SynchroBPosImplausible" 751 "DFC_SynchroBPosRateHigh" 752 "DFC_SynchroBPosSpare1" 753 "DFC_SynchroBPosSpare2" 754 "DFC_SynchroC1EngageFault" 755 "DFC_SynchroC1SpitoutInShiftFault" 756 "DFC_SynchroC1SpitoutNoShiftFault" 757 "DFC_SynchroC1StuckFault" 758 "DFC_SynchroC2EngageFault" 759 "DFC_SynchroC2SpitoutInShiftFault" 760 "DFC_SynchroC2SpitoutNoShiftFault" 761 "DFC_SynchroC2StuckFault" 762 "DFC_SynchroCOutOfNInShiftFault" 763 "DFC_SynchroCOutOfNNoShiftFault" 764 "DFC_SynchroCPosImplausible" 765 "DFC_SynchroCPosRateHigh" 766 "DFC_SynchroCPosSpare1" 767 "DFC_SynchroCPosSpare2" 768 "DFC_SynchroD1EngageFault" 769 "DFC_SynchroD1SpitoutInShiftFault" 770 "DFC_SynchroD1SpitoutNoShiftFault" 771 "DFC_SynchroD1StuckFault" 772 "DFC_SynchroDOutOfNInShiftFault" 773 "DFC_SynchroDOutOfNNoShiftFault" 774 "DFC_SynchroDPosImplausible" 775 "DFC_SynchroDPosRateHigh" 776 "DFC_SynchroDPosSpare1" 777 "DFC_SynchroDPosSpare2" 778 "DFC_SynchroF1EngageFault" 779 "DFC_SynchroF1SpitoutInShiftFault" 780 "DFC_SynchroF1SpitoutNoShiftFault" 781 "DFC_SynchroF1StuckFault" 782 "DFC_SynchroF2EngageFault" 783 "DFC_SynchroF2SpitoutInShiftFault" 784 "DFC_SynchroF2SpitoutNoShiftFault" 785 "DFC_SynchroF2StuckFault" 786 "DFC_SynchroFOutOfNInShiftFault" 787 "DFC_SynchroFOutOfNNoShiftFault" 788 "DFC_SynchroFPosImplausible" 789 "DFC_SynchroFPosRateHigh" 790 "DFC_SynchroFPosSpare1" 791 "DFC_SynchroFPosSpare2" 792 "DFC_UpSwImplausible" 793 "DFC_UpSwRateHigh" 794 "DFC_UpSwSpare1" 795 "DFC_UpSwSpare2" 796 "DFC_VehicleSpeedErrorRx" 797 "DFC_WheelTorqueESPErrorRx" 798 "DFC_YawRateErrorRx" 799 "DFC_Can0Motor_01_TO" 800 "DFC_Can0Motor_02_TO" 801 "DFC_Can0Motor_03_TO" 802 "DFC_Can1BYPASS_TDG1_11_TO" 803 "DFC_Can1BYPASS_TDG1_12_TO" 804 "DFC_Can1BYPASS_TDG1_13_TO" 805 "DFC_Can1BYPASS_TDG1_14_TO" 806 "DFC_Can1BYPASS_TDG1_15_TO" 807 "DFC_Can1BYPASS_TDG1_16_PlaceHolder_TO" 808 "DFC_Can1BYPASS_TDG1_17_PlaceHolder_TO" 809 "DFC_Can1BYPASS_TDG1_18_PlaceHolder_TO" 810 "DFC_Can1BYPASS_TDG1_19_Placeholder_TO" 811 "DFC_Can1BYPASS_TDG1_20_Placeholder_TO" 812 "DFC_Can1BYPASS_TDG1_21_TO" 813 "DFC_Can1BYPASS_TDG1_22_TO" 814 "DFC_Can1Cool_Act_Sts_TO" 815 "DFC_DsmTest0" 816 "DFC_FrAACC_06ISigGroup_ACC_06_TO" 817 "DFC_FrAACC_06_TO" 818 "DFC_FrAACC_07ISigGroup_ACC_07_TO" 819 "DFC_FrAACC_07_TO" 820 "DFC_FrAAirbag_01ISigGroup_Airbag_01_TO" 821 "DFC_FrAAirbag_01_TO" 822 "DFC_FrAAirbag_02ISigGroup_Airbag_02_TO" 823 "DFC_FrAAirbag_02_TO" 824 "DFC_FrABCM_01_TO" 825 "DFC_FrABremse_EV_01ISigGroup_Bremse_EV_01_TO" 826 "DFC_FrABremse_EV_01_TO" 827 "DFC_FrABremse_EV_02ISigGroup_Bremse_EV_02_TO" 828 "DFC_FrABremse_EV_02_TO" 829 "DFC_FrACharisma_01_TO" 830 "DFC_FrADiagnose_01_TO" 831 "DFC_FrAEBKV_01ISigGroup_EBKV_01_TO" 832 "DFC_FrAEBKV_01_TO" 833 "DFC_FrAEM1_HYB_06_TO" 834 "DFC_FrAEM1_HYB_12ISigGroup_EM1_HYB_12_TO" 835 "DFC_FrAEM1_HYB_12_TO" 836 "DFC_FrAEPB_01ISigGroup_EPB_01_TO" 837 "DFC_FrAEPB_01_TO" 838 "DFC_FrAESP_03ISigGroup_ESP_03_TO" 839 "DFC_FrAESP_03_TO" 840 "DFC_FrAESP_05ISigGroup_ESP_05_TO" 841 "DFC_FrAESP_05_TO" 842 "DFC_FrAESP_07ISigGroup_ESP_07_TO" 843 "DFC_FrAESP_07_TO" 844 "DFC_FrAESP_08ISigGroup_ESP_08_TO" 845 "DFC_FrAESP_08_TO" 846 "DFC_FrAESP_15ISigGroup_ESP_15_TO" 847 "DFC_FrAESP_15_TO" 848 "DFC_FrAESP_20ISigGroup_ESP_20_TO" 849 "DFC_FrAESP_20_TO" 850 "DFC_FrAESP_21ISigGroup_ESP_21_TO" 851 "DFC_FrAESP_21_TO" 852 "DFC_FrAESP_22ISigGroup_ESP_22_TO" 853 "DFC_FrAESP_22_TO" 854 "DFC_FrAESP_23ISigGroup_ESP_23_TO" 855 "DFC_FrAESP_23_TO" 856 "DFC_FrAESP_24ISigGroup_ESP_24_TO" 857 "DFC_FrAESP_24_TO" 858 "DFC_FrAESP_26_TO" 859 "DFC_FrAESP_28ISigGroup_ESP_28_TO" 860 "DFC_FrAESP_28_TO" 861 "DFC_FrAESP_31ISigGroup_ESP_31_TO" 862 "DFC_FrAESP_31_TO" 863 "DFC_FrAESP_32ISigGroup_ESP_32_TO" 864 "DFC_FrAESP_32_TO" 865 "DFC_FrAESP_33ISigGroup_ESP_33_TO" 866 "DFC_FrAESP_33_TO" 867 "DFC_FrAESP_41ISigGroup_ESP_41_TO" 868 "DFC_FrAESP_41_TO" 869 "DFC_FrAESP_44ISigGroup_ESP_44_TO" 870 "DFC_FrAESP_44_TO" 871 "DFC_FrAKlemmen_Status_01ISigGroup_Klemmen_Status_01_TO" 872 "DFC_FrAKlemmen_Status_01_TO" 873 "DFC_FrAKlima_11_TO" 874 "DFC_FrAKombi_02_TO" 875 "DFC_FrALCV_01ISigGroup_LCV_01_TO" 876 "DFC_FrALCV_01_TO" 877 "DFC_FrALWI_01ISigGroup_LWI_01_TO" 878 "DFC_FrALWI_01_TO" 879 "DFC_FrAMFL_Tasten_01_TO" 880 "DFC_FrAMSG_EM1_18_TO" 881 "DFC_FrAMSG_EM1_29_TO" 882 "DFC_FrAMotor_07_TO" 883 "DFC_FrAMotor_11ISigGroup_Motor_11_TO" 884 "DFC_FrAMotor_11_TO" 885 "DFC_FrAMotor_12ISigGroup_Motor_12_TO" 886 "DFC_FrAMotor_12_TO" 887 "DFC_FrAMotor_14ISigGroup_Motor_14_TO" 888 "DFC_FrAMotor_14_TO" 889 "DFC_FrAMotor_16_TO" 890 "DFC_FrAMotor_17_TO" 891 "DFC_FrAMotor_18_TO" 892 "DFC_FrAMotor_20ISigGroup_Motor_20_TO" 893 "DFC_FrAMotor_20_TO" 894 "DFC_FrAMotor_27ISigGroup_Motor_27_TO" 895 "DFC_FrAMotor_27_TO" 896 "DFC_FrAMotor_28ISigGroup_Motor_28_TO" 897 "DFC_FrAMotor_28_TO" 898 "DFC_FrAMotor_35_TO" 899 "DFC_FrAMotor_38_LB_TO" 900 "DFC_FrAMotor_47_TO" 901 "DFC_FrAMotor_Code_01ISigGroup_Motor_Code_01_TO" 902 "DFC_FrAMotor_Code_01_TO" 903 "DFC_FrAMotor_Hybrid_11_TO" 904 "DFC_FrAMotor_TS_01ISigGroup_Motor_TS_01_TO" 905 "DFC_FrAMotor_TS_01_TO" 906 "DFC_FrAMotor_TS_02ISigGroup_Motor_TS_02_TO" 907 "DFC_FrAMotor_TS_02_TO" 908 "DFC_FrAMotor_TS_03ISigGroup_Motor_TS_03_TO" 909 "DFC_FrAMotor_TS_03_TO" 910 "DFC_FrANVEM_02_TO" 911 "DFC_FrANVEM_05_TO" 912 "DFC_FrAOBD_01_TO" 913 "DFC_FrAOBD_02_TO" 914 "DFC_FrASARA_06ISigGroup_SARA_06_TO" 915 "DFC_FrASARA_06_TO" 916 "DFC_FrASysteminfo_01_TO" 917 "DFC_FrATSG_FT_02ISigGroup_TSG_FT_02_TO" 918 "DFC_FrATSG_FT_02_TO" 919 "DFC_FrATSK_06ISigGroup_TSK_06_TO" 920 "DFC_FrATSK_06_TO" 921 "DFC_FrATSK_08ISigGroup_TSK_08_TO" 922 "DFC_FrATSK_08_TO" 923 "DFC_FrAVIN_01_0_TO" 924 "DFC_FrAVIN_01_1_TO" 925 "DFC_FrAVIN_01_2_TO" 926 "DFC_IPT" 927 "DFC_L3Error" 928 "DFC_SftyCfgMon" 929 "DFC_SftyShtOff" 930 "DFC_DsmTest4" 931 "DFC_BSWM_E_ACTION_FAILED" 932 "DFC_BSWM_E_INTRPTQUEUE_FULL" 933 "DFC_CANSM_E_BUS_OFF_NETWORK_0" 934 "DFC_CANSM_E_BUS_OFF_NETWORK_1" 935 "DFC_CANSM_E_BUS_OFF_NETWORK_2" 936 "DFC_CANSM_E_BUS_OFF_NETWORK_3" 937 "DFC_FRSM_E_CLUSTER_STARTUP" 938 "DFC_FRTRCV_E_NO_TRCV_CONTROL_0" 939 "DFC_FR_E_ACCESS" 940 "DFC_RBA_IOEXTLIB_KEEPALIVE_DRV" 941 "DFC_RBA_IOEXTLIB_KEEPALIVE_INI" 942 "DFC_rba_MultiStackTrace_Threshold" 943 "DFC_CAN_E_TIMEOUT" 944 "DFC_FRSM_E_CLUSTER_SYNC_LOSS" 945 "DFC_PDUR_E_INIT_FAILED" 946 "DFC_PDUR_E_PDU_INSTANCE_LOST" 947 "DFC_rba_IoSigRtc_StopCounter" 948 "DFC_rba_T15_Diag_ComInVld_Event" 949 "DFC_rba_T15_Diag_ComOff_HwOn_Event" 950 "DFC_rba_T15_Diag_ComOn_HwOff_Event" 951 "DFC_DSMDummy" 952 "DFC_DsmTest3";
VAL_ 2041 SEQ_ShiftSequenchiftSequencer_sm 0 "ASG_ShiftComplete" 1 "ASG_DisengageToNeutral" 2 "ASG_EngageClutch" 3 "ASG_RollTorqueOff" 4 "ASG_RollTorqueOn" 5 "ASG_SelectandPrepareClutch" 6 "ASG_PerformShift";
VAL_ 2041 DFES_numDFC_29_ 0 "DFC_Unused" 1 "DFC_DsmTest2" 2 "DFC_Can0Getriebe_01" 3 "DFC_Can0Motor_01_CHK" 4 "DFC_Can0Motor_01_CNT" 5 "DFC_Can0Motor_01_DLC" 6 "DFC_Can0Motor_02_CHK" 7 "DFC_Can0Motor_02_CNT" 8 "DFC_Can0Motor_02_DLC" 9 "DFC_Can0Motor_03_CHK" 10 "DFC_Can0Motor_03_CNT" 11 "DFC_Can0Motor_03_DLC" 12 "DFC_Can1BYPASS_TDG1_11_DLC" 13 "DFC_Can1BYPASS_TDG1_12_DLC" 14 "DFC_Can1BYPASS_TDG1_13_DLC" 15 "DFC_Can1BYPASS_TDG1_14_DLC" 16 "DFC_Can1BYPASS_TDG1_15_DLC" 17 "DFC_Can1BYPASS_TDG1_16_PlaceHolder_DLC" 18 "DFC_Can1BYPASS_TDG1_17_PlaceHolder_DLC" 19 "DFC_Can1BYPASS_TDG1_18_PlaceHolder_DLC" 20 "DFC_Can1BYPASS_TDG1_19_Placeholder_DLC" 21 "DFC_Can1BYPASS_TDG1_20_Placeholder_DLC" 22 "DFC_Can1BYPASS_TDG1_21_DLC" 23 "DFC_Can1BYPASS_TDG1_22_DLC" 24 "DFC_Can1BYPASS_TDG1_AA" 25 "DFC_Can1BYPASS_TDG1_AB" 26 "DFC_Can1BYPASS_TDG1_AC" 27 "DFC_Can1BYPASS_TDG1_AD" 28 "DFC_Can1BYPASS_TDG1_AE" 29 "DFC_Can1BYPASS_TDG1_AF" 30 "DFC_Can1BYPASS_TDG1_BA" 31 "DFC_Can1BYPASS_TDG1_BB" 32 "DFC_Can1BYPASS_TDG1_BC" 33 "DFC_Can1BYPASS_TDG1_BD" 34 "DFC_Can1BYPASS_TDG1_BE_PlaceHolder" 35 "DFC_Can1BYPASS_TDG1_BF_PlaceHolder" 36 "DFC_Can1BYPASS_TDG1_CA_PlaceHolder" 37 "DFC_Can1BYPASS_TDG1_CB_PlaceHolder" 38 "DFC_Can1BYPASS_TDG1_CC_PlaceHolder" 39 "DFC_Can1Cool_Act_Cmd" 40 "DFC_Can1Cool_Act_Sts_DLC" 41 "DFC_DsmTest1" 42 "DFC_FrAACC_06ISigGroup_ACC_06_CHK" 43 "DFC_FrAACC_06ISigGroup_ACC_06_CNT" 44 "DFC_FrAACC_07ISigGroup_ACC_07_CHK" 45 "DFC_FrAACC_07ISigGroup_ACC_07_CNT" 46 "DFC_FrAAirbag_01ISigGroup_Airbag_01_CHK" 47 "DFC_FrAAirbag_01ISigGroup_Airbag_01_CNT" 48 "DFC_FrAAirbag_02ISigGroup_Airbag_02_CHK" 49 "DFC_FrAAirbag_02ISigGroup_Airbag_02_CNT" 50 "DFC_FrABremse_EV_01ISigGroup_Bremse_EV_01_CHK" 51 "DFC_FrABremse_EV_01ISigGroup_Bremse_EV_01_CNT" 52 "DFC_FrABremse_EV_02ISigGroup_Bremse_EV_02_CHK" 53 "DFC_FrABremse_EV_02ISigGroup_Bremse_EV_02_CNT" 54 "DFC_FrAEBKV_01ISigGroup_EBKV_01_CHK" 55 "DFC_FrAEBKV_01ISigGroup_EBKV_01_CNT" 56 "DFC_FrAEM1_HYB_12ISigGroup_EM1_HYB_12_CHK" 57 "DFC_FrAEM1_HYB_12ISigGroup_EM1_HYB_12_CNT" 58 "DFC_FrAEPB_01ISigGroup_EPB_01_CHK" 59 "DFC_FrAEPB_01ISigGroup_EPB_01_CNT" 60 "DFC_FrAESP_03ISigGroup_ESP_03_CHK" 61 "DFC_FrAESP_03ISigGroup_ESP_03_CNT" 62 "DFC_FrAESP_05ISigGroup_ESP_05_CHK" 63 "DFC_FrAESP_05ISigGroup_ESP_05_CNT" 64 "DFC_FrAESP_07ISigGroup_ESP_07_CHK" 65 "DFC_FrAESP_07ISigGroup_ESP_07_CNT" 66 "DFC_FrAESP_08ISigGroup_ESP_08_CHK" 67 "DFC_FrAESP_08ISigGroup_ESP_08_CNT" 68 "DFC_FrAESP_15ISigGroup_ESP_15_CHK" 69 "DFC_FrAESP_15ISigGroup_ESP_15_CNT" 70 "DFC_FrAESP_20ISigGroup_ESP_20_CHK" 71 "DFC_FrAESP_20ISigGroup_ESP_20_CNT" 72 "DFC_FrAESP_21ISigGroup_ESP_21_CHK" 73 "DFC_FrAESP_21ISigGroup_ESP_21_CNT" 74 "DFC_FrAESP_22ISigGroup_ESP_22_CHK" 75 "DFC_FrAESP_22ISigGroup_ESP_22_CNT" 76 "DFC_FrAESP_23ISigGroup_ESP_23_CHK" 77 "DFC_FrAESP_23ISigGroup_ESP_23_CNT" 78 "DFC_FrAESP_24ISigGroup_ESP_24_CHK" 79 "DFC_FrAESP_24ISigGroup_ESP_24_CNT" 80 "DFC_FrAESP_28ISigGroup_ESP_28_CHK" 81 "DFC_FrAESP_28ISigGroup_ESP_28_CNT" 82 "DFC_FrAESP_31ISigGroup_ESP_31_CHK" 83 "DFC_FrAESP_31ISigGroup_ESP_31_CNT" 84 "DFC_FrAESP_32ISigGroup_ESP_32_CHK" 85 "DFC_FrAESP_32ISigGroup_ESP_32_CNT" 86 "DFC_FrAESP_33ISigGroup_ESP_33_CHK" 87 "DFC_FrAESP_33ISigGroup_ESP_33_CNT" 88 "DFC_FrAESP_41ISigGroup_ESP_41_CHK" 89 "DFC_FrAESP_41ISigGroup_ESP_41_CNT" 90 "DFC_FrAESP_44ISigGroup_ESP_44_CHK" 91 "DFC_FrAESP_44ISigGroup_ESP_44_CNT" 92 "DFC_FrAGetriebe_11" 93 "DFC_FrAGetriebe_12" 94 "DFC_FrAGetriebe_13" 95 "DFC_FrAGetriebe_14" 96 "DFC_FrAGetriebe_15" 97 "DFC_FrAGetriebe_16" 98 "DFC_FrAGetriebe_17" 99 "DFC_FrAGetriebe_18" 100 "DFC_FrAGetriebe_HYB_12" 101 "DFC_FrAKN_Getriebe" 102 "DFC_FrAKlemmen_Status_01ISigGroup_Klemmen_Status_01_CHK" 103 "DFC_FrAKlemmen_Status_01ISigGroup_Klemmen_Status_01_CNT" 104 "DFC_FrALCV_01ISigGroup_LCV_01_CHK" 105 "DFC_FrALCV_01ISigGroup_LCV_01_CNT" 106 "DFC_FrALWI_01ISigGroup_LWI_01_CHK" 107 "DFC_FrALWI_01ISigGroup_LWI_01_CNT" 108 "DFC_FrAMotor_11ISigGroup_Motor_11_CHK" 109 "DFC_FrAMotor_11ISigGroup_Motor_11_CNT" 110 "DFC_FrAMotor_12ISigGroup_Motor_12_CHK" 111 "DFC_FrAMotor_12ISigGroup_Motor_12_CNT" 112 "DFC_FrAMotor_14ISigGroup_Motor_14_CHK" 113 "DFC_FrAMotor_14ISigGroup_Motor_14_CNT" 114 "DFC_FrAMotor_20ISigGroup_Motor_20_CHK" 115 "DFC_FrAMotor_20ISigGroup_Motor_20_CNT" 116 "DFC_FrAMotor_27ISigGroup_Motor_27_CHK" 117 "DFC_FrAMotor_27ISigGroup_Motor_27_CNT" 118 "DFC_FrAMotor_28ISigGroup_Motor_28_CHK" 119 "DFC_FrAMotor_28ISigGroup_Motor_28_CNT" 120 "DFC_FrAMotor_Code_01ISigGroup_Motor_Code_01_CHK" 121 "DFC_FrAMotor_Code_01ISigGroup_Motor_Code_01_CNT" 122 "DFC_FrAMotor_TS_01ISigGroup_Motor_TS_01_CHK" 123 "DFC_FrAMotor_TS_01ISigGroup_Motor_TS_01_CNT" 124 "DFC_FrAMotor_TS_02ISigGroup_Motor_TS_02_CHK" 125 "DFC_FrAMotor_TS_02ISigGroup_Motor_TS_02_CNT" 126 "DFC_FrAMotor_TS_03ISigGroup_Motor_TS_03_CHK" 127 "DFC_FrAMotor_TS_03ISigGroup_Motor_TS_03_CNT" 128 "DFC_FrASARA_06ISigGroup_SARA_06_CHK" 129 "DFC_FrASARA_06ISigGroup_SARA_06_CNT" 130 "DFC_FrATSG_FT_02ISigGroup_TSG_FT_02_CHK" 131 "DFC_FrATSG_FT_02ISigGroup_TSG_FT_02_CNT" 132 "DFC_FrATSK_06ISigGroup_TSK_06_CHK" 133 "DFC_FrATSK_06ISigGroup_TSK_06_CNT" 134 "DFC_FrATSK_08ISigGroup_TSK_08_CHK" 135 "DFC_FrATSK_08ISigGroup_TSK_08_CNT" 136 "DFC_FrAWBA_03" 137 "DFC_AdcBkg" 138 "DFC_Adc_Rdnt_0" 139 "DFC_Adc_Rdnt_1" 140 "DFC_Adc_Rdnt_2" 141 "DFC_Adc_Rdnt_3" 142 "DFC_Adc_Rdnt_4" 143 "DFC_Adc_Rdnt_5" 144 "DFC_Adc_Rdnt_6" 145 "DFC_Adc_Rdnt_7" 146 "DFC_Adc_Rdnt_8" 147 "DFC_Adc_Rdnt_9" 148 "DFC_Adc_SB_0" 149 "DFC_Adc_SB_1" 150 "DFC_Adc_SB_2" 151 "DFC_Adc_SB_3" 152 "DFC_Adc_SB_4" 153 "DFC_Adc_SB_5" 154 "DFC_Adc_SB_6" 155 "DFC_Adc_SB_7" 156 "DFC_Adc_SB_8" 157 "DFC_Adc_SB_9" 158 "DFC_Adc_SG_0" 159 "DFC_Adc_SG_1" 160 "DFC_Adc_SG_2" 161 "DFC_Adc_SG_3" 162 "DFC_Adc_SG_4" 163 "DFC_Adc_SG_5" 164 "DFC_Adc_SG_6" 165 "DFC_Adc_SG_7" 166 "DFC_Adc_SG_8" 167 "DFC_Adc_SG_9" 168 "DFC_Adc_Unit" 169 "DFC_BattSply_UHi" 170 "DFC_BattSply_ULo" 171 "DFC_CpuTemp" 172 "DFC_CrntCtrl_Channel_0" 173 "DFC_CrntCtrl_Channel_1" 174 "DFC_CrntCtrl_Channel_2" 175 "DFC_CrntCtrl_Channel_3" 176 "DFC_CrntCtrl_Channel_4" 177 "DFC_CrntCtrl_Channel_5" 178 "DFC_CrntCtrl_Channel_6" 179 "DFC_CrntCtrl_Channel_7" 180 "DFC_CrntCtrl_Channel_8" 181 "DFC_CrntCtrl_Channel_9" 182 "DFC_CrntCtrl_Channel_10" 183 "DFC_CrntCtrl_Channel_11" 184 "DFC_CrntCtrl_Channel_12" 185 "DFC_CrntCtrl_Channel_13" 186 "DFC_CrntCtrl_Channel_14" 187 "DFC_CrntCtrl_Channel_15" 188 "DFC_CrntCtrl_Channel_16" 189 "DFC_CrntCtrl_Channel_17" 190 "DFC_CrntCtrl_Channel_18" 191 "DFC_CrntCtrl_Channel_19" 192 "DFC_CrntCtrl_CrntMon_0" 193 "DFC_CrntCtrl_CrntMon_1" 194 "DFC_CrntCtrl_CrntMon_2" 195 "DFC_CrntCtrl_CrntMon_3" 196 "DFC_CrntCtrl_CrntMon_4" 197 "DFC_CrntCtrl_CrntMon_5" 198 "DFC_CrntCtrl_CrntMon_6" 199 "DFC_CrntCtrl_CrntMon_7" 200 "DFC_CrntCtrl_CrntMon_8" 201 "DFC_CrntCtrl_CrntMon_9" 202 "DFC_CrntCtrl_CrntMon_10" 203 "DFC_CrntCtrl_CrntMon_11" 204 "DFC_CrntCtrl_CrntMon_12" 205 "DFC_CrntCtrl_CrntMon_13" 206 "DFC_CrntCtrl_CrntMon_14" 207 "DFC_CrntCtrl_CrntMon_15" 208 "DFC_CrntCtrl_CrntMon_16" 209 "DFC_CrntCtrl_CrntMon_17" 210 "DFC_CrntCtrl_CrntMon_18" 211 "DFC_CrntCtrl_CrntMon_19" 212 "DFC_CrntCtrl_OP_0" 213 "DFC_CrntCtrl_OP_1" 214 "DFC_CrntCtrl_OP_2" 215 "DFC_CrntCtrl_OP_3" 216 "DFC_CrntCtrl_OP_4" 217 "DFC_CrntCtrl_OP_5" 218 "DFC_CrntCtrl_OP_6" 219 "DFC_CrntCtrl_OP_7" 220 "DFC_CrntCtrl_OP_8" 221 "DFC_CrntCtrl_OP_9" 222 "DFC_CrntCtrl_OP_10" 223 "DFC_CrntCtrl_OP_11" 224 "DFC_CrntCtrl_OP_12" 225 "DFC_CrntCtrl_OP_13" 226 "DFC_CrntCtrl_OP_14" 227 "DFC_CrntCtrl_OP_15" 228 "DFC_CrntCtrl_OP_16" 229 "DFC_CrntCtrl_OP_17" 230 "DFC_CrntCtrl_OP_18" 231 "DFC_CrntCtrl_OP_19" 232 "DFC_CrntCtrl_SB_0" 233 "DFC_CrntCtrl_SB_1" 234 "DFC_CrntCtrl_SB_2" 235 "DFC_CrntCtrl_SB_3" 236 "DFC_CrntCtrl_SB_4" 237 "DFC_CrntCtrl_SB_5" 238 "DFC_CrntCtrl_SB_6" 239 "DFC_CrntCtrl_SB_7" 240 "DFC_CrntCtrl_SB_8" 241 "DFC_CrntCtrl_SB_9" 242 "DFC_CrntCtrl_SB_10" 243 "DFC_CrntCtrl_SB_11" 244 "DFC_CrntCtrl_SB_12" 245 "DFC_CrntCtrl_SB_13" 246 "DFC_CrntCtrl_SB_14" 247 "DFC_CrntCtrl_SB_15" 248 "DFC_CrntCtrl_SB_16" 249 "DFC_CrntCtrl_SB_17" 250 "DFC_CrntCtrl_SB_18" 251 "DFC_CrntCtrl_SB_19" 252 "DFC_CrntCtrl_SG_0" 253 "DFC_CrntCtrl_SG_1" 254 "DFC_CrntCtrl_SG_2" 255 "DFC_CrntCtrl_SG_3" 256 "DFC_CrntCtrl_SG_4" 257 "DFC_CrntCtrl_SG_5" 258 "DFC_CrntCtrl_SG_6" 259 "DFC_CrntCtrl_SG_7" 260 "DFC_CrntCtrl_SG_8" 261 "DFC_CrntCtrl_SG_9" 262 "DFC_CrntCtrl_SG_10" 263 "DFC_CrntCtrl_SG_11" 264 "DFC_CrntCtrl_SG_12" 265 "DFC_CrntCtrl_SG_13" 266 "DFC_CrntCtrl_SG_14" 267 "DFC_CrntCtrl_SG_15" 268 "DFC_CrntCtrl_SG_16" 269 "DFC_CrntCtrl_SG_17" 270 "DFC_CrntCtrl_SG_18" 271 "DFC_CrntCtrl_SG_19" 272 "DFC_CrntCtrl_Unit_0" 273 "DFC_CrntCtrl_Unit_1" 274 "DFC_CtrlMot_DNR_0" 275 "DFC_CtrlMot_DNR_1" 276 "DFC_CtrlMot_OC_0" 277 "DFC_CtrlMot_OC_1" 278 "DFC_CtrlMot_OL_0" 279 "DFC_CtrlMot_OL_1" 280 "DFC_CtrlMot_SB_0" 281 "DFC_CtrlMot_SB_1" 282 "DFC_CtrlMot_SG_0" 283 "DFC_CtrlMot_SG_1" 284 "DFC_Flx_AdcInUnit_0" 285 "DFC_Flx_AdcInUnit_1" 286 "DFC_Flx_AdcInUnit_2" 287 "DFC_Flx_RMeasUnit_0" 288 "DFC_Flx_RMeasUnit_1" 289 "DFC_Flx_SB_0" 290 "DFC_Flx_SB_1" 291 "DFC_Flx_SB_2" 292 "DFC_Flx_SB_3" 293 "DFC_Flx_SB_4" 294 "DFC_Flx_SB_5" 295 "DFC_Flx_SB_6" 296 "DFC_Flx_SB_7" 297 "DFC_Flx_SB_8" 298 "DFC_Flx_SB_9" 299 "DFC_Flx_SB_10" 300 "DFC_Flx_SB_11" 301 "DFC_Flx_SB_12" 302 "DFC_Flx_SB_13" 303 "DFC_Flx_SB_14" 304 "DFC_Flx_SB_15" 305 "DFC_Flx_SB_16" 306 "DFC_Flx_SB_17" 307 "DFC_Flx_SB_18" 308 "DFC_Flx_SB_19" 309 "DFC_Flx_SB_20" 310 "DFC_Flx_SB_21" 311 "DFC_Flx_SB_22" 312 "DFC_Flx_SB_23" 313 "DFC_Flx_SB_24" 314 "DFC_Flx_SB_25" 315 "DFC_Flx_SB_26" 316 "DFC_Flx_SG_0" 317 "DFC_Flx_SG_1" 318 "DFC_Flx_SG_2" 319 "DFC_Flx_SG_3" 320 "DFC_Flx_SG_4" 321 "DFC_Flx_SG_5" 322 "DFC_Flx_SG_6" 323 "DFC_Flx_SG_7" 324 "DFC_Flx_SG_8" 325 "DFC_Flx_SG_9" 326 "DFC_Flx_SG_10" 327 "DFC_Flx_SG_11" 328 "DFC_Flx_SG_12" 329 "DFC_Flx_SG_13" 330 "DFC_Flx_SG_14" 331 "DFC_Flx_SG_15" 332 "DFC_Flx_SG_16" 333 "DFC_Flx_SG_17" 334 "DFC_Flx_SG_18" 335 "DFC_Flx_SG_19" 336 "DFC_Flx_SG_20" 337 "DFC_Flx_SG_21" 338 "DFC_Flx_SG_22" 339 "DFC_Flx_SG_23" 340 "DFC_Flx_SG_24" 341 "DFC_Flx_SG_25" 342 "DFC_Flx_SG_26" 343 "DFC_Flx_Sig_0" 344 "DFC_Flx_Sig_1" 345 "DFC_Flx_Sig_2" 346 "DFC_Flx_Sig_3" 347 "DFC_Flx_Sig_4" 348 "DFC_Flx_Sig_5" 349 "DFC_Flx_Sig_6" 350 "DFC_Flx_Sig_7" 351 "DFC_Flx_Sig_8" 352 "DFC_Flx_Sig_9" 353 "DFC_Flx_Sig_10" 354 "DFC_Flx_Sig_11" 355 "DFC_Flx_Sig_12" 356 "DFC_Flx_Sig_13" 357 "DFC_Flx_Sig_14" 358 "DFC_Flx_Sig_15" 359 "DFC_Flx_Sig_16" 360 "DFC_Flx_Sig_17" 361 "DFC_Flx_Sig_18" 362 "DFC_Flx_Sig_19" 363 "DFC_Flx_Sig_20" 364 "DFC_Flx_Sig_21" 365 "DFC_Flx_Sig_22" 366 "DFC_Flx_Sig_23" 367 "DFC_Flx_Sig_24" 368 "DFC_Flx_Sig_25" 369 "DFC_Flx_Sig_26" 370 "DFC_Gtm_Clk" 371 "DFC_HiSide_OP_0" 372 "DFC_HiSide_OP_1" 373 "DFC_HiSide_OP_2" 374 "DFC_HiSide_OP_3" 375 "DFC_HiSide_OP_4" 376 "DFC_HiSide_OP_5" 377 "DFC_HiSide_SB_0" 378 "DFC_HiSide_SB_1" 379 "DFC_HiSide_SB_2" 380 "DFC_HiSide_SB_3" 381 "DFC_HiSide_SB_4" 382 "DFC_HiSide_SB_5" 383 "DFC_HiSide_SG_0" 384 "DFC_HiSide_SG_1" 385 "DFC_HiSide_SG_2" 386 "DFC_HiSide_SG_3" 387 "DFC_HiSide_SG_4" 388 "DFC_HiSide_SG_5" 389 "DFC_IntSply_0" 390 "DFC_IntSply_1" 391 "DFC_IntSply_2" 392 "DFC_IntSply_3" 393 "DFC_IntSply_4" 394 "DFC_IntSply_5" 395 "DFC_IntTemp" 396 "DFC_LssRly_OL" 397 "DFC_LssRly_SB" 398 "DFC_LssRly_SG" 399 "DFC_Lss_OL_0" 400 "DFC_Lss_OL_1" 401 "DFC_Lss_OL_2" 402 "DFC_Lss_OL_3" 403 "DFC_Lss_OL_4" 404 "DFC_Lss_OL_5" 405 "DFC_Lss_OL_6" 406 "DFC_Lss_OL_7" 407 "DFC_Lss_OL_8" 408 "DFC_Lss_OL_9" 409 "DFC_Lss_OL_10" 410 "DFC_Lss_OL_11" 411 "DFC_Lss_SB_0" 412 "DFC_Lss_SB_1" 413 "DFC_Lss_SB_2" 414 "DFC_Lss_SB_3" 415 "DFC_Lss_SB_4" 416 "DFC_Lss_SB_5" 417 "DFC_Lss_SB_6" 418 "DFC_Lss_SB_7" 419 "DFC_Lss_SB_8" 420 "DFC_Lss_SB_9" 421 "DFC_Lss_SB_10" 422 "DFC_Lss_SB_11" 423 "DFC_Lss_SG_0" 424 "DFC_Lss_SG_1" 425 "DFC_Lss_SG_2" 426 "DFC_Lss_SG_3" 427 "DFC_Lss_SG_4" 428 "DFC_Lss_SG_5" 429 "DFC_Lss_SG_6" 430 "DFC_Lss_SG_7" 431 "DFC_Lss_SG_8" 432 "DFC_Lss_SG_9" 433 "DFC_Lss_SG_10" 434 "DFC_Lss_SG_11" 435 "DFC_Lss_Unit" 436 "DFC_OsTmrMon" 437 "DFC_PwmIn_GtmTim_0" 438 "DFC_PwmIn_GtmTim_1" 439 "DFC_PwmIn_GtmTim_2" 440 "DFC_PwmIn_GtmTim_3" 441 "DFC_PwmIn_GtmTim_4" 442 "DFC_PwmIn_GtmTim_5" 443 "DFC_PwmIn_GtmTim_6" 444 "DFC_PwmIn_GtmTim_7" 445 "DFC_PwmIn_GtmTim_8" 446 "DFC_PwmIn_GtmTim_9" 447 "DFC_PwmIn_GtmTim_10" 448 "DFC_PwmIn_GtmTim_11" 449 "DFC_PwmIn_SB_0" 450 "DFC_PwmIn_SB_1" 451 "DFC_PwmIn_SB_2" 452 "DFC_PwmIn_SB_3" 453 "DFC_PwmIn_SB_4" 454 "DFC_PwmIn_SB_5" 455 "DFC_PwmIn_SB_6" 456 "DFC_PwmIn_SB_7" 457 "DFC_PwmIn_SB_8" 458 "DFC_PwmIn_SB_9" 459 "DFC_PwmIn_SB_10" 460 "DFC_PwmIn_SB_11" 461 "DFC_PwmIn_SG_0" 462 "DFC_PwmIn_SG_1" 463 "DFC_PwmIn_SG_2" 464 "DFC_PwmIn_SG_3" 465 "DFC_PwmIn_SG_4" 466 "DFC_PwmIn_SG_5" 467 "DFC_PwmIn_SG_6" 468 "DFC_PwmIn_SG_7" 469 "DFC_PwmIn_SG_8" 470 "DFC_PwmIn_SG_9" 471 "DFC_PwmIn_SG_10" 472 "DFC_PwmIn_SG_11" 473 "DFC_PwmIn_Sig_0" 474 "DFC_PwmIn_Sig_1" 475 "DFC_PwmIn_Sig_2" 476 "DFC_PwmIn_Sig_3" 477 "DFC_PwmIn_Sig_4" 478 "DFC_PwmIn_Sig_5" 479 "DFC_PwmIn_Sig_6" 480 "DFC_PwmIn_Sig_7" 481 "DFC_PwmIn_Sig_8" 482 "DFC_PwmIn_Sig_9" 483 "DFC_PwmIn_Sig_10" 484 "DFC_PwmIn_Sig_11" 485 "DFC_SafeSt_flgDn" 486 "DFC_SnsrSply_SB_0" 487 "DFC_SnsrSply_SB_1" 488 "DFC_SnsrSply_SB_2" 489 "DFC_SnsrSply_SB_3" 490 "DFC_SnsrSply_SB_4" 491 "DFC_SnsrSply_SB_5" 492 "DFC_SnsrSply_SG_0" 493 "DFC_SnsrSply_SG_1" 494 "DFC_SnsrSply_SG_2" 495 "DFC_SnsrSply_SG_3" 496 "DFC_SnsrSply_SG_4" 497 "DFC_SnsrSply_SG_5" 498 "DFC_Spd_NdPls_0" 499 "DFC_Spd_NdPls_1" 500 "DFC_Spd_NdPls_2" 501 "DFC_Spd_NdPls_3" 502 "DFC_Spd_NdPls_4" 503 "DFC_Spd_OP_0" 504 "DFC_Spd_OP_1" 505 "DFC_Spd_OP_2" 506 "DFC_Spd_OP_3" 507 "DFC_Spd_OP_4" 508 "DFC_Spd_Pls_0" 509 "DFC_Spd_Pls_1" 510 "DFC_Spd_Pls_2" 511 "DFC_Spd_Pls_3" 512 "DFC_Spd_Pls_4" 513 "DFC_Spd_SB_0" 514 "DFC_Spd_SB_1" 515 "DFC_Spd_SB_2" 516 "DFC_Spd_SB_3" 517 "DFC_Spd_SB_4" 518 "DFC_Spd_SG_0" 519 "DFC_Spd_SG_1" 520 "DFC_Spd_SG_2" 521 "DFC_Spd_SG_3" 522 "DFC_Spd_SG_4" 523 "DFC_Spd_Sig_0" 524 "DFC_Spd_Sig_1" 525 "DFC_Spd_Sig_2" 526 "DFC_Spd_Sig_3" 527 "DFC_Spd_Sig_4" 528 "DFC_Spd_Sync_0" 529 "DFC_Spd_Sync_1" 530 "DFC_Spd_Sync_2" 531 "DFC_Spd_Sync_3" 532 "DFC_Spd_Sync_4" 533 "DFC_WdgSys" 534 "DFC_WdgWd" 535 "DFC_AcceleratorPedalErrorRx" 536 "DFC_AccumulatorChargeFault" 537 "DFC_AltitudeErrorRx" 538 "DFC_BLDCPumpDerateRx" 539 "DFC_BLDCPumpErrorRx" 540 "DFC_BrakePressureErrorRx" 541 "DFC_BrakeSwitchErrorRx" 542 "DFC_BrakeSwitchImplausible1" 543 "DFC_BrakeSwitchImplausible2" 544 "DFC_BrakeSwitchRateHigh" 545 "DFC_BrakeSwitchSpare1" 546 "DFC_BrakeSwitchSpare2" 547 "DFC_ChargeValveStuck" 548 "DFC_Clutch1AdaptationFault" 549 "DFC_Clutch1OverPressure" 550 "DFC_Clutch1UnderPressure" 551 "DFC_Clutch2AdaptationFault" 552 "DFC_Clutch2OverPressure" 553 "DFC_Clutch2UnderPressure" 554 "DFC_ClutchCoolingValveFault" 555 "DFC_ClutchCoolingValveStuck" 556 "DFC_ClutchOverTempoerature" 557 "DFC_ClutchShutOffValveFault" 558 "DFC_CoolantTempErrorRx" 559 "DFC_CoolingPressureImplausible" 560 "DFC_CoolingPressureRateHigh" 561 "DFC_CoolingPressureTooHigh" 562 "DFC_CoolingPressureTooLow" 563 "DFC_CrntCtrl_Reg_1" 564 "DFC_CrntCtrl_Reg_10" 565 "DFC_CrntCtrl_Reg_11" 566 "DFC_CrntCtrl_Reg_12" 567 "DFC_CrntCtrl_Reg_16" 568 "DFC_CrntCtrl_Reg_17" 569 "DFC_CrntCtrl_Reg_18" 570 "DFC_CrntCtrl_Reg_19" 571 "DFC_CrntCtrl_Reg_2" 572 "DFC_CrntCtrl_Reg_3" 573 "DFC_CrntCtrl_Reg_6" 574 "DFC_CrntCtrl_Reg_7" 575 "DFC_CrntCtrl_Reg_9" 576 "DFC_DSTSpare1" 577 "DFC_DSTSpare2" 578 "DFC_DWCSpare1" 579 "DFC_DWCSpare2" 580 "DFC_DWCSpare3" 581 "DFC_DWCSpare4" 582 "DFC_DWCSpare5" 583 "DFC_DWCSpare6" 584 "DFC_DWCSpare7" 585 "DFC_DoorStatusErrorRx" 586 "DFC_DownSwImplausible" 587 "DFC_DownSwRateHigh" 588 "DFC_DownSwSpare1" 589 "DFC_DownSwSpare2" 590 "DFC_EM1SpeedErrorRx" 591 "DFC_ENGDriveTorqueImplausible" 592 "DFC_ENGEngineProblem" 593 "DFC_ENGIdiotStart" 594 "DFC_ENGSpare1" 595 "DFC_ENGSpare2" 596 "DFC_ESPStatusErrorRx" 597 "DFC_EngineOilTempErrorRx" 598 "DFC_EngineSpeedErrorRx" 599 "DFC_EngineSpeedPWMImplausible1" 600 "DFC_EngineSpeedPWMImplausible2" 601 "DFC_EngineSpeedPWMRateHigh" 602 "DFC_EngineSpeedPWMSpare1" 603 "DFC_EngineSpeedPWMSpare2" 604 "DFC_EngineTorqueErrorRx" 605 "DFC_ExternalTempErrorRx" 606 "DFC_FailStuckNFault" 607 "DFC_FrontLeftWheelSpeedErrorRx" 608 "DFC_FrontRightWheelSpeedErrorRx" 609 "DFC_GearCoolingValveStuck" 610 "DFC_K1PressureImplausible" 611 "DFC_K1PressureRateHigh" 612 "DFC_K1PressureSpare1" 613 "DFC_K1PressureSpare2" 614 "DFC_K1SpeedHigh" 615 "DFC_K1SpeedImplausible" 616 "DFC_K1SpeedSpare1" 617 "DFC_K1SpeedSpare2" 618 "DFC_K2PressureImplausible" 619 "DFC_K2PressureRateHigh" 620 "DFC_K2PressureSpare1" 621 "DFC_K2PressureSpare2" 622 "DFC_K2SpeedHigh" 623 "DFC_K2SpeedImplausible" 624 "DFC_K2SpeedSpare1" 625 "DFC_K2SpeedSpare2" 626 "DFC_L2ClutchPressureVsCurrentOdd" 627 "DFC_L2ClutchTorqueDirection" 628 "DFC_L2DoubleClutchEngagement" 629 "DFC_L2DoubleGearEven" 630 "DFC_L2EM1ShaftOverspeed" 631 "DFC_L2EPBWhenMoving" 632 "DFC_L2EvenClutchGradientInCreep" 633 "DFC_L2ForwardDriveEven" 634 "DFC_L2ForwardDriveOdd" 635 "DFC_L2ForwardGearAndMode" 636 "DFC_L2GearCombinationEM1Overspeed" 637 "DFC_L2GearCombinationRequest" 638 "DFC_L2InputShaftEngineOverspeed" 639 "DFC_L2InsufficientLubrication" 640 "DFC_L2InvalidDownshiftOdd" 641 "DFC_L2InvalidGearControl" 642 "DFC_L2LeaveNeutral" 643 "DFC_L2LeavePark" 644 "DFC_L2ModeDisplay" 645 "DFC_L2ModeSelection" 646 "DFC_L2MovementWithChargeCable" 647 "DFC_L2OddClutchGradientInCreep" 648 "DFC_L2OddShaftAccelerationImplausible" 649 "DFC_L2ParkFailNoEPB" 650 "DFC_L2ParkPosition" 651 "DFC_L2ParkValveOverride" 652 "DFC_L2ParkWhenMoving" 653 "DFC_L2ReferenceSpeedFail" 654 "DFC_L2ReverseDrive" 655 "DFC_L2ShaftOverSpeedFromIP" 656 "DFC_L2ShaftOverSpeedFromOP" 657 "DFC_L2Spare1" 658 "DFC_L2Spare2" 659 "DFC_L2TorqueNoShift" 660 "DFC_L2TorqueRequestCupOfFuel" 661 "DFC_L2VGPOverride" 662 "DFC_L2VKUGLOveride" 663 "DFC_L2VSS1Overirde" 664 "DFC_L2VSS2Overirde" 665 "DFC_LatAccErrorRx" 666 "DFC_LinePressureImplausible" 667 "DFC_LinePressureLeakageHigh" 668 "DFC_LinePressureRateHigh" 669 "DFC_LinePressureSpare1" 670 "DFC_LinePressureSpare2" 671 "DFC_LinePressureTooHigh" 672 "DFC_LinePressureTooLow" 673 "DFC_LongAccErrorRx" 674 "DFC_LubeOilOverTemperature" 675 "DFC_LubeTemperatureImplausible" 676 "DFC_LubeTemperatureRateHigh" 677 "DFC_LubeTemperatureSpare1" 678 "DFC_LubeTemperatureSpare2" 679 "DFC_MOTEngineProblem" 680 "DFC_MOTSpare1" 681 "DFC_MOTSpare2" 682 "DFC_ModeMSwImplausible" 683 "DFC_ModeMSwSpare1" 684 "DFC_ModeMSwSpare2" 685 "DFC_ModeMSwSwRateHigh" 686 "DFC_ModePSwImplausible" 687 "DFC_ModePSwSpare1" 688 "DFC_ModePSwSpare2" 689 "DFC_ModePSwSwRateHigh" 690 "DFC_ModeRSwImplausible" 691 "DFC_ModeRSwSpare1" 692 "DFC_ModeRSwSpare2" 693 "DFC_ModeRSwSwRateHigh" 694 "DFC_ParkLockDisengageFail" 695 "DFC_ParkLockEngageFail" 696 "DFC_ParkLockPosImplausible" 697 "DFC_ParkLockPosRateHigh" 698 "DFC_ParkLockPosSpare1" 699 "DFC_ParkLockPosSpare2" 700 "DFC_PumpResponseFault" 701 "DFC_PumpSpeedError" 702 "DFC_RearLeftWheelSpeedErrorRx" 703 "DFC_RearRightWheelSpeedErrorRx" 704 "DFC_RedSpeedHigh" 705 "DFC_RedSpeedImplausible" 706 "DFC_RedSpeedSpare1" 707 "DFC_RedSpeedSpare2" 708 "DFC_SEQSpare1" 709 "DFC_SEQSpare2" 710 "DFC_SEQTimeout" 711 "DFC_Spare_0" 712 "DFC_Spare_1" 713 "DFC_Spare_2" 714 "DFC_Spare_3" 715 "DFC_Spare_4" 716 "DFC_Spare_5" 717 "DFC_Spare_6" 718 "DFC_Spare_7" 719 "DFC_Spare_8" 720 "DFC_Spare_9" 721 "DFC_SumpOilOverTemperature" 722 "DFC_SumpTemperatureImplausible" 723 "DFC_SumpTemperatureRateHigh" 724 "DFC_SumpTemperatureSpare1" 725 "DFC_SumpTemperatureSpare2" 726 "DFC_SynchroA1EngageFault" 727 "DFC_SynchroA1SpitoutInShiftFault" 728 "DFC_SynchroA1SpitoutNoShiftFault" 729 "DFC_SynchroA1StuckFault" 730 "DFC_SynchroA2EngageFault" 731 "DFC_SynchroA2SpitoutInShiftFault" 732 "DFC_SynchroA2SpitoutNoShiftFault" 733 "DFC_SynchroA2StuckFault" 734 "DFC_SynchroAOutOfNInShiftFault" 735 "DFC_SynchroAOutOfNNoShiftFault" 736 "DFC_SynchroAPosImplausible" 737 "DFC_SynchroAPosRateHigh" 738 "DFC_SynchroAPosSpare1" 739 "DFC_SynchroAPosSpare2" 740 "DFC_SynchroB1EngageFault" 741 "DFC_SynchroB1SpitoutInShiftFault" 742 "DFC_SynchroB1SpitoutNoShiftFault" 743 "DFC_SynchroB1StuckFault" 744 "DFC_SynchroB2EngageFault" 745 "DFC_SynchroB2SpitoutInShiftFault" 746 "DFC_SynchroB2SpitoutNoShiftFault" 747 "DFC_SynchroB2StuckFault" 748 "DFC_SynchroBOutOfNInShiftFault" 749 "DFC_SynchroBOutOfNNoShiftFault" 750 "DFC_SynchroBPosImplausible" 751 "DFC_SynchroBPosRateHigh" 752 "DFC_SynchroBPosSpare1" 753 "DFC_SynchroBPosSpare2" 754 "DFC_SynchroC1EngageFault" 755 "DFC_SynchroC1SpitoutInShiftFault" 756 "DFC_SynchroC1SpitoutNoShiftFault" 757 "DFC_SynchroC1StuckFault" 758 "DFC_SynchroC2EngageFault" 759 "DFC_SynchroC2SpitoutInShiftFault" 760 "DFC_SynchroC2SpitoutNoShiftFault" 761 "DFC_SynchroC2StuckFault" 762 "DFC_SynchroCOutOfNInShiftFault" 763 "DFC_SynchroCOutOfNNoShiftFault" 764 "DFC_SynchroCPosImplausible" 765 "DFC_SynchroCPosRateHigh" 766 "DFC_SynchroCPosSpare1" 767 "DFC_SynchroCPosSpare2" 768 "DFC_SynchroD1EngageFault" 769 "DFC_SynchroD1SpitoutInShiftFault" 770 "DFC_SynchroD1SpitoutNoShiftFault" 771 "DFC_SynchroD1StuckFault" 772 "DFC_SynchroDOutOfNInShiftFault" 773 "DFC_SynchroDOutOfNNoShiftFault" 774 "DFC_SynchroDPosImplausible" 775 "DFC_SynchroDPosRateHigh" 776 "DFC_SynchroDPosSpare1" 777 "DFC_SynchroDPosSpare2" 778 "DFC_SynchroF1EngageFault" 779 "DFC_SynchroF1SpitoutInShiftFault" 780 "DFC_SynchroF1SpitoutNoShiftFault" 781 "DFC_SynchroF1StuckFault" 782 "DFC_SynchroF2EngageFault" 783 "DFC_SynchroF2SpitoutInShiftFault" 784 "DFC_SynchroF2SpitoutNoShiftFault" 785 "DFC_SynchroF2StuckFault" 786 "DFC_SynchroFOutOfNInShiftFault" 787 "DFC_SynchroFOutOfNNoShiftFault" 788 "DFC_SynchroFPosImplausible" 789 "DFC_SynchroFPosRateHigh" 790 "DFC_SynchroFPosSpare1" 791 "DFC_SynchroFPosSpare2" 792 "DFC_UpSwImplausible" 793 "DFC_UpSwRateHigh" 794 "DFC_UpSwSpare1" 795 "DFC_UpSwSpare2" 796 "DFC_VehicleSpeedErrorRx" 797 "DFC_WheelTorqueESPErrorRx" 798 "DFC_YawRateErrorRx" 799 "DFC_Can0Motor_01_TO" 800 "DFC_Can0Motor_02_TO" 801 "DFC_Can0Motor_03_TO" 802 "DFC_Can1BYPASS_TDG1_11_TO" 803 "DFC_Can1BYPASS_TDG1_12_TO" 804 "DFC_Can1BYPASS_TDG1_13_TO" 805 "DFC_Can1BYPASS_TDG1_14_TO" 806 "DFC_Can1BYPASS_TDG1_15_TO" 807 "DFC_Can1BYPASS_TDG1_16_PlaceHolder_TO" 808 "DFC_Can1BYPASS_TDG1_17_PlaceHolder_TO" 809 "DFC_Can1BYPASS_TDG1_18_PlaceHolder_TO" 810 "DFC_Can1BYPASS_TDG1_19_Placeholder_TO" 811 "DFC_Can1BYPASS_TDG1_20_Placeholder_TO" 812 "DFC_Can1BYPASS_TDG1_21_TO" 813 "DFC_Can1BYPASS_TDG1_22_TO" 814 "DFC_Can1Cool_Act_Sts_TO" 815 "DFC_DsmTest0" 816 "DFC_FrAACC_06ISigGroup_ACC_06_TO" 817 "DFC_FrAACC_06_TO" 818 "DFC_FrAACC_07ISigGroup_ACC_07_TO" 819 "DFC_FrAACC_07_TO" 820 "DFC_FrAAirbag_01ISigGroup_Airbag_01_TO" 821 "DFC_FrAAirbag_01_TO" 822 "DFC_FrAAirbag_02ISigGroup_Airbag_02_TO" 823 "DFC_FrAAirbag_02_TO" 824 "DFC_FrABCM_01_TO" 825 "DFC_FrABremse_EV_01ISigGroup_Bremse_EV_01_TO" 826 "DFC_FrABremse_EV_01_TO" 827 "DFC_FrABremse_EV_02ISigGroup_Bremse_EV_02_TO" 828 "DFC_FrABremse_EV_02_TO" 829 "DFC_FrACharisma_01_TO" 830 "DFC_FrADiagnose_01_TO" 831 "DFC_FrAEBKV_01ISigGroup_EBKV_01_TO" 832 "DFC_FrAEBKV_01_TO" 833 "DFC_FrAEM1_HYB_06_TO" 834 "DFC_FrAEM1_HYB_12ISigGroup_EM1_HYB_12_TO" 835 "DFC_FrAEM1_HYB_12_TO" 836 "DFC_FrAEPB_01ISigGroup_EPB_01_TO" 837 "DFC_FrAEPB_01_TO" 838 "DFC_FrAESP_03ISigGroup_ESP_03_TO" 839 "DFC_FrAESP_03_TO" 840 "DFC_FrAESP_05ISigGroup_ESP_05_TO" 841 "DFC_FrAESP_05_TO" 842 "DFC_FrAESP_07ISigGroup_ESP_07_TO" 843 "DFC_FrAESP_07_TO" 844 "DFC_FrAESP_08ISigGroup_ESP_08_TO" 845 "DFC_FrAESP_08_TO" 846 "DFC_FrAESP_15ISigGroup_ESP_15_TO" 847 "DFC_FrAESP_15_TO" 848 "DFC_FrAESP_20ISigGroup_ESP_20_TO" 849 "DFC_FrAESP_20_TO" 850 "DFC_FrAESP_21ISigGroup_ESP_21_TO" 851 "DFC_FrAESP_21_TO" 852 "DFC_FrAESP_22ISigGroup_ESP_22_TO" 853 "DFC_FrAESP_22_TO" 854 "DFC_FrAESP_23ISigGroup_ESP_23_TO" 855 "DFC_FrAESP_23_TO" 856 "DFC_FrAESP_24ISigGroup_ESP_24_TO" 857 "DFC_FrAESP_24_TO" 858 "DFC_FrAESP_26_TO" 859 "DFC_FrAESP_28ISigGroup_ESP_28_TO" 860 "DFC_FrAESP_28_TO" 861 "DFC_FrAESP_31ISigGroup_ESP_31_TO" 862 "DFC_FrAESP_31_TO" 863 "DFC_FrAESP_32ISigGroup_ESP_32_TO" 864 "DFC_FrAESP_32_TO" 865 "DFC_FrAESP_33ISigGroup_ESP_33_TO" 866 "DFC_FrAESP_33_TO" 867 "DFC_FrAESP_41ISigGroup_ESP_41_TO" 868 "DFC_FrAESP_41_TO" 869 "DFC_FrAESP_44ISigGroup_ESP_44_TO" 870 "DFC_FrAESP_44_TO" 871 "DFC_FrAKlemmen_Status_01ISigGroup_Klemmen_Status_01_TO" 872 "DFC_FrAKlemmen_Status_01_TO" 873 "DFC_FrAKlima_11_TO" 874 "DFC_FrAKombi_02_TO" 875 "DFC_FrALCV_01ISigGroup_LCV_01_TO" 876 "DFC_FrALCV_01_TO" 877 "DFC_FrALWI_01ISigGroup_LWI_01_TO" 878 "DFC_FrALWI_01_TO" 879 "DFC_FrAMFL_Tasten_01_TO" 880 "DFC_FrAMSG_EM1_18_TO" 881 "DFC_FrAMSG_EM1_29_TO" 882 "DFC_FrAMotor_07_TO" 883 "DFC_FrAMotor_11ISigGroup_Motor_11_TO" 884 "DFC_FrAMotor_11_TO" 885 "DFC_FrAMotor_12ISigGroup_Motor_12_TO" 886 "DFC_FrAMotor_12_TO" 887 "DFC_FrAMotor_14ISigGroup_Motor_14_TO" 888 "DFC_FrAMotor_14_TO" 889 "DFC_FrAMotor_16_TO" 890 "DFC_FrAMotor_17_TO" 891 "DFC_FrAMotor_18_TO" 892 "DFC_FrAMotor_20ISigGroup_Motor_20_TO" 893 "DFC_FrAMotor_20_TO" 894 "DFC_FrAMotor_27ISigGroup_Motor_27_TO" 895 "DFC_FrAMotor_27_TO" 896 "DFC_FrAMotor_28ISigGroup_Motor_28_TO" 897 "DFC_FrAMotor_28_TO" 898 "DFC_FrAMotor_35_TO" 899 "DFC_FrAMotor_38_LB_TO" 900 "DFC_FrAMotor_47_TO" 901 "DFC_FrAMotor_Code_01ISigGroup_Motor_Code_01_TO" 902 "DFC_FrAMotor_Code_01_TO" 903 "DFC_FrAMotor_Hybrid_11_TO" 904 "DFC_FrAMotor_TS_01ISigGroup_Motor_TS_01_TO" 905 "DFC_FrAMotor_TS_01_TO" 906 "DFC_FrAMotor_TS_02ISigGroup_Motor_TS_02_TO" 907 "DFC_FrAMotor_TS_02_TO" 908 "DFC_FrAMotor_TS_03ISigGroup_Motor_TS_03_TO" 909 "DFC_FrAMotor_TS_03_TO" 910 "DFC_FrANVEM_02_TO" 911 "DFC_FrANVEM_05_TO" 912 "DFC_FrAOBD_01_TO" 913 "DFC_FrAOBD_02_TO" 914 "DFC_FrASARA_06ISigGroup_SARA_06_TO" 915 "DFC_FrASARA_06_TO" 916 "DFC_FrASysteminfo_01_TO" 917 "DFC_FrATSG_FT_02ISigGroup_TSG_FT_02_TO" 918 "DFC_FrATSG_FT_02_TO" 919 "DFC_FrATSK_06ISigGroup_TSK_06_TO" 920 "DFC_FrATSK_06_TO" 921 "DFC_FrATSK_08ISigGroup_TSK_08_TO" 922 "DFC_FrATSK_08_TO" 923 "DFC_FrAVIN_01_0_TO" 924 "DFC_FrAVIN_01_1_TO" 925 "DFC_FrAVIN_01_2_TO" 926 "DFC_IPT" 927 "DFC_L3Error" 928 "DFC_SftyCfgMon" 929 "DFC_SftyShtOff" 930 "DFC_DsmTest4" 931 "DFC_BSWM_E_ACTION_FAILED" 932 "DFC_BSWM_E_INTRPTQUEUE_FULL" 933 "DFC_CANSM_E_BUS_OFF_NETWORK_0" 934 "DFC_CANSM_E_BUS_OFF_NETWORK_1" 935 "DFC_CANSM_E_BUS_OFF_NETWORK_2" 936 "DFC_CANSM_E_BUS_OFF_NETWORK_3" 937 "DFC_FRSM_E_CLUSTER_STARTUP" 938 "DFC_FRTRCV_E_NO_TRCV_CONTROL_0" 939 "DFC_FR_E_ACCESS" 940 "DFC_RBA_IOEXTLIB_KEEPALIVE_DRV" 941 "DFC_RBA_IOEXTLIB_KEEPALIVE_INI" 942 "DFC_rba_MultiStackTrace_Threshold" 943 "DFC_CAN_E_TIMEOUT" 944 "DFC_FRSM_E_CLUSTER_SYNC_LOSS" 945 "DFC_PDUR_E_INIT_FAILED" 946 "DFC_PDUR_E_PDU_INSTANCE_LOST" 947 "DFC_rba_IoSigRtc_StopCounter" 948 "DFC_rba_T15_Diag_ComInVld_Event" 949 "DFC_rba_T15_Diag_ComOff_HwOn_Event" 950 "DFC_rba_T15_Diag_ComOn_HwOff_Event" 951 "DFC_DSMDummy" 952 "DFC_DsmTest3";
VAL_ 2041 SEQ_ShiftSeque_1_iftSequencer_sm 0 "DCT_ShiftComplete" 1 "DCT_AssessShift" 2 "DCT_InGear" 3 "DCT_NeutralSelection" 4 "DCT_PrepareClutch" 5 "DCT_SpeedPhase" 6 "DCT_TorquePhase" 7 "DCT_PerformShift";
VAL_ 2041 SEQ_ShiftSeque_2_iftSequencer_sm 0 "P2P3_ShiftComplete" 1 "P2P3_DisengageToNeutral" 2 "P2P3_EngageClutch" 3 "P2P3_PrepareClutch" 4 "P2P3_RollTorqueOff" 5 "P2P3_RollTorqueOn" 6 "P2P3_SelectandPrepareClutch" 7 "P2P3_PerformShift";
VAL_ 2041 SEQ_TargetHybMode 0 "IOP_HybUndefined" 1 "IOP_HybUncoupled" 2 "IOP_HybP2OddIn" 3 "IOP_HybP2EvenIn" 4 "IOP_HybP2OddAndEvenIn" 5 "IOP_HybP3OddIn" 6 "IOP_HybP3EvenIn" 7 "IOP_HybP3Lay";
VAL_ 2041 SEQ_K2Request 0 "DWC_Initialise" 1 "DWC_Neutral" 2 "DWC_Prepare" 3 "DWC_TorquePhase" 4 "DWC_InGear" 5 "DWC_SpeedPhase" 6 "DWC_Disengage" 7 "DWC_SelfTesting";
VAL_ 2041 SEQ_K1Request 0 "DWC_Initialise" 1 "DWC_Neutral" 2 "DWC_Prepare" 3 "DWC_TorquePhase" 4 "DWC_InGear" 5 "DWC_SpeedPhase" 6 "DWC_Disengage" 7 "DWC_SelfTesting";
VAL_ 2041 SEQ_Input2Request 0 "GAC_Initialise" 1 "GAC_Wait" 2 "GAC_Select";
VAL_ 2041 SEQ_Input1Request 0 "GAC_Initialise" 1 "GAC_Wait" 2 "GAC_Select";
VAL_ 2041 SEQ_HybRequest 0 "GAC_Initialise" 1 "GAC_Wait" 2 "GAC_Select";
VAL_ 2041 SEQ_HybMode 0 "IOP_HybUndefined" 1 "IOP_HybUncoupled" 2 "IOP_HybP2OddIn" 3 "IOP_HybP2EvenIn" 4 "IOP_HybP2OddAndEvenIn" 5 "IOP_HybP3OddIn" 6 "IOP_HybP3EvenIn" 7 "IOP_HybP3Lay";
VAL_ 2041 SEQ_EngineRequest 0 "ENG_Initialise" 1 "ENG_NoIntervention" 2 "ENG_TorqueRollOff" 3 "ENG_SpeedControl" 4 "ENG_TorqueRollOn" 5 "ENG_ModulateTorque" 6 "ENG_TorqueLimit";
VAL_ 2041 SEQ_CurrentHybMode 0 "IOP_HybUndefined" 1 "IOP_HybUncoupled" 2 "IOP_HybP2OddIn" 3 "IOP_HybP2EvenIn" 4 "IOP_HybP2OddAndEvenIn" 5 "IOP_HybP3OddIn" 6 "IOP_HybP3EvenIn" 7 "IOP_HybP3Lay";
VAL_ 2041 PCL_PressureAvailable 0 "FALSE" 1 "TRUE";
VAL_ 2041 MOT_MotorStatus 0 "ENG_Initialising" 1 "ENG_InProgress" 2 "ENG_Complete" 3 "ENG_Failed";
VAL_ 2041 MOT_MotorState 0 "ENG_Initialise" 1 "ENG_NoIntervention" 2 "ENG_TorqueRollOff" 3 "ENG_SpeedControl" 4 "ENG_TorqueRollOn" 5 "ENG_ModulateTorque" 6 "ENG_TorqueLimit";
VAL_ 2041 IOP_TransmissionemperatureStatus 0 "FALSE" 1 "TRUE";
VAL_ 2041 IOP_StatusSumpOilTemperature 0 "FALSE" 1 "TRUE";
VAL_ 2041 IOP_StatusSpeedSensorOdd 0 "FALSE" 1 "TRUE";
VAL_ 2041 IOP_StatusSpeedSensorGear37 0 "FALSE" 1 "TRUE";
VAL_ 2041 IOP_StatusSpeedSensorEven 0 "FALSE" 1 "TRUE";
VAL_ 2041 IOP_StatusPosnSynchroF 0 "FALSE" 1 "TRUE";
VAL_ 2041 IOP_StatusPosnSynchroD 0 "FALSE" 1 "TRUE";
VAL_ 2041 IOP_StatusPosnSynchroC 0 "FALSE" 1 "TRUE";
VAL_ 2041 IOP_StatusPosnSynchroB 0 "FALSE" 1 "TRUE";
VAL_ 2041 IOP_StatusPosnSynchroA 0 "FALSE" 1 "TRUE";
VAL_ 2041 IOP_SS6_Status 0 "FALSE" 1 "TRUE";
VAL_ 2041 IOP_SS5_Status 0 "FALSE" 1 "TRUE";
VAL_ 2041 IOP_SS4_Status 0 "FALSE" 1 "TRUE";
VAL_ 2041 IOP_SS3_Status 0 "FALSE" 1 "TRUE";
VAL_ 2041 IOP_SS2_Status 0 "FALSE" 1 "TRUE";
VAL_ 2041 IOP_SS1_Status 0 "FALSE" 1 "TRUE";
VAL_ 2041 IOP_ParkLockPosStatus 0 "FALSE" 1 "TRUE";
VAL_ 2041 IOP_ParkButtonStatus 0 "FALSE" 1 "TRUE";
VAL_ 2041 IOP_ParkButton 0 "FALSE" 1 "TRUE";
VAL_ 2041 IOP_KL30_3_Status 0 "FALSE" 1 "TRUE";
VAL_ 2041 IOP_KL30_2_Status 0 "FALSE" 1 "TRUE";
VAL_ 2041 IOP_KL30_1_Status 0 "FALSE" 1 "TRUE";
VAL_ 2041 IOP_KL15 0 "FALSE" 1 "TRUE";
VAL_ 2041 IOP_InternalOutputSpeedStatus 0 "FALSE" 1 "TRUE";
VAL_ 2041 IOP_BrakeSwitch 0 "FALSE" 1 "TRUE";
VAL_ 2041 IOP_SpeedControlType 0 "IOP_Speed_NoIntervention" 1 "IOP_Speed_Pullaway" 2 "IOP_Speed_PowerOnUpshift" 3 "IOP_Speed_PowerOnDownshift" 4 "IOP_Speed_PowerOffUpshift" 5 "IOP_Speed_ActiveEMachine" 6 "IOP_Speed_Limitation" 7 "IOP_Speed_PowerOffDownshift" 8 "IOP_Speed_ASGUpshift" 9 "IOP_Speed_ASGDownshift" 10 "IOP_Speed_AMTUpshift" 11 "IOP_Speed_PreControlInjectionCut";
VAL_ 2041 IOP_P2P3Config 0 "IOP_P2P3Config_Init" 1 "IOP_P2P3Config_P2" 2 "IOP_P2P3Config_P2_Backup" 3 "IOP_P2P3Config_P3" 4 "IOP_P2P3Config_P3_Backup" 5 "IOP_P2P3Config_Decoupled" 6 "IOP_P2P3Config_Transition" 7 "IOP_P2P3Config_Default";
VAL_ 2041 IOP_MaxEngineTorqueEnabled 0 "FALSE" 1 "TRUE";
VAL_ 2041 IOP_GearboxMILStatus 0 "FALSE" 1 "TRUE";
VAL_ 2041 IOP_DrivingModeIst 0 "DrivingModeIst_Init" 1 "DrivingModeIst_Pos1" 2 "DrivingModeIst_Pos2" 3 "DrivingModeIst_Pos3" 4 "DrivingModeIst_Pos4" 5 "DrivingModeIst_Drive" 6 "DrivingModeIst_Neutral" 7 "DrivingModeIst_Reverse" 8 "DrivingModeIst_Park" 10 "DrivingModeIst_TipPlus" 11 "DrivingModeIst_TipMinus" 12 "DrivingModeIst_Sport" 13 "DrivingModeIst_TempManual" 14 "DrivingModeIst_TipMode";
VAL_ 2041 IOP_DrivingModeDisplay 0 "IOP_Display_Intermediate" 1 "IOP_Display_Park" 2 "IOP_Display_Reverse" 3 "IOP_Display_Neutral" 4 "IOP_Display_Drive" 5 "IOP_Display_Sport" 6 "IOP_Display_Manual" 7 "IOP_Display_TempManual" 8 "IOP_Display_E" 9 "IOP_Display_MS" 10 "IOP_Display_SportPlus" 11 "IOP_Display_MS_Plus" 12 "IOP_Display_Offroad" 13 "IOP_Display_B";
VAL_ 2041 IOP_TransMode 0 "IOP_WINTERMODE" 1 "IOP_NORMALMODE" 2 "IOP_SPORTMODE" 3 "IOP_TRACKMODE" 4 "IOP_ELECTRICMODE1" 5 "IOP_ELECTRICMODE2";
VAL_ 2041 IOP_KL50EngStart 0 "FALSE" 1 "TRUE";
VAL_ 2041 GAC_MdHybEnga 0 "IOP_HybUndefined" 1 "IOP_HybUncoupled" 2 "IOP_HybP2OddIn" 3 "IOP_HybP2EvenIn" 4 "IOP_HybP2OddAndEvenIn" 5 "IOP_HybP3OddIn" 6 "IOP_HybP3EvenIn" 7 "IOP_HybP3Lay";
VAL_ 2041 DWC_K2Status 0 "DWC_Initialising" 1 "DWC_InProgress" 2 "DWC_Complete" 3 "DWC_Failed";
VAL_ 2041 DWC_K2State 0 "DWC_Initialise" 1 "DWC_Neutral" 2 "DWC_Prepare" 3 "DWC_TorquePhase" 4 "DWC_InGear" 5 "DWC_SpeedPhase" 6 "DWC_Disengage" 7 "DWC_SelfTesting";
VAL_ 2041 DWC_K1Status 0 "DWC_Initialising" 1 "DWC_InProgress" 2 "DWC_Complete" 3 "DWC_Failed";
VAL_ 2041 DWC_K1State 0 "DWC_Initialise" 1 "DWC_Neutral" 2 "DWC_Prepare" 3 "DWC_TorquePhase" 4 "DWC_InGear" 5 "DWC_SpeedPhase" 6 "DWC_Disengage" 7 "DWC_SelfTesting";
VAL_ 2041 DWC_DownshiftType 0 "DWC_PowerOff" 1 "DWC_PowerOn";
VAL_ 2041 DST_HybridMode 0 "DST_NoRequest" 1 "DST_RegenOC" 2 "DST_RegenIC" 3 "DST_EBoostOC" 4 "DST_EBoostIC" 5 "DST_eDriveOC" 6 "DST_eDriveIC" 7 "DST_eRevOC" 8 "DST_eRevIC" 9 "DST_eCrank" 10 "DST_4WD_Idle" 11 "DST_4WD_EDrive" 12 "DST_4WD_Parallel" 13 "DST_FWD_Serial" 14 "DST_Decouple";
VAL_ 2041 DFES_stChk_00_ 0 "OkNoTst" 1 "OkTested" 2 "OkHealed" 3 "OkRstNoTst" 4 "DefectNoTst" 5 "DefectDelay" 6 "Defect" 7 "DefectRstNoTst";
VAL_ 2041 DFES_stChk_01_ 0 "OkNoTst" 1 "OkTested" 2 "OkHealed" 3 "OkRstNoTst" 4 "DefectNoTst" 5 "DefectDelay" 6 "Defect" 7 "DefectRstNoTst";
VAL_ 2041 DFES_stChk_02_ 0 "OkNoTst" 1 "OkTested" 2 "OkHealed" 3 "OkRstNoTst" 4 "DefectNoTst" 5 "DefectDelay" 6 "Defect" 7 "DefectRstNoTst";
VAL_ 2041 DFES_stChk_03_ 0 "OkNoTst" 1 "OkTested" 2 "OkHealed" 3 "OkRstNoTst" 4 "DefectNoTst" 5 "DefectDelay" 6 "Defect" 7 "DefectRstNoTst";
VAL_ 2041 DFES_stChk_04_ 0 "OkNoTst" 1 "OkTested" 2 "OkHealed" 3 "OkRstNoTst" 4 "DefectNoTst" 5 "DefectDelay" 6 "Defect" 7 "DefectRstNoTst";
VAL_ 2041 DFES_stChk_05_ 0 "OkNoTst" 1 "OkTested" 2 "OkHealed" 3 "OkRstNoTst" 4 "DefectNoTst" 5 "DefectDelay" 6 "Defect" 7 "DefectRstNoTst";
VAL_ 2041 DFES_stChk_06_ 0 "OkNoTst" 1 "OkTested" 2 "OkHealed" 3 "OkRstNoTst" 4 "DefectNoTst" 5 "DefectDelay" 6 "Defect" 7 "DefectRstNoTst";
VAL_ 2041 DFES_stChk_07_ 0 "OkNoTst" 1 "OkTested" 2 "OkHealed" 3 "OkRstNoTst" 4 "DefectNoTst" 5 "DefectDelay" 6 "Defect" 7 "DefectRstNoTst";
VAL_ 2041 DFES_stChk_08_ 0 "OkNoTst" 1 "OkTested" 2 "OkHealed" 3 "OkRstNoTst" 4 "DefectNoTst" 5 "DefectDelay" 6 "Defect" 7 "DefectRstNoTst";
VAL_ 2041 DFES_stChk_09_ 0 "OkNoTst" 1 "OkTested" 2 "OkHealed" 3 "OkRstNoTst" 4 "DefectNoTst" 5 "DefectDelay" 6 "Defect" 7 "DefectRstNoTst";
VAL_ 2041 DFES_stChk_10_ 0 "OkNoTst" 1 "OkTested" 2 "OkHealed" 3 "OkRstNoTst" 4 "DefectNoTst" 5 "DefectDelay" 6 "Defect" 7 "DefectRstNoTst";
VAL_ 2041 DFES_stChk_11_ 0 "OkNoTst" 1 "OkTested" 2 "OkHealed" 3 "OkRstNoTst" 4 "DefectNoTst" 5 "DefectDelay" 6 "Defect" 7 "DefectRstNoTst";
VAL_ 2041 DFES_stChk_12_ 0 "OkNoTst" 1 "OkTested" 2 "OkHealed" 3 "OkRstNoTst" 4 "DefectNoTst" 5 "DefectDelay" 6 "Defect" 7 "DefectRstNoTst";
VAL_ 2041 DFES_stChk_13_ 0 "OkNoTst" 1 "OkTested" 2 "OkHealed" 3 "OkRstNoTst" 4 "DefectNoTst" 5 "DefectDelay" 6 "Defect" 7 "DefectRstNoTst";
VAL_ 2041 DFES_stChk_14_ 0 "OkNoTst" 1 "OkTested" 2 "OkHealed" 3 "OkRstNoTst" 4 "DefectNoTst" 5 "DefectDelay" 6 "Defect" 7 "DefectRstNoTst";
VAL_ 2041 DFES_stChk_15_ 0 "OkNoTst" 1 "OkTested" 2 "OkHealed" 3 "OkRstNoTst" 4 "DefectNoTst" 5 "DefectDelay" 6 "Defect" 7 "DefectRstNoTst";
VAL_ 2041 DFES_stChk_16_ 0 "OkNoTst" 1 "OkTested" 2 "OkHealed" 3 "OkRstNoTst" 4 "DefectNoTst" 5 "DefectDelay" 6 "Defect" 7 "DefectRstNoTst";
VAL_ 2041 DFES_stChk_17_ 0 "OkNoTst" 1 "OkTested" 2 "OkHealed" 3 "OkRstNoTst" 4 "DefectNoTst" 5 "DefectDelay" 6 "Defect" 7 "DefectRstNoTst";
VAL_ 2041 DFES_stChk_18_ 0 "OkNoTst" 1 "OkTested" 2 "OkHealed" 3 "OkRstNoTst" 4 "DefectNoTst" 5 "DefectDelay" 6 "Defect" 7 "DefectRstNoTst";
VAL_ 2041 DFES_stChk_19_ 0 "OkNoTst" 1 "OkTested" 2 "OkHealed" 3 "OkRstNoTst" 4 "DefectNoTst" 5 "DefectDelay" 6 "Defect" 7 "DefectRstNoTst";
VAL_ 2041 DFES_stChk_20_ 0 "OkNoTst" 1 "OkTested" 2 "OkHealed" 3 "OkRstNoTst" 4 "DefectNoTst" 5 "DefectDelay" 6 "Defect" 7 "DefectRstNoTst";
VAL_ 2041 DFES_stChk_21_ 0 "OkNoTst" 1 "OkTested" 2 "OkHealed" 3 "OkRstNoTst" 4 "DefectNoTst" 5 "DefectDelay" 6 "Defect" 7 "DefectRstNoTst";
VAL_ 2041 DFES_stChk_22_ 0 "OkNoTst" 1 "OkTested" 2 "OkHealed" 3 "OkRstNoTst" 4 "DefectNoTst" 5 "DefectDelay" 6 "Defect" 7 "DefectRstNoTst";
VAL_ 2041 DFES_stChk_23_ 0 "OkNoTst" 1 "OkTested" 2 "OkHealed" 3 "OkRstNoTst" 4 "DefectNoTst" 5 "DefectDelay" 6 "Defect" 7 "DefectRstNoTst";
VAL_ 2041 DFES_stChk_24_ 0 "OkNoTst" 1 "OkTested" 2 "OkHealed" 3 "OkRstNoTst" 4 "DefectNoTst" 5 "DefectDelay" 6 "Defect" 7 "DefectRstNoTst";
VAL_ 2041 DFES_stChk_25_ 0 "OkNoTst" 1 "OkTested" 2 "OkHealed" 3 "OkRstNoTst" 4 "DefectNoTst" 5 "DefectDelay" 6 "Defect" 7 "DefectRstNoTst";
VAL_ 2041 DFES_stChk_26_ 0 "OkNoTst" 1 "OkTested" 2 "OkHealed" 3 "OkRstNoTst" 4 "DefectNoTst" 5 "DefectDelay" 6 "Defect" 7 "DefectRstNoTst";
VAL_ 2041 DFES_stChk_27_ 0 "OkNoTst" 1 "OkTested" 2 "OkHealed" 3 "OkRstNoTst" 4 "DefectNoTst" 5 "DefectDelay" 6 "Defect" 7 "DefectRstNoTst";
VAL_ 2041 DFES_stChk_28_ 0 "OkNoTst" 1 "OkTested" 2 "OkHealed" 3 "OkRstNoTst" 4 "DefectNoTst" 5 "DefectDelay" 6 "Defect" 7 "DefectRstNoTst";
VAL_ 2041 DFES_stChk_29_ 0 "OkNoTst" 1 "OkTested" 2 "OkHealed" 3 "OkRstNoTst" 4 "DefectNoTst" 5 "DefectDelay" 6 "Defect" 7 "DefectRstNoTst";
VAL_ 2041 IOP_DrivingMode 0 "DrivingMode_Intermediate" 1 "DrivingMode_Init" 5 "DrivingMode_Park" 6 "DrivingMode_Reverse" 7 "DrivingMode_Neutral" 8 "DrivingMode_Drive" 9 "DrivingMode_Sport" 10 "DrivingMode_Efficiency" 13 "DrivingMode_TipS" 14 "DrivingMode_TipD" 15 "DrivingMode_Fail";
VAL_ 2041 DST_DrivingMode 0 "DST_Neutral" 1 "DST_Reverse" 2 "DST_Winter" 3 "DST_Normal" 4 "DST_Sport" 5 "DST_Race" 6 "DST_Manual" 7 "DST_Forward" 8 "DST_Electric" 9 "DST_ElectricRX" 10 "DST_NotDefined" 11 "DST_Park";
