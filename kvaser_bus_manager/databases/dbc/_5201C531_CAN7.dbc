VERSION "HIPBNYYYYYYYYYYYYYYYYYYYYYYYYYYY"

BS_:

BU_: Logger _5201C531

BO_ 2011 DTODAQ0: 8 _5201C531
  SG_ PID0 M : 0|8@1+ (1,0) [0|0] "" Logger
  SG_ GAC_GAC_HybBankCtrl_sm m0 : 8|8@1+ (1,0) [0|3] "" Logger

BO_ 2041 DTODAQ1: 8 _5201C531
  SG_ PID1 M : 0|8@1+ (1,0) [0|0] "" Logger
  SG_ DWC_IOP_SystemStatus m1 : 8|32@1+ (1,0) [0|4.29497e+09] "" Logger
  SG_ rbg_BattSply_stQly m1 : 40|16@1+ (1,0) [0|65535] "" Logger
  SG_ IOP_CommsTx_IOP_LimitTorqueGear m1 : 56|8@1+ (1,0) [0|11] "" Logger
  SG_ DWC_DWC_TorqueControl_DWC_ITerm m2 : 8|32@1- (0.0001,-0) [-2000|2000] "" Logger
  SG_ rbg_BattSply_u m2 : 40|16@1+ (0.001,-0) [0|65.535] "V" Logger
  SG_ L2_Lodi_L2_ClutchStatusEven m2 : 56|8@1+ (1,0) [0|3] "" Logger
  SG_ DWC_DWC_TorqueControl_DWC_PITerm m3 : 8|32@1- (0.1,-0) [-4000|4000] "" Logger
  SG_ SWC_HAL_CommsTx__MaxEngineTorque m3 : 40|16@1- (0.1,-0) [-2000|2000] "" Logger
  SG_ L2_Lodi_L2_ClutctatusEvenQuality m3 : 56|8@1- (1,0) [-1|4] "" Logger
  SG_ DWC_NVUSAGEB_DWCatorPlateTempMax m4 : 8|32@1- (0.0001,-0) [-50|1000] "" Logger
  SG_ L2_Lodi_L2_SpeedSecondary m4 : 40|16@1- (1,0) [-20000|20000] "" Logger
  SG_ L2_Lodi_L2_ClutchStatusOdd m4 : 56|8@1+ (1,0) [0|3] "" Logger
  SG_ DWC_NVUSAGEB_D_1_torPlateTempMax m5 : 8|32@1- (0.0001,-0) [-50|1000] "" Logger
  SG_ DWC_DWC_K1Torque m5 : 40|16@1- (0.1,-0) [-2000|2000] "" Logger
  SG_ L2_Lodi_L2_ClutcStatusOddQuality m5 : 56|8@1- (1,0) [-1|4] "" Logger
  SG_ DWC_DWC_K1TorqueFB m6 : 8|16@1- (0.1,-0) [-2000|2000] "" Logger
  SG_ DWC_DWC_K2Torque m6 : 24|16@1- (0.1,-0) [-2000|2000] "" Logger
  SG_ DWC_DWC_K2TorqueFB m6 : 40|16@1- (0.1,-0) [-2000|2000] "" Logger
  SG_ L2_Lodi_L2_Debou_L2_McFcBF_00_07 m6 : 56|8@1+ (1,0) [0|255] "" Logger
  SG_ DWC_DWC_SlipTarget m7 : 8|16@1- (1,0) [-20000|20000] "" Logger
  SG_ DWC_DWC_InputProg_DWC_K1Pressure m7 : 24|16@1- (0.001,-0) [-2|32] "" Logger
  SG_ DWC_DWC_InputProssing_DWC_K1Slip m7 : 40|16@1- (1,0) [-20000|20000] "" Logger
  SG_ L2_Lodi_L2_Debou_L2_McFcBF_08_15 m7 : 56|8@1+ (1,0) [0|255] "" Logger
  SG_ DWC_DWC_InputProg_DWC_K2Pressure m8 : 8|16@1- (0.001,-0) [-2|32] "" Logger
  SG_ DWC_DWC_InputProssing_DWC_K2Slip m8 : 24|16@1- (1,0) [-20000|20000] "" Logger
  SG_ DWC_DWC_K1DeviceWC_CurrentDemand m8 : 40|16@1+ (1,0) [0|5000] "" Logger
  SG_ L2_Lodi_L2_Debou_L2_McFcBF_16_23 m8 : 56|8@1+ (1,0) [0|255] "" Logger
  SG_ DWC_DWC_K1DeviceC_PressureDemand m9 : 8|16@1- (0.001,-0) [-2|32] "" Logger
  SG_ DWC_DWC_K2DeviceWC_CurrentDemand m9 : 24|16@1+ (1,0) [0|5000] "" Logger
  SG_ DWC_DWC_K2DeviceC_PressureDemand m9 : 40|16@1- (0.001,-0) [-2|32] "" Logger
  SG_ L2_Lodi_L2_Debou_L2_McFcBF_24_31 m9 : 56|8@1+ (1,0) [0|255] "" Logger
  SG_ DWC_DWC_TorqueCollerTorqueDemand m10 : 8|16@1+ (0.1,-0) [0|2000] "" Logger
  SG_ DWC_DWC_TorqueCoC_DominantTorque m10 : 24|16@1- (0.1,-0) [-2000|2000] "" Logger
  SG_ DWC_DWC_TorqueCo_FFCTorqueDemand m10 : 40|16@1- (0.1,-0) [-2000|2000] "" Logger
  SG_ L2_Lodi_L2_Debou_L2_McFcBF_32_39 m10 : 56|8@1+ (1,0) [0|255] "" Logger
  SG_ DWC_DWC_TorqueCoutchTargetTorque m11 : 8|16@1+ (0.1,-0) [0|2000] "" Logger
  SG_ DWC_DWC_TorqueControl_DWC_PTerm m11 : 24|16@1- (0.1,-0) [-2000|2000] "" Logger
  SG_ DWC_DWC_TorqueCoWC_PassiveTorque m11 : 40|16@1- (0.1,-0) [-2000|2000] "" Logger
  SG_ L2_Lodi_L2_Debou_L2_McFcBF_40_47 m11 : 56|8@1+ (1,0) [0|255] "" Logger
  SG_ DWC_DWC_TorqueCorol_DWC_SLCError m12 : 8|16@1- (1,0) [-20000|20000] "" Logger
  SG_ DWC_DWC_TorqueCo_DriverTorqueRaw m12 : 24|16@1- (0.1,-0) [-2000|2000] "" Logger
  SG_ DWC_DWC_TorqueCorqueNoGearboxRaw m12 : 40|16@1- (0.1,-0) [-2000|2000] "" Logger
  SG_ L2_Lodi_L2_Debou_L2_McFcBF_48_49 m12 : 56|8@1+ (1,0) [0|255] "" Logger
  SG_ GAC_GAC_PosnGrac0_A m13 : 8|16@1- (0.001,-0) [-20|20] "" Logger
  SG_ GAC_GAC_PosnGrac1_B m13 : 24|16@1- (0.001,-0) [-20|20] "" Logger
  SG_ GAC_GAC_PosnGrac2_C m13 : 40|16@1- (0.001,-0) [-20|20] "" Logger
  SG_ DST_DST_ShiftMode m13 : 56|8@1+ (1,0) [0|16] "" Logger
  SG_ GAC_GAC_PosnGrac3_D m14 : 8|16@1- (0.001,-0) [-20|20] "" Logger
  SG_ GAC_GAC_PosnGrac4_F m14 : 24|16@1- (0.001,-0) [-20|20] "" Logger
  SG_ PCL_PCL_Control_CL_BitFieldFault m14 : 40|16@1+ (1,0) [0|65535] "" Logger
  SG_ DST_DST_LodiParkInterface_sm m14 : 56|8@1+ (1,0) [0|5] "" Logger
  SG_ PCL_PCL_Control_PCL_FlowCC m15 : 8|16@1+ (0.01,-0) [0|127.5] "litres/min" Logger
  SG_ PCL_PCL_Control_PCL_FlowGL_Motor m15 : 24|16@1+ (0.01,-0) [0|127.5] "litres/min" Logger
  SG_ PCL_PCL_Control_PCL_FlowGL_Valve m15 : 40|16@1+ (0.01,-0) [0|127.5] "litres/min" Logger
  SG_ DST_DST_ModeSelectGeneric_sm m15 : 56|8@1+ (1,0) [0|4] "" Logger
  SG_ PCL_PCL_Control__FlowGearLubeDem m16 : 8|16@1+ (0.01,-0) [0|127.5] "litres/min" Logger
  SG_ PCL_PCL_Control_iags_PCL_FlowLPS m16 : 24|16@1+ (0.01,-0) [0|100] "" Logger
  SG_ PCL_PCL_Control__PressureCooling m16 : 40|16@1- (0.001,-0) [-2|32] "" Logger
  SG_ DWC_DWC_DCDemandK1 m16 : 56|8@1+ (1,0) [0|3] "" Logger
  SG_ PCL_PCL_Control_essureCoolingMax m17 : 8|16@1- (0.001,-0) [-2|32] "" Logger
  SG_ PCL_PCL_Control_essureCoolingMin m17 : 24|16@1- (0.001,-0) [-2|32] "" Logger
  SG_ PCL_PCL_Control_reCoolingNominal m17 : 40|16@1- (0.001,-0) [-2|32] "" Logger
  SG_ DWC_DWC_DCDemandK2 m17 : 56|8@1+ (1,0) [0|3] "" Logger
  SG_ IOP_TransmissionOilTemperature m18 : 8|16@1- (1,0) [-50|200] "" Logger
  SG_ IOP_SumpOilTemperature m18 : 24|16@1- (1,0) [-50|200] "" Logger
  SG_ IOP_SpeedShaftReduction m18 : 40|16@1- (1,0) [-20000|20000] "" Logger
  SG_ DWC_DWC_FlgCleanK1 m18 : 56|8@1+ (1,0) [0|255] "" Logger
  SG_ IOP_SpeedSensorGear37 m19 : 8|16@1- (1,0) [-20000|20000] "" Logger
  SG_ IOP_SpeedSensorEven m19 : 24|16@1- (1,0) [-20000|20000] "" Logger
  SG_ IOP_ParkLockPos m19 : 40|16@1- (0.001,-0) [-20|20] "" Logger
  SG_ DWC_DWC_FlgCleanK2 m19 : 56|8@1+ (1,0) [0|255] "" Logger
  SG_ IOP_OutputSpeed m20 : 8|16@1- (1,0) [-20000|20000] "" Logger
  SG_ IOP_LinePressure m20 : 24|16@1- (0.005,-0) [-5|100] "" Logger
  SG_ IOP_KL30_1 m20 : 40|16@1+ (0.001,-0) [0|35] "" Logger
  SG_ DWC_DWC_FlgCleanVSS1 m20 : 56|8@1+ (1,0) [0|255] "" Logger
  SG_ IOP_K2Pressure m21 : 8|16@1- (0.001,-0) [-2|32] "" Logger
  SG_ IOP_K1Pressure m21 : 24|16@1- (0.001,-0) [-2|32] "" Logger
  SG_ IOP_Input2Speed m21 : 40|16@1+ (1,0) [0|20000] "" Logger
  SG_ DWC_DWC_K1DeviceStatus m21 : 56|8@1+ (1,0) [0|2] "" Logger
  SG_ IOP_Input1Speed m22 : 8|16@1+ (1,0) [0|20000] "" Logger
  SG_ IOP_EngineSpeed m22 : 24|16@1+ (1,0) [0|20000] "" Logger
  SG_ IOP_ClutchCoolingPressure m22 : 40|16@1- (0.001,-0) [-2|32] "" Logger
  SG_ DWC_DWC_K2DeviceStatus m22 : 56|8@1+ (1,0) [0|2] "" Logger
  SG_ IOP_ClutchCoolinInletTemperature m23 : 8|16@1- (1,0) [-50|200] "" Logger
  SG_ IOP_MaxEngineTorque m23 : 24|16@1- (0.1,-0) [-2000|2000] "" Logger
  SG_ IOP_BLDCPumpSpeedRequest m23 : 40|16@1+ (1,0) [0|20000] "" Logger
  SG_ DWC_DWC_SpeedPhaseType m23 : 56|8@1+ (1,0) [0|6] "" Logger
  SG_ IOP_LongitudinalAcceleration m24 : 8|16@1- (0.03125,-0) [-16|15.9688] "" Logger
  SG_ IOP_EngineTorqueNoGearbox m24 : 24|16@1- (0.1,-0) [-2000|2000] "" Logger
  SG_ IOP_EngineTorqueMaximum m24 : 40|16@1- (0.1,-0) [-2000|2000] "" Logger
  SG_ DWC_DWC_K1StateMachine_sm m24 : 56|8@1+ (1,0) [0|7] "" Logger
  SG_ IOP_EngineTorqueActual m25 : 8|16@1- (0.1,-0) [-2000|2000] "" Logger
  SG_ IOP_EngineTemperature m25 : 24|16@1- (1,0) [-60|195] "" Logger
  SG_ IOP_EM1Torque m25 : 40|16@1- (0.1,-0) [-2000|2000] "" Logger
  SG_ DWC_DWC_K2StateMachine_sm m25 : 56|8@1+ (1,0) [0|7] "" Logger
  SG_ IOP_BLDCPumpTorque m26 : 8|16@1+ (0.001,-0) [0|1.5] "" Logger
  SG_ IOP_BLDCPumpSpeedActual m26 : 24|16@1+ (1,0) [0|20000] "" Logger
  SG_ IOP_BLDCPumpFaults m26 : 40|16@1+ (1,0) [0|65535] "" Logger
  SG_ DWC_DWC_TorqueCoC_ControllerType m26 : 56|8@1+ (1,0) [0|2] "" Logger
  SG_ IOP_BLDCPumpDerating m27 : 8|16@1+ (1,0) [0|65535] "" Logger
  SG_ HAL_VSS2ActualCurrent m27 : 24|16@1+ (1,0) [0|5000] "" Logger
  SG_ HAL_VSS1ActualCurrent m27 : 40|16@1+ (1,0) [0|5000] "" Logger
  SG_ DWC_DWC_TorqueCoWC_DominantState m27 : 56|8@1+ (1,0) [0|7] "" Logger
  SG_ HAL_VKUGLActualCurrent m28 : 8|16@1+ (1,0) [0|5000] "" Logger
  SG_ HAL_VKUCCActualCurrent m28 : 24|16@1+ (1,0) [0|5000] "" Logger
  SG_ HAL_VKP2ActualCurrent m28 : 40|16@1+ (1,0) [0|5000] "" Logger
  SG_ DWC_DWC_TorqueCorol_DWC_FastFill m28 : 56|8@1+ (1,0) [0|255] "" Logger
  SG_ HAL_VKP1ActualCurrent m29 : 8|16@1+ (1,0) [0|5000] "" Logger
  SG_ HAL_VGQ5ActualCurrent m29 : 24|16@1+ (1,0) [0|5000] "" Logger
  SG_ HAL_VGQ4ActualCurrent m29 : 40|16@1+ (1,0) [0|5000] "" Logger
  SG_ DWC_DWC_TorqueCoDWC_PassiveState m29 : 56|8@1+ (1,0) [0|7] "" Logger
  SG_ HAL_VGQ3ActualCurrent m30 : 8|16@1+ (1,0) [0|5000] "" Logger
  SG_ HAL_VGQ2ActualCurrent m30 : 24|16@1+ (1,0) [0|5000] "" Logger
  SG_ HAL_VGQ1ActualCurrent m30 : 40|16@1+ (1,0) [0|5000] "" Logger
  SG_ ENG_EngineInterfgineInterface_sm m30 : 56|8@1+ (1,0) [0|6] "" Logger
  SG_ HAL_VGQ0ActualCurrent m31 : 8|16@1+ (1,0) [0|5000] "" Logger
  SG_ HAL_VGPActualCurrent m31 : 24|16@1+ (1,0) [0|5000] "" Logger
  SG_ GAC_CodeFailSpitNoShiftMsg m31 : 40|16@1+ (1,0) [0|65535] "" Logger
  SG_ GAC_GAC_CmdGrac0 m31 : 56|8@1+ (1,0) [0|5] "" Logger
  SG_ GAC_CodeFailSpitInShiftMsg m32 : 8|16@1+ (1,0) [0|65535] "" Logger
  SG_ GAC_CodeFailGracEngaMsg m32 : 24|16@1+ (1,0) [0|65535] "" Logger
  SG_ ENG_TorqueReserveRequest m32 : 40|16@1- (0.25,-0) [-1000|1547.75] "" Logger
  SG_ GAC_GAC_CmdGrac1 m32 : 56|8@1+ (1,0) [0|5] "" Logger
  SG_ IOP_SpeedSensorOdd m33 : 8|16@1- (1,0) [-20000|20000] "" Logger
  SG_ IOP_InternalOutputSpeed m33 : 24|16@1- (1,0) [-20000|20000] "" Logger
  SG_ GAC_CodeFailSpitNoShift m33 : 40|16@1+ (1,0) [0|65535] "" Logger
  SG_ GAC_GAC_CmdGrac2 m33 : 56|8@1+ (1,0) [0|5] "" Logger
  SG_ GAC_CodeFailSpitInShift m34 : 8|16@1+ (1,0) [0|65535] "" Logger
  SG_ GAC_CodeFailGracEnga m34 : 24|16@1+ (1,0) [0|65535] "" Logger
  SG_ GAC_CodeFailEngineOffCbr m34 : 40|16@1+ (1,0) [0|65535] "" Logger
  SG_ GAC_GAC_CmdGrac3 m34 : 56|8@1+ (1,0) [0|5] "" Logger
  SG_ DWC_NVLIFETIMEB_tOffsetKisspoint m35 : 8|16@1- (0.1,-0) [-1000|1000] "" Logger
  SG_ DWC_NVLIFETIMEB_entOffsetMaximum m35 : 24|16@1- (0.1,-0) [-1000|1000] "" Logger
  SG_ DWC_NVLIFETIME_1_OffsetKisspoint m35 : 40|16@1- (0.1,-0) [-1000|1000] "" Logger
  SG_ GAC_GAC_CmdGrac4 m35 : 56|8@1+ (1,0) [0|5] "" Logger
  SG_ DWC_NVLIFETIME_1_ntOffsetMaximum m36 : 8|16@1- (0.1,-0) [-1000|1000] "" Logger
  SG_ GAC_NVRAM_GAC_GrC_PosnAdpInGrNeg m36 : 24|16@1- (0.001,-0) [-20|20] "" Logger
  SG_ GAC_NVRAM_GAC_GrC_PosnAdpInGrPos m36 : 40|16@1- (0.001,-0) [-20|20] "" Logger
  SG_ GAC_GAC_CodeFailedGearTable m36 : 56|8@1+ (1,0) [0|255] "" Logger
  SG_ GAC_NVRAM_GAC__1__PosnAdpInGrNeg m37 : 8|16@1- (0.001,-0) [-20|20] "" Logger
  SG_ GAC_NVRAM_GAC__1__PosnAdpInGrPos m37 : 24|16@1- (0.001,-0) [-20|20] "" Logger
  SG_ GAC_NVRAM_GAC__2__PosnAdpInGrNeg m37 : 40|16@1- (0.001,-0) [-20|20] "" Logger
  SG_ GAC_GAC_CodeFailedHybridMode m37 : 56|8@1+ (1,0) [0|255] "" Logger
  SG_ GAC_NVRAM_GAC__2__PosnAdpInGrPos m38 : 8|16@1- (0.001,-0) [-20|20] "" Logger
  SG_ GAC_NVRAM_GAC__3__PosnAdpInGrNeg m38 : 24|16@1- (0.001,-0) [-20|20] "" Logger
  SG_ GAC_NVRAM_GAC__4__PosnAdpInGrNeg m38 : 40|16@1- (0.001,-0) [-20|20] "" Logger
  SG_ GAC_GAC_EOLPosnLC_StatePosnGracA m38 : 56|8@1+ (1,0) [0|5] "" Logger
  SG_ GAC_NVRAM_GAC__3__PosnAdpInGrPos m39 : 8|16@1- (0.001,-0) [-20|20] "" Logger
  SG_ DFES_numDFC_00_ m39 : 24|16@1+ (1,0) [0|952] "NO" Logger
  SG_ DFES_numDFC_01_ m39 : 40|16@1+ (1,0) [0|952] "NO" Logger
  SG_ GAC_GAC_EOLPosnLC_StatePosnGracB m39 : 56|8@1+ (1,0) [0|5] "" Logger
  SG_ DFES_numDFC_02_ m40 : 8|16@1+ (1,0) [0|952] "NO" Logger
  SG_ DFES_numDFC_03_ m40 : 24|16@1+ (1,0) [0|952] "NO" Logger
  SG_ DFES_numDFC_04_ m40 : 40|16@1+ (1,0) [0|952] "NO" Logger
  SG_ GAC_GAC_EOLPosnLC_StatePosnGracC m40 : 56|8@1+ (1,0) [0|5] "" Logger
  SG_ DFES_numDFC_05_ m41 : 8|16@1+ (1,0) [0|952] "NO" Logger

BA_DEF_ BU_ "CCP_TIMEOUT" INT 0 30000;
BA_DEF_ BU_ "CCP_CMD_TIMEOUT" INT 0 30000;
BA_DEF_ BU_ "CCP_VERSION" STRING ;
BA_DEF_ BU_ "CCP_CROID" INT 0 536870911;
BA_DEF_ BU_ "CCP_INITIAL_DELAY" INT 0 30000;
BA_DEF_ BU_ "CONNECT_RETRY_DELAY" INT 0 30000;
BA_DEF_ BU_ "CONNECT_RETRY_LIMIT" INT 0 30000;
BA_DEF_ BU_ "STATUS_CHECK_METHOD" STRING ;
BA_DEF_ BU_ "STATUS_CHECK_DELAY" INT 0 30000;
BA_DEF_ BU_ "CCP_EXCHANGEID" STRING ;
BA_DEF_ BU_ "CCP_BYTEORDER" STRING ;
BA_DEF_ BU_ "XCP_REVISION" STRING ;
BA_DEF_ BU_ "XCP_MAX_DLC_REQUIRED" INT 0 1;
BA_DEF_ BU_ "XCP_RESOURCE_PROTECTION_STATUS" INT 0 255;
BA_DEF_ BO_ "DTO_MESSAGE_HEADER_ENCODING_INFO" STRING ;
BA_DEF_ BO_ "DTO_MESSAGE_DAQ_LIST_INFO" STRING ;
BA_DEF_ BO_ "DTO_MESSAGE_DAQ_LIST_TIMES" STRING ;
BA_DEF_ BO_ "DTO_MESSAGE_DAQ_LIST_NAMES" STRING ;
BA_DEF_ BO_ "XCP_DATA0" STRING ;
BA_DEF_ BO_ "XCP_DATA1" STRING ;
BA_DEF_ BO_ "XCP_DATA2" STRING ;
BA_DEF_ BO_ "XCP_DATA3" STRING ;
BA_DEF_ BO_ "XCP_DATA4" STRING ;
BA_DEF_ BO_ "XCP_DATA5" STRING ;
BA_DEF_ BO_ "XCP_DATA6" STRING ;
BA_DEF_ BO_ "XCP_DATA7" STRING ;
BA_DEF_ BO_ "XCP_DATA8" STRING ;
BA_DEF_ BO_ "XCP_DATA9" STRING ;
BA_DEF_ BO_ "XCP_DATA10" STRING ;
BA_DEF_ BO_ "XCP_DATA11" STRING ;
BA_DEF_ BO_ "XCP_DATA12" STRING ;
BA_DEF_ BO_ "XCP_DATA13" STRING ;
BA_DEF_ BO_ "XCP_DATA14" STRING ;
BA_DEF_ BO_ "XCP_DATA15" STRING ;
BA_DEF_ BO_ "XCP_DATA16" STRING ;
BA_DEF_ BO_ "XCP_DATA17" STRING ;
BA_DEF_ BO_ "XCP_DATA18" STRING ;
BA_DEF_ BO_ "XCP_DATA19" STRING ;
BA_DEF_ BO_ "XCP_DATA20" STRING ;
BA_DEF_ BO_ "XCP_DATA21" STRING ;
BA_DEF_ BO_ "XCP_DATA22" STRING ;
BA_DEF_ BO_ "XCP_DATA23" STRING ;
BA_DEF_ BO_ "XCP_DATA24" STRING ;
BA_DEF_ BO_ "XCP_DATA25" STRING ;
BA_DEF_ BO_ "XCP_DATA26" STRING ;
BA_DEF_ BO_ "XCP_DATA27" STRING ;
BA_DEF_ BO_ "XCP_DATA28" STRING ;
BA_DEF_ BO_ "XCP_DATA29" STRING ;
BA_DEF_ BO_ "XCP_DATA30" STRING ;
BA_DEF_ SG_ "SignalLongName" STRING ;
BA_DEF_DEF_ "CCP_TIMEOUT" 0;
BA_DEF_DEF_ "CCP_CMD_TIMEOUT" 0;
BA_DEF_DEF_ "CCP_VERSION" "";
BA_DEF_DEF_ "CCP_CROID" 0;
BA_DEF_DEF_ "CCP_INITIAL_DELAY" 0;
BA_DEF_DEF_ "CONNECT_RETRY_DELAY" 0;
BA_DEF_DEF_ "CONNECT_RETRY_LIMIT" 0;
BA_DEF_DEF_ "STATUS_CHECK_METHOD" "VECTOR";
BA_DEF_DEF_ "STATUS_CHECK_DELAY" 0;
BA_DEF_DEF_ "CCP_EXCHANGEID" "";
BA_DEF_DEF_ "CCP_BYTEORDER" "INTEL";
BA_DEF_DEF_ "XCP_REVISION" "";
BA_DEF_DEF_ "XCP_MAX_DLC_REQUIRED" 0;
BA_DEF_DEF_ "XCP_RESOURCE_PROTECTION_STATUS" 0;
BA_DEF_DEF_ "DTO_MESSAGE_HEADER_ENCODING_INFO" "";
BA_DEF_DEF_ "DTO_MESSAGE_DAQ_LIST_INFO" "";
BA_DEF_DEF_ "DTO_MESSAGE_DAQ_LIST_TIMES" "";
BA_DEF_DEF_ "DTO_MESSAGE_DAQ_LIST_NAMES" "";
BA_DEF_DEF_ "XCP_DATA0" "";
BA_DEF_DEF_ "XCP_DATA1" "";
BA_DEF_DEF_ "XCP_DATA2" "";
BA_DEF_DEF_ "XCP_DATA3" "";
BA_DEF_DEF_ "XCP_DATA4" "";
BA_DEF_DEF_ "XCP_DATA5" "";
BA_DEF_DEF_ "XCP_DATA6" "";
BA_DEF_DEF_ "XCP_DATA7" "";
BA_DEF_DEF_ "XCP_DATA8" "";
BA_DEF_DEF_ "XCP_DATA9" "";
BA_DEF_DEF_ "XCP_DATA10" "";
BA_DEF_DEF_ "XCP_DATA11" "";
BA_DEF_DEF_ "XCP_DATA12" "";
BA_DEF_DEF_ "XCP_DATA13" "";
BA_DEF_DEF_ "XCP_DATA14" "";
BA_DEF_DEF_ "XCP_DATA15" "";
BA_DEF_DEF_ "XCP_DATA16" "";
BA_DEF_DEF_ "XCP_DATA17" "";
BA_DEF_DEF_ "XCP_DATA18" "";
BA_DEF_DEF_ "XCP_DATA19" "";
BA_DEF_DEF_ "XCP_DATA20" "";
BA_DEF_DEF_ "XCP_DATA21" "";
BA_DEF_DEF_ "XCP_DATA22" "";
BA_DEF_DEF_ "XCP_DATA23" "";
BA_DEF_DEF_ "XCP_DATA24" "";
BA_DEF_DEF_ "XCP_DATA25" "";
BA_DEF_DEF_ "XCP_DATA26" "";
BA_DEF_DEF_ "XCP_DATA27" "";
BA_DEF_DEF_ "XCP_DATA28" "";
BA_DEF_DEF_ "XCP_DATA29" "";
BA_DEF_DEF_ "XCP_DATA30" "";
BA_DEF_DEF_ "SignalLongName" "";
BA_ "CCP_TIMEOUT" BU_ _5201C531 1000;
BA_ "CCP_CMD_TIMEOUT" BU_ _5201C531 1000;
BA_ "CCP_VERSION" BU_ _5201C531 "0302";
BA_ "CCP_CROID" BU_ _5201C531 2032;
BA_ "CCP_INITIAL_DELAY" BU_ _5201C531 1000;
BA_ "STATUS_CHECK_DELAY" BU_ _5201C531 1000;
BA_ "XCP_REVISION" BU_ _5201C531 "0020";
BA_ "XCP_RESOURCE_PROTECTION_STATUS" BU_ _5201C531 4;
BA_ "DTO_MESSAGE_HEADER_ENCODING_INFO" BO_ 2011 "0 1 0 0 0 multiplication absolute";
BA_ "DTO_MESSAGE_DAQ_LIST_INFO" BO_ 2011 "0 0-0";
BA_ "DTO_MESSAGE_DAQ_LIST_TIMES" BO_ 2011 "0 5 1ms 1";
BA_ "DTO_MESSAGE_DAQ_LIST_NAMES" BO_ 2011 "0=5ms time synchronous";
BA_ "DTO_MESSAGE_HEADER_ENCODING_INFO" BO_ 2041 "0 1 0 0 0 multiplication absolute";
BA_ "DTO_MESSAGE_DAQ_LIST_INFO" BO_ 2041 "1 1-65";
BA_ "DTO_MESSAGE_DAQ_LIST_TIMES" BO_ 2041 "1 10 1ms 1";
BA_ "DTO_MESSAGE_DAQ_LIST_NAMES" BO_ 2041 "1=10ms time synchronous";
BA_ "SignalLongName" SG_ 2011 GAC_GAC_HybBankCtrl_sm "GAC.GAC_HybBankCtrl.sm";
BA_ "SignalLongName" SG_ 2041 DWC_IOP_SystemStatus "DWC.IOP_SystemStatus";
BA_ "SignalLongName" SG_ 2041 IOP_CommsTx_IOP_LimitTorqueGear "IOP_CommsTx.IOP_LimitTorqueGear";
BA_ "SignalLongName" SG_ 2041 DWC_DWC_TorqueControl_DWC_ITerm "DWC.DWC_TorqueControl.DWC_ITerm";
BA_ "SignalLongName" SG_ 2041 L2_Lodi_L2_ClutchStatusEven "L2_Lodi.L2_ClutchStatusEven";
BA_ "SignalLongName" SG_ 2041 DWC_DWC_TorqueControl_DWC_PITerm "DWC.DWC_TorqueControl.DWC_PITerm";
BA_ "SignalLongName" SG_ 2041 SWC_HAL_CommsTx__MaxEngineTorque "SWC_HAL_CommsTx.IOP_MaxEngineTorque";
BA_ "SignalLongName" SG_ 2041 L2_Lodi_L2_ClutctatusEvenQuality "L2_Lodi.L2_ClutchStatusEvenQuality";
BA_ "SignalLongName" SG_ 2041 DWC_NVUSAGEB_DWCatorPlateTempMax "DWC_NVUSAGEB.DWC_Clutch1SeperatorPlateTempMax";
BA_ "SignalLongName" SG_ 2041 L2_Lodi_L2_SpeedSecondary "L2_Lodi.L2_SpeedSecondary";
BA_ "SignalLongName" SG_ 2041 L2_Lodi_L2_ClutchStatusOdd "L2_Lodi.L2_ClutchStatusOdd";
BA_ "SignalLongName" SG_ 2041 DWC_NVUSAGEB_D_1_torPlateTempMax "DWC_NVUSAGEB.DWC_Clutch2SeperatorPlateTempMax";
BA_ "SignalLongName" SG_ 2041 DWC_DWC_K1Torque "DWC.DWC_K1Torque";
BA_ "SignalLongName" SG_ 2041 L2_Lodi_L2_ClutcStatusOddQuality "L2_Lodi.L2_ClutchStatusOddQuality";
BA_ "SignalLongName" SG_ 2041 DWC_DWC_K1TorqueFB "DWC.DWC_K1TorqueFB";
BA_ "SignalLongName" SG_ 2041 DWC_DWC_K2Torque "DWC.DWC_K2Torque";
BA_ "SignalLongName" SG_ 2041 DWC_DWC_K2TorqueFB "DWC.DWC_K2TorqueFB";
BA_ "SignalLongName" SG_ 2041 L2_Lodi_L2_Debou_L2_McFcBF_00_07 "L2_Lodi.L2_Debounce.L2_McFcBF_00_07";
BA_ "SignalLongName" SG_ 2041 DWC_DWC_SlipTarget "DWC.DWC_SlipTarget";
BA_ "SignalLongName" SG_ 2041 DWC_DWC_InputProg_DWC_K1Pressure "DWC.DWC_InputProcessing.DWC_K1Pressure";
BA_ "SignalLongName" SG_ 2041 DWC_DWC_InputProssing_DWC_K1Slip "DWC.DWC_InputProcessing.DWC_K1Slip";
BA_ "SignalLongName" SG_ 2041 L2_Lodi_L2_Debou_L2_McFcBF_08_15 "L2_Lodi.L2_Debounce.L2_McFcBF_08_15";
BA_ "SignalLongName" SG_ 2041 DWC_DWC_InputProg_DWC_K2Pressure "DWC.DWC_InputProcessing.DWC_K2Pressure";
BA_ "SignalLongName" SG_ 2041 DWC_DWC_InputProssing_DWC_K2Slip "DWC.DWC_InputProcessing.DWC_K2Slip";
BA_ "SignalLongName" SG_ 2041 DWC_DWC_K1DeviceWC_CurrentDemand "DWC.DWC_K1DeviceControl.DWC_CurrentDemand";
BA_ "SignalLongName" SG_ 2041 L2_Lodi_L2_Debou_L2_McFcBF_16_23 "L2_Lodi.L2_Debounce.L2_McFcBF_16_23";
BA_ "SignalLongName" SG_ 2041 DWC_DWC_K1DeviceC_PressureDemand "DWC.DWC_K1DeviceControl.DWC_PressureDemand";
BA_ "SignalLongName" SG_ 2041 DWC_DWC_K2DeviceWC_CurrentDemand "DWC.DWC_K2DeviceControl.DWC_CurrentDemand";
BA_ "SignalLongName" SG_ 2041 DWC_DWC_K2DeviceC_PressureDemand "DWC.DWC_K2DeviceControl.DWC_PressureDemand";
BA_ "SignalLongName" SG_ 2041 L2_Lodi_L2_Debou_L2_McFcBF_24_31 "L2_Lodi.L2_Debounce.L2_McFcBF_24_31";
BA_ "SignalLongName" SG_ 2041 DWC_DWC_TorqueCollerTorqueDemand "DWC.DWC_TorqueControl.DWC_ControllerTorqueDemand";
BA_ "SignalLongName" SG_ 2041 DWC_DWC_TorqueCoC_DominantTorque "DWC.DWC_TorqueControl.DWC_DominantTorque";
BA_ "SignalLongName" SG_ 2041 DWC_DWC_TorqueCo_FFCTorqueDemand "DWC.DWC_TorqueControl.DWC_FFCTorqueDemand";
BA_ "SignalLongName" SG_ 2041 L2_Lodi_L2_Debou_L2_McFcBF_32_39 "L2_Lodi.L2_Debounce.L2_McFcBF_32_39";
BA_ "SignalLongName" SG_ 2041 DWC_DWC_TorqueCoutchTargetTorque "DWC.DWC_TorqueControl.DWC_PAClutchTargetTorque";
BA_ "SignalLongName" SG_ 2041 DWC_DWC_TorqueControl_DWC_PTerm "DWC.DWC_TorqueControl.DWC_PTerm";
BA_ "SignalLongName" SG_ 2041 DWC_DWC_TorqueCoWC_PassiveTorque "DWC.DWC_TorqueControl.DWC_PassiveTorque";
BA_ "SignalLongName" SG_ 2041 L2_Lodi_L2_Debou_L2_McFcBF_40_47 "L2_Lodi.L2_Debounce.L2_McFcBF_40_47";
BA_ "SignalLongName" SG_ 2041 DWC_DWC_TorqueCorol_DWC_SLCError "DWC.DWC_TorqueControl.DWC_SLCError";
BA_ "SignalLongName" SG_ 2041 DWC_DWC_TorqueCo_DriverTorqueRaw "DWC.DWC_TorqueControl.IOP_DriverTorqueRaw";
BA_ "SignalLongName" SG_ 2041 DWC_DWC_TorqueCorqueNoGearboxRaw "DWC.DWC_TorqueControl.IOP_EngineTorqueNoGearboxRaw";
BA_ "SignalLongName" SG_ 2041 L2_Lodi_L2_Debou_L2_McFcBF_48_49 "L2_Lodi.L2_Debounce.L2_McFcBF_48_49";
BA_ "SignalLongName" SG_ 2041 GAC_GAC_PosnGrac0_A "GAC.GAC_PosnGrac0_A";
BA_ "SignalLongName" SG_ 2041 GAC_GAC_PosnGrac1_B "GAC.GAC_PosnGrac1_B";
BA_ "SignalLongName" SG_ 2041 GAC_GAC_PosnGrac2_C "GAC.GAC_PosnGrac2_C";
BA_ "SignalLongName" SG_ 2041 DST_DST_ShiftMode "DST.DST_ShiftMode";
BA_ "SignalLongName" SG_ 2041 GAC_GAC_PosnGrac3_D "GAC.GAC_PosnGrac3_D";
BA_ "SignalLongName" SG_ 2041 GAC_GAC_PosnGrac4_F "GAC.GAC_PosnGrac4_F";
BA_ "SignalLongName" SG_ 2041 PCL_PCL_Control_CL_BitFieldFault "PCL.PCL_Control.PCL_BitFieldFault";
BA_ "SignalLongName" SG_ 2041 DST_DST_LodiParkInterface_sm "DST.DST_LodiParkInterface.sm";
BA_ "SignalLongName" SG_ 2041 PCL_PCL_Control_PCL_FlowCC "PCL.PCL_Control.PCL_FlowCC";
BA_ "SignalLongName" SG_ 2041 PCL_PCL_Control_PCL_FlowGL_Motor "PCL.PCL_Control.PCL_FlowGL_Motor";
BA_ "SignalLongName" SG_ 2041 PCL_PCL_Control_PCL_FlowGL_Valve "PCL.PCL_Control.PCL_FlowGL_Valve";
BA_ "SignalLongName" SG_ 2041 DST_DST_ModeSelectGeneric_sm "DST.DST_ModeSelectGeneric.sm";
BA_ "SignalLongName" SG_ 2041 PCL_PCL_Control__FlowGearLubeDem "PCL.PCL_Control.PCL_FlowGearLubeDem";
BA_ "SignalLongName" SG_ 2041 PCL_PCL_Control_iags_PCL_FlowLPS "PCL.PCL_Control.PCL_CoolingValveDiags.PCL_FlowLPS";
BA_ "SignalLongName" SG_ 2041 PCL_PCL_Control__PressureCooling "PCL.PCL_Control.PCL_CoolingValveDiags.PCL_PressureCooling";
BA_ "SignalLongName" SG_ 2041 DWC_DWC_DCDemandK1 "DWC.DWC_DCDemandK1";
BA_ "SignalLongName" SG_ 2041 PCL_PCL_Control_essureCoolingMax "PCL.PCL_Control.PCL_CoolingValveDiags.PCL_PressureCoolingMax";
BA_ "SignalLongName" SG_ 2041 PCL_PCL_Control_essureCoolingMin "PCL.PCL_Control.PCL_CoolingValveDiags.PCL_PressureCoolingMin";
BA_ "SignalLongName" SG_ 2041 PCL_PCL_Control_reCoolingNominal "PCL.PCL_Control.PCL_CoolingValveDiags.PCL_PressureCoolingNominal";
BA_ "SignalLongName" SG_ 2041 DWC_DWC_DCDemandK2 "DWC.DWC_DCDemandK2";
BA_ "SignalLongName" SG_ 2041 DWC_DWC_FlgCleanK1 "DWC.DWC_FlgCleanK1";
BA_ "SignalLongName" SG_ 2041 DWC_DWC_FlgCleanK2 "DWC.DWC_FlgCleanK2";
BA_ "SignalLongName" SG_ 2041 DWC_DWC_FlgCleanVSS1 "DWC.DWC_FlgCleanVSS1";
BA_ "SignalLongName" SG_ 2041 DWC_DWC_K1DeviceStatus "DWC.DWC_K1DeviceStatus";
BA_ "SignalLongName" SG_ 2041 DWC_DWC_K2DeviceStatus "DWC.DWC_K2DeviceStatus";
BA_ "SignalLongName" SG_ 2041 IOP_ClutchCoolinInletTemperature "IOP_ClutchCoolingInletTemperature";
BA_ "SignalLongName" SG_ 2041 DWC_DWC_SpeedPhaseType "DWC.DWC_SpeedPhaseType";
BA_ "SignalLongName" SG_ 2041 DWC_DWC_K1StateMachine_sm "DWC.DWC_K1StateMachine.sm";
BA_ "SignalLongName" SG_ 2041 DWC_DWC_K2StateMachine_sm "DWC.DWC_K2StateMachine.sm";
BA_ "SignalLongName" SG_ 2041 DWC_DWC_TorqueCoC_ControllerType "DWC.DWC_TorqueControl.DWC_ControllerType";
BA_ "SignalLongName" SG_ 2041 DWC_DWC_TorqueCoWC_DominantState "DWC.DWC_TorqueControl.DWC_DominantState";
BA_ "SignalLongName" SG_ 2041 DWC_DWC_TorqueCorol_DWC_FastFill "DWC.DWC_TorqueControl.DWC_FastFill";
BA_ "SignalLongName" SG_ 2041 DWC_DWC_TorqueCoDWC_PassiveState "DWC.DWC_TorqueControl.DWC_PassiveState";
BA_ "SignalLongName" SG_ 2041 ENG_EngineInterfgineInterface_sm "ENG_EngineInterface.ENG_EngineInterface.sm";
BA_ "SignalLongName" SG_ 2041 GAC_GAC_CmdGrac0 "GAC.GAC_CmdGrac0";
BA_ "SignalLongName" SG_ 2041 GAC_GAC_CmdGrac1 "GAC.GAC_CmdGrac1";
BA_ "SignalLongName" SG_ 2041 GAC_GAC_CmdGrac2 "GAC.GAC_CmdGrac2";
BA_ "SignalLongName" SG_ 2041 GAC_GAC_CmdGrac3 "GAC.GAC_CmdGrac3";
BA_ "SignalLongName" SG_ 2041 DWC_NVLIFETIMEB_tOffsetKisspoint "DWC_NVLIFETIMEB.DWC_K1DeviceControl.DWC_PressCurrent.DWC_CurrentOffsetKisspoint";
BA_ "SignalLongName" SG_ 2041 DWC_NVLIFETIMEB_entOffsetMaximum "DWC_NVLIFETIMEB.DWC_K1DeviceControl.DWC_PressCurrent.DWC_CurrentOffsetMaximum";
BA_ "SignalLongName" SG_ 2041 DWC_NVLIFETIME_1_OffsetKisspoint "DWC_NVLIFETIMEB.DWC_K2DeviceControl.DWC_PressCurrent.DWC_CurrentOffsetKisspoint";
BA_ "SignalLongName" SG_ 2041 GAC_GAC_CmdGrac4 "GAC.GAC_CmdGrac4";
BA_ "SignalLongName" SG_ 2041 DWC_NVLIFETIME_1_ntOffsetMaximum "DWC_NVLIFETIMEB.DWC_K2DeviceControl.DWC_PressCurrent.DWC_CurrentOffsetMaximum";
BA_ "SignalLongName" SG_ 2041 GAC_NVRAM_GAC_GrC_PosnAdpInGrNeg "GAC_NVRAM.GAC_GracA.GAC_InGearLearn.GAC_PosnAdpInGrNeg";
BA_ "SignalLongName" SG_ 2041 GAC_NVRAM_GAC_GrC_PosnAdpInGrPos "GAC_NVRAM.GAC_GracA.GAC_InGearLearn.GAC_PosnAdpInGrPos";
BA_ "SignalLongName" SG_ 2041 GAC_GAC_CodeFailedGearTable "GAC.GAC_CodeFailedGearTable";
BA_ "SignalLongName" SG_ 2041 GAC_NVRAM_GAC__1__PosnAdpInGrNeg "GAC_NVRAM.GAC_GracB.GAC_InGearLearn.GAC_PosnAdpInGrNeg";
BA_ "SignalLongName" SG_ 2041 GAC_NVRAM_GAC__1__PosnAdpInGrPos "GAC_NVRAM.GAC_GracB.GAC_InGearLearn.GAC_PosnAdpInGrPos";
BA_ "SignalLongName" SG_ 2041 GAC_NVRAM_GAC__2__PosnAdpInGrNeg "GAC_NVRAM.GAC_GracC.GAC_InGearLearn.GAC_PosnAdpInGrNeg";
BA_ "SignalLongName" SG_ 2041 GAC_GAC_CodeFailedHybridMode "GAC.GAC_CodeFailedHybridMode";
BA_ "SignalLongName" SG_ 2041 GAC_NVRAM_GAC__2__PosnAdpInGrPos "GAC_NVRAM.GAC_GracC.GAC_InGearLearn.GAC_PosnAdpInGrPos";
BA_ "SignalLongName" SG_ 2041 GAC_NVRAM_GAC__3__PosnAdpInGrNeg "GAC_NVRAM.GAC_GracD.GAC_InGearLearn.GAC_PosnAdpInGrNeg";
BA_ "SignalLongName" SG_ 2041 GAC_NVRAM_GAC__4__PosnAdpInGrNeg "GAC_NVRAM.GAC_GracF.GAC_InGearLearn.GAC_PosnAdpInGrNeg";
BA_ "SignalLongName" SG_ 2041 GAC_GAC_EOLPosnLC_StatePosnGracA "GAC.GAC_EOLPosnLearn.GAC_StatePosnGracA";
BA_ "SignalLongName" SG_ 2041 GAC_NVRAM_GAC__3__PosnAdpInGrPos "GAC_NVRAM.GAC_GracF.GAC_InGearLearn.GAC_PosnAdpInGrPos";
BA_ "SignalLongName" SG_ 2041 DFES_numDFC_00_ "DFES_numDFC[00]";
BA_ "SignalLongName" SG_ 2041 DFES_numDFC_01_ "DFES_numDFC[01]";
BA_ "SignalLongName" SG_ 2041 GAC_GAC_EOLPosnLC_StatePosnGracB "GAC.GAC_EOLPosnLearn.GAC_StatePosnGracB";
BA_ "SignalLongName" SG_ 2041 DFES_numDFC_02_ "DFES_numDFC[02]";
BA_ "SignalLongName" SG_ 2041 DFES_numDFC_03_ "DFES_numDFC[03]";
BA_ "SignalLongName" SG_ 2041 DFES_numDFC_04_ "DFES_numDFC[04]";
BA_ "SignalLongName" SG_ 2041 GAC_GAC_EOLPosnLC_StatePosnGracC "GAC.GAC_EOLPosnLearn.GAC_StatePosnGracC";
BA_ "SignalLongName" SG_ 2041 DFES_numDFC_05_ "DFES_numDFC[05]";

VAL_ 2011 GAC_GAC_HybBankCtrl_sm 0 "HBC_Start" 1 "HBC_SelectGear" 2 "HBC_SelectNeutral" 3 "HBC_Wait";
VAL_ 2041 L2_Lodi_L2_ClutchStatusEven 0 "L2_ClutchUnknown" 1 "L2_ClutchOpen" 2 "L2_ClutchLowTorque" 3 "L2_ClutchHighTorque";
VAL_ 2041 L2_Lodi_L2_ClutchStatusOdd 0 "L2_ClutchUnknown" 1 "L2_ClutchOpen" 2 "L2_ClutchLowTorque" 3 "L2_ClutchHighTorque";
VAL_ 2041 DST_DST_LodiParkInterface_sm 0 "PowerUp" 1 "Disengaged" 2 "DisengagingPawl" 3 "Engaged" 4 "Engaging_WaitSyncB" 5 "EngagingPawl";
VAL_ 2041 DST_DST_ModeSelectGeneric_sm 0 "SM_Ini" 1 "SM_Forward" 2 "SM_Neutral" 3 "SM_Park" 4 "SM_Reverse";
VAL_ 2041 DWC_DWC_DCDemandK1 0 "DWC_Open" 1 "DWC_SelfTest" 2 "DWC_Fill" 3 "DWC_Close";
VAL_ 2041 DWC_DWC_DCDemandK2 0 "DWC_Open" 1 "DWC_SelfTest" 2 "DWC_Fill" 3 "DWC_Close";
VAL_ 2041 DWC_DWC_FlgCleanVSS1 0 "FALSE" 1 "TRUE";
VAL_ 2041 DWC_DWC_K1DeviceStatus 0 "DWC_Attempting" 1 "DWC_Failure" 2 "DWC_Achieved";
VAL_ 2041 DWC_DWC_K2DeviceStatus 0 "DWC_Attempting" 1 "DWC_Failure" 2 "DWC_Achieved";
VAL_ 2041 DWC_DWC_SpeedPhaseType 0 "DWC_Unknown" 1 "DWC_OffgoingUp" 2 "DWC_OffgoingDown" 3 "DWC_OncomingUp" 4 "DWC_OncomingDown" 5 "DWC_InertiaCancel" 6 "DWC_SyncEngine";
VAL_ 2041 DWC_DWC_K1StateMachine_sm 0 "DCS_Initialise" 1 "DCS_Disenagage" 2 "DCS_InGear" 3 "DCS_Neutral" 4 "DCS_Prepare" 5 "DCS_SelfTest" 6 "DCS_SpeedPhase" 7 "DCS_TorquePhase";
VAL_ 2041 DWC_DWC_K2StateMachine_sm 0 "DCS_Initialise" 1 "DCS_Disenagage" 2 "DCS_InGear" 3 "DCS_Neutral" 4 "DCS_Prepare" 5 "DCS_SelfTest" 6 "DCS_SpeedPhase" 7 "DCS_TorquePhase";
VAL_ 2041 DWC_DWC_TorqueCoC_ControllerType 0 "DWC_SpeedControl" 1 "DWC_SlipControl" 2 "DWC_GradientControl";
VAL_ 2041 DWC_DWC_TorqueCoWC_DominantState 0 "DWC_Initialise" 1 "DWC_Neutral" 2 "DWC_Prepare" 3 "DWC_TorquePhase" 4 "DWC_InGear" 5 "DWC_SpeedPhase" 6 "DWC_Disengage" 7 "DWC_SelfTesting";
VAL_ 2041 DWC_DWC_TorqueCorol_DWC_FastFill 0 "FALSE" 1 "TRUE";
VAL_ 2041 DWC_DWC_TorqueCoDWC_PassiveState 0 "DWC_Initialise" 1 "DWC_Neutral" 2 "DWC_Prepare" 3 "DWC_TorquePhase" 4 "DWC_InGear" 5 "DWC_SpeedPhase" 6 "DWC_Disengage" 7 "DWC_SelfTesting";
VAL_ 2041 ENG_EngineInterfgineInterface_sm 0 "Initialising" 1 "No_Intervention" 2 "Speed_Control" 3 "Support_DCT_Shift" 4 "Torque_Roll_Off" 5 "Torque_Roll_On" 6 "Support_ASG_Shift";
VAL_ 2041 GAC_GAC_CmdGrac0 0 "GAC_NoCmd" 1 "GAC_ToPosGr" 2 "GAC_ToN" 3 "GAC_ToNegGr" 4 "GAC_StayInPosGr" 5 "GAC_StayInNegGr";
VAL_ 2041 GAC_GAC_CmdGrac1 0 "GAC_NoCmd" 1 "GAC_ToPosGr" 2 "GAC_ToN" 3 "GAC_ToNegGr" 4 "GAC_StayInPosGr" 5 "GAC_StayInNegGr";
VAL_ 2041 GAC_GAC_CmdGrac2 0 "GAC_NoCmd" 1 "GAC_ToPosGr" 2 "GAC_ToN" 3 "GAC_ToNegGr" 4 "GAC_StayInPosGr" 5 "GAC_StayInNegGr";
VAL_ 2041 GAC_GAC_CmdGrac3 0 "GAC_NoCmd" 1 "GAC_ToPosGr" 2 "GAC_ToN" 3 "GAC_ToNegGr" 4 "GAC_StayInPosGr" 5 "GAC_StayInNegGr";
VAL_ 2041 GAC_GAC_CmdGrac4 0 "GAC_NoCmd" 1 "GAC_ToPosGr" 2 "GAC_ToN" 3 "GAC_ToNegGr" 4 "GAC_StayInPosGr" 5 "GAC_StayInNegGr";
VAL_ 2041 GAC_GAC_EOLPosnLC_StatePosnGracA 0 "GAC_Undefined" 1 "GAC_PositiveInGear" 2 "GAC_PositiveNowhere" 3 "GAC_InNeutral" 4 "GAC_NegativeNowhere" 5 "GAC_NegativeInGear";
VAL_ 2041 DFES_numDFC_00_ 0 "DFC_Unused" 1 "DFC_DsmTest2" 2 "DFC_Can0Getriebe_01" 3 "DFC_Can0Motor_01_CHK" 4 "DFC_Can0Motor_01_CNT" 5 "DFC_Can0Motor_01_DLC" 6 "DFC_Can0Motor_02_CHK" 7 "DFC_Can0Motor_02_CNT" 8 "DFC_Can0Motor_02_DLC" 9 "DFC_Can0Motor_03_CHK" 10 "DFC_Can0Motor_03_CNT" 11 "DFC_Can0Motor_03_DLC" 12 "DFC_Can1BYPASS_TDG1_11_DLC" 13 "DFC_Can1BYPASS_TDG1_12_DLC" 14 "DFC_Can1BYPASS_TDG1_13_DLC" 15 "DFC_Can1BYPASS_TDG1_14_DLC" 16 "DFC_Can1BYPASS_TDG1_15_DLC" 17 "DFC_Can1BYPASS_TDG1_16_PlaceHolder_DLC" 18 "DFC_Can1BYPASS_TDG1_17_PlaceHolder_DLC" 19 "DFC_Can1BYPASS_TDG1_18_PlaceHolder_DLC" 20 "DFC_Can1BYPASS_TDG1_19_Placeholder_DLC" 21 "DFC_Can1BYPASS_TDG1_20_Placeholder_DLC" 22 "DFC_Can1BYPASS_TDG1_21_DLC" 23 "DFC_Can1BYPASS_TDG1_22_DLC" 24 "DFC_Can1BYPASS_TDG1_AA" 25 "DFC_Can1BYPASS_TDG1_AB" 26 "DFC_Can1BYPASS_TDG1_AC" 27 "DFC_Can1BYPASS_TDG1_AD" 28 "DFC_Can1BYPASS_TDG1_AE" 29 "DFC_Can1BYPASS_TDG1_AF" 30 "DFC_Can1BYPASS_TDG1_BA" 31 "DFC_Can1BYPASS_TDG1_BB" 32 "DFC_Can1BYPASS_TDG1_BC" 33 "DFC_Can1BYPASS_TDG1_BD" 34 "DFC_Can1BYPASS_TDG1_BE_PlaceHolder" 35 "DFC_Can1BYPASS_TDG1_BF_PlaceHolder" 36 "DFC_Can1BYPASS_TDG1_CA_PlaceHolder" 37 "DFC_Can1BYPASS_TDG1_CB_PlaceHolder" 38 "DFC_Can1BYPASS_TDG1_CC_PlaceHolder" 39 "DFC_Can1Cool_Act_Cmd" 40 "DFC_Can1Cool_Act_Sts_DLC" 41 "DFC_DsmTest1" 42 "DFC_FrAACC_06ISigGroup_ACC_06_CHK" 43 "DFC_FrAACC_06ISigGroup_ACC_06_CNT" 44 "DFC_FrAACC_07ISigGroup_ACC_07_CHK" 45 "DFC_FrAACC_07ISigGroup_ACC_07_CNT" 46 "DFC_FrAAirbag_01ISigGroup_Airbag_01_CHK" 47 "DFC_FrAAirbag_01ISigGroup_Airbag_01_CNT" 48 "DFC_FrAAirbag_02ISigGroup_Airbag_02_CHK" 49 "DFC_FrAAirbag_02ISigGroup_Airbag_02_CNT" 50 "DFC_FrABremse_EV_01ISigGroup_Bremse_EV_01_CHK" 51 "DFC_FrABremse_EV_01ISigGroup_Bremse_EV_01_CNT" 52 "DFC_FrABremse_EV_02ISigGroup_Bremse_EV_02_CHK" 53 "DFC_FrABremse_EV_02ISigGroup_Bremse_EV_02_CNT" 54 "DFC_FrAEBKV_01ISigGroup_EBKV_01_CHK" 55 "DFC_FrAEBKV_01ISigGroup_EBKV_01_CNT" 56 "DFC_FrAEM1_HYB_12ISigGroup_EM1_HYB_12_CHK" 57 "DFC_FrAEM1_HYB_12ISigGroup_EM1_HYB_12_CNT" 58 "DFC_FrAEPB_01ISigGroup_EPB_01_CHK" 59 "DFC_FrAEPB_01ISigGroup_EPB_01_CNT" 60 "DFC_FrAESP_03ISigGroup_ESP_03_CHK" 61 "DFC_FrAESP_03ISigGroup_ESP_03_CNT" 62 "DFC_FrAESP_05ISigGroup_ESP_05_CHK" 63 "DFC_FrAESP_05ISigGroup_ESP_05_CNT" 64 "DFC_FrAESP_07ISigGroup_ESP_07_CHK" 65 "DFC_FrAESP_07ISigGroup_ESP_07_CNT" 66 "DFC_FrAESP_08ISigGroup_ESP_08_CHK" 67 "DFC_FrAESP_08ISigGroup_ESP_08_CNT" 68 "DFC_FrAESP_15ISigGroup_ESP_15_CHK" 69 "DFC_FrAESP_15ISigGroup_ESP_15_CNT" 70 "DFC_FrAESP_20ISigGroup_ESP_20_CHK" 71 "DFC_FrAESP_20ISigGroup_ESP_20_CNT" 72 "DFC_FrAESP_21ISigGroup_ESP_21_CHK" 73 "DFC_FrAESP_21ISigGroup_ESP_21_CNT" 74 "DFC_FrAESP_22ISigGroup_ESP_22_CHK" 75 "DFC_FrAESP_22ISigGroup_ESP_22_CNT" 76 "DFC_FrAESP_23ISigGroup_ESP_23_CHK" 77 "DFC_FrAESP_23ISigGroup_ESP_23_CNT" 78 "DFC_FrAESP_24ISigGroup_ESP_24_CHK" 79 "DFC_FrAESP_24ISigGroup_ESP_24_CNT" 80 "DFC_FrAESP_28ISigGroup_ESP_28_CHK" 81 "DFC_FrAESP_28ISigGroup_ESP_28_CNT" 82 "DFC_FrAESP_31ISigGroup_ESP_31_CHK" 83 "DFC_FrAESP_31ISigGroup_ESP_31_CNT" 84 "DFC_FrAESP_32ISigGroup_ESP_32_CHK" 85 "DFC_FrAESP_32ISigGroup_ESP_32_CNT" 86 "DFC_FrAESP_33ISigGroup_ESP_33_CHK" 87 "DFC_FrAESP_33ISigGroup_ESP_33_CNT" 88 "DFC_FrAESP_41ISigGroup_ESP_41_CHK" 89 "DFC_FrAESP_41ISigGroup_ESP_41_CNT" 90 "DFC_FrAESP_44ISigGroup_ESP_44_CHK" 91 "DFC_FrAESP_44ISigGroup_ESP_44_CNT" 92 "DFC_FrAGetriebe_11" 93 "DFC_FrAGetriebe_12" 94 "DFC_FrAGetriebe_13" 95 "DFC_FrAGetriebe_14" 96 "DFC_FrAGetriebe_15" 97 "DFC_FrAGetriebe_16" 98 "DFC_FrAGetriebe_17" 99 "DFC_FrAGetriebe_18" 100 "DFC_FrAGetriebe_HYB_12" 101 "DFC_FrAKN_Getriebe" 102 "DFC_FrAKlemmen_Status_01ISigGroup_Klemmen_Status_01_CHK" 103 "DFC_FrAKlemmen_Status_01ISigGroup_Klemmen_Status_01_CNT" 104 "DFC_FrALCV_01ISigGroup_LCV_01_CHK" 105 "DFC_FrALCV_01ISigGroup_LCV_01_CNT" 106 "DFC_FrALWI_01ISigGroup_LWI_01_CHK" 107 "DFC_FrALWI_01ISigGroup_LWI_01_CNT" 108 "DFC_FrAMotor_11ISigGroup_Motor_11_CHK" 109 "DFC_FrAMotor_11ISigGroup_Motor_11_CNT" 110 "DFC_FrAMotor_12ISigGroup_Motor_12_CHK" 111 "DFC_FrAMotor_12ISigGroup_Motor_12_CNT" 112 "DFC_FrAMotor_14ISigGroup_Motor_14_CHK" 113 "DFC_FrAMotor_14ISigGroup_Motor_14_CNT" 114 "DFC_FrAMotor_20ISigGroup_Motor_20_CHK" 115 "DFC_FrAMotor_20ISigGroup_Motor_20_CNT" 116 "DFC_FrAMotor_27ISigGroup_Motor_27_CHK" 117 "DFC_FrAMotor_27ISigGroup_Motor_27_CNT" 118 "DFC_FrAMotor_28ISigGroup_Motor_28_CHK" 119 "DFC_FrAMotor_28ISigGroup_Motor_28_CNT" 120 "DFC_FrAMotor_Code_01ISigGroup_Motor_Code_01_CHK" 121 "DFC_FrAMotor_Code_01ISigGroup_Motor_Code_01_CNT" 122 "DFC_FrAMotor_TS_01ISigGroup_Motor_TS_01_CHK" 123 "DFC_FrAMotor_TS_01ISigGroup_Motor_TS_01_CNT" 124 "DFC_FrAMotor_TS_02ISigGroup_Motor_TS_02_CHK" 125 "DFC_FrAMotor_TS_02ISigGroup_Motor_TS_02_CNT" 126 "DFC_FrAMotor_TS_03ISigGroup_Motor_TS_03_CHK" 127 "DFC_FrAMotor_TS_03ISigGroup_Motor_TS_03_CNT" 128 "DFC_FrASARA_06ISigGroup_SARA_06_CHK" 129 "DFC_FrASARA_06ISigGroup_SARA_06_CNT" 130 "DFC_FrATSG_FT_02ISigGroup_TSG_FT_02_CHK" 131 "DFC_FrATSG_FT_02ISigGroup_TSG_FT_02_CNT" 132 "DFC_FrATSK_06ISigGroup_TSK_06_CHK" 133 "DFC_FrATSK_06ISigGroup_TSK_06_CNT" 134 "DFC_FrATSK_08ISigGroup_TSK_08_CHK" 135 "DFC_FrATSK_08ISigGroup_TSK_08_CNT" 136 "DFC_FrAWBA_03" 137 "DFC_AdcBkg" 138 "DFC_Adc_Rdnt_0" 139 "DFC_Adc_Rdnt_1" 140 "DFC_Adc_Rdnt_2" 141 "DFC_Adc_Rdnt_3" 142 "DFC_Adc_Rdnt_4" 143 "DFC_Adc_Rdnt_5" 144 "DFC_Adc_Rdnt_6" 145 "DFC_Adc_Rdnt_7" 146 "DFC_Adc_Rdnt_8" 147 "DFC_Adc_Rdnt_9" 148 "DFC_Adc_SB_0" 149 "DFC_Adc_SB_1" 150 "DFC_Adc_SB_2" 151 "DFC_Adc_SB_3" 152 "DFC_Adc_SB_4" 153 "DFC_Adc_SB_5" 154 "DFC_Adc_SB_6" 155 "DFC_Adc_SB_7" 156 "DFC_Adc_SB_8" 157 "DFC_Adc_SB_9" 158 "DFC_Adc_SG_0" 159 "DFC_Adc_SG_1" 160 "DFC_Adc_SG_2" 161 "DFC_Adc_SG_3" 162 "DFC_Adc_SG_4" 163 "DFC_Adc_SG_5" 164 "DFC_Adc_SG_6" 165 "DFC_Adc_SG_7" 166 "DFC_Adc_SG_8" 167 "DFC_Adc_SG_9" 168 "DFC_Adc_Unit" 169 "DFC_BattSply_UHi" 170 "DFC_BattSply_ULo" 171 "DFC_CpuTemp" 172 "DFC_CrntCtrl_Channel_0" 173 "DFC_CrntCtrl_Channel_1" 174 "DFC_CrntCtrl_Channel_2" 175 "DFC_CrntCtrl_Channel_3" 176 "DFC_CrntCtrl_Channel_4" 177 "DFC_CrntCtrl_Channel_5" 178 "DFC_CrntCtrl_Channel_6" 179 "DFC_CrntCtrl_Channel_7" 180 "DFC_CrntCtrl_Channel_8" 181 "DFC_CrntCtrl_Channel_9" 182 "DFC_CrntCtrl_Channel_10" 183 "DFC_CrntCtrl_Channel_11" 184 "DFC_CrntCtrl_Channel_12" 185 "DFC_CrntCtrl_Channel_13" 186 "DFC_CrntCtrl_Channel_14" 187 "DFC_CrntCtrl_Channel_15" 188 "DFC_CrntCtrl_Channel_16" 189 "DFC_CrntCtrl_Channel_17" 190 "DFC_CrntCtrl_Channel_18" 191 "DFC_CrntCtrl_Channel_19" 192 "DFC_CrntCtrl_CrntMon_0" 193 "DFC_CrntCtrl_CrntMon_1" 194 "DFC_CrntCtrl_CrntMon_2" 195 "DFC_CrntCtrl_CrntMon_3" 196 "DFC_CrntCtrl_CrntMon_4" 197 "DFC_CrntCtrl_CrntMon_5" 198 "DFC_CrntCtrl_CrntMon_6" 199 "DFC_CrntCtrl_CrntMon_7" 200 "DFC_CrntCtrl_CrntMon_8" 201 "DFC_CrntCtrl_CrntMon_9" 202 "DFC_CrntCtrl_CrntMon_10" 203 "DFC_CrntCtrl_CrntMon_11" 204 "DFC_CrntCtrl_CrntMon_12" 205 "DFC_CrntCtrl_CrntMon_13" 206 "DFC_CrntCtrl_CrntMon_14" 207 "DFC_CrntCtrl_CrntMon_15" 208 "DFC_CrntCtrl_CrntMon_16" 209 "DFC_CrntCtrl_CrntMon_17" 210 "DFC_CrntCtrl_CrntMon_18" 211 "DFC_CrntCtrl_CrntMon_19" 212 "DFC_CrntCtrl_OP_0" 213 "DFC_CrntCtrl_OP_1" 214 "DFC_CrntCtrl_OP_2" 215 "DFC_CrntCtrl_OP_3" 216 "DFC_CrntCtrl_OP_4" 217 "DFC_CrntCtrl_OP_5" 218 "DFC_CrntCtrl_OP_6" 219 "DFC_CrntCtrl_OP_7" 220 "DFC_CrntCtrl_OP_8" 221 "DFC_CrntCtrl_OP_9" 222 "DFC_CrntCtrl_OP_10" 223 "DFC_CrntCtrl_OP_11" 224 "DFC_CrntCtrl_OP_12" 225 "DFC_CrntCtrl_OP_13" 226 "DFC_CrntCtrl_OP_14" 227 "DFC_CrntCtrl_OP_15" 228 "DFC_CrntCtrl_OP_16" 229 "DFC_CrntCtrl_OP_17" 230 "DFC_CrntCtrl_OP_18" 231 "DFC_CrntCtrl_OP_19" 232 "DFC_CrntCtrl_SB_0" 233 "DFC_CrntCtrl_SB_1" 234 "DFC_CrntCtrl_SB_2" 235 "DFC_CrntCtrl_SB_3" 236 "DFC_CrntCtrl_SB_4" 237 "DFC_CrntCtrl_SB_5" 238 "DFC_CrntCtrl_SB_6" 239 "DFC_CrntCtrl_SB_7" 240 "DFC_CrntCtrl_SB_8" 241 "DFC_CrntCtrl_SB_9" 242 "DFC_CrntCtrl_SB_10" 243 "DFC_CrntCtrl_SB_11" 244 "DFC_CrntCtrl_SB_12" 245 "DFC_CrntCtrl_SB_13" 246 "DFC_CrntCtrl_SB_14" 247 "DFC_CrntCtrl_SB_15" 248 "DFC_CrntCtrl_SB_16" 249 "DFC_CrntCtrl_SB_17" 250 "DFC_CrntCtrl_SB_18" 251 "DFC_CrntCtrl_SB_19" 252 "DFC_CrntCtrl_SG_0" 253 "DFC_CrntCtrl_SG_1" 254 "DFC_CrntCtrl_SG_2" 255 "DFC_CrntCtrl_SG_3" 256 "DFC_CrntCtrl_SG_4" 257 "DFC_CrntCtrl_SG_5" 258 "DFC_CrntCtrl_SG_6" 259 "DFC_CrntCtrl_SG_7" 260 "DFC_CrntCtrl_SG_8" 261 "DFC_CrntCtrl_SG_9" 262 "DFC_CrntCtrl_SG_10" 263 "DFC_CrntCtrl_SG_11" 264 "DFC_CrntCtrl_SG_12" 265 "DFC_CrntCtrl_SG_13" 266 "DFC_CrntCtrl_SG_14" 267 "DFC_CrntCtrl_SG_15" 268 "DFC_CrntCtrl_SG_16" 269 "DFC_CrntCtrl_SG_17" 270 "DFC_CrntCtrl_SG_18" 271 "DFC_CrntCtrl_SG_19" 272 "DFC_CrntCtrl_Unit_0" 273 "DFC_CrntCtrl_Unit_1" 274 "DFC_CtrlMot_DNR_0" 275 "DFC_CtrlMot_DNR_1" 276 "DFC_CtrlMot_OC_0" 277 "DFC_CtrlMot_OC_1" 278 "DFC_CtrlMot_OL_0" 279 "DFC_CtrlMot_OL_1" 280 "DFC_CtrlMot_SB_0" 281 "DFC_CtrlMot_SB_1" 282 "DFC_CtrlMot_SG_0" 283 "DFC_CtrlMot_SG_1" 284 "DFC_Flx_AdcInUnit_0" 285 "DFC_Flx_AdcInUnit_1" 286 "DFC_Flx_AdcInUnit_2" 287 "DFC_Flx_RMeasUnit_0" 288 "DFC_Flx_RMeasUnit_1" 289 "DFC_Flx_SB_0" 290 "DFC_Flx_SB_1" 291 "DFC_Flx_SB_2" 292 "DFC_Flx_SB_3" 293 "DFC_Flx_SB_4" 294 "DFC_Flx_SB_5" 295 "DFC_Flx_SB_6" 296 "DFC_Flx_SB_7" 297 "DFC_Flx_SB_8" 298 "DFC_Flx_SB_9" 299 "DFC_Flx_SB_10" 300 "DFC_Flx_SB_11" 301 "DFC_Flx_SB_12" 302 "DFC_Flx_SB_13" 303 "DFC_Flx_SB_14" 304 "DFC_Flx_SB_15" 305 "DFC_Flx_SB_16" 306 "DFC_Flx_SB_17" 307 "DFC_Flx_SB_18" 308 "DFC_Flx_SB_19" 309 "DFC_Flx_SB_20" 310 "DFC_Flx_SB_21" 311 "DFC_Flx_SB_22" 312 "DFC_Flx_SB_23" 313 "DFC_Flx_SB_24" 314 "DFC_Flx_SB_25" 315 "DFC_Flx_SB_26" 316 "DFC_Flx_SG_0" 317 "DFC_Flx_SG_1" 318 "DFC_Flx_SG_2" 319 "DFC_Flx_SG_3" 320 "DFC_Flx_SG_4" 321 "DFC_Flx_SG_5" 322 "DFC_Flx_SG_6" 323 "DFC_Flx_SG_7" 324 "DFC_Flx_SG_8" 325 "DFC_Flx_SG_9" 326 "DFC_Flx_SG_10" 327 "DFC_Flx_SG_11" 328 "DFC_Flx_SG_12" 329 "DFC_Flx_SG_13" 330 "DFC_Flx_SG_14" 331 "DFC_Flx_SG_15" 332 "DFC_Flx_SG_16" 333 "DFC_Flx_SG_17" 334 "DFC_Flx_SG_18" 335 "DFC_Flx_SG_19" 336 "DFC_Flx_SG_20" 337 "DFC_Flx_SG_21" 338 "DFC_Flx_SG_22" 339 "DFC_Flx_SG_23" 340 "DFC_Flx_SG_24" 341 "DFC_Flx_SG_25" 342 "DFC_Flx_SG_26" 343 "DFC_Flx_Sig_0" 344 "DFC_Flx_Sig_1" 345 "DFC_Flx_Sig_2" 346 "DFC_Flx_Sig_3" 347 "DFC_Flx_Sig_4" 348 "DFC_Flx_Sig_5" 349 "DFC_Flx_Sig_6" 350 "DFC_Flx_Sig_7" 351 "DFC_Flx_Sig_8" 352 "DFC_Flx_Sig_9" 353 "DFC_Flx_Sig_10" 354 "DFC_Flx_Sig_11" 355 "DFC_Flx_Sig_12" 356 "DFC_Flx_Sig_13" 357 "DFC_Flx_Sig_14" 358 "DFC_Flx_Sig_15" 359 "DFC_Flx_Sig_16" 360 "DFC_Flx_Sig_17" 361 "DFC_Flx_Sig_18" 362 "DFC_Flx_Sig_19" 363 "DFC_Flx_Sig_20" 364 "DFC_Flx_Sig_21" 365 "DFC_Flx_Sig_22" 366 "DFC_Flx_Sig_23" 367 "DFC_Flx_Sig_24" 368 "DFC_Flx_Sig_25" 369 "DFC_Flx_Sig_26" 370 "DFC_Gtm_Clk" 371 "DFC_HiSide_OP_0" 372 "DFC_HiSide_OP_1" 373 "DFC_HiSide_OP_2" 374 "DFC_HiSide_OP_3" 375 "DFC_HiSide_OP_4" 376 "DFC_HiSide_OP_5" 377 "DFC_HiSide_SB_0" 378 "DFC_HiSide_SB_1" 379 "DFC_HiSide_SB_2" 380 "DFC_HiSide_SB_3" 381 "DFC_HiSide_SB_4" 382 "DFC_HiSide_SB_5" 383 "DFC_HiSide_SG_0" 384 "DFC_HiSide_SG_1" 385 "DFC_HiSide_SG_2" 386 "DFC_HiSide_SG_3" 387 "DFC_HiSide_SG_4" 388 "DFC_HiSide_SG_5" 389 "DFC_IntSply_0" 390 "DFC_IntSply_1" 391 "DFC_IntSply_2" 392 "DFC_IntSply_3" 393 "DFC_IntSply_4" 394 "DFC_IntSply_5" 395 "DFC_IntTemp" 396 "DFC_LssRly_OL" 397 "DFC_LssRly_SB" 398 "DFC_LssRly_SG" 399 "DFC_Lss_OL_0" 400 "DFC_Lss_OL_1" 401 "DFC_Lss_OL_2" 402 "DFC_Lss_OL_3" 403 "DFC_Lss_OL_4" 404 "DFC_Lss_OL_5" 405 "DFC_Lss_OL_6" 406 "DFC_Lss_OL_7" 407 "DFC_Lss_OL_8" 408 "DFC_Lss_OL_9" 409 "DFC_Lss_OL_10" 410 "DFC_Lss_OL_11" 411 "DFC_Lss_SB_0" 412 "DFC_Lss_SB_1" 413 "DFC_Lss_SB_2" 414 "DFC_Lss_SB_3" 415 "DFC_Lss_SB_4" 416 "DFC_Lss_SB_5" 417 "DFC_Lss_SB_6" 418 "DFC_Lss_SB_7" 419 "DFC_Lss_SB_8" 420 "DFC_Lss_SB_9" 421 "DFC_Lss_SB_10" 422 "DFC_Lss_SB_11" 423 "DFC_Lss_SG_0" 424 "DFC_Lss_SG_1" 425 "DFC_Lss_SG_2" 426 "DFC_Lss_SG_3" 427 "DFC_Lss_SG_4" 428 "DFC_Lss_SG_5" 429 "DFC_Lss_SG_6" 430 "DFC_Lss_SG_7" 431 "DFC_Lss_SG_8" 432 "DFC_Lss_SG_9" 433 "DFC_Lss_SG_10" 434 "DFC_Lss_SG_11" 435 "DFC_Lss_Unit" 436 "DFC_OsTmrMon" 437 "DFC_PwmIn_GtmTim_0" 438 "DFC_PwmIn_GtmTim_1" 439 "DFC_PwmIn_GtmTim_2" 440 "DFC_PwmIn_GtmTim_3" 441 "DFC_PwmIn_GtmTim_4" 442 "DFC_PwmIn_GtmTim_5" 443 "DFC_PwmIn_GtmTim_6" 444 "DFC_PwmIn_GtmTim_7" 445 "DFC_PwmIn_GtmTim_8" 446 "DFC_PwmIn_GtmTim_9" 447 "DFC_PwmIn_GtmTim_10" 448 "DFC_PwmIn_GtmTim_11" 449 "DFC_PwmIn_SB_0" 450 "DFC_PwmIn_SB_1" 451 "DFC_PwmIn_SB_2" 452 "DFC_PwmIn_SB_3" 453 "DFC_PwmIn_SB_4" 454 "DFC_PwmIn_SB_5" 455 "DFC_PwmIn_SB_6" 456 "DFC_PwmIn_SB_7" 457 "DFC_PwmIn_SB_8" 458 "DFC_PwmIn_SB_9" 459 "DFC_PwmIn_SB_10" 460 "DFC_PwmIn_SB_11" 461 "DFC_PwmIn_SG_0" 462 "DFC_PwmIn_SG_1" 463 "DFC_PwmIn_SG_2" 464 "DFC_PwmIn_SG_3" 465 "DFC_PwmIn_SG_4" 466 "DFC_PwmIn_SG_5" 467 "DFC_PwmIn_SG_6" 468 "DFC_PwmIn_SG_7" 469 "DFC_PwmIn_SG_8" 470 "DFC_PwmIn_SG_9" 471 "DFC_PwmIn_SG_10" 472 "DFC_PwmIn_SG_11" 473 "DFC_PwmIn_Sig_0" 474 "DFC_PwmIn_Sig_1" 475 "DFC_PwmIn_Sig_2" 476 "DFC_PwmIn_Sig_3" 477 "DFC_PwmIn_Sig_4" 478 "DFC_PwmIn_Sig_5" 479 "DFC_PwmIn_Sig_6" 480 "DFC_PwmIn_Sig_7" 481 "DFC_PwmIn_Sig_8" 482 "DFC_PwmIn_Sig_9" 483 "DFC_PwmIn_Sig_10" 484 "DFC_PwmIn_Sig_11" 485 "DFC_SafeSt_flgDn" 486 "DFC_SnsrSply_SB_0" 487 "DFC_SnsrSply_SB_1" 488 "DFC_SnsrSply_SB_2" 489 "DFC_SnsrSply_SB_3" 490 "DFC_SnsrSply_SB_4" 491 "DFC_SnsrSply_SB_5" 492 "DFC_SnsrSply_SG_0" 493 "DFC_SnsrSply_SG_1" 494 "DFC_SnsrSply_SG_2" 495 "DFC_SnsrSply_SG_3" 496 "DFC_SnsrSply_SG_4" 497 "DFC_SnsrSply_SG_5" 498 "DFC_Spd_NdPls_0" 499 "DFC_Spd_NdPls_1" 500 "DFC_Spd_NdPls_2" 501 "DFC_Spd_NdPls_3" 502 "DFC_Spd_NdPls_4" 503 "DFC_Spd_OP_0" 504 "DFC_Spd_OP_1" 505 "DFC_Spd_OP_2" 506 "DFC_Spd_OP_3" 507 "DFC_Spd_OP_4" 508 "DFC_Spd_Pls_0" 509 "DFC_Spd_Pls_1" 510 "DFC_Spd_Pls_2" 511 "DFC_Spd_Pls_3" 512 "DFC_Spd_Pls_4" 513 "DFC_Spd_SB_0" 514 "DFC_Spd_SB_1" 515 "DFC_Spd_SB_2" 516 "DFC_Spd_SB_3" 517 "DFC_Spd_SB_4" 518 "DFC_Spd_SG_0" 519 "DFC_Spd_SG_1" 520 "DFC_Spd_SG_2" 521 "DFC_Spd_SG_3" 522 "DFC_Spd_SG_4" 523 "DFC_Spd_Sig_0" 524 "DFC_Spd_Sig_1" 525 "DFC_Spd_Sig_2" 526 "DFC_Spd_Sig_3" 527 "DFC_Spd_Sig_4" 528 "DFC_Spd_Sync_0" 529 "DFC_Spd_Sync_1" 530 "DFC_Spd_Sync_2" 531 "DFC_Spd_Sync_3" 532 "DFC_Spd_Sync_4" 533 "DFC_WdgSys" 534 "DFC_WdgWd" 535 "DFC_AcceleratorPedalErrorRx" 536 "DFC_AccumulatorChargeFault" 537 "DFC_AltitudeErrorRx" 538 "DFC_BLDCPumpDerateRx" 539 "DFC_BLDCPumpErrorRx" 540 "DFC_BrakePressureErrorRx" 541 "DFC_BrakeSwitchErrorRx" 542 "DFC_BrakeSwitchImplausible1" 543 "DFC_BrakeSwitchImplausible2" 544 "DFC_BrakeSwitchRateHigh" 545 "DFC_BrakeSwitchSpare1" 546 "DFC_BrakeSwitchSpare2" 547 "DFC_ChargeValveStuck" 548 "DFC_Clutch1AdaptationFault" 549 "DFC_Clutch1OverPressure" 550 "DFC_Clutch1UnderPressure" 551 "DFC_Clutch2AdaptationFault" 552 "DFC_Clutch2OverPressure" 553 "DFC_Clutch2UnderPressure" 554 "DFC_ClutchCoolingValveFault" 555 "DFC_ClutchCoolingValveStuck" 556 "DFC_ClutchOverTempoerature" 557 "DFC_ClutchShutOffValveFault" 558 "DFC_CoolantTempErrorRx" 559 "DFC_CoolingPressureImplausible" 560 "DFC_CoolingPressureRateHigh" 561 "DFC_CoolingPressureTooHigh" 562 "DFC_CoolingPressureTooLow" 563 "DFC_CrntCtrl_Reg_1" 564 "DFC_CrntCtrl_Reg_10" 565 "DFC_CrntCtrl_Reg_11" 566 "DFC_CrntCtrl_Reg_12" 567 "DFC_CrntCtrl_Reg_16" 568 "DFC_CrntCtrl_Reg_17" 569 "DFC_CrntCtrl_Reg_18" 570 "DFC_CrntCtrl_Reg_19" 571 "DFC_CrntCtrl_Reg_2" 572 "DFC_CrntCtrl_Reg_3" 573 "DFC_CrntCtrl_Reg_6" 574 "DFC_CrntCtrl_Reg_7" 575 "DFC_CrntCtrl_Reg_9" 576 "DFC_DSTSpare1" 577 "DFC_DSTSpare2" 578 "DFC_DWCSpare1" 579 "DFC_DWCSpare2" 580 "DFC_DWCSpare3" 581 "DFC_DWCSpare4" 582 "DFC_DWCSpare5" 583 "DFC_DWCSpare6" 584 "DFC_DWCSpare7" 585 "DFC_DoorStatusErrorRx" 586 "DFC_DownSwImplausible" 587 "DFC_DownSwRateHigh" 588 "DFC_DownSwSpare1" 589 "DFC_DownSwSpare2" 590 "DFC_EM1SpeedErrorRx" 591 "DFC_ENGDriveTorqueImplausible" 592 "DFC_ENGEngineProblem" 593 "DFC_ENGIdiotStart" 594 "DFC_ENGSpare1" 595 "DFC_ENGSpare2" 596 "DFC_ESPStatusErrorRx" 597 "DFC_EngineOilTempErrorRx" 598 "DFC_EngineSpeedErrorRx" 599 "DFC_EngineSpeedPWMImplausible1" 600 "DFC_EngineSpeedPWMImplausible2" 601 "DFC_EngineSpeedPWMRateHigh" 602 "DFC_EngineSpeedPWMSpare1" 603 "DFC_EngineSpeedPWMSpare2" 604 "DFC_EngineTorqueErrorRx" 605 "DFC_ExternalTempErrorRx" 606 "DFC_FailStuckNFault" 607 "DFC_FrontLeftWheelSpeedErrorRx" 608 "DFC_FrontRightWheelSpeedErrorRx" 609 "DFC_GearCoolingValveStuck" 610 "DFC_K1PressureImplausible" 611 "DFC_K1PressureRateHigh" 612 "DFC_K1PressureSpare1" 613 "DFC_K1PressureSpare2" 614 "DFC_K1SpeedHigh" 615 "DFC_K1SpeedImplausible" 616 "DFC_K1SpeedSpare1" 617 "DFC_K1SpeedSpare2" 618 "DFC_K2PressureImplausible" 619 "DFC_K2PressureRateHigh" 620 "DFC_K2PressureSpare1" 621 "DFC_K2PressureSpare2" 622 "DFC_K2SpeedHigh" 623 "DFC_K2SpeedImplausible" 624 "DFC_K2SpeedSpare1" 625 "DFC_K2SpeedSpare2" 626 "DFC_L2ClutchPressureVsCurrentOdd" 627 "DFC_L2ClutchTorqueDirection" 628 "DFC_L2DoubleClutchEngagement" 629 "DFC_L2DoubleGearEven" 630 "DFC_L2EM1ShaftOverspeed" 631 "DFC_L2EPBWhenMoving" 632 "DFC_L2EvenClutchGradientInCreep" 633 "DFC_L2ForwardDriveEven" 634 "DFC_L2ForwardDriveOdd" 635 "DFC_L2ForwardGearAndMode" 636 "DFC_L2GearCombinationEM1Overspeed" 637 "DFC_L2GearCombinationRequest" 638 "DFC_L2InputShaftEngineOverspeed" 639 "DFC_L2InsufficientLubrication" 640 "DFC_L2InvalidDownshiftOdd" 641 "DFC_L2InvalidGearControl" 642 "DFC_L2LeaveNeutral" 643 "DFC_L2LeavePark" 644 "DFC_L2ModeDisplay" 645 "DFC_L2ModeSelection" 646 "DFC_L2MovementWithChargeCable" 647 "DFC_L2OddClutchGradientInCreep" 648 "DFC_L2OddShaftAccelerationImplausible" 649 "DFC_L2ParkFailNoEPB" 650 "DFC_L2ParkPosition" 651 "DFC_L2ParkValveOverride" 652 "DFC_L2ParkWhenMoving" 653 "DFC_L2ReferenceSpeedFail" 654 "DFC_L2ReverseDrive" 655 "DFC_L2ShaftOverSpeedFromIP" 656 "DFC_L2ShaftOverSpeedFromOP" 657 "DFC_L2Spare1" 658 "DFC_L2Spare2" 659 "DFC_L2TorqueNoShift" 660 "DFC_L2TorqueRequestCupOfFuel" 661 "DFC_L2VGPOverride" 662 "DFC_L2VKUGLOveride" 663 "DFC_L2VSS1Overirde" 664 "DFC_L2VSS2Overirde" 665 "DFC_LatAccErrorRx" 666 "DFC_LinePressureImplausible" 667 "DFC_LinePressureLeakageHigh" 668 "DFC_LinePressureRateHigh" 669 "DFC_LinePressureSpare1" 670 "DFC_LinePressureSpare2" 671 "DFC_LinePressureTooHigh" 672 "DFC_LinePressureTooLow" 673 "DFC_LongAccErrorRx" 674 "DFC_LubeOilOverTemperature" 675 "DFC_LubeTemperatureImplausible" 676 "DFC_LubeTemperatureRateHigh" 677 "DFC_LubeTemperatureSpare1" 678 "DFC_LubeTemperatureSpare2" 679 "DFC_MOTEngineProblem" 680 "DFC_MOTSpare1" 681 "DFC_MOTSpare2" 682 "DFC_ModeMSwImplausible" 683 "DFC_ModeMSwSpare1" 684 "DFC_ModeMSwSpare2" 685 "DFC_ModeMSwSwRateHigh" 686 "DFC_ModePSwImplausible" 687 "DFC_ModePSwSpare1" 688 "DFC_ModePSwSpare2" 689 "DFC_ModePSwSwRateHigh" 690 "DFC_ModeRSwImplausible" 691 "DFC_ModeRSwSpare1" 692 "DFC_ModeRSwSpare2" 693 "DFC_ModeRSwSwRateHigh" 694 "DFC_ParkLockDisengageFail" 695 "DFC_ParkLockEngageFail" 696 "DFC_ParkLockPosImplausible" 697 "DFC_ParkLockPosRateHigh" 698 "DFC_ParkLockPosSpare1" 699 "DFC_ParkLockPosSpare2" 700 "DFC_PumpResponseFault" 701 "DFC_PumpSpeedError" 702 "DFC_RearLeftWheelSpeedErrorRx" 703 "DFC_RearRightWheelSpeedErrorRx" 704 "DFC_RedSpeedHigh" 705 "DFC_RedSpeedImplausible" 706 "DFC_RedSpeedSpare1" 707 "DFC_RedSpeedSpare2" 708 "DFC_SEQSpare1" 709 "DFC_SEQSpare2" 710 "DFC_SEQTimeout" 711 "DFC_Spare_0" 712 "DFC_Spare_1" 713 "DFC_Spare_2" 714 "DFC_Spare_3" 715 "DFC_Spare_4" 716 "DFC_Spare_5" 717 "DFC_Spare_6" 718 "DFC_Spare_7" 719 "DFC_Spare_8" 720 "DFC_Spare_9" 721 "DFC_SumpOilOverTemperature" 722 "DFC_SumpTemperatureImplausible" 723 "DFC_SumpTemperatureRateHigh" 724 "DFC_SumpTemperatureSpare1" 725 "DFC_SumpTemperatureSpare2" 726 "DFC_SynchroA1EngageFault" 727 "DFC_SynchroA1SpitoutInShiftFault" 728 "DFC_SynchroA1SpitoutNoShiftFault" 729 "DFC_SynchroA1StuckFault" 730 "DFC_SynchroA2EngageFault" 731 "DFC_SynchroA2SpitoutInShiftFault" 732 "DFC_SynchroA2SpitoutNoShiftFault" 733 "DFC_SynchroA2StuckFault" 734 "DFC_SynchroAOutOfNInShiftFault" 735 "DFC_SynchroAOutOfNNoShiftFault" 736 "DFC_SynchroAPosImplausible" 737 "DFC_SynchroAPosRateHigh" 738 "DFC_SynchroAPosSpare1" 739 "DFC_SynchroAPosSpare2" 740 "DFC_SynchroB1EngageFault" 741 "DFC_SynchroB1SpitoutInShiftFault" 742 "DFC_SynchroB1SpitoutNoShiftFault" 743 "DFC_SynchroB1StuckFault" 744 "DFC_SynchroB2EngageFault" 745 "DFC_SynchroB2SpitoutInShiftFault" 746 "DFC_SynchroB2SpitoutNoShiftFault" 747 "DFC_SynchroB2StuckFault" 748 "DFC_SynchroBOutOfNInShiftFault" 749 "DFC_SynchroBOutOfNNoShiftFault" 750 "DFC_SynchroBPosImplausible" 751 "DFC_SynchroBPosRateHigh" 752 "DFC_SynchroBPosSpare1" 753 "DFC_SynchroBPosSpare2" 754 "DFC_SynchroC1EngageFault" 755 "DFC_SynchroC1SpitoutInShiftFault" 756 "DFC_SynchroC1SpitoutNoShiftFault" 757 "DFC_SynchroC1StuckFault" 758 "DFC_SynchroC2EngageFault" 759 "DFC_SynchroC2SpitoutInShiftFault" 760 "DFC_SynchroC2SpitoutNoShiftFault" 761 "DFC_SynchroC2StuckFault" 762 "DFC_SynchroCOutOfNInShiftFault" 763 "DFC_SynchroCOutOfNNoShiftFault" 764 "DFC_SynchroCPosImplausible" 765 "DFC_SynchroCPosRateHigh" 766 "DFC_SynchroCPosSpare1" 767 "DFC_SynchroCPosSpare2" 768 "DFC_SynchroD1EngageFault" 769 "DFC_SynchroD1SpitoutInShiftFault" 770 "DFC_SynchroD1SpitoutNoShiftFault" 771 "DFC_SynchroD1StuckFault" 772 "DFC_SynchroDOutOfNInShiftFault" 773 "DFC_SynchroDOutOfNNoShiftFault" 774 "DFC_SynchroDPosImplausible" 775 "DFC_SynchroDPosRateHigh" 776 "DFC_SynchroDPosSpare1" 777 "DFC_SynchroDPosSpare2" 778 "DFC_SynchroF1EngageFault" 779 "DFC_SynchroF1SpitoutInShiftFault" 780 "DFC_SynchroF1SpitoutNoShiftFault" 781 "DFC_SynchroF1StuckFault" 782 "DFC_SynchroF2EngageFault" 783 "DFC_SynchroF2SpitoutInShiftFault" 784 "DFC_SynchroF2SpitoutNoShiftFault" 785 "DFC_SynchroF2StuckFault" 786 "DFC_SynchroFOutOfNInShiftFault" 787 "DFC_SynchroFOutOfNNoShiftFault" 788 "DFC_SynchroFPosImplausible" 789 "DFC_SynchroFPosRateHigh" 790 "DFC_SynchroFPosSpare1" 791 "DFC_SynchroFPosSpare2" 792 "DFC_UpSwImplausible" 793 "DFC_UpSwRateHigh" 794 "DFC_UpSwSpare1" 795 "DFC_UpSwSpare2" 796 "DFC_VehicleSpeedErrorRx" 797 "DFC_WheelTorqueESPErrorRx" 798 "DFC_YawRateErrorRx" 799 "DFC_Can0Motor_01_TO" 800 "DFC_Can0Motor_02_TO" 801 "DFC_Can0Motor_03_TO" 802 "DFC_Can1BYPASS_TDG1_11_TO" 803 "DFC_Can1BYPASS_TDG1_12_TO" 804 "DFC_Can1BYPASS_TDG1_13_TO" 805 "DFC_Can1BYPASS_TDG1_14_TO" 806 "DFC_Can1BYPASS_TDG1_15_TO" 807 "DFC_Can1BYPASS_TDG1_16_PlaceHolder_TO" 808 "DFC_Can1BYPASS_TDG1_17_PlaceHolder_TO" 809 "DFC_Can1BYPASS_TDG1_18_PlaceHolder_TO" 810 "DFC_Can1BYPASS_TDG1_19_Placeholder_TO" 811 "DFC_Can1BYPASS_TDG1_20_Placeholder_TO" 812 "DFC_Can1BYPASS_TDG1_21_TO" 813 "DFC_Can1BYPASS_TDG1_22_TO" 814 "DFC_Can1Cool_Act_Sts_TO" 815 "DFC_DsmTest0" 816 "DFC_FrAACC_06ISigGroup_ACC_06_TO" 817 "DFC_FrAACC_06_TO" 818 "DFC_FrAACC_07ISigGroup_ACC_07_TO" 819 "DFC_FrAACC_07_TO" 820 "DFC_FrAAirbag_01ISigGroup_Airbag_01_TO" 821 "DFC_FrAAirbag_01_TO" 822 "DFC_FrAAirbag_02ISigGroup_Airbag_02_TO" 823 "DFC_FrAAirbag_02_TO" 824 "DFC_FrABCM_01_TO" 825 "DFC_FrABremse_EV_01ISigGroup_Bremse_EV_01_TO" 826 "DFC_FrABremse_EV_01_TO" 827 "DFC_FrABremse_EV_02ISigGroup_Bremse_EV_02_TO" 828 "DFC_FrABremse_EV_02_TO" 829 "DFC_FrACharisma_01_TO" 830 "DFC_FrADiagnose_01_TO" 831 "DFC_FrAEBKV_01ISigGroup_EBKV_01_TO" 832 "DFC_FrAEBKV_01_TO" 833 "DFC_FrAEM1_HYB_06_TO" 834 "DFC_FrAEM1_HYB_12ISigGroup_EM1_HYB_12_TO" 835 "DFC_FrAEM1_HYB_12_TO" 836 "DFC_FrAEPB_01ISigGroup_EPB_01_TO" 837 "DFC_FrAEPB_01_TO" 838 "DFC_FrAESP_03ISigGroup_ESP_03_TO" 839 "DFC_FrAESP_03_TO" 840 "DFC_FrAESP_05ISigGroup_ESP_05_TO" 841 "DFC_FrAESP_05_TO" 842 "DFC_FrAESP_07ISigGroup_ESP_07_TO" 843 "DFC_FrAESP_07_TO" 844 "DFC_FrAESP_08ISigGroup_ESP_08_TO" 845 "DFC_FrAESP_08_TO" 846 "DFC_FrAESP_15ISigGroup_ESP_15_TO" 847 "DFC_FrAESP_15_TO" 848 "DFC_FrAESP_20ISigGroup_ESP_20_TO" 849 "DFC_FrAESP_20_TO" 850 "DFC_FrAESP_21ISigGroup_ESP_21_TO" 851 "DFC_FrAESP_21_TO" 852 "DFC_FrAESP_22ISigGroup_ESP_22_TO" 853 "DFC_FrAESP_22_TO" 854 "DFC_FrAESP_23ISigGroup_ESP_23_TO" 855 "DFC_FrAESP_23_TO" 856 "DFC_FrAESP_24ISigGroup_ESP_24_TO" 857 "DFC_FrAESP_24_TO" 858 "DFC_FrAESP_26_TO" 859 "DFC_FrAESP_28ISigGroup_ESP_28_TO" 860 "DFC_FrAESP_28_TO" 861 "DFC_FrAESP_31ISigGroup_ESP_31_TO" 862 "DFC_FrAESP_31_TO" 863 "DFC_FrAESP_32ISigGroup_ESP_32_TO" 864 "DFC_FrAESP_32_TO" 865 "DFC_FrAESP_33ISigGroup_ESP_33_TO" 866 "DFC_FrAESP_33_TO" 867 "DFC_FrAESP_41ISigGroup_ESP_41_TO" 868 "DFC_FrAESP_41_TO" 869 "DFC_FrAESP_44ISigGroup_ESP_44_TO" 870 "DFC_FrAESP_44_TO" 871 "DFC_FrAKlemmen_Status_01ISigGroup_Klemmen_Status_01_TO" 872 "DFC_FrAKlemmen_Status_01_TO" 873 "DFC_FrAKlima_11_TO" 874 "DFC_FrAKombi_02_TO" 875 "DFC_FrALCV_01ISigGroup_LCV_01_TO" 876 "DFC_FrALCV_01_TO" 877 "DFC_FrALWI_01ISigGroup_LWI_01_TO" 878 "DFC_FrALWI_01_TO" 879 "DFC_FrAMFL_Tasten_01_TO" 880 "DFC_FrAMSG_EM1_18_TO" 881 "DFC_FrAMSG_EM1_29_TO" 882 "DFC_FrAMotor_07_TO" 883 "DFC_FrAMotor_11ISigGroup_Motor_11_TO" 884 "DFC_FrAMotor_11_TO" 885 "DFC_FrAMotor_12ISigGroup_Motor_12_TO" 886 "DFC_FrAMotor_12_TO" 887 "DFC_FrAMotor_14ISigGroup_Motor_14_TO" 888 "DFC_FrAMotor_14_TO" 889 "DFC_FrAMotor_16_TO" 890 "DFC_FrAMotor_17_TO" 891 "DFC_FrAMotor_18_TO" 892 "DFC_FrAMotor_20ISigGroup_Motor_20_TO" 893 "DFC_FrAMotor_20_TO" 894 "DFC_FrAMotor_27ISigGroup_Motor_27_TO" 895 "DFC_FrAMotor_27_TO" 896 "DFC_FrAMotor_28ISigGroup_Motor_28_TO" 897 "DFC_FrAMotor_28_TO" 898 "DFC_FrAMotor_35_TO" 899 "DFC_FrAMotor_38_LB_TO" 900 "DFC_FrAMotor_47_TO" 901 "DFC_FrAMotor_Code_01ISigGroup_Motor_Code_01_TO" 902 "DFC_FrAMotor_Code_01_TO" 903 "DFC_FrAMotor_Hybrid_11_TO" 904 "DFC_FrAMotor_TS_01ISigGroup_Motor_TS_01_TO" 905 "DFC_FrAMotor_TS_01_TO" 906 "DFC_FrAMotor_TS_02ISigGroup_Motor_TS_02_TO" 907 "DFC_FrAMotor_TS_02_TO" 908 "DFC_FrAMotor_TS_03ISigGroup_Motor_TS_03_TO" 909 "DFC_FrAMotor_TS_03_TO" 910 "DFC_FrANVEM_02_TO" 911 "DFC_FrANVEM_05_TO" 912 "DFC_FrAOBD_01_TO" 913 "DFC_FrAOBD_02_TO" 914 "DFC_FrASARA_06ISigGroup_SARA_06_TO" 915 "DFC_FrASARA_06_TO" 916 "DFC_FrASysteminfo_01_TO" 917 "DFC_FrATSG_FT_02ISigGroup_TSG_FT_02_TO" 918 "DFC_FrATSG_FT_02_TO" 919 "DFC_FrATSK_06ISigGroup_TSK_06_TO" 920 "DFC_FrATSK_06_TO" 921 "DFC_FrATSK_08ISigGroup_TSK_08_TO" 922 "DFC_FrATSK_08_TO" 923 "DFC_FrAVIN_01_0_TO" 924 "DFC_FrAVIN_01_1_TO" 925 "DFC_FrAVIN_01_2_TO" 926 "DFC_IPT" 927 "DFC_L3Error" 928 "DFC_SftyCfgMon" 929 "DFC_SftyShtOff" 930 "DFC_DsmTest4" 931 "DFC_BSWM_E_ACTION_FAILED" 932 "DFC_BSWM_E_INTRPTQUEUE_FULL" 933 "DFC_CANSM_E_BUS_OFF_NETWORK_0" 934 "DFC_CANSM_E_BUS_OFF_NETWORK_1" 935 "DFC_CANSM_E_BUS_OFF_NETWORK_2" 936 "DFC_CANSM_E_BUS_OFF_NETWORK_3" 937 "DFC_FRSM_E_CLUSTER_STARTUP" 938 "DFC_FRTRCV_E_NO_TRCV_CONTROL_0" 939 "DFC_FR_E_ACCESS" 940 "DFC_RBA_IOEXTLIB_KEEPALIVE_DRV" 941 "DFC_RBA_IOEXTLIB_KEEPALIVE_INI" 942 "DFC_rba_MultiStackTrace_Threshold" 943 "DFC_CAN_E_TIMEOUT" 944 "DFC_FRSM_E_CLUSTER_SYNC_LOSS" 945 "DFC_PDUR_E_INIT_FAILED" 946 "DFC_PDUR_E_PDU_INSTANCE_LOST" 947 "DFC_rba_IoSigRtc_StopCounter" 948 "DFC_rba_T15_Diag_ComInVld_Event" 949 "DFC_rba_T15_Diag_ComOff_HwOn_Event" 950 "DFC_rba_T15_Diag_ComOn_HwOff_Event" 951 "DFC_DSMDummy" 952 "DFC_DsmTest3";
VAL_ 2041 DFES_numDFC_01_ 0 "DFC_Unused" 1 "DFC_DsmTest2" 2 "DFC_Can0Getriebe_01" 3 "DFC_Can0Motor_01_CHK" 4 "DFC_Can0Motor_01_CNT" 5 "DFC_Can0Motor_01_DLC" 6 "DFC_Can0Motor_02_CHK" 7 "DFC_Can0Motor_02_CNT" 8 "DFC_Can0Motor_02_DLC" 9 "DFC_Can0Motor_03_CHK" 10 "DFC_Can0Motor_03_CNT" 11 "DFC_Can0Motor_03_DLC" 12 "DFC_Can1BYPASS_TDG1_11_DLC" 13 "DFC_Can1BYPASS_TDG1_12_DLC" 14 "DFC_Can1BYPASS_TDG1_13_DLC" 15 "DFC_Can1BYPASS_TDG1_14_DLC" 16 "DFC_Can1BYPASS_TDG1_15_DLC" 17 "DFC_Can1BYPASS_TDG1_16_PlaceHolder_DLC" 18 "DFC_Can1BYPASS_TDG1_17_PlaceHolder_DLC" 19 "DFC_Can1BYPASS_TDG1_18_PlaceHolder_DLC" 20 "DFC_Can1BYPASS_TDG1_19_Placeholder_DLC" 21 "DFC_Can1BYPASS_TDG1_20_Placeholder_DLC" 22 "DFC_Can1BYPASS_TDG1_21_DLC" 23 "DFC_Can1BYPASS_TDG1_22_DLC" 24 "DFC_Can1BYPASS_TDG1_AA" 25 "DFC_Can1BYPASS_TDG1_AB" 26 "DFC_Can1BYPASS_TDG1_AC" 27 "DFC_Can1BYPASS_TDG1_AD" 28 "DFC_Can1BYPASS_TDG1_AE" 29 "DFC_Can1BYPASS_TDG1_AF" 30 "DFC_Can1BYPASS_TDG1_BA" 31 "DFC_Can1BYPASS_TDG1_BB" 32 "DFC_Can1BYPASS_TDG1_BC" 33 "DFC_Can1BYPASS_TDG1_BD" 34 "DFC_Can1BYPASS_TDG1_BE_PlaceHolder" 35 "DFC_Can1BYPASS_TDG1_BF_PlaceHolder" 36 "DFC_Can1BYPASS_TDG1_CA_PlaceHolder" 37 "DFC_Can1BYPASS_TDG1_CB_PlaceHolder" 38 "DFC_Can1BYPASS_TDG1_CC_PlaceHolder" 39 "DFC_Can1Cool_Act_Cmd" 40 "DFC_Can1Cool_Act_Sts_DLC" 41 "DFC_DsmTest1" 42 "DFC_FrAACC_06ISigGroup_ACC_06_CHK" 43 "DFC_FrAACC_06ISigGroup_ACC_06_CNT" 44 "DFC_FrAACC_07ISigGroup_ACC_07_CHK" 45 "DFC_FrAACC_07ISigGroup_ACC_07_CNT" 46 "DFC_FrAAirbag_01ISigGroup_Airbag_01_CHK" 47 "DFC_FrAAirbag_01ISigGroup_Airbag_01_CNT" 48 "DFC_FrAAirbag_02ISigGroup_Airbag_02_CHK" 49 "DFC_FrAAirbag_02ISigGroup_Airbag_02_CNT" 50 "DFC_FrABremse_EV_01ISigGroup_Bremse_EV_01_CHK" 51 "DFC_FrABremse_EV_01ISigGroup_Bremse_EV_01_CNT" 52 "DFC_FrABremse_EV_02ISigGroup_Bremse_EV_02_CHK" 53 "DFC_FrABremse_EV_02ISigGroup_Bremse_EV_02_CNT" 54 "DFC_FrAEBKV_01ISigGroup_EBKV_01_CHK" 55 "DFC_FrAEBKV_01ISigGroup_EBKV_01_CNT" 56 "DFC_FrAEM1_HYB_12ISigGroup_EM1_HYB_12_CHK" 57 "DFC_FrAEM1_HYB_12ISigGroup_EM1_HYB_12_CNT" 58 "DFC_FrAEPB_01ISigGroup_EPB_01_CHK" 59 "DFC_FrAEPB_01ISigGroup_EPB_01_CNT" 60 "DFC_FrAESP_03ISigGroup_ESP_03_CHK" 61 "DFC_FrAESP_03ISigGroup_ESP_03_CNT" 62 "DFC_FrAESP_05ISigGroup_ESP_05_CHK" 63 "DFC_FrAESP_05ISigGroup_ESP_05_CNT" 64 "DFC_FrAESP_07ISigGroup_ESP_07_CHK" 65 "DFC_FrAESP_07ISigGroup_ESP_07_CNT" 66 "DFC_FrAESP_08ISigGroup_ESP_08_CHK" 67 "DFC_FrAESP_08ISigGroup_ESP_08_CNT" 68 "DFC_FrAESP_15ISigGroup_ESP_15_CHK" 69 "DFC_FrAESP_15ISigGroup_ESP_15_CNT" 70 "DFC_FrAESP_20ISigGroup_ESP_20_CHK" 71 "DFC_FrAESP_20ISigGroup_ESP_20_CNT" 72 "DFC_FrAESP_21ISigGroup_ESP_21_CHK" 73 "DFC_FrAESP_21ISigGroup_ESP_21_CNT" 74 "DFC_FrAESP_22ISigGroup_ESP_22_CHK" 75 "DFC_FrAESP_22ISigGroup_ESP_22_CNT" 76 "DFC_FrAESP_23ISigGroup_ESP_23_CHK" 77 "DFC_FrAESP_23ISigGroup_ESP_23_CNT" 78 "DFC_FrAESP_24ISigGroup_ESP_24_CHK" 79 "DFC_FrAESP_24ISigGroup_ESP_24_CNT" 80 "DFC_FrAESP_28ISigGroup_ESP_28_CHK" 81 "DFC_FrAESP_28ISigGroup_ESP_28_CNT" 82 "DFC_FrAESP_31ISigGroup_ESP_31_CHK" 83 "DFC_FrAESP_31ISigGroup_ESP_31_CNT" 84 "DFC_FrAESP_32ISigGroup_ESP_32_CHK" 85 "DFC_FrAESP_32ISigGroup_ESP_32_CNT" 86 "DFC_FrAESP_33ISigGroup_ESP_33_CHK" 87 "DFC_FrAESP_33ISigGroup_ESP_33_CNT" 88 "DFC_FrAESP_41ISigGroup_ESP_41_CHK" 89 "DFC_FrAESP_41ISigGroup_ESP_41_CNT" 90 "DFC_FrAESP_44ISigGroup_ESP_44_CHK" 91 "DFC_FrAESP_44ISigGroup_ESP_44_CNT" 92 "DFC_FrAGetriebe_11" 93 "DFC_FrAGetriebe_12" 94 "DFC_FrAGetriebe_13" 95 "DFC_FrAGetriebe_14" 96 "DFC_FrAGetriebe_15" 97 "DFC_FrAGetriebe_16" 98 "DFC_FrAGetriebe_17" 99 "DFC_FrAGetriebe_18" 100 "DFC_FrAGetriebe_HYB_12" 101 "DFC_FrAKN_Getriebe" 102 "DFC_FrAKlemmen_Status_01ISigGroup_Klemmen_Status_01_CHK" 103 "DFC_FrAKlemmen_Status_01ISigGroup_Klemmen_Status_01_CNT" 104 "DFC_FrALCV_01ISigGroup_LCV_01_CHK" 105 "DFC_FrALCV_01ISigGroup_LCV_01_CNT" 106 "DFC_FrALWI_01ISigGroup_LWI_01_CHK" 107 "DFC_FrALWI_01ISigGroup_LWI_01_CNT" 108 "DFC_FrAMotor_11ISigGroup_Motor_11_CHK" 109 "DFC_FrAMotor_11ISigGroup_Motor_11_CNT" 110 "DFC_FrAMotor_12ISigGroup_Motor_12_CHK" 111 "DFC_FrAMotor_12ISigGroup_Motor_12_CNT" 112 "DFC_FrAMotor_14ISigGroup_Motor_14_CHK" 113 "DFC_FrAMotor_14ISigGroup_Motor_14_CNT" 114 "DFC_FrAMotor_20ISigGroup_Motor_20_CHK" 115 "DFC_FrAMotor_20ISigGroup_Motor_20_CNT" 116 "DFC_FrAMotor_27ISigGroup_Motor_27_CHK" 117 "DFC_FrAMotor_27ISigGroup_Motor_27_CNT" 118 "DFC_FrAMotor_28ISigGroup_Motor_28_CHK" 119 "DFC_FrAMotor_28ISigGroup_Motor_28_CNT" 120 "DFC_FrAMotor_Code_01ISigGroup_Motor_Code_01_CHK" 121 "DFC_FrAMotor_Code_01ISigGroup_Motor_Code_01_CNT" 122 "DFC_FrAMotor_TS_01ISigGroup_Motor_TS_01_CHK" 123 "DFC_FrAMotor_TS_01ISigGroup_Motor_TS_01_CNT" 124 "DFC_FrAMotor_TS_02ISigGroup_Motor_TS_02_CHK" 125 "DFC_FrAMotor_TS_02ISigGroup_Motor_TS_02_CNT" 126 "DFC_FrAMotor_TS_03ISigGroup_Motor_TS_03_CHK" 127 "DFC_FrAMotor_TS_03ISigGroup_Motor_TS_03_CNT" 128 "DFC_FrASARA_06ISigGroup_SARA_06_CHK" 129 "DFC_FrASARA_06ISigGroup_SARA_06_CNT" 130 "DFC_FrATSG_FT_02ISigGroup_TSG_FT_02_CHK" 131 "DFC_FrATSG_FT_02ISigGroup_TSG_FT_02_CNT" 132 "DFC_FrATSK_06ISigGroup_TSK_06_CHK" 133 "DFC_FrATSK_06ISigGroup_TSK_06_CNT" 134 "DFC_FrATSK_08ISigGroup_TSK_08_CHK" 135 "DFC_FrATSK_08ISigGroup_TSK_08_CNT" 136 "DFC_FrAWBA_03" 137 "DFC_AdcBkg" 138 "DFC_Adc_Rdnt_0" 139 "DFC_Adc_Rdnt_1" 140 "DFC_Adc_Rdnt_2" 141 "DFC_Adc_Rdnt_3" 142 "DFC_Adc_Rdnt_4" 143 "DFC_Adc_Rdnt_5" 144 "DFC_Adc_Rdnt_6" 145 "DFC_Adc_Rdnt_7" 146 "DFC_Adc_Rdnt_8" 147 "DFC_Adc_Rdnt_9" 148 "DFC_Adc_SB_0" 149 "DFC_Adc_SB_1" 150 "DFC_Adc_SB_2" 151 "DFC_Adc_SB_3" 152 "DFC_Adc_SB_4" 153 "DFC_Adc_SB_5" 154 "DFC_Adc_SB_6" 155 "DFC_Adc_SB_7" 156 "DFC_Adc_SB_8" 157 "DFC_Adc_SB_9" 158 "DFC_Adc_SG_0" 159 "DFC_Adc_SG_1" 160 "DFC_Adc_SG_2" 161 "DFC_Adc_SG_3" 162 "DFC_Adc_SG_4" 163 "DFC_Adc_SG_5" 164 "DFC_Adc_SG_6" 165 "DFC_Adc_SG_7" 166 "DFC_Adc_SG_8" 167 "DFC_Adc_SG_9" 168 "DFC_Adc_Unit" 169 "DFC_BattSply_UHi" 170 "DFC_BattSply_ULo" 171 "DFC_CpuTemp" 172 "DFC_CrntCtrl_Channel_0" 173 "DFC_CrntCtrl_Channel_1" 174 "DFC_CrntCtrl_Channel_2" 175 "DFC_CrntCtrl_Channel_3" 176 "DFC_CrntCtrl_Channel_4" 177 "DFC_CrntCtrl_Channel_5" 178 "DFC_CrntCtrl_Channel_6" 179 "DFC_CrntCtrl_Channel_7" 180 "DFC_CrntCtrl_Channel_8" 181 "DFC_CrntCtrl_Channel_9" 182 "DFC_CrntCtrl_Channel_10" 183 "DFC_CrntCtrl_Channel_11" 184 "DFC_CrntCtrl_Channel_12" 185 "DFC_CrntCtrl_Channel_13" 186 "DFC_CrntCtrl_Channel_14" 187 "DFC_CrntCtrl_Channel_15" 188 "DFC_CrntCtrl_Channel_16" 189 "DFC_CrntCtrl_Channel_17" 190 "DFC_CrntCtrl_Channel_18" 191 "DFC_CrntCtrl_Channel_19" 192 "DFC_CrntCtrl_CrntMon_0" 193 "DFC_CrntCtrl_CrntMon_1" 194 "DFC_CrntCtrl_CrntMon_2" 195 "DFC_CrntCtrl_CrntMon_3" 196 "DFC_CrntCtrl_CrntMon_4" 197 "DFC_CrntCtrl_CrntMon_5" 198 "DFC_CrntCtrl_CrntMon_6" 199 "DFC_CrntCtrl_CrntMon_7" 200 "DFC_CrntCtrl_CrntMon_8" 201 "DFC_CrntCtrl_CrntMon_9" 202 "DFC_CrntCtrl_CrntMon_10" 203 "DFC_CrntCtrl_CrntMon_11" 204 "DFC_CrntCtrl_CrntMon_12" 205 "DFC_CrntCtrl_CrntMon_13" 206 "DFC_CrntCtrl_CrntMon_14" 207 "DFC_CrntCtrl_CrntMon_15" 208 "DFC_CrntCtrl_CrntMon_16" 209 "DFC_CrntCtrl_CrntMon_17" 210 "DFC_CrntCtrl_CrntMon_18" 211 "DFC_CrntCtrl_CrntMon_19" 212 "DFC_CrntCtrl_OP_0" 213 "DFC_CrntCtrl_OP_1" 214 "DFC_CrntCtrl_OP_2" 215 "DFC_CrntCtrl_OP_3" 216 "DFC_CrntCtrl_OP_4" 217 "DFC_CrntCtrl_OP_5" 218 "DFC_CrntCtrl_OP_6" 219 "DFC_CrntCtrl_OP_7" 220 "DFC_CrntCtrl_OP_8" 221 "DFC_CrntCtrl_OP_9" 222 "DFC_CrntCtrl_OP_10" 223 "DFC_CrntCtrl_OP_11" 224 "DFC_CrntCtrl_OP_12" 225 "DFC_CrntCtrl_OP_13" 226 "DFC_CrntCtrl_OP_14" 227 "DFC_CrntCtrl_OP_15" 228 "DFC_CrntCtrl_OP_16" 229 "DFC_CrntCtrl_OP_17" 230 "DFC_CrntCtrl_OP_18" 231 "DFC_CrntCtrl_OP_19" 232 "DFC_CrntCtrl_SB_0" 233 "DFC_CrntCtrl_SB_1" 234 "DFC_CrntCtrl_SB_2" 235 "DFC_CrntCtrl_SB_3" 236 "DFC_CrntCtrl_SB_4" 237 "DFC_CrntCtrl_SB_5" 238 "DFC_CrntCtrl_SB_6" 239 "DFC_CrntCtrl_SB_7" 240 "DFC_CrntCtrl_SB_8" 241 "DFC_CrntCtrl_SB_9" 242 "DFC_CrntCtrl_SB_10" 243 "DFC_CrntCtrl_SB_11" 244 "DFC_CrntCtrl_SB_12" 245 "DFC_CrntCtrl_SB_13" 246 "DFC_CrntCtrl_SB_14" 247 "DFC_CrntCtrl_SB_15" 248 "DFC_CrntCtrl_SB_16" 249 "DFC_CrntCtrl_SB_17" 250 "DFC_CrntCtrl_SB_18" 251 "DFC_CrntCtrl_SB_19" 252 "DFC_CrntCtrl_SG_0" 253 "DFC_CrntCtrl_SG_1" 254 "DFC_CrntCtrl_SG_2" 255 "DFC_CrntCtrl_SG_3" 256 "DFC_CrntCtrl_SG_4" 257 "DFC_CrntCtrl_SG_5" 258 "DFC_CrntCtrl_SG_6" 259 "DFC_CrntCtrl_SG_7" 260 "DFC_CrntCtrl_SG_8" 261 "DFC_CrntCtrl_SG_9" 262 "DFC_CrntCtrl_SG_10" 263 "DFC_CrntCtrl_SG_11" 264 "DFC_CrntCtrl_SG_12" 265 "DFC_CrntCtrl_SG_13" 266 "DFC_CrntCtrl_SG_14" 267 "DFC_CrntCtrl_SG_15" 268 "DFC_CrntCtrl_SG_16" 269 "DFC_CrntCtrl_SG_17" 270 "DFC_CrntCtrl_SG_18" 271 "DFC_CrntCtrl_SG_19" 272 "DFC_CrntCtrl_Unit_0" 273 "DFC_CrntCtrl_Unit_1" 274 "DFC_CtrlMot_DNR_0" 275 "DFC_CtrlMot_DNR_1" 276 "DFC_CtrlMot_OC_0" 277 "DFC_CtrlMot_OC_1" 278 "DFC_CtrlMot_OL_0" 279 "DFC_CtrlMot_OL_1" 280 "DFC_CtrlMot_SB_0" 281 "DFC_CtrlMot_SB_1" 282 "DFC_CtrlMot_SG_0" 283 "DFC_CtrlMot_SG_1" 284 "DFC_Flx_AdcInUnit_0" 285 "DFC_Flx_AdcInUnit_1" 286 "DFC_Flx_AdcInUnit_2" 287 "DFC_Flx_RMeasUnit_0" 288 "DFC_Flx_RMeasUnit_1" 289 "DFC_Flx_SB_0" 290 "DFC_Flx_SB_1" 291 "DFC_Flx_SB_2" 292 "DFC_Flx_SB_3" 293 "DFC_Flx_SB_4" 294 "DFC_Flx_SB_5" 295 "DFC_Flx_SB_6" 296 "DFC_Flx_SB_7" 297 "DFC_Flx_SB_8" 298 "DFC_Flx_SB_9" 299 "DFC_Flx_SB_10" 300 "DFC_Flx_SB_11" 301 "DFC_Flx_SB_12" 302 "DFC_Flx_SB_13" 303 "DFC_Flx_SB_14" 304 "DFC_Flx_SB_15" 305 "DFC_Flx_SB_16" 306 "DFC_Flx_SB_17" 307 "DFC_Flx_SB_18" 308 "DFC_Flx_SB_19" 309 "DFC_Flx_SB_20" 310 "DFC_Flx_SB_21" 311 "DFC_Flx_SB_22" 312 "DFC_Flx_SB_23" 313 "DFC_Flx_SB_24" 314 "DFC_Flx_SB_25" 315 "DFC_Flx_SB_26" 316 "DFC_Flx_SG_0" 317 "DFC_Flx_SG_1" 318 "DFC_Flx_SG_2" 319 "DFC_Flx_SG_3" 320 "DFC_Flx_SG_4" 321 "DFC_Flx_SG_5" 322 "DFC_Flx_SG_6" 323 "DFC_Flx_SG_7" 324 "DFC_Flx_SG_8" 325 "DFC_Flx_SG_9" 326 "DFC_Flx_SG_10" 327 "DFC_Flx_SG_11" 328 "DFC_Flx_SG_12" 329 "DFC_Flx_SG_13" 330 "DFC_Flx_SG_14" 331 "DFC_Flx_SG_15" 332 "DFC_Flx_SG_16" 333 "DFC_Flx_SG_17" 334 "DFC_Flx_SG_18" 335 "DFC_Flx_SG_19" 336 "DFC_Flx_SG_20" 337 "DFC_Flx_SG_21" 338 "DFC_Flx_SG_22" 339 "DFC_Flx_SG_23" 340 "DFC_Flx_SG_24" 341 "DFC_Flx_SG_25" 342 "DFC_Flx_SG_26" 343 "DFC_Flx_Sig_0" 344 "DFC_Flx_Sig_1" 345 "DFC_Flx_Sig_2" 346 "DFC_Flx_Sig_3" 347 "DFC_Flx_Sig_4" 348 "DFC_Flx_Sig_5" 349 "DFC_Flx_Sig_6" 350 "DFC_Flx_Sig_7" 351 "DFC_Flx_Sig_8" 352 "DFC_Flx_Sig_9" 353 "DFC_Flx_Sig_10" 354 "DFC_Flx_Sig_11" 355 "DFC_Flx_Sig_12" 356 "DFC_Flx_Sig_13" 357 "DFC_Flx_Sig_14" 358 "DFC_Flx_Sig_15" 359 "DFC_Flx_Sig_16" 360 "DFC_Flx_Sig_17" 361 "DFC_Flx_Sig_18" 362 "DFC_Flx_Sig_19" 363 "DFC_Flx_Sig_20" 364 "DFC_Flx_Sig_21" 365 "DFC_Flx_Sig_22" 366 "DFC_Flx_Sig_23" 367 "DFC_Flx_Sig_24" 368 "DFC_Flx_Sig_25" 369 "DFC_Flx_Sig_26" 370 "DFC_Gtm_Clk" 371 "DFC_HiSide_OP_0" 372 "DFC_HiSide_OP_1" 373 "DFC_HiSide_OP_2" 374 "DFC_HiSide_OP_3" 375 "DFC_HiSide_OP_4" 376 "DFC_HiSide_OP_5" 377 "DFC_HiSide_SB_0" 378 "DFC_HiSide_SB_1" 379 "DFC_HiSide_SB_2" 380 "DFC_HiSide_SB_3" 381 "DFC_HiSide_SB_4" 382 "DFC_HiSide_SB_5" 383 "DFC_HiSide_SG_0" 384 "DFC_HiSide_SG_1" 385 "DFC_HiSide_SG_2" 386 "DFC_HiSide_SG_3" 387 "DFC_HiSide_SG_4" 388 "DFC_HiSide_SG_5" 389 "DFC_IntSply_0" 390 "DFC_IntSply_1" 391 "DFC_IntSply_2" 392 "DFC_IntSply_3" 393 "DFC_IntSply_4" 394 "DFC_IntSply_5" 395 "DFC_IntTemp" 396 "DFC_LssRly_OL" 397 "DFC_LssRly_SB" 398 "DFC_LssRly_SG" 399 "DFC_Lss_OL_0" 400 "DFC_Lss_OL_1" 401 "DFC_Lss_OL_2" 402 "DFC_Lss_OL_3" 403 "DFC_Lss_OL_4" 404 "DFC_Lss_OL_5" 405 "DFC_Lss_OL_6" 406 "DFC_Lss_OL_7" 407 "DFC_Lss_OL_8" 408 "DFC_Lss_OL_9" 409 "DFC_Lss_OL_10" 410 "DFC_Lss_OL_11" 411 "DFC_Lss_SB_0" 412 "DFC_Lss_SB_1" 413 "DFC_Lss_SB_2" 414 "DFC_Lss_SB_3" 415 "DFC_Lss_SB_4" 416 "DFC_Lss_SB_5" 417 "DFC_Lss_SB_6" 418 "DFC_Lss_SB_7" 419 "DFC_Lss_SB_8" 420 "DFC_Lss_SB_9" 421 "DFC_Lss_SB_10" 422 "DFC_Lss_SB_11" 423 "DFC_Lss_SG_0" 424 "DFC_Lss_SG_1" 425 "DFC_Lss_SG_2" 426 "DFC_Lss_SG_3" 427 "DFC_Lss_SG_4" 428 "DFC_Lss_SG_5" 429 "DFC_Lss_SG_6" 430 "DFC_Lss_SG_7" 431 "DFC_Lss_SG_8" 432 "DFC_Lss_SG_9" 433 "DFC_Lss_SG_10" 434 "DFC_Lss_SG_11" 435 "DFC_Lss_Unit" 436 "DFC_OsTmrMon" 437 "DFC_PwmIn_GtmTim_0" 438 "DFC_PwmIn_GtmTim_1" 439 "DFC_PwmIn_GtmTim_2" 440 "DFC_PwmIn_GtmTim_3" 441 "DFC_PwmIn_GtmTim_4" 442 "DFC_PwmIn_GtmTim_5" 443 "DFC_PwmIn_GtmTim_6" 444 "DFC_PwmIn_GtmTim_7" 445 "DFC_PwmIn_GtmTim_8" 446 "DFC_PwmIn_GtmTim_9" 447 "DFC_PwmIn_GtmTim_10" 448 "DFC_PwmIn_GtmTim_11" 449 "DFC_PwmIn_SB_0" 450 "DFC_PwmIn_SB_1" 451 "DFC_PwmIn_SB_2" 452 "DFC_PwmIn_SB_3" 453 "DFC_PwmIn_SB_4" 454 "DFC_PwmIn_SB_5" 455 "DFC_PwmIn_SB_6" 456 "DFC_PwmIn_SB_7" 457 "DFC_PwmIn_SB_8" 458 "DFC_PwmIn_SB_9" 459 "DFC_PwmIn_SB_10" 460 "DFC_PwmIn_SB_11" 461 "DFC_PwmIn_SG_0" 462 "DFC_PwmIn_SG_1" 463 "DFC_PwmIn_SG_2" 464 "DFC_PwmIn_SG_3" 465 "DFC_PwmIn_SG_4" 466 "DFC_PwmIn_SG_5" 467 "DFC_PwmIn_SG_6" 468 "DFC_PwmIn_SG_7" 469 "DFC_PwmIn_SG_8" 470 "DFC_PwmIn_SG_9" 471 "DFC_PwmIn_SG_10" 472 "DFC_PwmIn_SG_11" 473 "DFC_PwmIn_Sig_0" 474 "DFC_PwmIn_Sig_1" 475 "DFC_PwmIn_Sig_2" 476 "DFC_PwmIn_Sig_3" 477 "DFC_PwmIn_Sig_4" 478 "DFC_PwmIn_Sig_5" 479 "DFC_PwmIn_Sig_6" 480 "DFC_PwmIn_Sig_7" 481 "DFC_PwmIn_Sig_8" 482 "DFC_PwmIn_Sig_9" 483 "DFC_PwmIn_Sig_10" 484 "DFC_PwmIn_Sig_11" 485 "DFC_SafeSt_flgDn" 486 "DFC_SnsrSply_SB_0" 487 "DFC_SnsrSply_SB_1" 488 "DFC_SnsrSply_SB_2" 489 "DFC_SnsrSply_SB_3" 490 "DFC_SnsrSply_SB_4" 491 "DFC_SnsrSply_SB_5" 492 "DFC_SnsrSply_SG_0" 493 "DFC_SnsrSply_SG_1" 494 "DFC_SnsrSply_SG_2" 495 "DFC_SnsrSply_SG_3" 496 "DFC_SnsrSply_SG_4" 497 "DFC_SnsrSply_SG_5" 498 "DFC_Spd_NdPls_0" 499 "DFC_Spd_NdPls_1" 500 "DFC_Spd_NdPls_2" 501 "DFC_Spd_NdPls_3" 502 "DFC_Spd_NdPls_4" 503 "DFC_Spd_OP_0" 504 "DFC_Spd_OP_1" 505 "DFC_Spd_OP_2" 506 "DFC_Spd_OP_3" 507 "DFC_Spd_OP_4" 508 "DFC_Spd_Pls_0" 509 "DFC_Spd_Pls_1" 510 "DFC_Spd_Pls_2" 511 "DFC_Spd_Pls_3" 512 "DFC_Spd_Pls_4" 513 "DFC_Spd_SB_0" 514 "DFC_Spd_SB_1" 515 "DFC_Spd_SB_2" 516 "DFC_Spd_SB_3" 517 "DFC_Spd_SB_4" 518 "DFC_Spd_SG_0" 519 "DFC_Spd_SG_1" 520 "DFC_Spd_SG_2" 521 "DFC_Spd_SG_3" 522 "DFC_Spd_SG_4" 523 "DFC_Spd_Sig_0" 524 "DFC_Spd_Sig_1" 525 "DFC_Spd_Sig_2" 526 "DFC_Spd_Sig_3" 527 "DFC_Spd_Sig_4" 528 "DFC_Spd_Sync_0" 529 "DFC_Spd_Sync_1" 530 "DFC_Spd_Sync_2" 531 "DFC_Spd_Sync_3" 532 "DFC_Spd_Sync_4" 533 "DFC_WdgSys" 534 "DFC_WdgWd" 535 "DFC_AcceleratorPedalErrorRx" 536 "DFC_AccumulatorChargeFault" 537 "DFC_AltitudeErrorRx" 538 "DFC_BLDCPumpDerateRx" 539 "DFC_BLDCPumpErrorRx" 540 "DFC_BrakePressureErrorRx" 541 "DFC_BrakeSwitchErrorRx" 542 "DFC_BrakeSwitchImplausible1" 543 "DFC_BrakeSwitchImplausible2" 544 "DFC_BrakeSwitchRateHigh" 545 "DFC_BrakeSwitchSpare1" 546 "DFC_BrakeSwitchSpare2" 547 "DFC_ChargeValveStuck" 548 "DFC_Clutch1AdaptationFault" 549 "DFC_Clutch1OverPressure" 550 "DFC_Clutch1UnderPressure" 551 "DFC_Clutch2AdaptationFault" 552 "DFC_Clutch2OverPressure" 553 "DFC_Clutch2UnderPressure" 554 "DFC_ClutchCoolingValveFault" 555 "DFC_ClutchCoolingValveStuck" 556 "DFC_ClutchOverTempoerature" 557 "DFC_ClutchShutOffValveFault" 558 "DFC_CoolantTempErrorRx" 559 "DFC_CoolingPressureImplausible" 560 "DFC_CoolingPressureRateHigh" 561 "DFC_CoolingPressureTooHigh" 562 "DFC_CoolingPressureTooLow" 563 "DFC_CrntCtrl_Reg_1" 564 "DFC_CrntCtrl_Reg_10" 565 "DFC_CrntCtrl_Reg_11" 566 "DFC_CrntCtrl_Reg_12" 567 "DFC_CrntCtrl_Reg_16" 568 "DFC_CrntCtrl_Reg_17" 569 "DFC_CrntCtrl_Reg_18" 570 "DFC_CrntCtrl_Reg_19" 571 "DFC_CrntCtrl_Reg_2" 572 "DFC_CrntCtrl_Reg_3" 573 "DFC_CrntCtrl_Reg_6" 574 "DFC_CrntCtrl_Reg_7" 575 "DFC_CrntCtrl_Reg_9" 576 "DFC_DSTSpare1" 577 "DFC_DSTSpare2" 578 "DFC_DWCSpare1" 579 "DFC_DWCSpare2" 580 "DFC_DWCSpare3" 581 "DFC_DWCSpare4" 582 "DFC_DWCSpare5" 583 "DFC_DWCSpare6" 584 "DFC_DWCSpare7" 585 "DFC_DoorStatusErrorRx" 586 "DFC_DownSwImplausible" 587 "DFC_DownSwRateHigh" 588 "DFC_DownSwSpare1" 589 "DFC_DownSwSpare2" 590 "DFC_EM1SpeedErrorRx" 591 "DFC_ENGDriveTorqueImplausible" 592 "DFC_ENGEngineProblem" 593 "DFC_ENGIdiotStart" 594 "DFC_ENGSpare1" 595 "DFC_ENGSpare2" 596 "DFC_ESPStatusErrorRx" 597 "DFC_EngineOilTempErrorRx" 598 "DFC_EngineSpeedErrorRx" 599 "DFC_EngineSpeedPWMImplausible1" 600 "DFC_EngineSpeedPWMImplausible2" 601 "DFC_EngineSpeedPWMRateHigh" 602 "DFC_EngineSpeedPWMSpare1" 603 "DFC_EngineSpeedPWMSpare2" 604 "DFC_EngineTorqueErrorRx" 605 "DFC_ExternalTempErrorRx" 606 "DFC_FailStuckNFault" 607 "DFC_FrontLeftWheelSpeedErrorRx" 608 "DFC_FrontRightWheelSpeedErrorRx" 609 "DFC_GearCoolingValveStuck" 610 "DFC_K1PressureImplausible" 611 "DFC_K1PressureRateHigh" 612 "DFC_K1PressureSpare1" 613 "DFC_K1PressureSpare2" 614 "DFC_K1SpeedHigh" 615 "DFC_K1SpeedImplausible" 616 "DFC_K1SpeedSpare1" 617 "DFC_K1SpeedSpare2" 618 "DFC_K2PressureImplausible" 619 "DFC_K2PressureRateHigh" 620 "DFC_K2PressureSpare1" 621 "DFC_K2PressureSpare2" 622 "DFC_K2SpeedHigh" 623 "DFC_K2SpeedImplausible" 624 "DFC_K2SpeedSpare1" 625 "DFC_K2SpeedSpare2" 626 "DFC_L2ClutchPressureVsCurrentOdd" 627 "DFC_L2ClutchTorqueDirection" 628 "DFC_L2DoubleClutchEngagement" 629 "DFC_L2DoubleGearEven" 630 "DFC_L2EM1ShaftOverspeed" 631 "DFC_L2EPBWhenMoving" 632 "DFC_L2EvenClutchGradientInCreep" 633 "DFC_L2ForwardDriveEven" 634 "DFC_L2ForwardDriveOdd" 635 "DFC_L2ForwardGearAndMode" 636 "DFC_L2GearCombinationEM1Overspeed" 637 "DFC_L2GearCombinationRequest" 638 "DFC_L2InputShaftEngineOverspeed" 639 "DFC_L2InsufficientLubrication" 640 "DFC_L2InvalidDownshiftOdd" 641 "DFC_L2InvalidGearControl" 642 "DFC_L2LeaveNeutral" 643 "DFC_L2LeavePark" 644 "DFC_L2ModeDisplay" 645 "DFC_L2ModeSelection" 646 "DFC_L2MovementWithChargeCable" 647 "DFC_L2OddClutchGradientInCreep" 648 "DFC_L2OddShaftAccelerationImplausible" 649 "DFC_L2ParkFailNoEPB" 650 "DFC_L2ParkPosition" 651 "DFC_L2ParkValveOverride" 652 "DFC_L2ParkWhenMoving" 653 "DFC_L2ReferenceSpeedFail" 654 "DFC_L2ReverseDrive" 655 "DFC_L2ShaftOverSpeedFromIP" 656 "DFC_L2ShaftOverSpeedFromOP" 657 "DFC_L2Spare1" 658 "DFC_L2Spare2" 659 "DFC_L2TorqueNoShift" 660 "DFC_L2TorqueRequestCupOfFuel" 661 "DFC_L2VGPOverride" 662 "DFC_L2VKUGLOveride" 663 "DFC_L2VSS1Overirde" 664 "DFC_L2VSS2Overirde" 665 "DFC_LatAccErrorRx" 666 "DFC_LinePressureImplausible" 667 "DFC_LinePressureLeakageHigh" 668 "DFC_LinePressureRateHigh" 669 "DFC_LinePressureSpare1" 670 "DFC_LinePressureSpare2" 671 "DFC_LinePressureTooHigh" 672 "DFC_LinePressureTooLow" 673 "DFC_LongAccErrorRx" 674 "DFC_LubeOilOverTemperature" 675 "DFC_LubeTemperatureImplausible" 676 "DFC_LubeTemperatureRateHigh" 677 "DFC_LubeTemperatureSpare1" 678 "DFC_LubeTemperatureSpare2" 679 "DFC_MOTEngineProblem" 680 "DFC_MOTSpare1" 681 "DFC_MOTSpare2" 682 "DFC_ModeMSwImplausible" 683 "DFC_ModeMSwSpare1" 684 "DFC_ModeMSwSpare2" 685 "DFC_ModeMSwSwRateHigh" 686 "DFC_ModePSwImplausible" 687 "DFC_ModePSwSpare1" 688 "DFC_ModePSwSpare2" 689 "DFC_ModePSwSwRateHigh" 690 "DFC_ModeRSwImplausible" 691 "DFC_ModeRSwSpare1" 692 "DFC_ModeRSwSpare2" 693 "DFC_ModeRSwSwRateHigh" 694 "DFC_ParkLockDisengageFail" 695 "DFC_ParkLockEngageFail" 696 "DFC_ParkLockPosImplausible" 697 "DFC_ParkLockPosRateHigh" 698 "DFC_ParkLockPosSpare1" 699 "DFC_ParkLockPosSpare2" 700 "DFC_PumpResponseFault" 701 "DFC_PumpSpeedError" 702 "DFC_RearLeftWheelSpeedErrorRx" 703 "DFC_RearRightWheelSpeedErrorRx" 704 "DFC_RedSpeedHigh" 705 "DFC_RedSpeedImplausible" 706 "DFC_RedSpeedSpare1" 707 "DFC_RedSpeedSpare2" 708 "DFC_SEQSpare1" 709 "DFC_SEQSpare2" 710 "DFC_SEQTimeout" 711 "DFC_Spare_0" 712 "DFC_Spare_1" 713 "DFC_Spare_2" 714 "DFC_Spare_3" 715 "DFC_Spare_4" 716 "DFC_Spare_5" 717 "DFC_Spare_6" 718 "DFC_Spare_7" 719 "DFC_Spare_8" 720 "DFC_Spare_9" 721 "DFC_SumpOilOverTemperature" 722 "DFC_SumpTemperatureImplausible" 723 "DFC_SumpTemperatureRateHigh" 724 "DFC_SumpTemperatureSpare1" 725 "DFC_SumpTemperatureSpare2" 726 "DFC_SynchroA1EngageFault" 727 "DFC_SynchroA1SpitoutInShiftFault" 728 "DFC_SynchroA1SpitoutNoShiftFault" 729 "DFC_SynchroA1StuckFault" 730 "DFC_SynchroA2EngageFault" 731 "DFC_SynchroA2SpitoutInShiftFault" 732 "DFC_SynchroA2SpitoutNoShiftFault" 733 "DFC_SynchroA2StuckFault" 734 "DFC_SynchroAOutOfNInShiftFault" 735 "DFC_SynchroAOutOfNNoShiftFault" 736 "DFC_SynchroAPosImplausible" 737 "DFC_SynchroAPosRateHigh" 738 "DFC_SynchroAPosSpare1" 739 "DFC_SynchroAPosSpare2" 740 "DFC_SynchroB1EngageFault" 741 "DFC_SynchroB1SpitoutInShiftFault" 742 "DFC_SynchroB1SpitoutNoShiftFault" 743 "DFC_SynchroB1StuckFault" 744 "DFC_SynchroB2EngageFault" 745 "DFC_SynchroB2SpitoutInShiftFault" 746 "DFC_SynchroB2SpitoutNoShiftFault" 747 "DFC_SynchroB2StuckFault" 748 "DFC_SynchroBOutOfNInShiftFault" 749 "DFC_SynchroBOutOfNNoShiftFault" 750 "DFC_SynchroBPosImplausible" 751 "DFC_SynchroBPosRateHigh" 752 "DFC_SynchroBPosSpare1" 753 "DFC_SynchroBPosSpare2" 754 "DFC_SynchroC1EngageFault" 755 "DFC_SynchroC1SpitoutInShiftFault" 756 "DFC_SynchroC1SpitoutNoShiftFault" 757 "DFC_SynchroC1StuckFault" 758 "DFC_SynchroC2EngageFault" 759 "DFC_SynchroC2SpitoutInShiftFault" 760 "DFC_SynchroC2SpitoutNoShiftFault" 761 "DFC_SynchroC2StuckFault" 762 "DFC_SynchroCOutOfNInShiftFault" 763 "DFC_SynchroCOutOfNNoShiftFault" 764 "DFC_SynchroCPosImplausible" 765 "DFC_SynchroCPosRateHigh" 766 "DFC_SynchroCPosSpare1" 767 "DFC_SynchroCPosSpare2" 768 "DFC_SynchroD1EngageFault" 769 "DFC_SynchroD1SpitoutInShiftFault" 770 "DFC_SynchroD1SpitoutNoShiftFault" 771 "DFC_SynchroD1StuckFault" 772 "DFC_SynchroDOutOfNInShiftFault" 773 "DFC_SynchroDOutOfNNoShiftFault" 774 "DFC_SynchroDPosImplausible" 775 "DFC_SynchroDPosRateHigh" 776 "DFC_SynchroDPosSpare1" 777 "DFC_SynchroDPosSpare2" 778 "DFC_SynchroF1EngageFault" 779 "DFC_SynchroF1SpitoutInShiftFault" 780 "DFC_SynchroF1SpitoutNoShiftFault" 781 "DFC_SynchroF1StuckFault" 782 "DFC_SynchroF2EngageFault" 783 "DFC_SynchroF2SpitoutInShiftFault" 784 "DFC_SynchroF2SpitoutNoShiftFault" 785 "DFC_SynchroF2StuckFault" 786 "DFC_SynchroFOutOfNInShiftFault" 787 "DFC_SynchroFOutOfNNoShiftFault" 788 "DFC_SynchroFPosImplausible" 789 "DFC_SynchroFPosRateHigh" 790 "DFC_SynchroFPosSpare1" 791 "DFC_SynchroFPosSpare2" 792 "DFC_UpSwImplausible" 793 "DFC_UpSwRateHigh" 794 "DFC_UpSwSpare1" 795 "DFC_UpSwSpare2" 796 "DFC_VehicleSpeedErrorRx" 797 "DFC_WheelTorqueESPErrorRx" 798 "DFC_YawRateErrorRx" 799 "DFC_Can0Motor_01_TO" 800 "DFC_Can0Motor_02_TO" 801 "DFC_Can0Motor_03_TO" 802 "DFC_Can1BYPASS_TDG1_11_TO" 803 "DFC_Can1BYPASS_TDG1_12_TO" 804 "DFC_Can1BYPASS_TDG1_13_TO" 805 "DFC_Can1BYPASS_TDG1_14_TO" 806 "DFC_Can1BYPASS_TDG1_15_TO" 807 "DFC_Can1BYPASS_TDG1_16_PlaceHolder_TO" 808 "DFC_Can1BYPASS_TDG1_17_PlaceHolder_TO" 809 "DFC_Can1BYPASS_TDG1_18_PlaceHolder_TO" 810 "DFC_Can1BYPASS_TDG1_19_Placeholder_TO" 811 "DFC_Can1BYPASS_TDG1_20_Placeholder_TO" 812 "DFC_Can1BYPASS_TDG1_21_TO" 813 "DFC_Can1BYPASS_TDG1_22_TO" 814 "DFC_Can1Cool_Act_Sts_TO" 815 "DFC_DsmTest0" 816 "DFC_FrAACC_06ISigGroup_ACC_06_TO" 817 "DFC_FrAACC_06_TO" 818 "DFC_FrAACC_07ISigGroup_ACC_07_TO" 819 "DFC_FrAACC_07_TO" 820 "DFC_FrAAirbag_01ISigGroup_Airbag_01_TO" 821 "DFC_FrAAirbag_01_TO" 822 "DFC_FrAAirbag_02ISigGroup_Airbag_02_TO" 823 "DFC_FrAAirbag_02_TO" 824 "DFC_FrABCM_01_TO" 825 "DFC_FrABremse_EV_01ISigGroup_Bremse_EV_01_TO" 826 "DFC_FrABremse_EV_01_TO" 827 "DFC_FrABremse_EV_02ISigGroup_Bremse_EV_02_TO" 828 "DFC_FrABremse_EV_02_TO" 829 "DFC_FrACharisma_01_TO" 830 "DFC_FrADiagnose_01_TO" 831 "DFC_FrAEBKV_01ISigGroup_EBKV_01_TO" 832 "DFC_FrAEBKV_01_TO" 833 "DFC_FrAEM1_HYB_06_TO" 834 "DFC_FrAEM1_HYB_12ISigGroup_EM1_HYB_12_TO" 835 "DFC_FrAEM1_HYB_12_TO" 836 "DFC_FrAEPB_01ISigGroup_EPB_01_TO" 837 "DFC_FrAEPB_01_TO" 838 "DFC_FrAESP_03ISigGroup_ESP_03_TO" 839 "DFC_FrAESP_03_TO" 840 "DFC_FrAESP_05ISigGroup_ESP_05_TO" 841 "DFC_FrAESP_05_TO" 842 "DFC_FrAESP_07ISigGroup_ESP_07_TO" 843 "DFC_FrAESP_07_TO" 844 "DFC_FrAESP_08ISigGroup_ESP_08_TO" 845 "DFC_FrAESP_08_TO" 846 "DFC_FrAESP_15ISigGroup_ESP_15_TO" 847 "DFC_FrAESP_15_TO" 848 "DFC_FrAESP_20ISigGroup_ESP_20_TO" 849 "DFC_FrAESP_20_TO" 850 "DFC_FrAESP_21ISigGroup_ESP_21_TO" 851 "DFC_FrAESP_21_TO" 852 "DFC_FrAESP_22ISigGroup_ESP_22_TO" 853 "DFC_FrAESP_22_TO" 854 "DFC_FrAESP_23ISigGroup_ESP_23_TO" 855 "DFC_FrAESP_23_TO" 856 "DFC_FrAESP_24ISigGroup_ESP_24_TO" 857 "DFC_FrAESP_24_TO" 858 "DFC_FrAESP_26_TO" 859 "DFC_FrAESP_28ISigGroup_ESP_28_TO" 860 "DFC_FrAESP_28_TO" 861 "DFC_FrAESP_31ISigGroup_ESP_31_TO" 862 "DFC_FrAESP_31_TO" 863 "DFC_FrAESP_32ISigGroup_ESP_32_TO" 864 "DFC_FrAESP_32_TO" 865 "DFC_FrAESP_33ISigGroup_ESP_33_TO" 866 "DFC_FrAESP_33_TO" 867 "DFC_FrAESP_41ISigGroup_ESP_41_TO" 868 "DFC_FrAESP_41_TO" 869 "DFC_FrAESP_44ISigGroup_ESP_44_TO" 870 "DFC_FrAESP_44_TO" 871 "DFC_FrAKlemmen_Status_01ISigGroup_Klemmen_Status_01_TO" 872 "DFC_FrAKlemmen_Status_01_TO" 873 "DFC_FrAKlima_11_TO" 874 "DFC_FrAKombi_02_TO" 875 "DFC_FrALCV_01ISigGroup_LCV_01_TO" 876 "DFC_FrALCV_01_TO" 877 "DFC_FrALWI_01ISigGroup_LWI_01_TO" 878 "DFC_FrALWI_01_TO" 879 "DFC_FrAMFL_Tasten_01_TO" 880 "DFC_FrAMSG_EM1_18_TO" 881 "DFC_FrAMSG_EM1_29_TO" 882 "DFC_FrAMotor_07_TO" 883 "DFC_FrAMotor_11ISigGroup_Motor_11_TO" 884 "DFC_FrAMotor_11_TO" 885 "DFC_FrAMotor_12ISigGroup_Motor_12_TO" 886 "DFC_FrAMotor_12_TO" 887 "DFC_FrAMotor_14ISigGroup_Motor_14_TO" 888 "DFC_FrAMotor_14_TO" 889 "DFC_FrAMotor_16_TO" 890 "DFC_FrAMotor_17_TO" 891 "DFC_FrAMotor_18_TO" 892 "DFC_FrAMotor_20ISigGroup_Motor_20_TO" 893 "DFC_FrAMotor_20_TO" 894 "DFC_FrAMotor_27ISigGroup_Motor_27_TO" 895 "DFC_FrAMotor_27_TO" 896 "DFC_FrAMotor_28ISigGroup_Motor_28_TO" 897 "DFC_FrAMotor_28_TO" 898 "DFC_FrAMotor_35_TO" 899 "DFC_FrAMotor_38_LB_TO" 900 "DFC_FrAMotor_47_TO" 901 "DFC_FrAMotor_Code_01ISigGroup_Motor_Code_01_TO" 902 "DFC_FrAMotor_Code_01_TO" 903 "DFC_FrAMotor_Hybrid_11_TO" 904 "DFC_FrAMotor_TS_01ISigGroup_Motor_TS_01_TO" 905 "DFC_FrAMotor_TS_01_TO" 906 "DFC_FrAMotor_TS_02ISigGroup_Motor_TS_02_TO" 907 "DFC_FrAMotor_TS_02_TO" 908 "DFC_FrAMotor_TS_03ISigGroup_Motor_TS_03_TO" 909 "DFC_FrAMotor_TS_03_TO" 910 "DFC_FrANVEM_02_TO" 911 "DFC_FrANVEM_05_TO" 912 "DFC_FrAOBD_01_TO" 913 "DFC_FrAOBD_02_TO" 914 "DFC_FrASARA_06ISigGroup_SARA_06_TO" 915 "DFC_FrASARA_06_TO" 916 "DFC_FrASysteminfo_01_TO" 917 "DFC_FrATSG_FT_02ISigGroup_TSG_FT_02_TO" 918 "DFC_FrATSG_FT_02_TO" 919 "DFC_FrATSK_06ISigGroup_TSK_06_TO" 920 "DFC_FrATSK_06_TO" 921 "DFC_FrATSK_08ISigGroup_TSK_08_TO" 922 "DFC_FrATSK_08_TO" 923 "DFC_FrAVIN_01_0_TO" 924 "DFC_FrAVIN_01_1_TO" 925 "DFC_FrAVIN_01_2_TO" 926 "DFC_IPT" 927 "DFC_L3Error" 928 "DFC_SftyCfgMon" 929 "DFC_SftyShtOff" 930 "DFC_DsmTest4" 931 "DFC_BSWM_E_ACTION_FAILED" 932 "DFC_BSWM_E_INTRPTQUEUE_FULL" 933 "DFC_CANSM_E_BUS_OFF_NETWORK_0" 934 "DFC_CANSM_E_BUS_OFF_NETWORK_1" 935 "DFC_CANSM_E_BUS_OFF_NETWORK_2" 936 "DFC_CANSM_E_BUS_OFF_NETWORK_3" 937 "DFC_FRSM_E_CLUSTER_STARTUP" 938 "DFC_FRTRCV_E_NO_TRCV_CONTROL_0" 939 "DFC_FR_E_ACCESS" 940 "DFC_RBA_IOEXTLIB_KEEPALIVE_DRV" 941 "DFC_RBA_IOEXTLIB_KEEPALIVE_INI" 942 "DFC_rba_MultiStackTrace_Threshold" 943 "DFC_CAN_E_TIMEOUT" 944 "DFC_FRSM_E_CLUSTER_SYNC_LOSS" 945 "DFC_PDUR_E_INIT_FAILED" 946 "DFC_PDUR_E_PDU_INSTANCE_LOST" 947 "DFC_rba_IoSigRtc_StopCounter" 948 "DFC_rba_T15_Diag_ComInVld_Event" 949 "DFC_rba_T15_Diag_ComOff_HwOn_Event" 950 "DFC_rba_T15_Diag_ComOn_HwOff_Event" 951 "DFC_DSMDummy" 952 "DFC_DsmTest3";
VAL_ 2041 GAC_GAC_EOLPosnLC_StatePosnGracB 0 "GAC_Undefined" 1 "GAC_PositiveInGear" 2 "GAC_PositiveNowhere" 3 "GAC_InNeutral" 4 "GAC_NegativeNowhere" 5 "GAC_NegativeInGear";
VAL_ 2041 DFES_numDFC_02_ 0 "DFC_Unused" 1 "DFC_DsmTest2" 2 "DFC_Can0Getriebe_01" 3 "DFC_Can0Motor_01_CHK" 4 "DFC_Can0Motor_01_CNT" 5 "DFC_Can0Motor_01_DLC" 6 "DFC_Can0Motor_02_CHK" 7 "DFC_Can0Motor_02_CNT" 8 "DFC_Can0Motor_02_DLC" 9 "DFC_Can0Motor_03_CHK" 10 "DFC_Can0Motor_03_CNT" 11 "DFC_Can0Motor_03_DLC" 12 "DFC_Can1BYPASS_TDG1_11_DLC" 13 "DFC_Can1BYPASS_TDG1_12_DLC" 14 "DFC_Can1BYPASS_TDG1_13_DLC" 15 "DFC_Can1BYPASS_TDG1_14_DLC" 16 "DFC_Can1BYPASS_TDG1_15_DLC" 17 "DFC_Can1BYPASS_TDG1_16_PlaceHolder_DLC" 18 "DFC_Can1BYPASS_TDG1_17_PlaceHolder_DLC" 19 "DFC_Can1BYPASS_TDG1_18_PlaceHolder_DLC" 20 "DFC_Can1BYPASS_TDG1_19_Placeholder_DLC" 21 "DFC_Can1BYPASS_TDG1_20_Placeholder_DLC" 22 "DFC_Can1BYPASS_TDG1_21_DLC" 23 "DFC_Can1BYPASS_TDG1_22_DLC" 24 "DFC_Can1BYPASS_TDG1_AA" 25 "DFC_Can1BYPASS_TDG1_AB" 26 "DFC_Can1BYPASS_TDG1_AC" 27 "DFC_Can1BYPASS_TDG1_AD" 28 "DFC_Can1BYPASS_TDG1_AE" 29 "DFC_Can1BYPASS_TDG1_AF" 30 "DFC_Can1BYPASS_TDG1_BA" 31 "DFC_Can1BYPASS_TDG1_BB" 32 "DFC_Can1BYPASS_TDG1_BC" 33 "DFC_Can1BYPASS_TDG1_BD" 34 "DFC_Can1BYPASS_TDG1_BE_PlaceHolder" 35 "DFC_Can1BYPASS_TDG1_BF_PlaceHolder" 36 "DFC_Can1BYPASS_TDG1_CA_PlaceHolder" 37 "DFC_Can1BYPASS_TDG1_CB_PlaceHolder" 38 "DFC_Can1BYPASS_TDG1_CC_PlaceHolder" 39 "DFC_Can1Cool_Act_Cmd" 40 "DFC_Can1Cool_Act_Sts_DLC" 41 "DFC_DsmTest1" 42 "DFC_FrAACC_06ISigGroup_ACC_06_CHK" 43 "DFC_FrAACC_06ISigGroup_ACC_06_CNT" 44 "DFC_FrAACC_07ISigGroup_ACC_07_CHK" 45 "DFC_FrAACC_07ISigGroup_ACC_07_CNT" 46 "DFC_FrAAirbag_01ISigGroup_Airbag_01_CHK" 47 "DFC_FrAAirbag_01ISigGroup_Airbag_01_CNT" 48 "DFC_FrAAirbag_02ISigGroup_Airbag_02_CHK" 49 "DFC_FrAAirbag_02ISigGroup_Airbag_02_CNT" 50 "DFC_FrABremse_EV_01ISigGroup_Bremse_EV_01_CHK" 51 "DFC_FrABremse_EV_01ISigGroup_Bremse_EV_01_CNT" 52 "DFC_FrABremse_EV_02ISigGroup_Bremse_EV_02_CHK" 53 "DFC_FrABremse_EV_02ISigGroup_Bremse_EV_02_CNT" 54 "DFC_FrAEBKV_01ISigGroup_EBKV_01_CHK" 55 "DFC_FrAEBKV_01ISigGroup_EBKV_01_CNT" 56 "DFC_FrAEM1_HYB_12ISigGroup_EM1_HYB_12_CHK" 57 "DFC_FrAEM1_HYB_12ISigGroup_EM1_HYB_12_CNT" 58 "DFC_FrAEPB_01ISigGroup_EPB_01_CHK" 59 "DFC_FrAEPB_01ISigGroup_EPB_01_CNT" 60 "DFC_FrAESP_03ISigGroup_ESP_03_CHK" 61 "DFC_FrAESP_03ISigGroup_ESP_03_CNT" 62 "DFC_FrAESP_05ISigGroup_ESP_05_CHK" 63 "DFC_FrAESP_05ISigGroup_ESP_05_CNT" 64 "DFC_FrAESP_07ISigGroup_ESP_07_CHK" 65 "DFC_FrAESP_07ISigGroup_ESP_07_CNT" 66 "DFC_FrAESP_08ISigGroup_ESP_08_CHK" 67 "DFC_FrAESP_08ISigGroup_ESP_08_CNT" 68 "DFC_FrAESP_15ISigGroup_ESP_15_CHK" 69 "DFC_FrAESP_15ISigGroup_ESP_15_CNT" 70 "DFC_FrAESP_20ISigGroup_ESP_20_CHK" 71 "DFC_FrAESP_20ISigGroup_ESP_20_CNT" 72 "DFC_FrAESP_21ISigGroup_ESP_21_CHK" 73 "DFC_FrAESP_21ISigGroup_ESP_21_CNT" 74 "DFC_FrAESP_22ISigGroup_ESP_22_CHK" 75 "DFC_FrAESP_22ISigGroup_ESP_22_CNT" 76 "DFC_FrAESP_23ISigGroup_ESP_23_CHK" 77 "DFC_FrAESP_23ISigGroup_ESP_23_CNT" 78 "DFC_FrAESP_24ISigGroup_ESP_24_CHK" 79 "DFC_FrAESP_24ISigGroup_ESP_24_CNT" 80 "DFC_FrAESP_28ISigGroup_ESP_28_CHK" 81 "DFC_FrAESP_28ISigGroup_ESP_28_CNT" 82 "DFC_FrAESP_31ISigGroup_ESP_31_CHK" 83 "DFC_FrAESP_31ISigGroup_ESP_31_CNT" 84 "DFC_FrAESP_32ISigGroup_ESP_32_CHK" 85 "DFC_FrAESP_32ISigGroup_ESP_32_CNT" 86 "DFC_FrAESP_33ISigGroup_ESP_33_CHK" 87 "DFC_FrAESP_33ISigGroup_ESP_33_CNT" 88 "DFC_FrAESP_41ISigGroup_ESP_41_CHK" 89 "DFC_FrAESP_41ISigGroup_ESP_41_CNT" 90 "DFC_FrAESP_44ISigGroup_ESP_44_CHK" 91 "DFC_FrAESP_44ISigGroup_ESP_44_CNT" 92 "DFC_FrAGetriebe_11" 93 "DFC_FrAGetriebe_12" 94 "DFC_FrAGetriebe_13" 95 "DFC_FrAGetriebe_14" 96 "DFC_FrAGetriebe_15" 97 "DFC_FrAGetriebe_16" 98 "DFC_FrAGetriebe_17" 99 "DFC_FrAGetriebe_18" 100 "DFC_FrAGetriebe_HYB_12" 101 "DFC_FrAKN_Getriebe" 102 "DFC_FrAKlemmen_Status_01ISigGroup_Klemmen_Status_01_CHK" 103 "DFC_FrAKlemmen_Status_01ISigGroup_Klemmen_Status_01_CNT" 104 "DFC_FrALCV_01ISigGroup_LCV_01_CHK" 105 "DFC_FrALCV_01ISigGroup_LCV_01_CNT" 106 "DFC_FrALWI_01ISigGroup_LWI_01_CHK" 107 "DFC_FrALWI_01ISigGroup_LWI_01_CNT" 108 "DFC_FrAMotor_11ISigGroup_Motor_11_CHK" 109 "DFC_FrAMotor_11ISigGroup_Motor_11_CNT" 110 "DFC_FrAMotor_12ISigGroup_Motor_12_CHK" 111 "DFC_FrAMotor_12ISigGroup_Motor_12_CNT" 112 "DFC_FrAMotor_14ISigGroup_Motor_14_CHK" 113 "DFC_FrAMotor_14ISigGroup_Motor_14_CNT" 114 "DFC_FrAMotor_20ISigGroup_Motor_20_CHK" 115 "DFC_FrAMotor_20ISigGroup_Motor_20_CNT" 116 "DFC_FrAMotor_27ISigGroup_Motor_27_CHK" 117 "DFC_FrAMotor_27ISigGroup_Motor_27_CNT" 118 "DFC_FrAMotor_28ISigGroup_Motor_28_CHK" 119 "DFC_FrAMotor_28ISigGroup_Motor_28_CNT" 120 "DFC_FrAMotor_Code_01ISigGroup_Motor_Code_01_CHK" 121 "DFC_FrAMotor_Code_01ISigGroup_Motor_Code_01_CNT" 122 "DFC_FrAMotor_TS_01ISigGroup_Motor_TS_01_CHK" 123 "DFC_FrAMotor_TS_01ISigGroup_Motor_TS_01_CNT" 124 "DFC_FrAMotor_TS_02ISigGroup_Motor_TS_02_CHK" 125 "DFC_FrAMotor_TS_02ISigGroup_Motor_TS_02_CNT" 126 "DFC_FrAMotor_TS_03ISigGroup_Motor_TS_03_CHK" 127 "DFC_FrAMotor_TS_03ISigGroup_Motor_TS_03_CNT" 128 "DFC_FrASARA_06ISigGroup_SARA_06_CHK" 129 "DFC_FrASARA_06ISigGroup_SARA_06_CNT" 130 "DFC_FrATSG_FT_02ISigGroup_TSG_FT_02_CHK" 131 "DFC_FrATSG_FT_02ISigGroup_TSG_FT_02_CNT" 132 "DFC_FrATSK_06ISigGroup_TSK_06_CHK" 133 "DFC_FrATSK_06ISigGroup_TSK_06_CNT" 134 "DFC_FrATSK_08ISigGroup_TSK_08_CHK" 135 "DFC_FrATSK_08ISigGroup_TSK_08_CNT" 136 "DFC_FrAWBA_03" 137 "DFC_AdcBkg" 138 "DFC_Adc_Rdnt_0" 139 "DFC_Adc_Rdnt_1" 140 "DFC_Adc_Rdnt_2" 141 "DFC_Adc_Rdnt_3" 142 "DFC_Adc_Rdnt_4" 143 "DFC_Adc_Rdnt_5" 144 "DFC_Adc_Rdnt_6" 145 "DFC_Adc_Rdnt_7" 146 "DFC_Adc_Rdnt_8" 147 "DFC_Adc_Rdnt_9" 148 "DFC_Adc_SB_0" 149 "DFC_Adc_SB_1" 150 "DFC_Adc_SB_2" 151 "DFC_Adc_SB_3" 152 "DFC_Adc_SB_4" 153 "DFC_Adc_SB_5" 154 "DFC_Adc_SB_6" 155 "DFC_Adc_SB_7" 156 "DFC_Adc_SB_8" 157 "DFC_Adc_SB_9" 158 "DFC_Adc_SG_0" 159 "DFC_Adc_SG_1" 160 "DFC_Adc_SG_2" 161 "DFC_Adc_SG_3" 162 "DFC_Adc_SG_4" 163 "DFC_Adc_SG_5" 164 "DFC_Adc_SG_6" 165 "DFC_Adc_SG_7" 166 "DFC_Adc_SG_8" 167 "DFC_Adc_SG_9" 168 "DFC_Adc_Unit" 169 "DFC_BattSply_UHi" 170 "DFC_BattSply_ULo" 171 "DFC_CpuTemp" 172 "DFC_CrntCtrl_Channel_0" 173 "DFC_CrntCtrl_Channel_1" 174 "DFC_CrntCtrl_Channel_2" 175 "DFC_CrntCtrl_Channel_3" 176 "DFC_CrntCtrl_Channel_4" 177 "DFC_CrntCtrl_Channel_5" 178 "DFC_CrntCtrl_Channel_6" 179 "DFC_CrntCtrl_Channel_7" 180 "DFC_CrntCtrl_Channel_8" 181 "DFC_CrntCtrl_Channel_9" 182 "DFC_CrntCtrl_Channel_10" 183 "DFC_CrntCtrl_Channel_11" 184 "DFC_CrntCtrl_Channel_12" 185 "DFC_CrntCtrl_Channel_13" 186 "DFC_CrntCtrl_Channel_14" 187 "DFC_CrntCtrl_Channel_15" 188 "DFC_CrntCtrl_Channel_16" 189 "DFC_CrntCtrl_Channel_17" 190 "DFC_CrntCtrl_Channel_18" 191 "DFC_CrntCtrl_Channel_19" 192 "DFC_CrntCtrl_CrntMon_0" 193 "DFC_CrntCtrl_CrntMon_1" 194 "DFC_CrntCtrl_CrntMon_2" 195 "DFC_CrntCtrl_CrntMon_3" 196 "DFC_CrntCtrl_CrntMon_4" 197 "DFC_CrntCtrl_CrntMon_5" 198 "DFC_CrntCtrl_CrntMon_6" 199 "DFC_CrntCtrl_CrntMon_7" 200 "DFC_CrntCtrl_CrntMon_8" 201 "DFC_CrntCtrl_CrntMon_9" 202 "DFC_CrntCtrl_CrntMon_10" 203 "DFC_CrntCtrl_CrntMon_11" 204 "DFC_CrntCtrl_CrntMon_12" 205 "DFC_CrntCtrl_CrntMon_13" 206 "DFC_CrntCtrl_CrntMon_14" 207 "DFC_CrntCtrl_CrntMon_15" 208 "DFC_CrntCtrl_CrntMon_16" 209 "DFC_CrntCtrl_CrntMon_17" 210 "DFC_CrntCtrl_CrntMon_18" 211 "DFC_CrntCtrl_CrntMon_19" 212 "DFC_CrntCtrl_OP_0" 213 "DFC_CrntCtrl_OP_1" 214 "DFC_CrntCtrl_OP_2" 215 "DFC_CrntCtrl_OP_3" 216 "DFC_CrntCtrl_OP_4" 217 "DFC_CrntCtrl_OP_5" 218 "DFC_CrntCtrl_OP_6" 219 "DFC_CrntCtrl_OP_7" 220 "DFC_CrntCtrl_OP_8" 221 "DFC_CrntCtrl_OP_9" 222 "DFC_CrntCtrl_OP_10" 223 "DFC_CrntCtrl_OP_11" 224 "DFC_CrntCtrl_OP_12" 225 "DFC_CrntCtrl_OP_13" 226 "DFC_CrntCtrl_OP_14" 227 "DFC_CrntCtrl_OP_15" 228 "DFC_CrntCtrl_OP_16" 229 "DFC_CrntCtrl_OP_17" 230 "DFC_CrntCtrl_OP_18" 231 "DFC_CrntCtrl_OP_19" 232 "DFC_CrntCtrl_SB_0" 233 "DFC_CrntCtrl_SB_1" 234 "DFC_CrntCtrl_SB_2" 235 "DFC_CrntCtrl_SB_3" 236 "DFC_CrntCtrl_SB_4" 237 "DFC_CrntCtrl_SB_5" 238 "DFC_CrntCtrl_SB_6" 239 "DFC_CrntCtrl_SB_7" 240 "DFC_CrntCtrl_SB_8" 241 "DFC_CrntCtrl_SB_9" 242 "DFC_CrntCtrl_SB_10" 243 "DFC_CrntCtrl_SB_11" 244 "DFC_CrntCtrl_SB_12" 245 "DFC_CrntCtrl_SB_13" 246 "DFC_CrntCtrl_SB_14" 247 "DFC_CrntCtrl_SB_15" 248 "DFC_CrntCtrl_SB_16" 249 "DFC_CrntCtrl_SB_17" 250 "DFC_CrntCtrl_SB_18" 251 "DFC_CrntCtrl_SB_19" 252 "DFC_CrntCtrl_SG_0" 253 "DFC_CrntCtrl_SG_1" 254 "DFC_CrntCtrl_SG_2" 255 "DFC_CrntCtrl_SG_3" 256 "DFC_CrntCtrl_SG_4" 257 "DFC_CrntCtrl_SG_5" 258 "DFC_CrntCtrl_SG_6" 259 "DFC_CrntCtrl_SG_7" 260 "DFC_CrntCtrl_SG_8" 261 "DFC_CrntCtrl_SG_9" 262 "DFC_CrntCtrl_SG_10" 263 "DFC_CrntCtrl_SG_11" 264 "DFC_CrntCtrl_SG_12" 265 "DFC_CrntCtrl_SG_13" 266 "DFC_CrntCtrl_SG_14" 267 "DFC_CrntCtrl_SG_15" 268 "DFC_CrntCtrl_SG_16" 269 "DFC_CrntCtrl_SG_17" 270 "DFC_CrntCtrl_SG_18" 271 "DFC_CrntCtrl_SG_19" 272 "DFC_CrntCtrl_Unit_0" 273 "DFC_CrntCtrl_Unit_1" 274 "DFC_CtrlMot_DNR_0" 275 "DFC_CtrlMot_DNR_1" 276 "DFC_CtrlMot_OC_0" 277 "DFC_CtrlMot_OC_1" 278 "DFC_CtrlMot_OL_0" 279 "DFC_CtrlMot_OL_1" 280 "DFC_CtrlMot_SB_0" 281 "DFC_CtrlMot_SB_1" 282 "DFC_CtrlMot_SG_0" 283 "DFC_CtrlMot_SG_1" 284 "DFC_Flx_AdcInUnit_0" 285 "DFC_Flx_AdcInUnit_1" 286 "DFC_Flx_AdcInUnit_2" 287 "DFC_Flx_RMeasUnit_0" 288 "DFC_Flx_RMeasUnit_1" 289 "DFC_Flx_SB_0" 290 "DFC_Flx_SB_1" 291 "DFC_Flx_SB_2" 292 "DFC_Flx_SB_3" 293 "DFC_Flx_SB_4" 294 "DFC_Flx_SB_5" 295 "DFC_Flx_SB_6" 296 "DFC_Flx_SB_7" 297 "DFC_Flx_SB_8" 298 "DFC_Flx_SB_9" 299 "DFC_Flx_SB_10" 300 "DFC_Flx_SB_11" 301 "DFC_Flx_SB_12" 302 "DFC_Flx_SB_13" 303 "DFC_Flx_SB_14" 304 "DFC_Flx_SB_15" 305 "DFC_Flx_SB_16" 306 "DFC_Flx_SB_17" 307 "DFC_Flx_SB_18" 308 "DFC_Flx_SB_19" 309 "DFC_Flx_SB_20" 310 "DFC_Flx_SB_21" 311 "DFC_Flx_SB_22" 312 "DFC_Flx_SB_23" 313 "DFC_Flx_SB_24" 314 "DFC_Flx_SB_25" 315 "DFC_Flx_SB_26" 316 "DFC_Flx_SG_0" 317 "DFC_Flx_SG_1" 318 "DFC_Flx_SG_2" 319 "DFC_Flx_SG_3" 320 "DFC_Flx_SG_4" 321 "DFC_Flx_SG_5" 322 "DFC_Flx_SG_6" 323 "DFC_Flx_SG_7" 324 "DFC_Flx_SG_8" 325 "DFC_Flx_SG_9" 326 "DFC_Flx_SG_10" 327 "DFC_Flx_SG_11" 328 "DFC_Flx_SG_12" 329 "DFC_Flx_SG_13" 330 "DFC_Flx_SG_14" 331 "DFC_Flx_SG_15" 332 "DFC_Flx_SG_16" 333 "DFC_Flx_SG_17" 334 "DFC_Flx_SG_18" 335 "DFC_Flx_SG_19" 336 "DFC_Flx_SG_20" 337 "DFC_Flx_SG_21" 338 "DFC_Flx_SG_22" 339 "DFC_Flx_SG_23" 340 "DFC_Flx_SG_24" 341 "DFC_Flx_SG_25" 342 "DFC_Flx_SG_26" 343 "DFC_Flx_Sig_0" 344 "DFC_Flx_Sig_1" 345 "DFC_Flx_Sig_2" 346 "DFC_Flx_Sig_3" 347 "DFC_Flx_Sig_4" 348 "DFC_Flx_Sig_5" 349 "DFC_Flx_Sig_6" 350 "DFC_Flx_Sig_7" 351 "DFC_Flx_Sig_8" 352 "DFC_Flx_Sig_9" 353 "DFC_Flx_Sig_10" 354 "DFC_Flx_Sig_11" 355 "DFC_Flx_Sig_12" 356 "DFC_Flx_Sig_13" 357 "DFC_Flx_Sig_14" 358 "DFC_Flx_Sig_15" 359 "DFC_Flx_Sig_16" 360 "DFC_Flx_Sig_17" 361 "DFC_Flx_Sig_18" 362 "DFC_Flx_Sig_19" 363 "DFC_Flx_Sig_20" 364 "DFC_Flx_Sig_21" 365 "DFC_Flx_Sig_22" 366 "DFC_Flx_Sig_23" 367 "DFC_Flx_Sig_24" 368 "DFC_Flx_Sig_25" 369 "DFC_Flx_Sig_26" 370 "DFC_Gtm_Clk" 371 "DFC_HiSide_OP_0" 372 "DFC_HiSide_OP_1" 373 "DFC_HiSide_OP_2" 374 "DFC_HiSide_OP_3" 375 "DFC_HiSide_OP_4" 376 "DFC_HiSide_OP_5" 377 "DFC_HiSide_SB_0" 378 "DFC_HiSide_SB_1" 379 "DFC_HiSide_SB_2" 380 "DFC_HiSide_SB_3" 381 "DFC_HiSide_SB_4" 382 "DFC_HiSide_SB_5" 383 "DFC_HiSide_SG_0" 384 "DFC_HiSide_SG_1" 385 "DFC_HiSide_SG_2" 386 "DFC_HiSide_SG_3" 387 "DFC_HiSide_SG_4" 388 "DFC_HiSide_SG_5" 389 "DFC_IntSply_0" 390 "DFC_IntSply_1" 391 "DFC_IntSply_2" 392 "DFC_IntSply_3" 393 "DFC_IntSply_4" 394 "DFC_IntSply_5" 395 "DFC_IntTemp" 396 "DFC_LssRly_OL" 397 "DFC_LssRly_SB" 398 "DFC_LssRly_SG" 399 "DFC_Lss_OL_0" 400 "DFC_Lss_OL_1" 401 "DFC_Lss_OL_2" 402 "DFC_Lss_OL_3" 403 "DFC_Lss_OL_4" 404 "DFC_Lss_OL_5" 405 "DFC_Lss_OL_6" 406 "DFC_Lss_OL_7" 407 "DFC_Lss_OL_8" 408 "DFC_Lss_OL_9" 409 "DFC_Lss_OL_10" 410 "DFC_Lss_OL_11" 411 "DFC_Lss_SB_0" 412 "DFC_Lss_SB_1" 413 "DFC_Lss_SB_2" 414 "DFC_Lss_SB_3" 415 "DFC_Lss_SB_4" 416 "DFC_Lss_SB_5" 417 "DFC_Lss_SB_6" 418 "DFC_Lss_SB_7" 419 "DFC_Lss_SB_8" 420 "DFC_Lss_SB_9" 421 "DFC_Lss_SB_10" 422 "DFC_Lss_SB_11" 423 "DFC_Lss_SG_0" 424 "DFC_Lss_SG_1" 425 "DFC_Lss_SG_2" 426 "DFC_Lss_SG_3" 427 "DFC_Lss_SG_4" 428 "DFC_Lss_SG_5" 429 "DFC_Lss_SG_6" 430 "DFC_Lss_SG_7" 431 "DFC_Lss_SG_8" 432 "DFC_Lss_SG_9" 433 "DFC_Lss_SG_10" 434 "DFC_Lss_SG_11" 435 "DFC_Lss_Unit" 436 "DFC_OsTmrMon" 437 "DFC_PwmIn_GtmTim_0" 438 "DFC_PwmIn_GtmTim_1" 439 "DFC_PwmIn_GtmTim_2" 440 "DFC_PwmIn_GtmTim_3" 441 "DFC_PwmIn_GtmTim_4" 442 "DFC_PwmIn_GtmTim_5" 443 "DFC_PwmIn_GtmTim_6" 444 "DFC_PwmIn_GtmTim_7" 445 "DFC_PwmIn_GtmTim_8" 446 "DFC_PwmIn_GtmTim_9" 447 "DFC_PwmIn_GtmTim_10" 448 "DFC_PwmIn_GtmTim_11" 449 "DFC_PwmIn_SB_0" 450 "DFC_PwmIn_SB_1" 451 "DFC_PwmIn_SB_2" 452 "DFC_PwmIn_SB_3" 453 "DFC_PwmIn_SB_4" 454 "DFC_PwmIn_SB_5" 455 "DFC_PwmIn_SB_6" 456 "DFC_PwmIn_SB_7" 457 "DFC_PwmIn_SB_8" 458 "DFC_PwmIn_SB_9" 459 "DFC_PwmIn_SB_10" 460 "DFC_PwmIn_SB_11" 461 "DFC_PwmIn_SG_0" 462 "DFC_PwmIn_SG_1" 463 "DFC_PwmIn_SG_2" 464 "DFC_PwmIn_SG_3" 465 "DFC_PwmIn_SG_4" 466 "DFC_PwmIn_SG_5" 467 "DFC_PwmIn_SG_6" 468 "DFC_PwmIn_SG_7" 469 "DFC_PwmIn_SG_8" 470 "DFC_PwmIn_SG_9" 471 "DFC_PwmIn_SG_10" 472 "DFC_PwmIn_SG_11" 473 "DFC_PwmIn_Sig_0" 474 "DFC_PwmIn_Sig_1" 475 "DFC_PwmIn_Sig_2" 476 "DFC_PwmIn_Sig_3" 477 "DFC_PwmIn_Sig_4" 478 "DFC_PwmIn_Sig_5" 479 "DFC_PwmIn_Sig_6" 480 "DFC_PwmIn_Sig_7" 481 "DFC_PwmIn_Sig_8" 482 "DFC_PwmIn_Sig_9" 483 "DFC_PwmIn_Sig_10" 484 "DFC_PwmIn_Sig_11" 485 "DFC_SafeSt_flgDn" 486 "DFC_SnsrSply_SB_0" 487 "DFC_SnsrSply_SB_1" 488 "DFC_SnsrSply_SB_2" 489 "DFC_SnsrSply_SB_3" 490 "DFC_SnsrSply_SB_4" 491 "DFC_SnsrSply_SB_5" 492 "DFC_SnsrSply_SG_0" 493 "DFC_SnsrSply_SG_1" 494 "DFC_SnsrSply_SG_2" 495 "DFC_SnsrSply_SG_3" 496 "DFC_SnsrSply_SG_4" 497 "DFC_SnsrSply_SG_5" 498 "DFC_Spd_NdPls_0" 499 "DFC_Spd_NdPls_1" 500 "DFC_Spd_NdPls_2" 501 "DFC_Spd_NdPls_3" 502 "DFC_Spd_NdPls_4" 503 "DFC_Spd_OP_0" 504 "DFC_Spd_OP_1" 505 "DFC_Spd_OP_2" 506 "DFC_Spd_OP_3" 507 "DFC_Spd_OP_4" 508 "DFC_Spd_Pls_0" 509 "DFC_Spd_Pls_1" 510 "DFC_Spd_Pls_2" 511 "DFC_Spd_Pls_3" 512 "DFC_Spd_Pls_4" 513 "DFC_Spd_SB_0" 514 "DFC_Spd_SB_1" 515 "DFC_Spd_SB_2" 516 "DFC_Spd_SB_3" 517 "DFC_Spd_SB_4" 518 "DFC_Spd_SG_0" 519 "DFC_Spd_SG_1" 520 "DFC_Spd_SG_2" 521 "DFC_Spd_SG_3" 522 "DFC_Spd_SG_4" 523 "DFC_Spd_Sig_0" 524 "DFC_Spd_Sig_1" 525 "DFC_Spd_Sig_2" 526 "DFC_Spd_Sig_3" 527 "DFC_Spd_Sig_4" 528 "DFC_Spd_Sync_0" 529 "DFC_Spd_Sync_1" 530 "DFC_Spd_Sync_2" 531 "DFC_Spd_Sync_3" 532 "DFC_Spd_Sync_4" 533 "DFC_WdgSys" 534 "DFC_WdgWd" 535 "DFC_AcceleratorPedalErrorRx" 536 "DFC_AccumulatorChargeFault" 537 "DFC_AltitudeErrorRx" 538 "DFC_BLDCPumpDerateRx" 539 "DFC_BLDCPumpErrorRx" 540 "DFC_BrakePressureErrorRx" 541 "DFC_BrakeSwitchErrorRx" 542 "DFC_BrakeSwitchImplausible1" 543 "DFC_BrakeSwitchImplausible2" 544 "DFC_BrakeSwitchRateHigh" 545 "DFC_BrakeSwitchSpare1" 546 "DFC_BrakeSwitchSpare2" 547 "DFC_ChargeValveStuck" 548 "DFC_Clutch1AdaptationFault" 549 "DFC_Clutch1OverPressure" 550 "DFC_Clutch1UnderPressure" 551 "DFC_Clutch2AdaptationFault" 552 "DFC_Clutch2OverPressure" 553 "DFC_Clutch2UnderPressure" 554 "DFC_ClutchCoolingValveFault" 555 "DFC_ClutchCoolingValveStuck" 556 "DFC_ClutchOverTempoerature" 557 "DFC_ClutchShutOffValveFault" 558 "DFC_CoolantTempErrorRx" 559 "DFC_CoolingPressureImplausible" 560 "DFC_CoolingPressureRateHigh" 561 "DFC_CoolingPressureTooHigh" 562 "DFC_CoolingPressureTooLow" 563 "DFC_CrntCtrl_Reg_1" 564 "DFC_CrntCtrl_Reg_10" 565 "DFC_CrntCtrl_Reg_11" 566 "DFC_CrntCtrl_Reg_12" 567 "DFC_CrntCtrl_Reg_16" 568 "DFC_CrntCtrl_Reg_17" 569 "DFC_CrntCtrl_Reg_18" 570 "DFC_CrntCtrl_Reg_19" 571 "DFC_CrntCtrl_Reg_2" 572 "DFC_CrntCtrl_Reg_3" 573 "DFC_CrntCtrl_Reg_6" 574 "DFC_CrntCtrl_Reg_7" 575 "DFC_CrntCtrl_Reg_9" 576 "DFC_DSTSpare1" 577 "DFC_DSTSpare2" 578 "DFC_DWCSpare1" 579 "DFC_DWCSpare2" 580 "DFC_DWCSpare3" 581 "DFC_DWCSpare4" 582 "DFC_DWCSpare5" 583 "DFC_DWCSpare6" 584 "DFC_DWCSpare7" 585 "DFC_DoorStatusErrorRx" 586 "DFC_DownSwImplausible" 587 "DFC_DownSwRateHigh" 588 "DFC_DownSwSpare1" 589 "DFC_DownSwSpare2" 590 "DFC_EM1SpeedErrorRx" 591 "DFC_ENGDriveTorqueImplausible" 592 "DFC_ENGEngineProblem" 593 "DFC_ENGIdiotStart" 594 "DFC_ENGSpare1" 595 "DFC_ENGSpare2" 596 "DFC_ESPStatusErrorRx" 597 "DFC_EngineOilTempErrorRx" 598 "DFC_EngineSpeedErrorRx" 599 "DFC_EngineSpeedPWMImplausible1" 600 "DFC_EngineSpeedPWMImplausible2" 601 "DFC_EngineSpeedPWMRateHigh" 602 "DFC_EngineSpeedPWMSpare1" 603 "DFC_EngineSpeedPWMSpare2" 604 "DFC_EngineTorqueErrorRx" 605 "DFC_ExternalTempErrorRx" 606 "DFC_FailStuckNFault" 607 "DFC_FrontLeftWheelSpeedErrorRx" 608 "DFC_FrontRightWheelSpeedErrorRx" 609 "DFC_GearCoolingValveStuck" 610 "DFC_K1PressureImplausible" 611 "DFC_K1PressureRateHigh" 612 "DFC_K1PressureSpare1" 613 "DFC_K1PressureSpare2" 614 "DFC_K1SpeedHigh" 615 "DFC_K1SpeedImplausible" 616 "DFC_K1SpeedSpare1" 617 "DFC_K1SpeedSpare2" 618 "DFC_K2PressureImplausible" 619 "DFC_K2PressureRateHigh" 620 "DFC_K2PressureSpare1" 621 "DFC_K2PressureSpare2" 622 "DFC_K2SpeedHigh" 623 "DFC_K2SpeedImplausible" 624 "DFC_K2SpeedSpare1" 625 "DFC_K2SpeedSpare2" 626 "DFC_L2ClutchPressureVsCurrentOdd" 627 "DFC_L2ClutchTorqueDirection" 628 "DFC_L2DoubleClutchEngagement" 629 "DFC_L2DoubleGearEven" 630 "DFC_L2EM1ShaftOverspeed" 631 "DFC_L2EPBWhenMoving" 632 "DFC_L2EvenClutchGradientInCreep" 633 "DFC_L2ForwardDriveEven" 634 "DFC_L2ForwardDriveOdd" 635 "DFC_L2ForwardGearAndMode" 636 "DFC_L2GearCombinationEM1Overspeed" 637 "DFC_L2GearCombinationRequest" 638 "DFC_L2InputShaftEngineOverspeed" 639 "DFC_L2InsufficientLubrication" 640 "DFC_L2InvalidDownshiftOdd" 641 "DFC_L2InvalidGearControl" 642 "DFC_L2LeaveNeutral" 643 "DFC_L2LeavePark" 644 "DFC_L2ModeDisplay" 645 "DFC_L2ModeSelection" 646 "DFC_L2MovementWithChargeCable" 647 "DFC_L2OddClutchGradientInCreep" 648 "DFC_L2OddShaftAccelerationImplausible" 649 "DFC_L2ParkFailNoEPB" 650 "DFC_L2ParkPosition" 651 "DFC_L2ParkValveOverride" 652 "DFC_L2ParkWhenMoving" 653 "DFC_L2ReferenceSpeedFail" 654 "DFC_L2ReverseDrive" 655 "DFC_L2ShaftOverSpeedFromIP" 656 "DFC_L2ShaftOverSpeedFromOP" 657 "DFC_L2Spare1" 658 "DFC_L2Spare2" 659 "DFC_L2TorqueNoShift" 660 "DFC_L2TorqueRequestCupOfFuel" 661 "DFC_L2VGPOverride" 662 "DFC_L2VKUGLOveride" 663 "DFC_L2VSS1Overirde" 664 "DFC_L2VSS2Overirde" 665 "DFC_LatAccErrorRx" 666 "DFC_LinePressureImplausible" 667 "DFC_LinePressureLeakageHigh" 668 "DFC_LinePressureRateHigh" 669 "DFC_LinePressureSpare1" 670 "DFC_LinePressureSpare2" 671 "DFC_LinePressureTooHigh" 672 "DFC_LinePressureTooLow" 673 "DFC_LongAccErrorRx" 674 "DFC_LubeOilOverTemperature" 675 "DFC_LubeTemperatureImplausible" 676 "DFC_LubeTemperatureRateHigh" 677 "DFC_LubeTemperatureSpare1" 678 "DFC_LubeTemperatureSpare2" 679 "DFC_MOTEngineProblem" 680 "DFC_MOTSpare1" 681 "DFC_MOTSpare2" 682 "DFC_ModeMSwImplausible" 683 "DFC_ModeMSwSpare1" 684 "DFC_ModeMSwSpare2" 685 "DFC_ModeMSwSwRateHigh" 686 "DFC_ModePSwImplausible" 687 "DFC_ModePSwSpare1" 688 "DFC_ModePSwSpare2" 689 "DFC_ModePSwSwRateHigh" 690 "DFC_ModeRSwImplausible" 691 "DFC_ModeRSwSpare1" 692 "DFC_ModeRSwSpare2" 693 "DFC_ModeRSwSwRateHigh" 694 "DFC_ParkLockDisengageFail" 695 "DFC_ParkLockEngageFail" 696 "DFC_ParkLockPosImplausible" 697 "DFC_ParkLockPosRateHigh" 698 "DFC_ParkLockPosSpare1" 699 "DFC_ParkLockPosSpare2" 700 "DFC_PumpResponseFault" 701 "DFC_PumpSpeedError" 702 "DFC_RearLeftWheelSpeedErrorRx" 703 "DFC_RearRightWheelSpeedErrorRx" 704 "DFC_RedSpeedHigh" 705 "DFC_RedSpeedImplausible" 706 "DFC_RedSpeedSpare1" 707 "DFC_RedSpeedSpare2" 708 "DFC_SEQSpare1" 709 "DFC_SEQSpare2" 710 "DFC_SEQTimeout" 711 "DFC_Spare_0" 712 "DFC_Spare_1" 713 "DFC_Spare_2" 714 "DFC_Spare_3" 715 "DFC_Spare_4" 716 "DFC_Spare_5" 717 "DFC_Spare_6" 718 "DFC_Spare_7" 719 "DFC_Spare_8" 720 "DFC_Spare_9" 721 "DFC_SumpOilOverTemperature" 722 "DFC_SumpTemperatureImplausible" 723 "DFC_SumpTemperatureRateHigh" 724 "DFC_SumpTemperatureSpare1" 725 "DFC_SumpTemperatureSpare2" 726 "DFC_SynchroA1EngageFault" 727 "DFC_SynchroA1SpitoutInShiftFault" 728 "DFC_SynchroA1SpitoutNoShiftFault" 729 "DFC_SynchroA1StuckFault" 730 "DFC_SynchroA2EngageFault" 731 "DFC_SynchroA2SpitoutInShiftFault" 732 "DFC_SynchroA2SpitoutNoShiftFault" 733 "DFC_SynchroA2StuckFault" 734 "DFC_SynchroAOutOfNInShiftFault" 735 "DFC_SynchroAOutOfNNoShiftFault" 736 "DFC_SynchroAPosImplausible" 737 "DFC_SynchroAPosRateHigh" 738 "DFC_SynchroAPosSpare1" 739 "DFC_SynchroAPosSpare2" 740 "DFC_SynchroB1EngageFault" 741 "DFC_SynchroB1SpitoutInShiftFault" 742 "DFC_SynchroB1SpitoutNoShiftFault" 743 "DFC_SynchroB1StuckFault" 744 "DFC_SynchroB2EngageFault" 745 "DFC_SynchroB2SpitoutInShiftFault" 746 "DFC_SynchroB2SpitoutNoShiftFault" 747 "DFC_SynchroB2StuckFault" 748 "DFC_SynchroBOutOfNInShiftFault" 749 "DFC_SynchroBOutOfNNoShiftFault" 750 "DFC_SynchroBPosImplausible" 751 "DFC_SynchroBPosRateHigh" 752 "DFC_SynchroBPosSpare1" 753 "DFC_SynchroBPosSpare2" 754 "DFC_SynchroC1EngageFault" 755 "DFC_SynchroC1SpitoutInShiftFault" 756 "DFC_SynchroC1SpitoutNoShiftFault" 757 "DFC_SynchroC1StuckFault" 758 "DFC_SynchroC2EngageFault" 759 "DFC_SynchroC2SpitoutInShiftFault" 760 "DFC_SynchroC2SpitoutNoShiftFault" 761 "DFC_SynchroC2StuckFault" 762 "DFC_SynchroCOutOfNInShiftFault" 763 "DFC_SynchroCOutOfNNoShiftFault" 764 "DFC_SynchroCPosImplausible" 765 "DFC_SynchroCPosRateHigh" 766 "DFC_SynchroCPosSpare1" 767 "DFC_SynchroCPosSpare2" 768 "DFC_SynchroD1EngageFault" 769 "DFC_SynchroD1SpitoutInShiftFault" 770 "DFC_SynchroD1SpitoutNoShiftFault" 771 "DFC_SynchroD1StuckFault" 772 "DFC_SynchroDOutOfNInShiftFault" 773 "DFC_SynchroDOutOfNNoShiftFault" 774 "DFC_SynchroDPosImplausible" 775 "DFC_SynchroDPosRateHigh" 776 "DFC_SynchroDPosSpare1" 777 "DFC_SynchroDPosSpare2" 778 "DFC_SynchroF1EngageFault" 779 "DFC_SynchroF1SpitoutInShiftFault" 780 "DFC_SynchroF1SpitoutNoShiftFault" 781 "DFC_SynchroF1StuckFault" 782 "DFC_SynchroF2EngageFault" 783 "DFC_SynchroF2SpitoutInShiftFault" 784 "DFC_SynchroF2SpitoutNoShiftFault" 785 "DFC_SynchroF2StuckFault" 786 "DFC_SynchroFOutOfNInShiftFault" 787 "DFC_SynchroFOutOfNNoShiftFault" 788 "DFC_SynchroFPosImplausible" 789 "DFC_SynchroFPosRateHigh" 790 "DFC_SynchroFPosSpare1" 791 "DFC_SynchroFPosSpare2" 792 "DFC_UpSwImplausible" 793 "DFC_UpSwRateHigh" 794 "DFC_UpSwSpare1" 795 "DFC_UpSwSpare2" 796 "DFC_VehicleSpeedErrorRx" 797 "DFC_WheelTorqueESPErrorRx" 798 "DFC_YawRateErrorRx" 799 "DFC_Can0Motor_01_TO" 800 "DFC_Can0Motor_02_TO" 801 "DFC_Can0Motor_03_TO" 802 "DFC_Can1BYPASS_TDG1_11_TO" 803 "DFC_Can1BYPASS_TDG1_12_TO" 804 "DFC_Can1BYPASS_TDG1_13_TO" 805 "DFC_Can1BYPASS_TDG1_14_TO" 806 "DFC_Can1BYPASS_TDG1_15_TO" 807 "DFC_Can1BYPASS_TDG1_16_PlaceHolder_TO" 808 "DFC_Can1BYPASS_TDG1_17_PlaceHolder_TO" 809 "DFC_Can1BYPASS_TDG1_18_PlaceHolder_TO" 810 "DFC_Can1BYPASS_TDG1_19_Placeholder_TO" 811 "DFC_Can1BYPASS_TDG1_20_Placeholder_TO" 812 "DFC_Can1BYPASS_TDG1_21_TO" 813 "DFC_Can1BYPASS_TDG1_22_TO" 814 "DFC_Can1Cool_Act_Sts_TO" 815 "DFC_DsmTest0" 816 "DFC_FrAACC_06ISigGroup_ACC_06_TO" 817 "DFC_FrAACC_06_TO" 818 "DFC_FrAACC_07ISigGroup_ACC_07_TO" 819 "DFC_FrAACC_07_TO" 820 "DFC_FrAAirbag_01ISigGroup_Airbag_01_TO" 821 "DFC_FrAAirbag_01_TO" 822 "DFC_FrAAirbag_02ISigGroup_Airbag_02_TO" 823 "DFC_FrAAirbag_02_TO" 824 "DFC_FrABCM_01_TO" 825 "DFC_FrABremse_EV_01ISigGroup_Bremse_EV_01_TO" 826 "DFC_FrABremse_EV_01_TO" 827 "DFC_FrABremse_EV_02ISigGroup_Bremse_EV_02_TO" 828 "DFC_FrABremse_EV_02_TO" 829 "DFC_FrACharisma_01_TO" 830 "DFC_FrADiagnose_01_TO" 831 "DFC_FrAEBKV_01ISigGroup_EBKV_01_TO" 832 "DFC_FrAEBKV_01_TO" 833 "DFC_FrAEM1_HYB_06_TO" 834 "DFC_FrAEM1_HYB_12ISigGroup_EM1_HYB_12_TO" 835 "DFC_FrAEM1_HYB_12_TO" 836 "DFC_FrAEPB_01ISigGroup_EPB_01_TO" 837 "DFC_FrAEPB_01_TO" 838 "DFC_FrAESP_03ISigGroup_ESP_03_TO" 839 "DFC_FrAESP_03_TO" 840 "DFC_FrAESP_05ISigGroup_ESP_05_TO" 841 "DFC_FrAESP_05_TO" 842 "DFC_FrAESP_07ISigGroup_ESP_07_TO" 843 "DFC_FrAESP_07_TO" 844 "DFC_FrAESP_08ISigGroup_ESP_08_TO" 845 "DFC_FrAESP_08_TO" 846 "DFC_FrAESP_15ISigGroup_ESP_15_TO" 847 "DFC_FrAESP_15_TO" 848 "DFC_FrAESP_20ISigGroup_ESP_20_TO" 849 "DFC_FrAESP_20_TO" 850 "DFC_FrAESP_21ISigGroup_ESP_21_TO" 851 "DFC_FrAESP_21_TO" 852 "DFC_FrAESP_22ISigGroup_ESP_22_TO" 853 "DFC_FrAESP_22_TO" 854 "DFC_FrAESP_23ISigGroup_ESP_23_TO" 855 "DFC_FrAESP_23_TO" 856 "DFC_FrAESP_24ISigGroup_ESP_24_TO" 857 "DFC_FrAESP_24_TO" 858 "DFC_FrAESP_26_TO" 859 "DFC_FrAESP_28ISigGroup_ESP_28_TO" 860 "DFC_FrAESP_28_TO" 861 "DFC_FrAESP_31ISigGroup_ESP_31_TO" 862 "DFC_FrAESP_31_TO" 863 "DFC_FrAESP_32ISigGroup_ESP_32_TO" 864 "DFC_FrAESP_32_TO" 865 "DFC_FrAESP_33ISigGroup_ESP_33_TO" 866 "DFC_FrAESP_33_TO" 867 "DFC_FrAESP_41ISigGroup_ESP_41_TO" 868 "DFC_FrAESP_41_TO" 869 "DFC_FrAESP_44ISigGroup_ESP_44_TO" 870 "DFC_FrAESP_44_TO" 871 "DFC_FrAKlemmen_Status_01ISigGroup_Klemmen_Status_01_TO" 872 "DFC_FrAKlemmen_Status_01_TO" 873 "DFC_FrAKlima_11_TO" 874 "DFC_FrAKombi_02_TO" 875 "DFC_FrALCV_01ISigGroup_LCV_01_TO" 876 "DFC_FrALCV_01_TO" 877 "DFC_FrALWI_01ISigGroup_LWI_01_TO" 878 "DFC_FrALWI_01_TO" 879 "DFC_FrAMFL_Tasten_01_TO" 880 "DFC_FrAMSG_EM1_18_TO" 881 "DFC_FrAMSG_EM1_29_TO" 882 "DFC_FrAMotor_07_TO" 883 "DFC_FrAMotor_11ISigGroup_Motor_11_TO" 884 "DFC_FrAMotor_11_TO" 885 "DFC_FrAMotor_12ISigGroup_Motor_12_TO" 886 "DFC_FrAMotor_12_TO" 887 "DFC_FrAMotor_14ISigGroup_Motor_14_TO" 888 "DFC_FrAMotor_14_TO" 889 "DFC_FrAMotor_16_TO" 890 "DFC_FrAMotor_17_TO" 891 "DFC_FrAMotor_18_TO" 892 "DFC_FrAMotor_20ISigGroup_Motor_20_TO" 893 "DFC_FrAMotor_20_TO" 894 "DFC_FrAMotor_27ISigGroup_Motor_27_TO" 895 "DFC_FrAMotor_27_TO" 896 "DFC_FrAMotor_28ISigGroup_Motor_28_TO" 897 "DFC_FrAMotor_28_TO" 898 "DFC_FrAMotor_35_TO" 899 "DFC_FrAMotor_38_LB_TO" 900 "DFC_FrAMotor_47_TO" 901 "DFC_FrAMotor_Code_01ISigGroup_Motor_Code_01_TO" 902 "DFC_FrAMotor_Code_01_TO" 903 "DFC_FrAMotor_Hybrid_11_TO" 904 "DFC_FrAMotor_TS_01ISigGroup_Motor_TS_01_TO" 905 "DFC_FrAMotor_TS_01_TO" 906 "DFC_FrAMotor_TS_02ISigGroup_Motor_TS_02_TO" 907 "DFC_FrAMotor_TS_02_TO" 908 "DFC_FrAMotor_TS_03ISigGroup_Motor_TS_03_TO" 909 "DFC_FrAMotor_TS_03_TO" 910 "DFC_FrANVEM_02_TO" 911 "DFC_FrANVEM_05_TO" 912 "DFC_FrAOBD_01_TO" 913 "DFC_FrAOBD_02_TO" 914 "DFC_FrASARA_06ISigGroup_SARA_06_TO" 915 "DFC_FrASARA_06_TO" 916 "DFC_FrASysteminfo_01_TO" 917 "DFC_FrATSG_FT_02ISigGroup_TSG_FT_02_TO" 918 "DFC_FrATSG_FT_02_TO" 919 "DFC_FrATSK_06ISigGroup_TSK_06_TO" 920 "DFC_FrATSK_06_TO" 921 "DFC_FrATSK_08ISigGroup_TSK_08_TO" 922 "DFC_FrATSK_08_TO" 923 "DFC_FrAVIN_01_0_TO" 924 "DFC_FrAVIN_01_1_TO" 925 "DFC_FrAVIN_01_2_TO" 926 "DFC_IPT" 927 "DFC_L3Error" 928 "DFC_SftyCfgMon" 929 "DFC_SftyShtOff" 930 "DFC_DsmTest4" 931 "DFC_BSWM_E_ACTION_FAILED" 932 "DFC_BSWM_E_INTRPTQUEUE_FULL" 933 "DFC_CANSM_E_BUS_OFF_NETWORK_0" 934 "DFC_CANSM_E_BUS_OFF_NETWORK_1" 935 "DFC_CANSM_E_BUS_OFF_NETWORK_2" 936 "DFC_CANSM_E_BUS_OFF_NETWORK_3" 937 "DFC_FRSM_E_CLUSTER_STARTUP" 938 "DFC_FRTRCV_E_NO_TRCV_CONTROL_0" 939 "DFC_FR_E_ACCESS" 940 "DFC_RBA_IOEXTLIB_KEEPALIVE_DRV" 941 "DFC_RBA_IOEXTLIB_KEEPALIVE_INI" 942 "DFC_rba_MultiStackTrace_Threshold" 943 "DFC_CAN_E_TIMEOUT" 944 "DFC_FRSM_E_CLUSTER_SYNC_LOSS" 945 "DFC_PDUR_E_INIT_FAILED" 946 "DFC_PDUR_E_PDU_INSTANCE_LOST" 947 "DFC_rba_IoSigRtc_StopCounter" 948 "DFC_rba_T15_Diag_ComInVld_Event" 949 "DFC_rba_T15_Diag_ComOff_HwOn_Event" 950 "DFC_rba_T15_Diag_ComOn_HwOff_Event" 951 "DFC_DSMDummy" 952 "DFC_DsmTest3";
VAL_ 2041 DFES_numDFC_03_ 0 "DFC_Unused" 1 "DFC_DsmTest2" 2 "DFC_Can0Getriebe_01" 3 "DFC_Can0Motor_01_CHK" 4 "DFC_Can0Motor_01_CNT" 5 "DFC_Can0Motor_01_DLC" 6 "DFC_Can0Motor_02_CHK" 7 "DFC_Can0Motor_02_CNT" 8 "DFC_Can0Motor_02_DLC" 9 "DFC_Can0Motor_03_CHK" 10 "DFC_Can0Motor_03_CNT" 11 "DFC_Can0Motor_03_DLC" 12 "DFC_Can1BYPASS_TDG1_11_DLC" 13 "DFC_Can1BYPASS_TDG1_12_DLC" 14 "DFC_Can1BYPASS_TDG1_13_DLC" 15 "DFC_Can1BYPASS_TDG1_14_DLC" 16 "DFC_Can1BYPASS_TDG1_15_DLC" 17 "DFC_Can1BYPASS_TDG1_16_PlaceHolder_DLC" 18 "DFC_Can1BYPASS_TDG1_17_PlaceHolder_DLC" 19 "DFC_Can1BYPASS_TDG1_18_PlaceHolder_DLC" 20 "DFC_Can1BYPASS_TDG1_19_Placeholder_DLC" 21 "DFC_Can1BYPASS_TDG1_20_Placeholder_DLC" 22 "DFC_Can1BYPASS_TDG1_21_DLC" 23 "DFC_Can1BYPASS_TDG1_22_DLC" 24 "DFC_Can1BYPASS_TDG1_AA" 25 "DFC_Can1BYPASS_TDG1_AB" 26 "DFC_Can1BYPASS_TDG1_AC" 27 "DFC_Can1BYPASS_TDG1_AD" 28 "DFC_Can1BYPASS_TDG1_AE" 29 "DFC_Can1BYPASS_TDG1_AF" 30 "DFC_Can1BYPASS_TDG1_BA" 31 "DFC_Can1BYPASS_TDG1_BB" 32 "DFC_Can1BYPASS_TDG1_BC" 33 "DFC_Can1BYPASS_TDG1_BD" 34 "DFC_Can1BYPASS_TDG1_BE_PlaceHolder" 35 "DFC_Can1BYPASS_TDG1_BF_PlaceHolder" 36 "DFC_Can1BYPASS_TDG1_CA_PlaceHolder" 37 "DFC_Can1BYPASS_TDG1_CB_PlaceHolder" 38 "DFC_Can1BYPASS_TDG1_CC_PlaceHolder" 39 "DFC_Can1Cool_Act_Cmd" 40 "DFC_Can1Cool_Act_Sts_DLC" 41 "DFC_DsmTest1" 42 "DFC_FrAACC_06ISigGroup_ACC_06_CHK" 43 "DFC_FrAACC_06ISigGroup_ACC_06_CNT" 44 "DFC_FrAACC_07ISigGroup_ACC_07_CHK" 45 "DFC_FrAACC_07ISigGroup_ACC_07_CNT" 46 "DFC_FrAAirbag_01ISigGroup_Airbag_01_CHK" 47 "DFC_FrAAirbag_01ISigGroup_Airbag_01_CNT" 48 "DFC_FrAAirbag_02ISigGroup_Airbag_02_CHK" 49 "DFC_FrAAirbag_02ISigGroup_Airbag_02_CNT" 50 "DFC_FrABremse_EV_01ISigGroup_Bremse_EV_01_CHK" 51 "DFC_FrABremse_EV_01ISigGroup_Bremse_EV_01_CNT" 52 "DFC_FrABremse_EV_02ISigGroup_Bremse_EV_02_CHK" 53 "DFC_FrABremse_EV_02ISigGroup_Bremse_EV_02_CNT" 54 "DFC_FrAEBKV_01ISigGroup_EBKV_01_CHK" 55 "DFC_FrAEBKV_01ISigGroup_EBKV_01_CNT" 56 "DFC_FrAEM1_HYB_12ISigGroup_EM1_HYB_12_CHK" 57 "DFC_FrAEM1_HYB_12ISigGroup_EM1_HYB_12_CNT" 58 "DFC_FrAEPB_01ISigGroup_EPB_01_CHK" 59 "DFC_FrAEPB_01ISigGroup_EPB_01_CNT" 60 "DFC_FrAESP_03ISigGroup_ESP_03_CHK" 61 "DFC_FrAESP_03ISigGroup_ESP_03_CNT" 62 "DFC_FrAESP_05ISigGroup_ESP_05_CHK" 63 "DFC_FrAESP_05ISigGroup_ESP_05_CNT" 64 "DFC_FrAESP_07ISigGroup_ESP_07_CHK" 65 "DFC_FrAESP_07ISigGroup_ESP_07_CNT" 66 "DFC_FrAESP_08ISigGroup_ESP_08_CHK" 67 "DFC_FrAESP_08ISigGroup_ESP_08_CNT" 68 "DFC_FrAESP_15ISigGroup_ESP_15_CHK" 69 "DFC_FrAESP_15ISigGroup_ESP_15_CNT" 70 "DFC_FrAESP_20ISigGroup_ESP_20_CHK" 71 "DFC_FrAESP_20ISigGroup_ESP_20_CNT" 72 "DFC_FrAESP_21ISigGroup_ESP_21_CHK" 73 "DFC_FrAESP_21ISigGroup_ESP_21_CNT" 74 "DFC_FrAESP_22ISigGroup_ESP_22_CHK" 75 "DFC_FrAESP_22ISigGroup_ESP_22_CNT" 76 "DFC_FrAESP_23ISigGroup_ESP_23_CHK" 77 "DFC_FrAESP_23ISigGroup_ESP_23_CNT" 78 "DFC_FrAESP_24ISigGroup_ESP_24_CHK" 79 "DFC_FrAESP_24ISigGroup_ESP_24_CNT" 80 "DFC_FrAESP_28ISigGroup_ESP_28_CHK" 81 "DFC_FrAESP_28ISigGroup_ESP_28_CNT" 82 "DFC_FrAESP_31ISigGroup_ESP_31_CHK" 83 "DFC_FrAESP_31ISigGroup_ESP_31_CNT" 84 "DFC_FrAESP_32ISigGroup_ESP_32_CHK" 85 "DFC_FrAESP_32ISigGroup_ESP_32_CNT" 86 "DFC_FrAESP_33ISigGroup_ESP_33_CHK" 87 "DFC_FrAESP_33ISigGroup_ESP_33_CNT" 88 "DFC_FrAESP_41ISigGroup_ESP_41_CHK" 89 "DFC_FrAESP_41ISigGroup_ESP_41_CNT" 90 "DFC_FrAESP_44ISigGroup_ESP_44_CHK" 91 "DFC_FrAESP_44ISigGroup_ESP_44_CNT" 92 "DFC_FrAGetriebe_11" 93 "DFC_FrAGetriebe_12" 94 "DFC_FrAGetriebe_13" 95 "DFC_FrAGetriebe_14" 96 "DFC_FrAGetriebe_15" 97 "DFC_FrAGetriebe_16" 98 "DFC_FrAGetriebe_17" 99 "DFC_FrAGetriebe_18" 100 "DFC_FrAGetriebe_HYB_12" 101 "DFC_FrAKN_Getriebe" 102 "DFC_FrAKlemmen_Status_01ISigGroup_Klemmen_Status_01_CHK" 103 "DFC_FrAKlemmen_Status_01ISigGroup_Klemmen_Status_01_CNT" 104 "DFC_FrALCV_01ISigGroup_LCV_01_CHK" 105 "DFC_FrALCV_01ISigGroup_LCV_01_CNT" 106 "DFC_FrALWI_01ISigGroup_LWI_01_CHK" 107 "DFC_FrALWI_01ISigGroup_LWI_01_CNT" 108 "DFC_FrAMotor_11ISigGroup_Motor_11_CHK" 109 "DFC_FrAMotor_11ISigGroup_Motor_11_CNT" 110 "DFC_FrAMotor_12ISigGroup_Motor_12_CHK" 111 "DFC_FrAMotor_12ISigGroup_Motor_12_CNT" 112 "DFC_FrAMotor_14ISigGroup_Motor_14_CHK" 113 "DFC_FrAMotor_14ISigGroup_Motor_14_CNT" 114 "DFC_FrAMotor_20ISigGroup_Motor_20_CHK" 115 "DFC_FrAMotor_20ISigGroup_Motor_20_CNT" 116 "DFC_FrAMotor_27ISigGroup_Motor_27_CHK" 117 "DFC_FrAMotor_27ISigGroup_Motor_27_CNT" 118 "DFC_FrAMotor_28ISigGroup_Motor_28_CHK" 119 "DFC_FrAMotor_28ISigGroup_Motor_28_CNT" 120 "DFC_FrAMotor_Code_01ISigGroup_Motor_Code_01_CHK" 121 "DFC_FrAMotor_Code_01ISigGroup_Motor_Code_01_CNT" 122 "DFC_FrAMotor_TS_01ISigGroup_Motor_TS_01_CHK" 123 "DFC_FrAMotor_TS_01ISigGroup_Motor_TS_01_CNT" 124 "DFC_FrAMotor_TS_02ISigGroup_Motor_TS_02_CHK" 125 "DFC_FrAMotor_TS_02ISigGroup_Motor_TS_02_CNT" 126 "DFC_FrAMotor_TS_03ISigGroup_Motor_TS_03_CHK" 127 "DFC_FrAMotor_TS_03ISigGroup_Motor_TS_03_CNT" 128 "DFC_FrASARA_06ISigGroup_SARA_06_CHK" 129 "DFC_FrASARA_06ISigGroup_SARA_06_CNT" 130 "DFC_FrATSG_FT_02ISigGroup_TSG_FT_02_CHK" 131 "DFC_FrATSG_FT_02ISigGroup_TSG_FT_02_CNT" 132 "DFC_FrATSK_06ISigGroup_TSK_06_CHK" 133 "DFC_FrATSK_06ISigGroup_TSK_06_CNT" 134 "DFC_FrATSK_08ISigGroup_TSK_08_CHK" 135 "DFC_FrATSK_08ISigGroup_TSK_08_CNT" 136 "DFC_FrAWBA_03" 137 "DFC_AdcBkg" 138 "DFC_Adc_Rdnt_0" 139 "DFC_Adc_Rdnt_1" 140 "DFC_Adc_Rdnt_2" 141 "DFC_Adc_Rdnt_3" 142 "DFC_Adc_Rdnt_4" 143 "DFC_Adc_Rdnt_5" 144 "DFC_Adc_Rdnt_6" 145 "DFC_Adc_Rdnt_7" 146 "DFC_Adc_Rdnt_8" 147 "DFC_Adc_Rdnt_9" 148 "DFC_Adc_SB_0" 149 "DFC_Adc_SB_1" 150 "DFC_Adc_SB_2" 151 "DFC_Adc_SB_3" 152 "DFC_Adc_SB_4" 153 "DFC_Adc_SB_5" 154 "DFC_Adc_SB_6" 155 "DFC_Adc_SB_7" 156 "DFC_Adc_SB_8" 157 "DFC_Adc_SB_9" 158 "DFC_Adc_SG_0" 159 "DFC_Adc_SG_1" 160 "DFC_Adc_SG_2" 161 "DFC_Adc_SG_3" 162 "DFC_Adc_SG_4" 163 "DFC_Adc_SG_5" 164 "DFC_Adc_SG_6" 165 "DFC_Adc_SG_7" 166 "DFC_Adc_SG_8" 167 "DFC_Adc_SG_9" 168 "DFC_Adc_Unit" 169 "DFC_BattSply_UHi" 170 "DFC_BattSply_ULo" 171 "DFC_CpuTemp" 172 "DFC_CrntCtrl_Channel_0" 173 "DFC_CrntCtrl_Channel_1" 174 "DFC_CrntCtrl_Channel_2" 175 "DFC_CrntCtrl_Channel_3" 176 "DFC_CrntCtrl_Channel_4" 177 "DFC_CrntCtrl_Channel_5" 178 "DFC_CrntCtrl_Channel_6" 179 "DFC_CrntCtrl_Channel_7" 180 "DFC_CrntCtrl_Channel_8" 181 "DFC_CrntCtrl_Channel_9" 182 "DFC_CrntCtrl_Channel_10" 183 "DFC_CrntCtrl_Channel_11" 184 "DFC_CrntCtrl_Channel_12" 185 "DFC_CrntCtrl_Channel_13" 186 "DFC_CrntCtrl_Channel_14" 187 "DFC_CrntCtrl_Channel_15" 188 "DFC_CrntCtrl_Channel_16" 189 "DFC_CrntCtrl_Channel_17" 190 "DFC_CrntCtrl_Channel_18" 191 "DFC_CrntCtrl_Channel_19" 192 "DFC_CrntCtrl_CrntMon_0" 193 "DFC_CrntCtrl_CrntMon_1" 194 "DFC_CrntCtrl_CrntMon_2" 195 "DFC_CrntCtrl_CrntMon_3" 196 "DFC_CrntCtrl_CrntMon_4" 197 "DFC_CrntCtrl_CrntMon_5" 198 "DFC_CrntCtrl_CrntMon_6" 199 "DFC_CrntCtrl_CrntMon_7" 200 "DFC_CrntCtrl_CrntMon_8" 201 "DFC_CrntCtrl_CrntMon_9" 202 "DFC_CrntCtrl_CrntMon_10" 203 "DFC_CrntCtrl_CrntMon_11" 204 "DFC_CrntCtrl_CrntMon_12" 205 "DFC_CrntCtrl_CrntMon_13" 206 "DFC_CrntCtrl_CrntMon_14" 207 "DFC_CrntCtrl_CrntMon_15" 208 "DFC_CrntCtrl_CrntMon_16" 209 "DFC_CrntCtrl_CrntMon_17" 210 "DFC_CrntCtrl_CrntMon_18" 211 "DFC_CrntCtrl_CrntMon_19" 212 "DFC_CrntCtrl_OP_0" 213 "DFC_CrntCtrl_OP_1" 214 "DFC_CrntCtrl_OP_2" 215 "DFC_CrntCtrl_OP_3" 216 "DFC_CrntCtrl_OP_4" 217 "DFC_CrntCtrl_OP_5" 218 "DFC_CrntCtrl_OP_6" 219 "DFC_CrntCtrl_OP_7" 220 "DFC_CrntCtrl_OP_8" 221 "DFC_CrntCtrl_OP_9" 222 "DFC_CrntCtrl_OP_10" 223 "DFC_CrntCtrl_OP_11" 224 "DFC_CrntCtrl_OP_12" 225 "DFC_CrntCtrl_OP_13" 226 "DFC_CrntCtrl_OP_14" 227 "DFC_CrntCtrl_OP_15" 228 "DFC_CrntCtrl_OP_16" 229 "DFC_CrntCtrl_OP_17" 230 "DFC_CrntCtrl_OP_18" 231 "DFC_CrntCtrl_OP_19" 232 "DFC_CrntCtrl_SB_0" 233 "DFC_CrntCtrl_SB_1" 234 "DFC_CrntCtrl_SB_2" 235 "DFC_CrntCtrl_SB_3" 236 "DFC_CrntCtrl_SB_4" 237 "DFC_CrntCtrl_SB_5" 238 "DFC_CrntCtrl_SB_6" 239 "DFC_CrntCtrl_SB_7" 240 "DFC_CrntCtrl_SB_8" 241 "DFC_CrntCtrl_SB_9" 242 "DFC_CrntCtrl_SB_10" 243 "DFC_CrntCtrl_SB_11" 244 "DFC_CrntCtrl_SB_12" 245 "DFC_CrntCtrl_SB_13" 246 "DFC_CrntCtrl_SB_14" 247 "DFC_CrntCtrl_SB_15" 248 "DFC_CrntCtrl_SB_16" 249 "DFC_CrntCtrl_SB_17" 250 "DFC_CrntCtrl_SB_18" 251 "DFC_CrntCtrl_SB_19" 252 "DFC_CrntCtrl_SG_0" 253 "DFC_CrntCtrl_SG_1" 254 "DFC_CrntCtrl_SG_2" 255 "DFC_CrntCtrl_SG_3" 256 "DFC_CrntCtrl_SG_4" 257 "DFC_CrntCtrl_SG_5" 258 "DFC_CrntCtrl_SG_6" 259 "DFC_CrntCtrl_SG_7" 260 "DFC_CrntCtrl_SG_8" 261 "DFC_CrntCtrl_SG_9" 262 "DFC_CrntCtrl_SG_10" 263 "DFC_CrntCtrl_SG_11" 264 "DFC_CrntCtrl_SG_12" 265 "DFC_CrntCtrl_SG_13" 266 "DFC_CrntCtrl_SG_14" 267 "DFC_CrntCtrl_SG_15" 268 "DFC_CrntCtrl_SG_16" 269 "DFC_CrntCtrl_SG_17" 270 "DFC_CrntCtrl_SG_18" 271 "DFC_CrntCtrl_SG_19" 272 "DFC_CrntCtrl_Unit_0" 273 "DFC_CrntCtrl_Unit_1" 274 "DFC_CtrlMot_DNR_0" 275 "DFC_CtrlMot_DNR_1" 276 "DFC_CtrlMot_OC_0" 277 "DFC_CtrlMot_OC_1" 278 "DFC_CtrlMot_OL_0" 279 "DFC_CtrlMot_OL_1" 280 "DFC_CtrlMot_SB_0" 281 "DFC_CtrlMot_SB_1" 282 "DFC_CtrlMot_SG_0" 283 "DFC_CtrlMot_SG_1" 284 "DFC_Flx_AdcInUnit_0" 285 "DFC_Flx_AdcInUnit_1" 286 "DFC_Flx_AdcInUnit_2" 287 "DFC_Flx_RMeasUnit_0" 288 "DFC_Flx_RMeasUnit_1" 289 "DFC_Flx_SB_0" 290 "DFC_Flx_SB_1" 291 "DFC_Flx_SB_2" 292 "DFC_Flx_SB_3" 293 "DFC_Flx_SB_4" 294 "DFC_Flx_SB_5" 295 "DFC_Flx_SB_6" 296 "DFC_Flx_SB_7" 297 "DFC_Flx_SB_8" 298 "DFC_Flx_SB_9" 299 "DFC_Flx_SB_10" 300 "DFC_Flx_SB_11" 301 "DFC_Flx_SB_12" 302 "DFC_Flx_SB_13" 303 "DFC_Flx_SB_14" 304 "DFC_Flx_SB_15" 305 "DFC_Flx_SB_16" 306 "DFC_Flx_SB_17" 307 "DFC_Flx_SB_18" 308 "DFC_Flx_SB_19" 309 "DFC_Flx_SB_20" 310 "DFC_Flx_SB_21" 311 "DFC_Flx_SB_22" 312 "DFC_Flx_SB_23" 313 "DFC_Flx_SB_24" 314 "DFC_Flx_SB_25" 315 "DFC_Flx_SB_26" 316 "DFC_Flx_SG_0" 317 "DFC_Flx_SG_1" 318 "DFC_Flx_SG_2" 319 "DFC_Flx_SG_3" 320 "DFC_Flx_SG_4" 321 "DFC_Flx_SG_5" 322 "DFC_Flx_SG_6" 323 "DFC_Flx_SG_7" 324 "DFC_Flx_SG_8" 325 "DFC_Flx_SG_9" 326 "DFC_Flx_SG_10" 327 "DFC_Flx_SG_11" 328 "DFC_Flx_SG_12" 329 "DFC_Flx_SG_13" 330 "DFC_Flx_SG_14" 331 "DFC_Flx_SG_15" 332 "DFC_Flx_SG_16" 333 "DFC_Flx_SG_17" 334 "DFC_Flx_SG_18" 335 "DFC_Flx_SG_19" 336 "DFC_Flx_SG_20" 337 "DFC_Flx_SG_21" 338 "DFC_Flx_SG_22" 339 "DFC_Flx_SG_23" 340 "DFC_Flx_SG_24" 341 "DFC_Flx_SG_25" 342 "DFC_Flx_SG_26" 343 "DFC_Flx_Sig_0" 344 "DFC_Flx_Sig_1" 345 "DFC_Flx_Sig_2" 346 "DFC_Flx_Sig_3" 347 "DFC_Flx_Sig_4" 348 "DFC_Flx_Sig_5" 349 "DFC_Flx_Sig_6" 350 "DFC_Flx_Sig_7" 351 "DFC_Flx_Sig_8" 352 "DFC_Flx_Sig_9" 353 "DFC_Flx_Sig_10" 354 "DFC_Flx_Sig_11" 355 "DFC_Flx_Sig_12" 356 "DFC_Flx_Sig_13" 357 "DFC_Flx_Sig_14" 358 "DFC_Flx_Sig_15" 359 "DFC_Flx_Sig_16" 360 "DFC_Flx_Sig_17" 361 "DFC_Flx_Sig_18" 362 "DFC_Flx_Sig_19" 363 "DFC_Flx_Sig_20" 364 "DFC_Flx_Sig_21" 365 "DFC_Flx_Sig_22" 366 "DFC_Flx_Sig_23" 367 "DFC_Flx_Sig_24" 368 "DFC_Flx_Sig_25" 369 "DFC_Flx_Sig_26" 370 "DFC_Gtm_Clk" 371 "DFC_HiSide_OP_0" 372 "DFC_HiSide_OP_1" 373 "DFC_HiSide_OP_2" 374 "DFC_HiSide_OP_3" 375 "DFC_HiSide_OP_4" 376 "DFC_HiSide_OP_5" 377 "DFC_HiSide_SB_0" 378 "DFC_HiSide_SB_1" 379 "DFC_HiSide_SB_2" 380 "DFC_HiSide_SB_3" 381 "DFC_HiSide_SB_4" 382 "DFC_HiSide_SB_5" 383 "DFC_HiSide_SG_0" 384 "DFC_HiSide_SG_1" 385 "DFC_HiSide_SG_2" 386 "DFC_HiSide_SG_3" 387 "DFC_HiSide_SG_4" 388 "DFC_HiSide_SG_5" 389 "DFC_IntSply_0" 390 "DFC_IntSply_1" 391 "DFC_IntSply_2" 392 "DFC_IntSply_3" 393 "DFC_IntSply_4" 394 "DFC_IntSply_5" 395 "DFC_IntTemp" 396 "DFC_LssRly_OL" 397 "DFC_LssRly_SB" 398 "DFC_LssRly_SG" 399 "DFC_Lss_OL_0" 400 "DFC_Lss_OL_1" 401 "DFC_Lss_OL_2" 402 "DFC_Lss_OL_3" 403 "DFC_Lss_OL_4" 404 "DFC_Lss_OL_5" 405 "DFC_Lss_OL_6" 406 "DFC_Lss_OL_7" 407 "DFC_Lss_OL_8" 408 "DFC_Lss_OL_9" 409 "DFC_Lss_OL_10" 410 "DFC_Lss_OL_11" 411 "DFC_Lss_SB_0" 412 "DFC_Lss_SB_1" 413 "DFC_Lss_SB_2" 414 "DFC_Lss_SB_3" 415 "DFC_Lss_SB_4" 416 "DFC_Lss_SB_5" 417 "DFC_Lss_SB_6" 418 "DFC_Lss_SB_7" 419 "DFC_Lss_SB_8" 420 "DFC_Lss_SB_9" 421 "DFC_Lss_SB_10" 422 "DFC_Lss_SB_11" 423 "DFC_Lss_SG_0" 424 "DFC_Lss_SG_1" 425 "DFC_Lss_SG_2" 426 "DFC_Lss_SG_3" 427 "DFC_Lss_SG_4" 428 "DFC_Lss_SG_5" 429 "DFC_Lss_SG_6" 430 "DFC_Lss_SG_7" 431 "DFC_Lss_SG_8" 432 "DFC_Lss_SG_9" 433 "DFC_Lss_SG_10" 434 "DFC_Lss_SG_11" 435 "DFC_Lss_Unit" 436 "DFC_OsTmrMon" 437 "DFC_PwmIn_GtmTim_0" 438 "DFC_PwmIn_GtmTim_1" 439 "DFC_PwmIn_GtmTim_2" 440 "DFC_PwmIn_GtmTim_3" 441 "DFC_PwmIn_GtmTim_4" 442 "DFC_PwmIn_GtmTim_5" 443 "DFC_PwmIn_GtmTim_6" 444 "DFC_PwmIn_GtmTim_7" 445 "DFC_PwmIn_GtmTim_8" 446 "DFC_PwmIn_GtmTim_9" 447 "DFC_PwmIn_GtmTim_10" 448 "DFC_PwmIn_GtmTim_11" 449 "DFC_PwmIn_SB_0" 450 "DFC_PwmIn_SB_1" 451 "DFC_PwmIn_SB_2" 452 "DFC_PwmIn_SB_3" 453 "DFC_PwmIn_SB_4" 454 "DFC_PwmIn_SB_5" 455 "DFC_PwmIn_SB_6" 456 "DFC_PwmIn_SB_7" 457 "DFC_PwmIn_SB_8" 458 "DFC_PwmIn_SB_9" 459 "DFC_PwmIn_SB_10" 460 "DFC_PwmIn_SB_11" 461 "DFC_PwmIn_SG_0" 462 "DFC_PwmIn_SG_1" 463 "DFC_PwmIn_SG_2" 464 "DFC_PwmIn_SG_3" 465 "DFC_PwmIn_SG_4" 466 "DFC_PwmIn_SG_5" 467 "DFC_PwmIn_SG_6" 468 "DFC_PwmIn_SG_7" 469 "DFC_PwmIn_SG_8" 470 "DFC_PwmIn_SG_9" 471 "DFC_PwmIn_SG_10" 472 "DFC_PwmIn_SG_11" 473 "DFC_PwmIn_Sig_0" 474 "DFC_PwmIn_Sig_1" 475 "DFC_PwmIn_Sig_2" 476 "DFC_PwmIn_Sig_3" 477 "DFC_PwmIn_Sig_4" 478 "DFC_PwmIn_Sig_5" 479 "DFC_PwmIn_Sig_6" 480 "DFC_PwmIn_Sig_7" 481 "DFC_PwmIn_Sig_8" 482 "DFC_PwmIn_Sig_9" 483 "DFC_PwmIn_Sig_10" 484 "DFC_PwmIn_Sig_11" 485 "DFC_SafeSt_flgDn" 486 "DFC_SnsrSply_SB_0" 487 "DFC_SnsrSply_SB_1" 488 "DFC_SnsrSply_SB_2" 489 "DFC_SnsrSply_SB_3" 490 "DFC_SnsrSply_SB_4" 491 "DFC_SnsrSply_SB_5" 492 "DFC_SnsrSply_SG_0" 493 "DFC_SnsrSply_SG_1" 494 "DFC_SnsrSply_SG_2" 495 "DFC_SnsrSply_SG_3" 496 "DFC_SnsrSply_SG_4" 497 "DFC_SnsrSply_SG_5" 498 "DFC_Spd_NdPls_0" 499 "DFC_Spd_NdPls_1" 500 "DFC_Spd_NdPls_2" 501 "DFC_Spd_NdPls_3" 502 "DFC_Spd_NdPls_4" 503 "DFC_Spd_OP_0" 504 "DFC_Spd_OP_1" 505 "DFC_Spd_OP_2" 506 "DFC_Spd_OP_3" 507 "DFC_Spd_OP_4" 508 "DFC_Spd_Pls_0" 509 "DFC_Spd_Pls_1" 510 "DFC_Spd_Pls_2" 511 "DFC_Spd_Pls_3" 512 "DFC_Spd_Pls_4" 513 "DFC_Spd_SB_0" 514 "DFC_Spd_SB_1" 515 "DFC_Spd_SB_2" 516 "DFC_Spd_SB_3" 517 "DFC_Spd_SB_4" 518 "DFC_Spd_SG_0" 519 "DFC_Spd_SG_1" 520 "DFC_Spd_SG_2" 521 "DFC_Spd_SG_3" 522 "DFC_Spd_SG_4" 523 "DFC_Spd_Sig_0" 524 "DFC_Spd_Sig_1" 525 "DFC_Spd_Sig_2" 526 "DFC_Spd_Sig_3" 527 "DFC_Spd_Sig_4" 528 "DFC_Spd_Sync_0" 529 "DFC_Spd_Sync_1" 530 "DFC_Spd_Sync_2" 531 "DFC_Spd_Sync_3" 532 "DFC_Spd_Sync_4" 533 "DFC_WdgSys" 534 "DFC_WdgWd" 535 "DFC_AcceleratorPedalErrorRx" 536 "DFC_AccumulatorChargeFault" 537 "DFC_AltitudeErrorRx" 538 "DFC_BLDCPumpDerateRx" 539 "DFC_BLDCPumpErrorRx" 540 "DFC_BrakePressureErrorRx" 541 "DFC_BrakeSwitchErrorRx" 542 "DFC_BrakeSwitchImplausible1" 543 "DFC_BrakeSwitchImplausible2" 544 "DFC_BrakeSwitchRateHigh" 545 "DFC_BrakeSwitchSpare1" 546 "DFC_BrakeSwitchSpare2" 547 "DFC_ChargeValveStuck" 548 "DFC_Clutch1AdaptationFault" 549 "DFC_Clutch1OverPressure" 550 "DFC_Clutch1UnderPressure" 551 "DFC_Clutch2AdaptationFault" 552 "DFC_Clutch2OverPressure" 553 "DFC_Clutch2UnderPressure" 554 "DFC_ClutchCoolingValveFault" 555 "DFC_ClutchCoolingValveStuck" 556 "DFC_ClutchOverTempoerature" 557 "DFC_ClutchShutOffValveFault" 558 "DFC_CoolantTempErrorRx" 559 "DFC_CoolingPressureImplausible" 560 "DFC_CoolingPressureRateHigh" 561 "DFC_CoolingPressureTooHigh" 562 "DFC_CoolingPressureTooLow" 563 "DFC_CrntCtrl_Reg_1" 564 "DFC_CrntCtrl_Reg_10" 565 "DFC_CrntCtrl_Reg_11" 566 "DFC_CrntCtrl_Reg_12" 567 "DFC_CrntCtrl_Reg_16" 568 "DFC_CrntCtrl_Reg_17" 569 "DFC_CrntCtrl_Reg_18" 570 "DFC_CrntCtrl_Reg_19" 571 "DFC_CrntCtrl_Reg_2" 572 "DFC_CrntCtrl_Reg_3" 573 "DFC_CrntCtrl_Reg_6" 574 "DFC_CrntCtrl_Reg_7" 575 "DFC_CrntCtrl_Reg_9" 576 "DFC_DSTSpare1" 577 "DFC_DSTSpare2" 578 "DFC_DWCSpare1" 579 "DFC_DWCSpare2" 580 "DFC_DWCSpare3" 581 "DFC_DWCSpare4" 582 "DFC_DWCSpare5" 583 "DFC_DWCSpare6" 584 "DFC_DWCSpare7" 585 "DFC_DoorStatusErrorRx" 586 "DFC_DownSwImplausible" 587 "DFC_DownSwRateHigh" 588 "DFC_DownSwSpare1" 589 "DFC_DownSwSpare2" 590 "DFC_EM1SpeedErrorRx" 591 "DFC_ENGDriveTorqueImplausible" 592 "DFC_ENGEngineProblem" 593 "DFC_ENGIdiotStart" 594 "DFC_ENGSpare1" 595 "DFC_ENGSpare2" 596 "DFC_ESPStatusErrorRx" 597 "DFC_EngineOilTempErrorRx" 598 "DFC_EngineSpeedErrorRx" 599 "DFC_EngineSpeedPWMImplausible1" 600 "DFC_EngineSpeedPWMImplausible2" 601 "DFC_EngineSpeedPWMRateHigh" 602 "DFC_EngineSpeedPWMSpare1" 603 "DFC_EngineSpeedPWMSpare2" 604 "DFC_EngineTorqueErrorRx" 605 "DFC_ExternalTempErrorRx" 606 "DFC_FailStuckNFault" 607 "DFC_FrontLeftWheelSpeedErrorRx" 608 "DFC_FrontRightWheelSpeedErrorRx" 609 "DFC_GearCoolingValveStuck" 610 "DFC_K1PressureImplausible" 611 "DFC_K1PressureRateHigh" 612 "DFC_K1PressureSpare1" 613 "DFC_K1PressureSpare2" 614 "DFC_K1SpeedHigh" 615 "DFC_K1SpeedImplausible" 616 "DFC_K1SpeedSpare1" 617 "DFC_K1SpeedSpare2" 618 "DFC_K2PressureImplausible" 619 "DFC_K2PressureRateHigh" 620 "DFC_K2PressureSpare1" 621 "DFC_K2PressureSpare2" 622 "DFC_K2SpeedHigh" 623 "DFC_K2SpeedImplausible" 624 "DFC_K2SpeedSpare1" 625 "DFC_K2SpeedSpare2" 626 "DFC_L2ClutchPressureVsCurrentOdd" 627 "DFC_L2ClutchTorqueDirection" 628 "DFC_L2DoubleClutchEngagement" 629 "DFC_L2DoubleGearEven" 630 "DFC_L2EM1ShaftOverspeed" 631 "DFC_L2EPBWhenMoving" 632 "DFC_L2EvenClutchGradientInCreep" 633 "DFC_L2ForwardDriveEven" 634 "DFC_L2ForwardDriveOdd" 635 "DFC_L2ForwardGearAndMode" 636 "DFC_L2GearCombinationEM1Overspeed" 637 "DFC_L2GearCombinationRequest" 638 "DFC_L2InputShaftEngineOverspeed" 639 "DFC_L2InsufficientLubrication" 640 "DFC_L2InvalidDownshiftOdd" 641 "DFC_L2InvalidGearControl" 642 "DFC_L2LeaveNeutral" 643 "DFC_L2LeavePark" 644 "DFC_L2ModeDisplay" 645 "DFC_L2ModeSelection" 646 "DFC_L2MovementWithChargeCable" 647 "DFC_L2OddClutchGradientInCreep" 648 "DFC_L2OddShaftAccelerationImplausible" 649 "DFC_L2ParkFailNoEPB" 650 "DFC_L2ParkPosition" 651 "DFC_L2ParkValveOverride" 652 "DFC_L2ParkWhenMoving" 653 "DFC_L2ReferenceSpeedFail" 654 "DFC_L2ReverseDrive" 655 "DFC_L2ShaftOverSpeedFromIP" 656 "DFC_L2ShaftOverSpeedFromOP" 657 "DFC_L2Spare1" 658 "DFC_L2Spare2" 659 "DFC_L2TorqueNoShift" 660 "DFC_L2TorqueRequestCupOfFuel" 661 "DFC_L2VGPOverride" 662 "DFC_L2VKUGLOveride" 663 "DFC_L2VSS1Overirde" 664 "DFC_L2VSS2Overirde" 665 "DFC_LatAccErrorRx" 666 "DFC_LinePressureImplausible" 667 "DFC_LinePressureLeakageHigh" 668 "DFC_LinePressureRateHigh" 669 "DFC_LinePressureSpare1" 670 "DFC_LinePressureSpare2" 671 "DFC_LinePressureTooHigh" 672 "DFC_LinePressureTooLow" 673 "DFC_LongAccErrorRx" 674 "DFC_LubeOilOverTemperature" 675 "DFC_LubeTemperatureImplausible" 676 "DFC_LubeTemperatureRateHigh" 677 "DFC_LubeTemperatureSpare1" 678 "DFC_LubeTemperatureSpare2" 679 "DFC_MOTEngineProblem" 680 "DFC_MOTSpare1" 681 "DFC_MOTSpare2" 682 "DFC_ModeMSwImplausible" 683 "DFC_ModeMSwSpare1" 684 "DFC_ModeMSwSpare2" 685 "DFC_ModeMSwSwRateHigh" 686 "DFC_ModePSwImplausible" 687 "DFC_ModePSwSpare1" 688 "DFC_ModePSwSpare2" 689 "DFC_ModePSwSwRateHigh" 690 "DFC_ModeRSwImplausible" 691 "DFC_ModeRSwSpare1" 692 "DFC_ModeRSwSpare2" 693 "DFC_ModeRSwSwRateHigh" 694 "DFC_ParkLockDisengageFail" 695 "DFC_ParkLockEngageFail" 696 "DFC_ParkLockPosImplausible" 697 "DFC_ParkLockPosRateHigh" 698 "DFC_ParkLockPosSpare1" 699 "DFC_ParkLockPosSpare2" 700 "DFC_PumpResponseFault" 701 "DFC_PumpSpeedError" 702 "DFC_RearLeftWheelSpeedErrorRx" 703 "DFC_RearRightWheelSpeedErrorRx" 704 "DFC_RedSpeedHigh" 705 "DFC_RedSpeedImplausible" 706 "DFC_RedSpeedSpare1" 707 "DFC_RedSpeedSpare2" 708 "DFC_SEQSpare1" 709 "DFC_SEQSpare2" 710 "DFC_SEQTimeout" 711 "DFC_Spare_0" 712 "DFC_Spare_1" 713 "DFC_Spare_2" 714 "DFC_Spare_3" 715 "DFC_Spare_4" 716 "DFC_Spare_5" 717 "DFC_Spare_6" 718 "DFC_Spare_7" 719 "DFC_Spare_8" 720 "DFC_Spare_9" 721 "DFC_SumpOilOverTemperature" 722 "DFC_SumpTemperatureImplausible" 723 "DFC_SumpTemperatureRateHigh" 724 "DFC_SumpTemperatureSpare1" 725 "DFC_SumpTemperatureSpare2" 726 "DFC_SynchroA1EngageFault" 727 "DFC_SynchroA1SpitoutInShiftFault" 728 "DFC_SynchroA1SpitoutNoShiftFault" 729 "DFC_SynchroA1StuckFault" 730 "DFC_SynchroA2EngageFault" 731 "DFC_SynchroA2SpitoutInShiftFault" 732 "DFC_SynchroA2SpitoutNoShiftFault" 733 "DFC_SynchroA2StuckFault" 734 "DFC_SynchroAOutOfNInShiftFault" 735 "DFC_SynchroAOutOfNNoShiftFault" 736 "DFC_SynchroAPosImplausible" 737 "DFC_SynchroAPosRateHigh" 738 "DFC_SynchroAPosSpare1" 739 "DFC_SynchroAPosSpare2" 740 "DFC_SynchroB1EngageFault" 741 "DFC_SynchroB1SpitoutInShiftFault" 742 "DFC_SynchroB1SpitoutNoShiftFault" 743 "DFC_SynchroB1StuckFault" 744 "DFC_SynchroB2EngageFault" 745 "DFC_SynchroB2SpitoutInShiftFault" 746 "DFC_SynchroB2SpitoutNoShiftFault" 747 "DFC_SynchroB2StuckFault" 748 "DFC_SynchroBOutOfNInShiftFault" 749 "DFC_SynchroBOutOfNNoShiftFault" 750 "DFC_SynchroBPosImplausible" 751 "DFC_SynchroBPosRateHigh" 752 "DFC_SynchroBPosSpare1" 753 "DFC_SynchroBPosSpare2" 754 "DFC_SynchroC1EngageFault" 755 "DFC_SynchroC1SpitoutInShiftFault" 756 "DFC_SynchroC1SpitoutNoShiftFault" 757 "DFC_SynchroC1StuckFault" 758 "DFC_SynchroC2EngageFault" 759 "DFC_SynchroC2SpitoutInShiftFault" 760 "DFC_SynchroC2SpitoutNoShiftFault" 761 "DFC_SynchroC2StuckFault" 762 "DFC_SynchroCOutOfNInShiftFault" 763 "DFC_SynchroCOutOfNNoShiftFault" 764 "DFC_SynchroCPosImplausible" 765 "DFC_SynchroCPosRateHigh" 766 "DFC_SynchroCPosSpare1" 767 "DFC_SynchroCPosSpare2" 768 "DFC_SynchroD1EngageFault" 769 "DFC_SynchroD1SpitoutInShiftFault" 770 "DFC_SynchroD1SpitoutNoShiftFault" 771 "DFC_SynchroD1StuckFault" 772 "DFC_SynchroDOutOfNInShiftFault" 773 "DFC_SynchroDOutOfNNoShiftFault" 774 "DFC_SynchroDPosImplausible" 775 "DFC_SynchroDPosRateHigh" 776 "DFC_SynchroDPosSpare1" 777 "DFC_SynchroDPosSpare2" 778 "DFC_SynchroF1EngageFault" 779 "DFC_SynchroF1SpitoutInShiftFault" 780 "DFC_SynchroF1SpitoutNoShiftFault" 781 "DFC_SynchroF1StuckFault" 782 "DFC_SynchroF2EngageFault" 783 "DFC_SynchroF2SpitoutInShiftFault" 784 "DFC_SynchroF2SpitoutNoShiftFault" 785 "DFC_SynchroF2StuckFault" 786 "DFC_SynchroFOutOfNInShiftFault" 787 "DFC_SynchroFOutOfNNoShiftFault" 788 "DFC_SynchroFPosImplausible" 789 "DFC_SynchroFPosRateHigh" 790 "DFC_SynchroFPosSpare1" 791 "DFC_SynchroFPosSpare2" 792 "DFC_UpSwImplausible" 793 "DFC_UpSwRateHigh" 794 "DFC_UpSwSpare1" 795 "DFC_UpSwSpare2" 796 "DFC_VehicleSpeedErrorRx" 797 "DFC_WheelTorqueESPErrorRx" 798 "DFC_YawRateErrorRx" 799 "DFC_Can0Motor_01_TO" 800 "DFC_Can0Motor_02_TO" 801 "DFC_Can0Motor_03_TO" 802 "DFC_Can1BYPASS_TDG1_11_TO" 803 "DFC_Can1BYPASS_TDG1_12_TO" 804 "DFC_Can1BYPASS_TDG1_13_TO" 805 "DFC_Can1BYPASS_TDG1_14_TO" 806 "DFC_Can1BYPASS_TDG1_15_TO" 807 "DFC_Can1BYPASS_TDG1_16_PlaceHolder_TO" 808 "DFC_Can1BYPASS_TDG1_17_PlaceHolder_TO" 809 "DFC_Can1BYPASS_TDG1_18_PlaceHolder_TO" 810 "DFC_Can1BYPASS_TDG1_19_Placeholder_TO" 811 "DFC_Can1BYPASS_TDG1_20_Placeholder_TO" 812 "DFC_Can1BYPASS_TDG1_21_TO" 813 "DFC_Can1BYPASS_TDG1_22_TO" 814 "DFC_Can1Cool_Act_Sts_TO" 815 "DFC_DsmTest0" 816 "DFC_FrAACC_06ISigGroup_ACC_06_TO" 817 "DFC_FrAACC_06_TO" 818 "DFC_FrAACC_07ISigGroup_ACC_07_TO" 819 "DFC_FrAACC_07_TO" 820 "DFC_FrAAirbag_01ISigGroup_Airbag_01_TO" 821 "DFC_FrAAirbag_01_TO" 822 "DFC_FrAAirbag_02ISigGroup_Airbag_02_TO" 823 "DFC_FrAAirbag_02_TO" 824 "DFC_FrABCM_01_TO" 825 "DFC_FrABremse_EV_01ISigGroup_Bremse_EV_01_TO" 826 "DFC_FrABremse_EV_01_TO" 827 "DFC_FrABremse_EV_02ISigGroup_Bremse_EV_02_TO" 828 "DFC_FrABremse_EV_02_TO" 829 "DFC_FrACharisma_01_TO" 830 "DFC_FrADiagnose_01_TO" 831 "DFC_FrAEBKV_01ISigGroup_EBKV_01_TO" 832 "DFC_FrAEBKV_01_TO" 833 "DFC_FrAEM1_HYB_06_TO" 834 "DFC_FrAEM1_HYB_12ISigGroup_EM1_HYB_12_TO" 835 "DFC_FrAEM1_HYB_12_TO" 836 "DFC_FrAEPB_01ISigGroup_EPB_01_TO" 837 "DFC_FrAEPB_01_TO" 838 "DFC_FrAESP_03ISigGroup_ESP_03_TO" 839 "DFC_FrAESP_03_TO" 840 "DFC_FrAESP_05ISigGroup_ESP_05_TO" 841 "DFC_FrAESP_05_TO" 842 "DFC_FrAESP_07ISigGroup_ESP_07_TO" 843 "DFC_FrAESP_07_TO" 844 "DFC_FrAESP_08ISigGroup_ESP_08_TO" 845 "DFC_FrAESP_08_TO" 846 "DFC_FrAESP_15ISigGroup_ESP_15_TO" 847 "DFC_FrAESP_15_TO" 848 "DFC_FrAESP_20ISigGroup_ESP_20_TO" 849 "DFC_FrAESP_20_TO" 850 "DFC_FrAESP_21ISigGroup_ESP_21_TO" 851 "DFC_FrAESP_21_TO" 852 "DFC_FrAESP_22ISigGroup_ESP_22_TO" 853 "DFC_FrAESP_22_TO" 854 "DFC_FrAESP_23ISigGroup_ESP_23_TO" 855 "DFC_FrAESP_23_TO" 856 "DFC_FrAESP_24ISigGroup_ESP_24_TO" 857 "DFC_FrAESP_24_TO" 858 "DFC_FrAESP_26_TO" 859 "DFC_FrAESP_28ISigGroup_ESP_28_TO" 860 "DFC_FrAESP_28_TO" 861 "DFC_FrAESP_31ISigGroup_ESP_31_TO" 862 "DFC_FrAESP_31_TO" 863 "DFC_FrAESP_32ISigGroup_ESP_32_TO" 864 "DFC_FrAESP_32_TO" 865 "DFC_FrAESP_33ISigGroup_ESP_33_TO" 866 "DFC_FrAESP_33_TO" 867 "DFC_FrAESP_41ISigGroup_ESP_41_TO" 868 "DFC_FrAESP_41_TO" 869 "DFC_FrAESP_44ISigGroup_ESP_44_TO" 870 "DFC_FrAESP_44_TO" 871 "DFC_FrAKlemmen_Status_01ISigGroup_Klemmen_Status_01_TO" 872 "DFC_FrAKlemmen_Status_01_TO" 873 "DFC_FrAKlima_11_TO" 874 "DFC_FrAKombi_02_TO" 875 "DFC_FrALCV_01ISigGroup_LCV_01_TO" 876 "DFC_FrALCV_01_TO" 877 "DFC_FrALWI_01ISigGroup_LWI_01_TO" 878 "DFC_FrALWI_01_TO" 879 "DFC_FrAMFL_Tasten_01_TO" 880 "DFC_FrAMSG_EM1_18_TO" 881 "DFC_FrAMSG_EM1_29_TO" 882 "DFC_FrAMotor_07_TO" 883 "DFC_FrAMotor_11ISigGroup_Motor_11_TO" 884 "DFC_FrAMotor_11_TO" 885 "DFC_FrAMotor_12ISigGroup_Motor_12_TO" 886 "DFC_FrAMotor_12_TO" 887 "DFC_FrAMotor_14ISigGroup_Motor_14_TO" 888 "DFC_FrAMotor_14_TO" 889 "DFC_FrAMotor_16_TO" 890 "DFC_FrAMotor_17_TO" 891 "DFC_FrAMotor_18_TO" 892 "DFC_FrAMotor_20ISigGroup_Motor_20_TO" 893 "DFC_FrAMotor_20_TO" 894 "DFC_FrAMotor_27ISigGroup_Motor_27_TO" 895 "DFC_FrAMotor_27_TO" 896 "DFC_FrAMotor_28ISigGroup_Motor_28_TO" 897 "DFC_FrAMotor_28_TO" 898 "DFC_FrAMotor_35_TO" 899 "DFC_FrAMotor_38_LB_TO" 900 "DFC_FrAMotor_47_TO" 901 "DFC_FrAMotor_Code_01ISigGroup_Motor_Code_01_TO" 902 "DFC_FrAMotor_Code_01_TO" 903 "DFC_FrAMotor_Hybrid_11_TO" 904 "DFC_FrAMotor_TS_01ISigGroup_Motor_TS_01_TO" 905 "DFC_FrAMotor_TS_01_TO" 906 "DFC_FrAMotor_TS_02ISigGroup_Motor_TS_02_TO" 907 "DFC_FrAMotor_TS_02_TO" 908 "DFC_FrAMotor_TS_03ISigGroup_Motor_TS_03_TO" 909 "DFC_FrAMotor_TS_03_TO" 910 "DFC_FrANVEM_02_TO" 911 "DFC_FrANVEM_05_TO" 912 "DFC_FrAOBD_01_TO" 913 "DFC_FrAOBD_02_TO" 914 "DFC_FrASARA_06ISigGroup_SARA_06_TO" 915 "DFC_FrASARA_06_TO" 916 "DFC_FrASysteminfo_01_TO" 917 "DFC_FrATSG_FT_02ISigGroup_TSG_FT_02_TO" 918 "DFC_FrATSG_FT_02_TO" 919 "DFC_FrATSK_06ISigGroup_TSK_06_TO" 920 "DFC_FrATSK_06_TO" 921 "DFC_FrATSK_08ISigGroup_TSK_08_TO" 922 "DFC_FrATSK_08_TO" 923 "DFC_FrAVIN_01_0_TO" 924 "DFC_FrAVIN_01_1_TO" 925 "DFC_FrAVIN_01_2_TO" 926 "DFC_IPT" 927 "DFC_L3Error" 928 "DFC_SftyCfgMon" 929 "DFC_SftyShtOff" 930 "DFC_DsmTest4" 931 "DFC_BSWM_E_ACTION_FAILED" 932 "DFC_BSWM_E_INTRPTQUEUE_FULL" 933 "DFC_CANSM_E_BUS_OFF_NETWORK_0" 934 "DFC_CANSM_E_BUS_OFF_NETWORK_1" 935 "DFC_CANSM_E_BUS_OFF_NETWORK_2" 936 "DFC_CANSM_E_BUS_OFF_NETWORK_3" 937 "DFC_FRSM_E_CLUSTER_STARTUP" 938 "DFC_FRTRCV_E_NO_TRCV_CONTROL_0" 939 "DFC_FR_E_ACCESS" 940 "DFC_RBA_IOEXTLIB_KEEPALIVE_DRV" 941 "DFC_RBA_IOEXTLIB_KEEPALIVE_INI" 942 "DFC_rba_MultiStackTrace_Threshold" 943 "DFC_CAN_E_TIMEOUT" 944 "DFC_FRSM_E_CLUSTER_SYNC_LOSS" 945 "DFC_PDUR_E_INIT_FAILED" 946 "DFC_PDUR_E_PDU_INSTANCE_LOST" 947 "DFC_rba_IoSigRtc_StopCounter" 948 "DFC_rba_T15_Diag_ComInVld_Event" 949 "DFC_rba_T15_Diag_ComOff_HwOn_Event" 950 "DFC_rba_T15_Diag_ComOn_HwOff_Event" 951 "DFC_DSMDummy" 952 "DFC_DsmTest3";
VAL_ 2041 DFES_numDFC_04_ 0 "DFC_Unused" 1 "DFC_DsmTest2" 2 "DFC_Can0Getriebe_01" 3 "DFC_Can0Motor_01_CHK" 4 "DFC_Can0Motor_01_CNT" 5 "DFC_Can0Motor_01_DLC" 6 "DFC_Can0Motor_02_CHK" 7 "DFC_Can0Motor_02_CNT" 8 "DFC_Can0Motor_02_DLC" 9 "DFC_Can0Motor_03_CHK" 10 "DFC_Can0Motor_03_CNT" 11 "DFC_Can0Motor_03_DLC" 12 "DFC_Can1BYPASS_TDG1_11_DLC" 13 "DFC_Can1BYPASS_TDG1_12_DLC" 14 "DFC_Can1BYPASS_TDG1_13_DLC" 15 "DFC_Can1BYPASS_TDG1_14_DLC" 16 "DFC_Can1BYPASS_TDG1_15_DLC" 17 "DFC_Can1BYPASS_TDG1_16_PlaceHolder_DLC" 18 "DFC_Can1BYPASS_TDG1_17_PlaceHolder_DLC" 19 "DFC_Can1BYPASS_TDG1_18_PlaceHolder_DLC" 20 "DFC_Can1BYPASS_TDG1_19_Placeholder_DLC" 21 "DFC_Can1BYPASS_TDG1_20_Placeholder_DLC" 22 "DFC_Can1BYPASS_TDG1_21_DLC" 23 "DFC_Can1BYPASS_TDG1_22_DLC" 24 "DFC_Can1BYPASS_TDG1_AA" 25 "DFC_Can1BYPASS_TDG1_AB" 26 "DFC_Can1BYPASS_TDG1_AC" 27 "DFC_Can1BYPASS_TDG1_AD" 28 "DFC_Can1BYPASS_TDG1_AE" 29 "DFC_Can1BYPASS_TDG1_AF" 30 "DFC_Can1BYPASS_TDG1_BA" 31 "DFC_Can1BYPASS_TDG1_BB" 32 "DFC_Can1BYPASS_TDG1_BC" 33 "DFC_Can1BYPASS_TDG1_BD" 34 "DFC_Can1BYPASS_TDG1_BE_PlaceHolder" 35 "DFC_Can1BYPASS_TDG1_BF_PlaceHolder" 36 "DFC_Can1BYPASS_TDG1_CA_PlaceHolder" 37 "DFC_Can1BYPASS_TDG1_CB_PlaceHolder" 38 "DFC_Can1BYPASS_TDG1_CC_PlaceHolder" 39 "DFC_Can1Cool_Act_Cmd" 40 "DFC_Can1Cool_Act_Sts_DLC" 41 "DFC_DsmTest1" 42 "DFC_FrAACC_06ISigGroup_ACC_06_CHK" 43 "DFC_FrAACC_06ISigGroup_ACC_06_CNT" 44 "DFC_FrAACC_07ISigGroup_ACC_07_CHK" 45 "DFC_FrAACC_07ISigGroup_ACC_07_CNT" 46 "DFC_FrAAirbag_01ISigGroup_Airbag_01_CHK" 47 "DFC_FrAAirbag_01ISigGroup_Airbag_01_CNT" 48 "DFC_FrAAirbag_02ISigGroup_Airbag_02_CHK" 49 "DFC_FrAAirbag_02ISigGroup_Airbag_02_CNT" 50 "DFC_FrABremse_EV_01ISigGroup_Bremse_EV_01_CHK" 51 "DFC_FrABremse_EV_01ISigGroup_Bremse_EV_01_CNT" 52 "DFC_FrABremse_EV_02ISigGroup_Bremse_EV_02_CHK" 53 "DFC_FrABremse_EV_02ISigGroup_Bremse_EV_02_CNT" 54 "DFC_FrAEBKV_01ISigGroup_EBKV_01_CHK" 55 "DFC_FrAEBKV_01ISigGroup_EBKV_01_CNT" 56 "DFC_FrAEM1_HYB_12ISigGroup_EM1_HYB_12_CHK" 57 "DFC_FrAEM1_HYB_12ISigGroup_EM1_HYB_12_CNT" 58 "DFC_FrAEPB_01ISigGroup_EPB_01_CHK" 59 "DFC_FrAEPB_01ISigGroup_EPB_01_CNT" 60 "DFC_FrAESP_03ISigGroup_ESP_03_CHK" 61 "DFC_FrAESP_03ISigGroup_ESP_03_CNT" 62 "DFC_FrAESP_05ISigGroup_ESP_05_CHK" 63 "DFC_FrAESP_05ISigGroup_ESP_05_CNT" 64 "DFC_FrAESP_07ISigGroup_ESP_07_CHK" 65 "DFC_FrAESP_07ISigGroup_ESP_07_CNT" 66 "DFC_FrAESP_08ISigGroup_ESP_08_CHK" 67 "DFC_FrAESP_08ISigGroup_ESP_08_CNT" 68 "DFC_FrAESP_15ISigGroup_ESP_15_CHK" 69 "DFC_FrAESP_15ISigGroup_ESP_15_CNT" 70 "DFC_FrAESP_20ISigGroup_ESP_20_CHK" 71 "DFC_FrAESP_20ISigGroup_ESP_20_CNT" 72 "DFC_FrAESP_21ISigGroup_ESP_21_CHK" 73 "DFC_FrAESP_21ISigGroup_ESP_21_CNT" 74 "DFC_FrAESP_22ISigGroup_ESP_22_CHK" 75 "DFC_FrAESP_22ISigGroup_ESP_22_CNT" 76 "DFC_FrAESP_23ISigGroup_ESP_23_CHK" 77 "DFC_FrAESP_23ISigGroup_ESP_23_CNT" 78 "DFC_FrAESP_24ISigGroup_ESP_24_CHK" 79 "DFC_FrAESP_24ISigGroup_ESP_24_CNT" 80 "DFC_FrAESP_28ISigGroup_ESP_28_CHK" 81 "DFC_FrAESP_28ISigGroup_ESP_28_CNT" 82 "DFC_FrAESP_31ISigGroup_ESP_31_CHK" 83 "DFC_FrAESP_31ISigGroup_ESP_31_CNT" 84 "DFC_FrAESP_32ISigGroup_ESP_32_CHK" 85 "DFC_FrAESP_32ISigGroup_ESP_32_CNT" 86 "DFC_FrAESP_33ISigGroup_ESP_33_CHK" 87 "DFC_FrAESP_33ISigGroup_ESP_33_CNT" 88 "DFC_FrAESP_41ISigGroup_ESP_41_CHK" 89 "DFC_FrAESP_41ISigGroup_ESP_41_CNT" 90 "DFC_FrAESP_44ISigGroup_ESP_44_CHK" 91 "DFC_FrAESP_44ISigGroup_ESP_44_CNT" 92 "DFC_FrAGetriebe_11" 93 "DFC_FrAGetriebe_12" 94 "DFC_FrAGetriebe_13" 95 "DFC_FrAGetriebe_14" 96 "DFC_FrAGetriebe_15" 97 "DFC_FrAGetriebe_16" 98 "DFC_FrAGetriebe_17" 99 "DFC_FrAGetriebe_18" 100 "DFC_FrAGetriebe_HYB_12" 101 "DFC_FrAKN_Getriebe" 102 "DFC_FrAKlemmen_Status_01ISigGroup_Klemmen_Status_01_CHK" 103 "DFC_FrAKlemmen_Status_01ISigGroup_Klemmen_Status_01_CNT" 104 "DFC_FrALCV_01ISigGroup_LCV_01_CHK" 105 "DFC_FrALCV_01ISigGroup_LCV_01_CNT" 106 "DFC_FrALWI_01ISigGroup_LWI_01_CHK" 107 "DFC_FrALWI_01ISigGroup_LWI_01_CNT" 108 "DFC_FrAMotor_11ISigGroup_Motor_11_CHK" 109 "DFC_FrAMotor_11ISigGroup_Motor_11_CNT" 110 "DFC_FrAMotor_12ISigGroup_Motor_12_CHK" 111 "DFC_FrAMotor_12ISigGroup_Motor_12_CNT" 112 "DFC_FrAMotor_14ISigGroup_Motor_14_CHK" 113 "DFC_FrAMotor_14ISigGroup_Motor_14_CNT" 114 "DFC_FrAMotor_20ISigGroup_Motor_20_CHK" 115 "DFC_FrAMotor_20ISigGroup_Motor_20_CNT" 116 "DFC_FrAMotor_27ISigGroup_Motor_27_CHK" 117 "DFC_FrAMotor_27ISigGroup_Motor_27_CNT" 118 "DFC_FrAMotor_28ISigGroup_Motor_28_CHK" 119 "DFC_FrAMotor_28ISigGroup_Motor_28_CNT" 120 "DFC_FrAMotor_Code_01ISigGroup_Motor_Code_01_CHK" 121 "DFC_FrAMotor_Code_01ISigGroup_Motor_Code_01_CNT" 122 "DFC_FrAMotor_TS_01ISigGroup_Motor_TS_01_CHK" 123 "DFC_FrAMotor_TS_01ISigGroup_Motor_TS_01_CNT" 124 "DFC_FrAMotor_TS_02ISigGroup_Motor_TS_02_CHK" 125 "DFC_FrAMotor_TS_02ISigGroup_Motor_TS_02_CNT" 126 "DFC_FrAMotor_TS_03ISigGroup_Motor_TS_03_CHK" 127 "DFC_FrAMotor_TS_03ISigGroup_Motor_TS_03_CNT" 128 "DFC_FrASARA_06ISigGroup_SARA_06_CHK" 129 "DFC_FrASARA_06ISigGroup_SARA_06_CNT" 130 "DFC_FrATSG_FT_02ISigGroup_TSG_FT_02_CHK" 131 "DFC_FrATSG_FT_02ISigGroup_TSG_FT_02_CNT" 132 "DFC_FrATSK_06ISigGroup_TSK_06_CHK" 133 "DFC_FrATSK_06ISigGroup_TSK_06_CNT" 134 "DFC_FrATSK_08ISigGroup_TSK_08_CHK" 135 "DFC_FrATSK_08ISigGroup_TSK_08_CNT" 136 "DFC_FrAWBA_03" 137 "DFC_AdcBkg" 138 "DFC_Adc_Rdnt_0" 139 "DFC_Adc_Rdnt_1" 140 "DFC_Adc_Rdnt_2" 141 "DFC_Adc_Rdnt_3" 142 "DFC_Adc_Rdnt_4" 143 "DFC_Adc_Rdnt_5" 144 "DFC_Adc_Rdnt_6" 145 "DFC_Adc_Rdnt_7" 146 "DFC_Adc_Rdnt_8" 147 "DFC_Adc_Rdnt_9" 148 "DFC_Adc_SB_0" 149 "DFC_Adc_SB_1" 150 "DFC_Adc_SB_2" 151 "DFC_Adc_SB_3" 152 "DFC_Adc_SB_4" 153 "DFC_Adc_SB_5" 154 "DFC_Adc_SB_6" 155 "DFC_Adc_SB_7" 156 "DFC_Adc_SB_8" 157 "DFC_Adc_SB_9" 158 "DFC_Adc_SG_0" 159 "DFC_Adc_SG_1" 160 "DFC_Adc_SG_2" 161 "DFC_Adc_SG_3" 162 "DFC_Adc_SG_4" 163 "DFC_Adc_SG_5" 164 "DFC_Adc_SG_6" 165 "DFC_Adc_SG_7" 166 "DFC_Adc_SG_8" 167 "DFC_Adc_SG_9" 168 "DFC_Adc_Unit" 169 "DFC_BattSply_UHi" 170 "DFC_BattSply_ULo" 171 "DFC_CpuTemp" 172 "DFC_CrntCtrl_Channel_0" 173 "DFC_CrntCtrl_Channel_1" 174 "DFC_CrntCtrl_Channel_2" 175 "DFC_CrntCtrl_Channel_3" 176 "DFC_CrntCtrl_Channel_4" 177 "DFC_CrntCtrl_Channel_5" 178 "DFC_CrntCtrl_Channel_6" 179 "DFC_CrntCtrl_Channel_7" 180 "DFC_CrntCtrl_Channel_8" 181 "DFC_CrntCtrl_Channel_9" 182 "DFC_CrntCtrl_Channel_10" 183 "DFC_CrntCtrl_Channel_11" 184 "DFC_CrntCtrl_Channel_12" 185 "DFC_CrntCtrl_Channel_13" 186 "DFC_CrntCtrl_Channel_14" 187 "DFC_CrntCtrl_Channel_15" 188 "DFC_CrntCtrl_Channel_16" 189 "DFC_CrntCtrl_Channel_17" 190 "DFC_CrntCtrl_Channel_18" 191 "DFC_CrntCtrl_Channel_19" 192 "DFC_CrntCtrl_CrntMon_0" 193 "DFC_CrntCtrl_CrntMon_1" 194 "DFC_CrntCtrl_CrntMon_2" 195 "DFC_CrntCtrl_CrntMon_3" 196 "DFC_CrntCtrl_CrntMon_4" 197 "DFC_CrntCtrl_CrntMon_5" 198 "DFC_CrntCtrl_CrntMon_6" 199 "DFC_CrntCtrl_CrntMon_7" 200 "DFC_CrntCtrl_CrntMon_8" 201 "DFC_CrntCtrl_CrntMon_9" 202 "DFC_CrntCtrl_CrntMon_10" 203 "DFC_CrntCtrl_CrntMon_11" 204 "DFC_CrntCtrl_CrntMon_12" 205 "DFC_CrntCtrl_CrntMon_13" 206 "DFC_CrntCtrl_CrntMon_14" 207 "DFC_CrntCtrl_CrntMon_15" 208 "DFC_CrntCtrl_CrntMon_16" 209 "DFC_CrntCtrl_CrntMon_17" 210 "DFC_CrntCtrl_CrntMon_18" 211 "DFC_CrntCtrl_CrntMon_19" 212 "DFC_CrntCtrl_OP_0" 213 "DFC_CrntCtrl_OP_1" 214 "DFC_CrntCtrl_OP_2" 215 "DFC_CrntCtrl_OP_3" 216 "DFC_CrntCtrl_OP_4" 217 "DFC_CrntCtrl_OP_5" 218 "DFC_CrntCtrl_OP_6" 219 "DFC_CrntCtrl_OP_7" 220 "DFC_CrntCtrl_OP_8" 221 "DFC_CrntCtrl_OP_9" 222 "DFC_CrntCtrl_OP_10" 223 "DFC_CrntCtrl_OP_11" 224 "DFC_CrntCtrl_OP_12" 225 "DFC_CrntCtrl_OP_13" 226 "DFC_CrntCtrl_OP_14" 227 "DFC_CrntCtrl_OP_15" 228 "DFC_CrntCtrl_OP_16" 229 "DFC_CrntCtrl_OP_17" 230 "DFC_CrntCtrl_OP_18" 231 "DFC_CrntCtrl_OP_19" 232 "DFC_CrntCtrl_SB_0" 233 "DFC_CrntCtrl_SB_1" 234 "DFC_CrntCtrl_SB_2" 235 "DFC_CrntCtrl_SB_3" 236 "DFC_CrntCtrl_SB_4" 237 "DFC_CrntCtrl_SB_5" 238 "DFC_CrntCtrl_SB_6" 239 "DFC_CrntCtrl_SB_7" 240 "DFC_CrntCtrl_SB_8" 241 "DFC_CrntCtrl_SB_9" 242 "DFC_CrntCtrl_SB_10" 243 "DFC_CrntCtrl_SB_11" 244 "DFC_CrntCtrl_SB_12" 245 "DFC_CrntCtrl_SB_13" 246 "DFC_CrntCtrl_SB_14" 247 "DFC_CrntCtrl_SB_15" 248 "DFC_CrntCtrl_SB_16" 249 "DFC_CrntCtrl_SB_17" 250 "DFC_CrntCtrl_SB_18" 251 "DFC_CrntCtrl_SB_19" 252 "DFC_CrntCtrl_SG_0" 253 "DFC_CrntCtrl_SG_1" 254 "DFC_CrntCtrl_SG_2" 255 "DFC_CrntCtrl_SG_3" 256 "DFC_CrntCtrl_SG_4" 257 "DFC_CrntCtrl_SG_5" 258 "DFC_CrntCtrl_SG_6" 259 "DFC_CrntCtrl_SG_7" 260 "DFC_CrntCtrl_SG_8" 261 "DFC_CrntCtrl_SG_9" 262 "DFC_CrntCtrl_SG_10" 263 "DFC_CrntCtrl_SG_11" 264 "DFC_CrntCtrl_SG_12" 265 "DFC_CrntCtrl_SG_13" 266 "DFC_CrntCtrl_SG_14" 267 "DFC_CrntCtrl_SG_15" 268 "DFC_CrntCtrl_SG_16" 269 "DFC_CrntCtrl_SG_17" 270 "DFC_CrntCtrl_SG_18" 271 "DFC_CrntCtrl_SG_19" 272 "DFC_CrntCtrl_Unit_0" 273 "DFC_CrntCtrl_Unit_1" 274 "DFC_CtrlMot_DNR_0" 275 "DFC_CtrlMot_DNR_1" 276 "DFC_CtrlMot_OC_0" 277 "DFC_CtrlMot_OC_1" 278 "DFC_CtrlMot_OL_0" 279 "DFC_CtrlMot_OL_1" 280 "DFC_CtrlMot_SB_0" 281 "DFC_CtrlMot_SB_1" 282 "DFC_CtrlMot_SG_0" 283 "DFC_CtrlMot_SG_1" 284 "DFC_Flx_AdcInUnit_0" 285 "DFC_Flx_AdcInUnit_1" 286 "DFC_Flx_AdcInUnit_2" 287 "DFC_Flx_RMeasUnit_0" 288 "DFC_Flx_RMeasUnit_1" 289 "DFC_Flx_SB_0" 290 "DFC_Flx_SB_1" 291 "DFC_Flx_SB_2" 292 "DFC_Flx_SB_3" 293 "DFC_Flx_SB_4" 294 "DFC_Flx_SB_5" 295 "DFC_Flx_SB_6" 296 "DFC_Flx_SB_7" 297 "DFC_Flx_SB_8" 298 "DFC_Flx_SB_9" 299 "DFC_Flx_SB_10" 300 "DFC_Flx_SB_11" 301 "DFC_Flx_SB_12" 302 "DFC_Flx_SB_13" 303 "DFC_Flx_SB_14" 304 "DFC_Flx_SB_15" 305 "DFC_Flx_SB_16" 306 "DFC_Flx_SB_17" 307 "DFC_Flx_SB_18" 308 "DFC_Flx_SB_19" 309 "DFC_Flx_SB_20" 310 "DFC_Flx_SB_21" 311 "DFC_Flx_SB_22" 312 "DFC_Flx_SB_23" 313 "DFC_Flx_SB_24" 314 "DFC_Flx_SB_25" 315 "DFC_Flx_SB_26" 316 "DFC_Flx_SG_0" 317 "DFC_Flx_SG_1" 318 "DFC_Flx_SG_2" 319 "DFC_Flx_SG_3" 320 "DFC_Flx_SG_4" 321 "DFC_Flx_SG_5" 322 "DFC_Flx_SG_6" 323 "DFC_Flx_SG_7" 324 "DFC_Flx_SG_8" 325 "DFC_Flx_SG_9" 326 "DFC_Flx_SG_10" 327 "DFC_Flx_SG_11" 328 "DFC_Flx_SG_12" 329 "DFC_Flx_SG_13" 330 "DFC_Flx_SG_14" 331 "DFC_Flx_SG_15" 332 "DFC_Flx_SG_16" 333 "DFC_Flx_SG_17" 334 "DFC_Flx_SG_18" 335 "DFC_Flx_SG_19" 336 "DFC_Flx_SG_20" 337 "DFC_Flx_SG_21" 338 "DFC_Flx_SG_22" 339 "DFC_Flx_SG_23" 340 "DFC_Flx_SG_24" 341 "DFC_Flx_SG_25" 342 "DFC_Flx_SG_26" 343 "DFC_Flx_Sig_0" 344 "DFC_Flx_Sig_1" 345 "DFC_Flx_Sig_2" 346 "DFC_Flx_Sig_3" 347 "DFC_Flx_Sig_4" 348 "DFC_Flx_Sig_5" 349 "DFC_Flx_Sig_6" 350 "DFC_Flx_Sig_7" 351 "DFC_Flx_Sig_8" 352 "DFC_Flx_Sig_9" 353 "DFC_Flx_Sig_10" 354 "DFC_Flx_Sig_11" 355 "DFC_Flx_Sig_12" 356 "DFC_Flx_Sig_13" 357 "DFC_Flx_Sig_14" 358 "DFC_Flx_Sig_15" 359 "DFC_Flx_Sig_16" 360 "DFC_Flx_Sig_17" 361 "DFC_Flx_Sig_18" 362 "DFC_Flx_Sig_19" 363 "DFC_Flx_Sig_20" 364 "DFC_Flx_Sig_21" 365 "DFC_Flx_Sig_22" 366 "DFC_Flx_Sig_23" 367 "DFC_Flx_Sig_24" 368 "DFC_Flx_Sig_25" 369 "DFC_Flx_Sig_26" 370 "DFC_Gtm_Clk" 371 "DFC_HiSide_OP_0" 372 "DFC_HiSide_OP_1" 373 "DFC_HiSide_OP_2" 374 "DFC_HiSide_OP_3" 375 "DFC_HiSide_OP_4" 376 "DFC_HiSide_OP_5" 377 "DFC_HiSide_SB_0" 378 "DFC_HiSide_SB_1" 379 "DFC_HiSide_SB_2" 380 "DFC_HiSide_SB_3" 381 "DFC_HiSide_SB_4" 382 "DFC_HiSide_SB_5" 383 "DFC_HiSide_SG_0" 384 "DFC_HiSide_SG_1" 385 "DFC_HiSide_SG_2" 386 "DFC_HiSide_SG_3" 387 "DFC_HiSide_SG_4" 388 "DFC_HiSide_SG_5" 389 "DFC_IntSply_0" 390 "DFC_IntSply_1" 391 "DFC_IntSply_2" 392 "DFC_IntSply_3" 393 "DFC_IntSply_4" 394 "DFC_IntSply_5" 395 "DFC_IntTemp" 396 "DFC_LssRly_OL" 397 "DFC_LssRly_SB" 398 "DFC_LssRly_SG" 399 "DFC_Lss_OL_0" 400 "DFC_Lss_OL_1" 401 "DFC_Lss_OL_2" 402 "DFC_Lss_OL_3" 403 "DFC_Lss_OL_4" 404 "DFC_Lss_OL_5" 405 "DFC_Lss_OL_6" 406 "DFC_Lss_OL_7" 407 "DFC_Lss_OL_8" 408 "DFC_Lss_OL_9" 409 "DFC_Lss_OL_10" 410 "DFC_Lss_OL_11" 411 "DFC_Lss_SB_0" 412 "DFC_Lss_SB_1" 413 "DFC_Lss_SB_2" 414 "DFC_Lss_SB_3" 415 "DFC_Lss_SB_4" 416 "DFC_Lss_SB_5" 417 "DFC_Lss_SB_6" 418 "DFC_Lss_SB_7" 419 "DFC_Lss_SB_8" 420 "DFC_Lss_SB_9" 421 "DFC_Lss_SB_10" 422 "DFC_Lss_SB_11" 423 "DFC_Lss_SG_0" 424 "DFC_Lss_SG_1" 425 "DFC_Lss_SG_2" 426 "DFC_Lss_SG_3" 427 "DFC_Lss_SG_4" 428 "DFC_Lss_SG_5" 429 "DFC_Lss_SG_6" 430 "DFC_Lss_SG_7" 431 "DFC_Lss_SG_8" 432 "DFC_Lss_SG_9" 433 "DFC_Lss_SG_10" 434 "DFC_Lss_SG_11" 435 "DFC_Lss_Unit" 436 "DFC_OsTmrMon" 437 "DFC_PwmIn_GtmTim_0" 438 "DFC_PwmIn_GtmTim_1" 439 "DFC_PwmIn_GtmTim_2" 440 "DFC_PwmIn_GtmTim_3" 441 "DFC_PwmIn_GtmTim_4" 442 "DFC_PwmIn_GtmTim_5" 443 "DFC_PwmIn_GtmTim_6" 444 "DFC_PwmIn_GtmTim_7" 445 "DFC_PwmIn_GtmTim_8" 446 "DFC_PwmIn_GtmTim_9" 447 "DFC_PwmIn_GtmTim_10" 448 "DFC_PwmIn_GtmTim_11" 449 "DFC_PwmIn_SB_0" 450 "DFC_PwmIn_SB_1" 451 "DFC_PwmIn_SB_2" 452 "DFC_PwmIn_SB_3" 453 "DFC_PwmIn_SB_4" 454 "DFC_PwmIn_SB_5" 455 "DFC_PwmIn_SB_6" 456 "DFC_PwmIn_SB_7" 457 "DFC_PwmIn_SB_8" 458 "DFC_PwmIn_SB_9" 459 "DFC_PwmIn_SB_10" 460 "DFC_PwmIn_SB_11" 461 "DFC_PwmIn_SG_0" 462 "DFC_PwmIn_SG_1" 463 "DFC_PwmIn_SG_2" 464 "DFC_PwmIn_SG_3" 465 "DFC_PwmIn_SG_4" 466 "DFC_PwmIn_SG_5" 467 "DFC_PwmIn_SG_6" 468 "DFC_PwmIn_SG_7" 469 "DFC_PwmIn_SG_8" 470 "DFC_PwmIn_SG_9" 471 "DFC_PwmIn_SG_10" 472 "DFC_PwmIn_SG_11" 473 "DFC_PwmIn_Sig_0" 474 "DFC_PwmIn_Sig_1" 475 "DFC_PwmIn_Sig_2" 476 "DFC_PwmIn_Sig_3" 477 "DFC_PwmIn_Sig_4" 478 "DFC_PwmIn_Sig_5" 479 "DFC_PwmIn_Sig_6" 480 "DFC_PwmIn_Sig_7" 481 "DFC_PwmIn_Sig_8" 482 "DFC_PwmIn_Sig_9" 483 "DFC_PwmIn_Sig_10" 484 "DFC_PwmIn_Sig_11" 485 "DFC_SafeSt_flgDn" 486 "DFC_SnsrSply_SB_0" 487 "DFC_SnsrSply_SB_1" 488 "DFC_SnsrSply_SB_2" 489 "DFC_SnsrSply_SB_3" 490 "DFC_SnsrSply_SB_4" 491 "DFC_SnsrSply_SB_5" 492 "DFC_SnsrSply_SG_0" 493 "DFC_SnsrSply_SG_1" 494 "DFC_SnsrSply_SG_2" 495 "DFC_SnsrSply_SG_3" 496 "DFC_SnsrSply_SG_4" 497 "DFC_SnsrSply_SG_5" 498 "DFC_Spd_NdPls_0" 499 "DFC_Spd_NdPls_1" 500 "DFC_Spd_NdPls_2" 501 "DFC_Spd_NdPls_3" 502 "DFC_Spd_NdPls_4" 503 "DFC_Spd_OP_0" 504 "DFC_Spd_OP_1" 505 "DFC_Spd_OP_2" 506 "DFC_Spd_OP_3" 507 "DFC_Spd_OP_4" 508 "DFC_Spd_Pls_0" 509 "DFC_Spd_Pls_1" 510 "DFC_Spd_Pls_2" 511 "DFC_Spd_Pls_3" 512 "DFC_Spd_Pls_4" 513 "DFC_Spd_SB_0" 514 "DFC_Spd_SB_1" 515 "DFC_Spd_SB_2" 516 "DFC_Spd_SB_3" 517 "DFC_Spd_SB_4" 518 "DFC_Spd_SG_0" 519 "DFC_Spd_SG_1" 520 "DFC_Spd_SG_2" 521 "DFC_Spd_SG_3" 522 "DFC_Spd_SG_4" 523 "DFC_Spd_Sig_0" 524 "DFC_Spd_Sig_1" 525 "DFC_Spd_Sig_2" 526 "DFC_Spd_Sig_3" 527 "DFC_Spd_Sig_4" 528 "DFC_Spd_Sync_0" 529 "DFC_Spd_Sync_1" 530 "DFC_Spd_Sync_2" 531 "DFC_Spd_Sync_3" 532 "DFC_Spd_Sync_4" 533 "DFC_WdgSys" 534 "DFC_WdgWd" 535 "DFC_AcceleratorPedalErrorRx" 536 "DFC_AccumulatorChargeFault" 537 "DFC_AltitudeErrorRx" 538 "DFC_BLDCPumpDerateRx" 539 "DFC_BLDCPumpErrorRx" 540 "DFC_BrakePressureErrorRx" 541 "DFC_BrakeSwitchErrorRx" 542 "DFC_BrakeSwitchImplausible1" 543 "DFC_BrakeSwitchImplausible2" 544 "DFC_BrakeSwitchRateHigh" 545 "DFC_BrakeSwitchSpare1" 546 "DFC_BrakeSwitchSpare2" 547 "DFC_ChargeValveStuck" 548 "DFC_Clutch1AdaptationFault" 549 "DFC_Clutch1OverPressure" 550 "DFC_Clutch1UnderPressure" 551 "DFC_Clutch2AdaptationFault" 552 "DFC_Clutch2OverPressure" 553 "DFC_Clutch2UnderPressure" 554 "DFC_ClutchCoolingValveFault" 555 "DFC_ClutchCoolingValveStuck" 556 "DFC_ClutchOverTempoerature" 557 "DFC_ClutchShutOffValveFault" 558 "DFC_CoolantTempErrorRx" 559 "DFC_CoolingPressureImplausible" 560 "DFC_CoolingPressureRateHigh" 561 "DFC_CoolingPressureTooHigh" 562 "DFC_CoolingPressureTooLow" 563 "DFC_CrntCtrl_Reg_1" 564 "DFC_CrntCtrl_Reg_10" 565 "DFC_CrntCtrl_Reg_11" 566 "DFC_CrntCtrl_Reg_12" 567 "DFC_CrntCtrl_Reg_16" 568 "DFC_CrntCtrl_Reg_17" 569 "DFC_CrntCtrl_Reg_18" 570 "DFC_CrntCtrl_Reg_19" 571 "DFC_CrntCtrl_Reg_2" 572 "DFC_CrntCtrl_Reg_3" 573 "DFC_CrntCtrl_Reg_6" 574 "DFC_CrntCtrl_Reg_7" 575 "DFC_CrntCtrl_Reg_9" 576 "DFC_DSTSpare1" 577 "DFC_DSTSpare2" 578 "DFC_DWCSpare1" 579 "DFC_DWCSpare2" 580 "DFC_DWCSpare3" 581 "DFC_DWCSpare4" 582 "DFC_DWCSpare5" 583 "DFC_DWCSpare6" 584 "DFC_DWCSpare7" 585 "DFC_DoorStatusErrorRx" 586 "DFC_DownSwImplausible" 587 "DFC_DownSwRateHigh" 588 "DFC_DownSwSpare1" 589 "DFC_DownSwSpare2" 590 "DFC_EM1SpeedErrorRx" 591 "DFC_ENGDriveTorqueImplausible" 592 "DFC_ENGEngineProblem" 593 "DFC_ENGIdiotStart" 594 "DFC_ENGSpare1" 595 "DFC_ENGSpare2" 596 "DFC_ESPStatusErrorRx" 597 "DFC_EngineOilTempErrorRx" 598 "DFC_EngineSpeedErrorRx" 599 "DFC_EngineSpeedPWMImplausible1" 600 "DFC_EngineSpeedPWMImplausible2" 601 "DFC_EngineSpeedPWMRateHigh" 602 "DFC_EngineSpeedPWMSpare1" 603 "DFC_EngineSpeedPWMSpare2" 604 "DFC_EngineTorqueErrorRx" 605 "DFC_ExternalTempErrorRx" 606 "DFC_FailStuckNFault" 607 "DFC_FrontLeftWheelSpeedErrorRx" 608 "DFC_FrontRightWheelSpeedErrorRx" 609 "DFC_GearCoolingValveStuck" 610 "DFC_K1PressureImplausible" 611 "DFC_K1PressureRateHigh" 612 "DFC_K1PressureSpare1" 613 "DFC_K1PressureSpare2" 614 "DFC_K1SpeedHigh" 615 "DFC_K1SpeedImplausible" 616 "DFC_K1SpeedSpare1" 617 "DFC_K1SpeedSpare2" 618 "DFC_K2PressureImplausible" 619 "DFC_K2PressureRateHigh" 620 "DFC_K2PressureSpare1" 621 "DFC_K2PressureSpare2" 622 "DFC_K2SpeedHigh" 623 "DFC_K2SpeedImplausible" 624 "DFC_K2SpeedSpare1" 625 "DFC_K2SpeedSpare2" 626 "DFC_L2ClutchPressureVsCurrentOdd" 627 "DFC_L2ClutchTorqueDirection" 628 "DFC_L2DoubleClutchEngagement" 629 "DFC_L2DoubleGearEven" 630 "DFC_L2EM1ShaftOverspeed" 631 "DFC_L2EPBWhenMoving" 632 "DFC_L2EvenClutchGradientInCreep" 633 "DFC_L2ForwardDriveEven" 634 "DFC_L2ForwardDriveOdd" 635 "DFC_L2ForwardGearAndMode" 636 "DFC_L2GearCombinationEM1Overspeed" 637 "DFC_L2GearCombinationRequest" 638 "DFC_L2InputShaftEngineOverspeed" 639 "DFC_L2InsufficientLubrication" 640 "DFC_L2InvalidDownshiftOdd" 641 "DFC_L2InvalidGearControl" 642 "DFC_L2LeaveNeutral" 643 "DFC_L2LeavePark" 644 "DFC_L2ModeDisplay" 645 "DFC_L2ModeSelection" 646 "DFC_L2MovementWithChargeCable" 647 "DFC_L2OddClutchGradientInCreep" 648 "DFC_L2OddShaftAccelerationImplausible" 649 "DFC_L2ParkFailNoEPB" 650 "DFC_L2ParkPosition" 651 "DFC_L2ParkValveOverride" 652 "DFC_L2ParkWhenMoving" 653 "DFC_L2ReferenceSpeedFail" 654 "DFC_L2ReverseDrive" 655 "DFC_L2ShaftOverSpeedFromIP" 656 "DFC_L2ShaftOverSpeedFromOP" 657 "DFC_L2Spare1" 658 "DFC_L2Spare2" 659 "DFC_L2TorqueNoShift" 660 "DFC_L2TorqueRequestCupOfFuel" 661 "DFC_L2VGPOverride" 662 "DFC_L2VKUGLOveride" 663 "DFC_L2VSS1Overirde" 664 "DFC_L2VSS2Overirde" 665 "DFC_LatAccErrorRx" 666 "DFC_LinePressureImplausible" 667 "DFC_LinePressureLeakageHigh" 668 "DFC_LinePressureRateHigh" 669 "DFC_LinePressureSpare1" 670 "DFC_LinePressureSpare2" 671 "DFC_LinePressureTooHigh" 672 "DFC_LinePressureTooLow" 673 "DFC_LongAccErrorRx" 674 "DFC_LubeOilOverTemperature" 675 "DFC_LubeTemperatureImplausible" 676 "DFC_LubeTemperatureRateHigh" 677 "DFC_LubeTemperatureSpare1" 678 "DFC_LubeTemperatureSpare2" 679 "DFC_MOTEngineProblem" 680 "DFC_MOTSpare1" 681 "DFC_MOTSpare2" 682 "DFC_ModeMSwImplausible" 683 "DFC_ModeMSwSpare1" 684 "DFC_ModeMSwSpare2" 685 "DFC_ModeMSwSwRateHigh" 686 "DFC_ModePSwImplausible" 687 "DFC_ModePSwSpare1" 688 "DFC_ModePSwSpare2" 689 "DFC_ModePSwSwRateHigh" 690 "DFC_ModeRSwImplausible" 691 "DFC_ModeRSwSpare1" 692 "DFC_ModeRSwSpare2" 693 "DFC_ModeRSwSwRateHigh" 694 "DFC_ParkLockDisengageFail" 695 "DFC_ParkLockEngageFail" 696 "DFC_ParkLockPosImplausible" 697 "DFC_ParkLockPosRateHigh" 698 "DFC_ParkLockPosSpare1" 699 "DFC_ParkLockPosSpare2" 700 "DFC_PumpResponseFault" 701 "DFC_PumpSpeedError" 702 "DFC_RearLeftWheelSpeedErrorRx" 703 "DFC_RearRightWheelSpeedErrorRx" 704 "DFC_RedSpeedHigh" 705 "DFC_RedSpeedImplausible" 706 "DFC_RedSpeedSpare1" 707 "DFC_RedSpeedSpare2" 708 "DFC_SEQSpare1" 709 "DFC_SEQSpare2" 710 "DFC_SEQTimeout" 711 "DFC_Spare_0" 712 "DFC_Spare_1" 713 "DFC_Spare_2" 714 "DFC_Spare_3" 715 "DFC_Spare_4" 716 "DFC_Spare_5" 717 "DFC_Spare_6" 718 "DFC_Spare_7" 719 "DFC_Spare_8" 720 "DFC_Spare_9" 721 "DFC_SumpOilOverTemperature" 722 "DFC_SumpTemperatureImplausible" 723 "DFC_SumpTemperatureRateHigh" 724 "DFC_SumpTemperatureSpare1" 725 "DFC_SumpTemperatureSpare2" 726 "DFC_SynchroA1EngageFault" 727 "DFC_SynchroA1SpitoutInShiftFault" 728 "DFC_SynchroA1SpitoutNoShiftFault" 729 "DFC_SynchroA1StuckFault" 730 "DFC_SynchroA2EngageFault" 731 "DFC_SynchroA2SpitoutInShiftFault" 732 "DFC_SynchroA2SpitoutNoShiftFault" 733 "DFC_SynchroA2StuckFault" 734 "DFC_SynchroAOutOfNInShiftFault" 735 "DFC_SynchroAOutOfNNoShiftFault" 736 "DFC_SynchroAPosImplausible" 737 "DFC_SynchroAPosRateHigh" 738 "DFC_SynchroAPosSpare1" 739 "DFC_SynchroAPosSpare2" 740 "DFC_SynchroB1EngageFault" 741 "DFC_SynchroB1SpitoutInShiftFault" 742 "DFC_SynchroB1SpitoutNoShiftFault" 743 "DFC_SynchroB1StuckFault" 744 "DFC_SynchroB2EngageFault" 745 "DFC_SynchroB2SpitoutInShiftFault" 746 "DFC_SynchroB2SpitoutNoShiftFault" 747 "DFC_SynchroB2StuckFault" 748 "DFC_SynchroBOutOfNInShiftFault" 749 "DFC_SynchroBOutOfNNoShiftFault" 750 "DFC_SynchroBPosImplausible" 751 "DFC_SynchroBPosRateHigh" 752 "DFC_SynchroBPosSpare1" 753 "DFC_SynchroBPosSpare2" 754 "DFC_SynchroC1EngageFault" 755 "DFC_SynchroC1SpitoutInShiftFault" 756 "DFC_SynchroC1SpitoutNoShiftFault" 757 "DFC_SynchroC1StuckFault" 758 "DFC_SynchroC2EngageFault" 759 "DFC_SynchroC2SpitoutInShiftFault" 760 "DFC_SynchroC2SpitoutNoShiftFault" 761 "DFC_SynchroC2StuckFault" 762 "DFC_SynchroCOutOfNInShiftFault" 763 "DFC_SynchroCOutOfNNoShiftFault" 764 "DFC_SynchroCPosImplausible" 765 "DFC_SynchroCPosRateHigh" 766 "DFC_SynchroCPosSpare1" 767 "DFC_SynchroCPosSpare2" 768 "DFC_SynchroD1EngageFault" 769 "DFC_SynchroD1SpitoutInShiftFault" 770 "DFC_SynchroD1SpitoutNoShiftFault" 771 "DFC_SynchroD1StuckFault" 772 "DFC_SynchroDOutOfNInShiftFault" 773 "DFC_SynchroDOutOfNNoShiftFault" 774 "DFC_SynchroDPosImplausible" 775 "DFC_SynchroDPosRateHigh" 776 "DFC_SynchroDPosSpare1" 777 "DFC_SynchroDPosSpare2" 778 "DFC_SynchroF1EngageFault" 779 "DFC_SynchroF1SpitoutInShiftFault" 780 "DFC_SynchroF1SpitoutNoShiftFault" 781 "DFC_SynchroF1StuckFault" 782 "DFC_SynchroF2EngageFault" 783 "DFC_SynchroF2SpitoutInShiftFault" 784 "DFC_SynchroF2SpitoutNoShiftFault" 785 "DFC_SynchroF2StuckFault" 786 "DFC_SynchroFOutOfNInShiftFault" 787 "DFC_SynchroFOutOfNNoShiftFault" 788 "DFC_SynchroFPosImplausible" 789 "DFC_SynchroFPosRateHigh" 790 "DFC_SynchroFPosSpare1" 791 "DFC_SynchroFPosSpare2" 792 "DFC_UpSwImplausible" 793 "DFC_UpSwRateHigh" 794 "DFC_UpSwSpare1" 795 "DFC_UpSwSpare2" 796 "DFC_VehicleSpeedErrorRx" 797 "DFC_WheelTorqueESPErrorRx" 798 "DFC_YawRateErrorRx" 799 "DFC_Can0Motor_01_TO" 800 "DFC_Can0Motor_02_TO" 801 "DFC_Can0Motor_03_TO" 802 "DFC_Can1BYPASS_TDG1_11_TO" 803 "DFC_Can1BYPASS_TDG1_12_TO" 804 "DFC_Can1BYPASS_TDG1_13_TO" 805 "DFC_Can1BYPASS_TDG1_14_TO" 806 "DFC_Can1BYPASS_TDG1_15_TO" 807 "DFC_Can1BYPASS_TDG1_16_PlaceHolder_TO" 808 "DFC_Can1BYPASS_TDG1_17_PlaceHolder_TO" 809 "DFC_Can1BYPASS_TDG1_18_PlaceHolder_TO" 810 "DFC_Can1BYPASS_TDG1_19_Placeholder_TO" 811 "DFC_Can1BYPASS_TDG1_20_Placeholder_TO" 812 "DFC_Can1BYPASS_TDG1_21_TO" 813 "DFC_Can1BYPASS_TDG1_22_TO" 814 "DFC_Can1Cool_Act_Sts_TO" 815 "DFC_DsmTest0" 816 "DFC_FrAACC_06ISigGroup_ACC_06_TO" 817 "DFC_FrAACC_06_TO" 818 "DFC_FrAACC_07ISigGroup_ACC_07_TO" 819 "DFC_FrAACC_07_TO" 820 "DFC_FrAAirbag_01ISigGroup_Airbag_01_TO" 821 "DFC_FrAAirbag_01_TO" 822 "DFC_FrAAirbag_02ISigGroup_Airbag_02_TO" 823 "DFC_FrAAirbag_02_TO" 824 "DFC_FrABCM_01_TO" 825 "DFC_FrABremse_EV_01ISigGroup_Bremse_EV_01_TO" 826 "DFC_FrABremse_EV_01_TO" 827 "DFC_FrABremse_EV_02ISigGroup_Bremse_EV_02_TO" 828 "DFC_FrABremse_EV_02_TO" 829 "DFC_FrACharisma_01_TO" 830 "DFC_FrADiagnose_01_TO" 831 "DFC_FrAEBKV_01ISigGroup_EBKV_01_TO" 832 "DFC_FrAEBKV_01_TO" 833 "DFC_FrAEM1_HYB_06_TO" 834 "DFC_FrAEM1_HYB_12ISigGroup_EM1_HYB_12_TO" 835 "DFC_FrAEM1_HYB_12_TO" 836 "DFC_FrAEPB_01ISigGroup_EPB_01_TO" 837 "DFC_FrAEPB_01_TO" 838 "DFC_FrAESP_03ISigGroup_ESP_03_TO" 839 "DFC_FrAESP_03_TO" 840 "DFC_FrAESP_05ISigGroup_ESP_05_TO" 841 "DFC_FrAESP_05_TO" 842 "DFC_FrAESP_07ISigGroup_ESP_07_TO" 843 "DFC_FrAESP_07_TO" 844 "DFC_FrAESP_08ISigGroup_ESP_08_TO" 845 "DFC_FrAESP_08_TO" 846 "DFC_FrAESP_15ISigGroup_ESP_15_TO" 847 "DFC_FrAESP_15_TO" 848 "DFC_FrAESP_20ISigGroup_ESP_20_TO" 849 "DFC_FrAESP_20_TO" 850 "DFC_FrAESP_21ISigGroup_ESP_21_TO" 851 "DFC_FrAESP_21_TO" 852 "DFC_FrAESP_22ISigGroup_ESP_22_TO" 853 "DFC_FrAESP_22_TO" 854 "DFC_FrAESP_23ISigGroup_ESP_23_TO" 855 "DFC_FrAESP_23_TO" 856 "DFC_FrAESP_24ISigGroup_ESP_24_TO" 857 "DFC_FrAESP_24_TO" 858 "DFC_FrAESP_26_TO" 859 "DFC_FrAESP_28ISigGroup_ESP_28_TO" 860 "DFC_FrAESP_28_TO" 861 "DFC_FrAESP_31ISigGroup_ESP_31_TO" 862 "DFC_FrAESP_31_TO" 863 "DFC_FrAESP_32ISigGroup_ESP_32_TO" 864 "DFC_FrAESP_32_TO" 865 "DFC_FrAESP_33ISigGroup_ESP_33_TO" 866 "DFC_FrAESP_33_TO" 867 "DFC_FrAESP_41ISigGroup_ESP_41_TO" 868 "DFC_FrAESP_41_TO" 869 "DFC_FrAESP_44ISigGroup_ESP_44_TO" 870 "DFC_FrAESP_44_TO" 871 "DFC_FrAKlemmen_Status_01ISigGroup_Klemmen_Status_01_TO" 872 "DFC_FrAKlemmen_Status_01_TO" 873 "DFC_FrAKlima_11_TO" 874 "DFC_FrAKombi_02_TO" 875 "DFC_FrALCV_01ISigGroup_LCV_01_TO" 876 "DFC_FrALCV_01_TO" 877 "DFC_FrALWI_01ISigGroup_LWI_01_TO" 878 "DFC_FrALWI_01_TO" 879 "DFC_FrAMFL_Tasten_01_TO" 880 "DFC_FrAMSG_EM1_18_TO" 881 "DFC_FrAMSG_EM1_29_TO" 882 "DFC_FrAMotor_07_TO" 883 "DFC_FrAMotor_11ISigGroup_Motor_11_TO" 884 "DFC_FrAMotor_11_TO" 885 "DFC_FrAMotor_12ISigGroup_Motor_12_TO" 886 "DFC_FrAMotor_12_TO" 887 "DFC_FrAMotor_14ISigGroup_Motor_14_TO" 888 "DFC_FrAMotor_14_TO" 889 "DFC_FrAMotor_16_TO" 890 "DFC_FrAMotor_17_TO" 891 "DFC_FrAMotor_18_TO" 892 "DFC_FrAMotor_20ISigGroup_Motor_20_TO" 893 "DFC_FrAMotor_20_TO" 894 "DFC_FrAMotor_27ISigGroup_Motor_27_TO" 895 "DFC_FrAMotor_27_TO" 896 "DFC_FrAMotor_28ISigGroup_Motor_28_TO" 897 "DFC_FrAMotor_28_TO" 898 "DFC_FrAMotor_35_TO" 899 "DFC_FrAMotor_38_LB_TO" 900 "DFC_FrAMotor_47_TO" 901 "DFC_FrAMotor_Code_01ISigGroup_Motor_Code_01_TO" 902 "DFC_FrAMotor_Code_01_TO" 903 "DFC_FrAMotor_Hybrid_11_TO" 904 "DFC_FrAMotor_TS_01ISigGroup_Motor_TS_01_TO" 905 "DFC_FrAMotor_TS_01_TO" 906 "DFC_FrAMotor_TS_02ISigGroup_Motor_TS_02_TO" 907 "DFC_FrAMotor_TS_02_TO" 908 "DFC_FrAMotor_TS_03ISigGroup_Motor_TS_03_TO" 909 "DFC_FrAMotor_TS_03_TO" 910 "DFC_FrANVEM_02_TO" 911 "DFC_FrANVEM_05_TO" 912 "DFC_FrAOBD_01_TO" 913 "DFC_FrAOBD_02_TO" 914 "DFC_FrASARA_06ISigGroup_SARA_06_TO" 915 "DFC_FrASARA_06_TO" 916 "DFC_FrASysteminfo_01_TO" 917 "DFC_FrATSG_FT_02ISigGroup_TSG_FT_02_TO" 918 "DFC_FrATSG_FT_02_TO" 919 "DFC_FrATSK_06ISigGroup_TSK_06_TO" 920 "DFC_FrATSK_06_TO" 921 "DFC_FrATSK_08ISigGroup_TSK_08_TO" 922 "DFC_FrATSK_08_TO" 923 "DFC_FrAVIN_01_0_TO" 924 "DFC_FrAVIN_01_1_TO" 925 "DFC_FrAVIN_01_2_TO" 926 "DFC_IPT" 927 "DFC_L3Error" 928 "DFC_SftyCfgMon" 929 "DFC_SftyShtOff" 930 "DFC_DsmTest4" 931 "DFC_BSWM_E_ACTION_FAILED" 932 "DFC_BSWM_E_INTRPTQUEUE_FULL" 933 "DFC_CANSM_E_BUS_OFF_NETWORK_0" 934 "DFC_CANSM_E_BUS_OFF_NETWORK_1" 935 "DFC_CANSM_E_BUS_OFF_NETWORK_2" 936 "DFC_CANSM_E_BUS_OFF_NETWORK_3" 937 "DFC_FRSM_E_CLUSTER_STARTUP" 938 "DFC_FRTRCV_E_NO_TRCV_CONTROL_0" 939 "DFC_FR_E_ACCESS" 940 "DFC_RBA_IOEXTLIB_KEEPALIVE_DRV" 941 "DFC_RBA_IOEXTLIB_KEEPALIVE_INI" 942 "DFC_rba_MultiStackTrace_Threshold" 943 "DFC_CAN_E_TIMEOUT" 944 "DFC_FRSM_E_CLUSTER_SYNC_LOSS" 945 "DFC_PDUR_E_INIT_FAILED" 946 "DFC_PDUR_E_PDU_INSTANCE_LOST" 947 "DFC_rba_IoSigRtc_StopCounter" 948 "DFC_rba_T15_Diag_ComInVld_Event" 949 "DFC_rba_T15_Diag_ComOff_HwOn_Event" 950 "DFC_rba_T15_Diag_ComOn_HwOff_Event" 951 "DFC_DSMDummy" 952 "DFC_DsmTest3";
VAL_ 2041 GAC_GAC_EOLPosnLC_StatePosnGracC 0 "GAC_Undefined" 1 "GAC_PositiveInGear" 2 "GAC_PositiveNowhere" 3 "GAC_InNeutral" 4 "GAC_NegativeNowhere" 5 "GAC_NegativeInGear";
VAL_ 2041 DFES_numDFC_05_ 0 "DFC_Unused" 1 "DFC_DsmTest2" 2 "DFC_Can0Getriebe_01" 3 "DFC_Can0Motor_01_CHK" 4 "DFC_Can0Motor_01_CNT" 5 "DFC_Can0Motor_01_DLC" 6 "DFC_Can0Motor_02_CHK" 7 "DFC_Can0Motor_02_CNT" 8 "DFC_Can0Motor_02_DLC" 9 "DFC_Can0Motor_03_CHK" 10 "DFC_Can0Motor_03_CNT" 11 "DFC_Can0Motor_03_DLC" 12 "DFC_Can1BYPASS_TDG1_11_DLC" 13 "DFC_Can1BYPASS_TDG1_12_DLC" 14 "DFC_Can1BYPASS_TDG1_13_DLC" 15 "DFC_Can1BYPASS_TDG1_14_DLC" 16 "DFC_Can1BYPASS_TDG1_15_DLC" 17 "DFC_Can1BYPASS_TDG1_16_PlaceHolder_DLC" 18 "DFC_Can1BYPASS_TDG1_17_PlaceHolder_DLC" 19 "DFC_Can1BYPASS_TDG1_18_PlaceHolder_DLC" 20 "DFC_Can1BYPASS_TDG1_19_Placeholder_DLC" 21 "DFC_Can1BYPASS_TDG1_20_Placeholder_DLC" 22 "DFC_Can1BYPASS_TDG1_21_DLC" 23 "DFC_Can1BYPASS_TDG1_22_DLC" 24 "DFC_Can1BYPASS_TDG1_AA" 25 "DFC_Can1BYPASS_TDG1_AB" 26 "DFC_Can1BYPASS_TDG1_AC" 27 "DFC_Can1BYPASS_TDG1_AD" 28 "DFC_Can1BYPASS_TDG1_AE" 29 "DFC_Can1BYPASS_TDG1_AF" 30 "DFC_Can1BYPASS_TDG1_BA" 31 "DFC_Can1BYPASS_TDG1_BB" 32 "DFC_Can1BYPASS_TDG1_BC" 33 "DFC_Can1BYPASS_TDG1_BD" 34 "DFC_Can1BYPASS_TDG1_BE_PlaceHolder" 35 "DFC_Can1BYPASS_TDG1_BF_PlaceHolder" 36 "DFC_Can1BYPASS_TDG1_CA_PlaceHolder" 37 "DFC_Can1BYPASS_TDG1_CB_PlaceHolder" 38 "DFC_Can1BYPASS_TDG1_CC_PlaceHolder" 39 "DFC_Can1Cool_Act_Cmd" 40 "DFC_Can1Cool_Act_Sts_DLC" 41 "DFC_DsmTest1" 42 "DFC_FrAACC_06ISigGroup_ACC_06_CHK" 43 "DFC_FrAACC_06ISigGroup_ACC_06_CNT" 44 "DFC_FrAACC_07ISigGroup_ACC_07_CHK" 45 "DFC_FrAACC_07ISigGroup_ACC_07_CNT" 46 "DFC_FrAAirbag_01ISigGroup_Airbag_01_CHK" 47 "DFC_FrAAirbag_01ISigGroup_Airbag_01_CNT" 48 "DFC_FrAAirbag_02ISigGroup_Airbag_02_CHK" 49 "DFC_FrAAirbag_02ISigGroup_Airbag_02_CNT" 50 "DFC_FrABremse_EV_01ISigGroup_Bremse_EV_01_CHK" 51 "DFC_FrABremse_EV_01ISigGroup_Bremse_EV_01_CNT" 52 "DFC_FrABremse_EV_02ISigGroup_Bremse_EV_02_CHK" 53 "DFC_FrABremse_EV_02ISigGroup_Bremse_EV_02_CNT" 54 "DFC_FrAEBKV_01ISigGroup_EBKV_01_CHK" 55 "DFC_FrAEBKV_01ISigGroup_EBKV_01_CNT" 56 "DFC_FrAEM1_HYB_12ISigGroup_EM1_HYB_12_CHK" 57 "DFC_FrAEM1_HYB_12ISigGroup_EM1_HYB_12_CNT" 58 "DFC_FrAEPB_01ISigGroup_EPB_01_CHK" 59 "DFC_FrAEPB_01ISigGroup_EPB_01_CNT" 60 "DFC_FrAESP_03ISigGroup_ESP_03_CHK" 61 "DFC_FrAESP_03ISigGroup_ESP_03_CNT" 62 "DFC_FrAESP_05ISigGroup_ESP_05_CHK" 63 "DFC_FrAESP_05ISigGroup_ESP_05_CNT" 64 "DFC_FrAESP_07ISigGroup_ESP_07_CHK" 65 "DFC_FrAESP_07ISigGroup_ESP_07_CNT" 66 "DFC_FrAESP_08ISigGroup_ESP_08_CHK" 67 "DFC_FrAESP_08ISigGroup_ESP_08_CNT" 68 "DFC_FrAESP_15ISigGroup_ESP_15_CHK" 69 "DFC_FrAESP_15ISigGroup_ESP_15_CNT" 70 "DFC_FrAESP_20ISigGroup_ESP_20_CHK" 71 "DFC_FrAESP_20ISigGroup_ESP_20_CNT" 72 "DFC_FrAESP_21ISigGroup_ESP_21_CHK" 73 "DFC_FrAESP_21ISigGroup_ESP_21_CNT" 74 "DFC_FrAESP_22ISigGroup_ESP_22_CHK" 75 "DFC_FrAESP_22ISigGroup_ESP_22_CNT" 76 "DFC_FrAESP_23ISigGroup_ESP_23_CHK" 77 "DFC_FrAESP_23ISigGroup_ESP_23_CNT" 78 "DFC_FrAESP_24ISigGroup_ESP_24_CHK" 79 "DFC_FrAESP_24ISigGroup_ESP_24_CNT" 80 "DFC_FrAESP_28ISigGroup_ESP_28_CHK" 81 "DFC_FrAESP_28ISigGroup_ESP_28_CNT" 82 "DFC_FrAESP_31ISigGroup_ESP_31_CHK" 83 "DFC_FrAESP_31ISigGroup_ESP_31_CNT" 84 "DFC_FrAESP_32ISigGroup_ESP_32_CHK" 85 "DFC_FrAESP_32ISigGroup_ESP_32_CNT" 86 "DFC_FrAESP_33ISigGroup_ESP_33_CHK" 87 "DFC_FrAESP_33ISigGroup_ESP_33_CNT" 88 "DFC_FrAESP_41ISigGroup_ESP_41_CHK" 89 "DFC_FrAESP_41ISigGroup_ESP_41_CNT" 90 "DFC_FrAESP_44ISigGroup_ESP_44_CHK" 91 "DFC_FrAESP_44ISigGroup_ESP_44_CNT" 92 "DFC_FrAGetriebe_11" 93 "DFC_FrAGetriebe_12" 94 "DFC_FrAGetriebe_13" 95 "DFC_FrAGetriebe_14" 96 "DFC_FrAGetriebe_15" 97 "DFC_FrAGetriebe_16" 98 "DFC_FrAGetriebe_17" 99 "DFC_FrAGetriebe_18" 100 "DFC_FrAGetriebe_HYB_12" 101 "DFC_FrAKN_Getriebe" 102 "DFC_FrAKlemmen_Status_01ISigGroup_Klemmen_Status_01_CHK" 103 "DFC_FrAKlemmen_Status_01ISigGroup_Klemmen_Status_01_CNT" 104 "DFC_FrALCV_01ISigGroup_LCV_01_CHK" 105 "DFC_FrALCV_01ISigGroup_LCV_01_CNT" 106 "DFC_FrALWI_01ISigGroup_LWI_01_CHK" 107 "DFC_FrALWI_01ISigGroup_LWI_01_CNT" 108 "DFC_FrAMotor_11ISigGroup_Motor_11_CHK" 109 "DFC_FrAMotor_11ISigGroup_Motor_11_CNT" 110 "DFC_FrAMotor_12ISigGroup_Motor_12_CHK" 111 "DFC_FrAMotor_12ISigGroup_Motor_12_CNT" 112 "DFC_FrAMotor_14ISigGroup_Motor_14_CHK" 113 "DFC_FrAMotor_14ISigGroup_Motor_14_CNT" 114 "DFC_FrAMotor_20ISigGroup_Motor_20_CHK" 115 "DFC_FrAMotor_20ISigGroup_Motor_20_CNT" 116 "DFC_FrAMotor_27ISigGroup_Motor_27_CHK" 117 "DFC_FrAMotor_27ISigGroup_Motor_27_CNT" 118 "DFC_FrAMotor_28ISigGroup_Motor_28_CHK" 119 "DFC_FrAMotor_28ISigGroup_Motor_28_CNT" 120 "DFC_FrAMotor_Code_01ISigGroup_Motor_Code_01_CHK" 121 "DFC_FrAMotor_Code_01ISigGroup_Motor_Code_01_CNT" 122 "DFC_FrAMotor_TS_01ISigGroup_Motor_TS_01_CHK" 123 "DFC_FrAMotor_TS_01ISigGroup_Motor_TS_01_CNT" 124 "DFC_FrAMotor_TS_02ISigGroup_Motor_TS_02_CHK" 125 "DFC_FrAMotor_TS_02ISigGroup_Motor_TS_02_CNT" 126 "DFC_FrAMotor_TS_03ISigGroup_Motor_TS_03_CHK" 127 "DFC_FrAMotor_TS_03ISigGroup_Motor_TS_03_CNT" 128 "DFC_FrASARA_06ISigGroup_SARA_06_CHK" 129 "DFC_FrASARA_06ISigGroup_SARA_06_CNT" 130 "DFC_FrATSG_FT_02ISigGroup_TSG_FT_02_CHK" 131 "DFC_FrATSG_FT_02ISigGroup_TSG_FT_02_CNT" 132 "DFC_FrATSK_06ISigGroup_TSK_06_CHK" 133 "DFC_FrATSK_06ISigGroup_TSK_06_CNT" 134 "DFC_FrATSK_08ISigGroup_TSK_08_CHK" 135 "DFC_FrATSK_08ISigGroup_TSK_08_CNT" 136 "DFC_FrAWBA_03" 137 "DFC_AdcBkg" 138 "DFC_Adc_Rdnt_0" 139 "DFC_Adc_Rdnt_1" 140 "DFC_Adc_Rdnt_2" 141 "DFC_Adc_Rdnt_3" 142 "DFC_Adc_Rdnt_4" 143 "DFC_Adc_Rdnt_5" 144 "DFC_Adc_Rdnt_6" 145 "DFC_Adc_Rdnt_7" 146 "DFC_Adc_Rdnt_8" 147 "DFC_Adc_Rdnt_9" 148 "DFC_Adc_SB_0" 149 "DFC_Adc_SB_1" 150 "DFC_Adc_SB_2" 151 "DFC_Adc_SB_3" 152 "DFC_Adc_SB_4" 153 "DFC_Adc_SB_5" 154 "DFC_Adc_SB_6" 155 "DFC_Adc_SB_7" 156 "DFC_Adc_SB_8" 157 "DFC_Adc_SB_9" 158 "DFC_Adc_SG_0" 159 "DFC_Adc_SG_1" 160 "DFC_Adc_SG_2" 161 "DFC_Adc_SG_3" 162 "DFC_Adc_SG_4" 163 "DFC_Adc_SG_5" 164 "DFC_Adc_SG_6" 165 "DFC_Adc_SG_7" 166 "DFC_Adc_SG_8" 167 "DFC_Adc_SG_9" 168 "DFC_Adc_Unit" 169 "DFC_BattSply_UHi" 170 "DFC_BattSply_ULo" 171 "DFC_CpuTemp" 172 "DFC_CrntCtrl_Channel_0" 173 "DFC_CrntCtrl_Channel_1" 174 "DFC_CrntCtrl_Channel_2" 175 "DFC_CrntCtrl_Channel_3" 176 "DFC_CrntCtrl_Channel_4" 177 "DFC_CrntCtrl_Channel_5" 178 "DFC_CrntCtrl_Channel_6" 179 "DFC_CrntCtrl_Channel_7" 180 "DFC_CrntCtrl_Channel_8" 181 "DFC_CrntCtrl_Channel_9" 182 "DFC_CrntCtrl_Channel_10" 183 "DFC_CrntCtrl_Channel_11" 184 "DFC_CrntCtrl_Channel_12" 185 "DFC_CrntCtrl_Channel_13" 186 "DFC_CrntCtrl_Channel_14" 187 "DFC_CrntCtrl_Channel_15" 188 "DFC_CrntCtrl_Channel_16" 189 "DFC_CrntCtrl_Channel_17" 190 "DFC_CrntCtrl_Channel_18" 191 "DFC_CrntCtrl_Channel_19" 192 "DFC_CrntCtrl_CrntMon_0" 193 "DFC_CrntCtrl_CrntMon_1" 194 "DFC_CrntCtrl_CrntMon_2" 195 "DFC_CrntCtrl_CrntMon_3" 196 "DFC_CrntCtrl_CrntMon_4" 197 "DFC_CrntCtrl_CrntMon_5" 198 "DFC_CrntCtrl_CrntMon_6" 199 "DFC_CrntCtrl_CrntMon_7" 200 "DFC_CrntCtrl_CrntMon_8" 201 "DFC_CrntCtrl_CrntMon_9" 202 "DFC_CrntCtrl_CrntMon_10" 203 "DFC_CrntCtrl_CrntMon_11" 204 "DFC_CrntCtrl_CrntMon_12" 205 "DFC_CrntCtrl_CrntMon_13" 206 "DFC_CrntCtrl_CrntMon_14" 207 "DFC_CrntCtrl_CrntMon_15" 208 "DFC_CrntCtrl_CrntMon_16" 209 "DFC_CrntCtrl_CrntMon_17" 210 "DFC_CrntCtrl_CrntMon_18" 211 "DFC_CrntCtrl_CrntMon_19" 212 "DFC_CrntCtrl_OP_0" 213 "DFC_CrntCtrl_OP_1" 214 "DFC_CrntCtrl_OP_2" 215 "DFC_CrntCtrl_OP_3" 216 "DFC_CrntCtrl_OP_4" 217 "DFC_CrntCtrl_OP_5" 218 "DFC_CrntCtrl_OP_6" 219 "DFC_CrntCtrl_OP_7" 220 "DFC_CrntCtrl_OP_8" 221 "DFC_CrntCtrl_OP_9" 222 "DFC_CrntCtrl_OP_10" 223 "DFC_CrntCtrl_OP_11" 224 "DFC_CrntCtrl_OP_12" 225 "DFC_CrntCtrl_OP_13" 226 "DFC_CrntCtrl_OP_14" 227 "DFC_CrntCtrl_OP_15" 228 "DFC_CrntCtrl_OP_16" 229 "DFC_CrntCtrl_OP_17" 230 "DFC_CrntCtrl_OP_18" 231 "DFC_CrntCtrl_OP_19" 232 "DFC_CrntCtrl_SB_0" 233 "DFC_CrntCtrl_SB_1" 234 "DFC_CrntCtrl_SB_2" 235 "DFC_CrntCtrl_SB_3" 236 "DFC_CrntCtrl_SB_4" 237 "DFC_CrntCtrl_SB_5" 238 "DFC_CrntCtrl_SB_6" 239 "DFC_CrntCtrl_SB_7" 240 "DFC_CrntCtrl_SB_8" 241 "DFC_CrntCtrl_SB_9" 242 "DFC_CrntCtrl_SB_10" 243 "DFC_CrntCtrl_SB_11" 244 "DFC_CrntCtrl_SB_12" 245 "DFC_CrntCtrl_SB_13" 246 "DFC_CrntCtrl_SB_14" 247 "DFC_CrntCtrl_SB_15" 248 "DFC_CrntCtrl_SB_16" 249 "DFC_CrntCtrl_SB_17" 250 "DFC_CrntCtrl_SB_18" 251 "DFC_CrntCtrl_SB_19" 252 "DFC_CrntCtrl_SG_0" 253 "DFC_CrntCtrl_SG_1" 254 "DFC_CrntCtrl_SG_2" 255 "DFC_CrntCtrl_SG_3" 256 "DFC_CrntCtrl_SG_4" 257 "DFC_CrntCtrl_SG_5" 258 "DFC_CrntCtrl_SG_6" 259 "DFC_CrntCtrl_SG_7" 260 "DFC_CrntCtrl_SG_8" 261 "DFC_CrntCtrl_SG_9" 262 "DFC_CrntCtrl_SG_10" 263 "DFC_CrntCtrl_SG_11" 264 "DFC_CrntCtrl_SG_12" 265 "DFC_CrntCtrl_SG_13" 266 "DFC_CrntCtrl_SG_14" 267 "DFC_CrntCtrl_SG_15" 268 "DFC_CrntCtrl_SG_16" 269 "DFC_CrntCtrl_SG_17" 270 "DFC_CrntCtrl_SG_18" 271 "DFC_CrntCtrl_SG_19" 272 "DFC_CrntCtrl_Unit_0" 273 "DFC_CrntCtrl_Unit_1" 274 "DFC_CtrlMot_DNR_0" 275 "DFC_CtrlMot_DNR_1" 276 "DFC_CtrlMot_OC_0" 277 "DFC_CtrlMot_OC_1" 278 "DFC_CtrlMot_OL_0" 279 "DFC_CtrlMot_OL_1" 280 "DFC_CtrlMot_SB_0" 281 "DFC_CtrlMot_SB_1" 282 "DFC_CtrlMot_SG_0" 283 "DFC_CtrlMot_SG_1" 284 "DFC_Flx_AdcInUnit_0" 285 "DFC_Flx_AdcInUnit_1" 286 "DFC_Flx_AdcInUnit_2" 287 "DFC_Flx_RMeasUnit_0" 288 "DFC_Flx_RMeasUnit_1" 289 "DFC_Flx_SB_0" 290 "DFC_Flx_SB_1" 291 "DFC_Flx_SB_2" 292 "DFC_Flx_SB_3" 293 "DFC_Flx_SB_4" 294 "DFC_Flx_SB_5" 295 "DFC_Flx_SB_6" 296 "DFC_Flx_SB_7" 297 "DFC_Flx_SB_8" 298 "DFC_Flx_SB_9" 299 "DFC_Flx_SB_10" 300 "DFC_Flx_SB_11" 301 "DFC_Flx_SB_12" 302 "DFC_Flx_SB_13" 303 "DFC_Flx_SB_14" 304 "DFC_Flx_SB_15" 305 "DFC_Flx_SB_16" 306 "DFC_Flx_SB_17" 307 "DFC_Flx_SB_18" 308 "DFC_Flx_SB_19" 309 "DFC_Flx_SB_20" 310 "DFC_Flx_SB_21" 311 "DFC_Flx_SB_22" 312 "DFC_Flx_SB_23" 313 "DFC_Flx_SB_24" 314 "DFC_Flx_SB_25" 315 "DFC_Flx_SB_26" 316 "DFC_Flx_SG_0" 317 "DFC_Flx_SG_1" 318 "DFC_Flx_SG_2" 319 "DFC_Flx_SG_3" 320 "DFC_Flx_SG_4" 321 "DFC_Flx_SG_5" 322 "DFC_Flx_SG_6" 323 "DFC_Flx_SG_7" 324 "DFC_Flx_SG_8" 325 "DFC_Flx_SG_9" 326 "DFC_Flx_SG_10" 327 "DFC_Flx_SG_11" 328 "DFC_Flx_SG_12" 329 "DFC_Flx_SG_13" 330 "DFC_Flx_SG_14" 331 "DFC_Flx_SG_15" 332 "DFC_Flx_SG_16" 333 "DFC_Flx_SG_17" 334 "DFC_Flx_SG_18" 335 "DFC_Flx_SG_19" 336 "DFC_Flx_SG_20" 337 "DFC_Flx_SG_21" 338 "DFC_Flx_SG_22" 339 "DFC_Flx_SG_23" 340 "DFC_Flx_SG_24" 341 "DFC_Flx_SG_25" 342 "DFC_Flx_SG_26" 343 "DFC_Flx_Sig_0" 344 "DFC_Flx_Sig_1" 345 "DFC_Flx_Sig_2" 346 "DFC_Flx_Sig_3" 347 "DFC_Flx_Sig_4" 348 "DFC_Flx_Sig_5" 349 "DFC_Flx_Sig_6" 350 "DFC_Flx_Sig_7" 351 "DFC_Flx_Sig_8" 352 "DFC_Flx_Sig_9" 353 "DFC_Flx_Sig_10" 354 "DFC_Flx_Sig_11" 355 "DFC_Flx_Sig_12" 356 "DFC_Flx_Sig_13" 357 "DFC_Flx_Sig_14" 358 "DFC_Flx_Sig_15" 359 "DFC_Flx_Sig_16" 360 "DFC_Flx_Sig_17" 361 "DFC_Flx_Sig_18" 362 "DFC_Flx_Sig_19" 363 "DFC_Flx_Sig_20" 364 "DFC_Flx_Sig_21" 365 "DFC_Flx_Sig_22" 366 "DFC_Flx_Sig_23" 367 "DFC_Flx_Sig_24" 368 "DFC_Flx_Sig_25" 369 "DFC_Flx_Sig_26" 370 "DFC_Gtm_Clk" 371 "DFC_HiSide_OP_0" 372 "DFC_HiSide_OP_1" 373 "DFC_HiSide_OP_2" 374 "DFC_HiSide_OP_3" 375 "DFC_HiSide_OP_4" 376 "DFC_HiSide_OP_5" 377 "DFC_HiSide_SB_0" 378 "DFC_HiSide_SB_1" 379 "DFC_HiSide_SB_2" 380 "DFC_HiSide_SB_3" 381 "DFC_HiSide_SB_4" 382 "DFC_HiSide_SB_5" 383 "DFC_HiSide_SG_0" 384 "DFC_HiSide_SG_1" 385 "DFC_HiSide_SG_2" 386 "DFC_HiSide_SG_3" 387 "DFC_HiSide_SG_4" 388 "DFC_HiSide_SG_5" 389 "DFC_IntSply_0" 390 "DFC_IntSply_1" 391 "DFC_IntSply_2" 392 "DFC_IntSply_3" 393 "DFC_IntSply_4" 394 "DFC_IntSply_5" 395 "DFC_IntTemp" 396 "DFC_LssRly_OL" 397 "DFC_LssRly_SB" 398 "DFC_LssRly_SG" 399 "DFC_Lss_OL_0" 400 "DFC_Lss_OL_1" 401 "DFC_Lss_OL_2" 402 "DFC_Lss_OL_3" 403 "DFC_Lss_OL_4" 404 "DFC_Lss_OL_5" 405 "DFC_Lss_OL_6" 406 "DFC_Lss_OL_7" 407 "DFC_Lss_OL_8" 408 "DFC_Lss_OL_9" 409 "DFC_Lss_OL_10" 410 "DFC_Lss_OL_11" 411 "DFC_Lss_SB_0" 412 "DFC_Lss_SB_1" 413 "DFC_Lss_SB_2" 414 "DFC_Lss_SB_3" 415 "DFC_Lss_SB_4" 416 "DFC_Lss_SB_5" 417 "DFC_Lss_SB_6" 418 "DFC_Lss_SB_7" 419 "DFC_Lss_SB_8" 420 "DFC_Lss_SB_9" 421 "DFC_Lss_SB_10" 422 "DFC_Lss_SB_11" 423 "DFC_Lss_SG_0" 424 "DFC_Lss_SG_1" 425 "DFC_Lss_SG_2" 426 "DFC_Lss_SG_3" 427 "DFC_Lss_SG_4" 428 "DFC_Lss_SG_5" 429 "DFC_Lss_SG_6" 430 "DFC_Lss_SG_7" 431 "DFC_Lss_SG_8" 432 "DFC_Lss_SG_9" 433 "DFC_Lss_SG_10" 434 "DFC_Lss_SG_11" 435 "DFC_Lss_Unit" 436 "DFC_OsTmrMon" 437 "DFC_PwmIn_GtmTim_0" 438 "DFC_PwmIn_GtmTim_1" 439 "DFC_PwmIn_GtmTim_2" 440 "DFC_PwmIn_GtmTim_3" 441 "DFC_PwmIn_GtmTim_4" 442 "DFC_PwmIn_GtmTim_5" 443 "DFC_PwmIn_GtmTim_6" 444 "DFC_PwmIn_GtmTim_7" 445 "DFC_PwmIn_GtmTim_8" 446 "DFC_PwmIn_GtmTim_9" 447 "DFC_PwmIn_GtmTim_10" 448 "DFC_PwmIn_GtmTim_11" 449 "DFC_PwmIn_SB_0" 450 "DFC_PwmIn_SB_1" 451 "DFC_PwmIn_SB_2" 452 "DFC_PwmIn_SB_3" 453 "DFC_PwmIn_SB_4" 454 "DFC_PwmIn_SB_5" 455 "DFC_PwmIn_SB_6" 456 "DFC_PwmIn_SB_7" 457 "DFC_PwmIn_SB_8" 458 "DFC_PwmIn_SB_9" 459 "DFC_PwmIn_SB_10" 460 "DFC_PwmIn_SB_11" 461 "DFC_PwmIn_SG_0" 462 "DFC_PwmIn_SG_1" 463 "DFC_PwmIn_SG_2" 464 "DFC_PwmIn_SG_3" 465 "DFC_PwmIn_SG_4" 466 "DFC_PwmIn_SG_5" 467 "DFC_PwmIn_SG_6" 468 "DFC_PwmIn_SG_7" 469 "DFC_PwmIn_SG_8" 470 "DFC_PwmIn_SG_9" 471 "DFC_PwmIn_SG_10" 472 "DFC_PwmIn_SG_11" 473 "DFC_PwmIn_Sig_0" 474 "DFC_PwmIn_Sig_1" 475 "DFC_PwmIn_Sig_2" 476 "DFC_PwmIn_Sig_3" 477 "DFC_PwmIn_Sig_4" 478 "DFC_PwmIn_Sig_5" 479 "DFC_PwmIn_Sig_6" 480 "DFC_PwmIn_Sig_7" 481 "DFC_PwmIn_Sig_8" 482 "DFC_PwmIn_Sig_9" 483 "DFC_PwmIn_Sig_10" 484 "DFC_PwmIn_Sig_11" 485 "DFC_SafeSt_flgDn" 486 "DFC_SnsrSply_SB_0" 487 "DFC_SnsrSply_SB_1" 488 "DFC_SnsrSply_SB_2" 489 "DFC_SnsrSply_SB_3" 490 "DFC_SnsrSply_SB_4" 491 "DFC_SnsrSply_SB_5" 492 "DFC_SnsrSply_SG_0" 493 "DFC_SnsrSply_SG_1" 494 "DFC_SnsrSply_SG_2" 495 "DFC_SnsrSply_SG_3" 496 "DFC_SnsrSply_SG_4" 497 "DFC_SnsrSply_SG_5" 498 "DFC_Spd_NdPls_0" 499 "DFC_Spd_NdPls_1" 500 "DFC_Spd_NdPls_2" 501 "DFC_Spd_NdPls_3" 502 "DFC_Spd_NdPls_4" 503 "DFC_Spd_OP_0" 504 "DFC_Spd_OP_1" 505 "DFC_Spd_OP_2" 506 "DFC_Spd_OP_3" 507 "DFC_Spd_OP_4" 508 "DFC_Spd_Pls_0" 509 "DFC_Spd_Pls_1" 510 "DFC_Spd_Pls_2" 511 "DFC_Spd_Pls_3" 512 "DFC_Spd_Pls_4" 513 "DFC_Spd_SB_0" 514 "DFC_Spd_SB_1" 515 "DFC_Spd_SB_2" 516 "DFC_Spd_SB_3" 517 "DFC_Spd_SB_4" 518 "DFC_Spd_SG_0" 519 "DFC_Spd_SG_1" 520 "DFC_Spd_SG_2" 521 "DFC_Spd_SG_3" 522 "DFC_Spd_SG_4" 523 "DFC_Spd_Sig_0" 524 "DFC_Spd_Sig_1" 525 "DFC_Spd_Sig_2" 526 "DFC_Spd_Sig_3" 527 "DFC_Spd_Sig_4" 528 "DFC_Spd_Sync_0" 529 "DFC_Spd_Sync_1" 530 "DFC_Spd_Sync_2" 531 "DFC_Spd_Sync_3" 532 "DFC_Spd_Sync_4" 533 "DFC_WdgSys" 534 "DFC_WdgWd" 535 "DFC_AcceleratorPedalErrorRx" 536 "DFC_AccumulatorChargeFault" 537 "DFC_AltitudeErrorRx" 538 "DFC_BLDCPumpDerateRx" 539 "DFC_BLDCPumpErrorRx" 540 "DFC_BrakePressureErrorRx" 541 "DFC_BrakeSwitchErrorRx" 542 "DFC_BrakeSwitchImplausible1" 543 "DFC_BrakeSwitchImplausible2" 544 "DFC_BrakeSwitchRateHigh" 545 "DFC_BrakeSwitchSpare1" 546 "DFC_BrakeSwitchSpare2" 547 "DFC_ChargeValveStuck" 548 "DFC_Clutch1AdaptationFault" 549 "DFC_Clutch1OverPressure" 550 "DFC_Clutch1UnderPressure" 551 "DFC_Clutch2AdaptationFault" 552 "DFC_Clutch2OverPressure" 553 "DFC_Clutch2UnderPressure" 554 "DFC_ClutchCoolingValveFault" 555 "DFC_ClutchCoolingValveStuck" 556 "DFC_ClutchOverTempoerature" 557 "DFC_ClutchShutOffValveFault" 558 "DFC_CoolantTempErrorRx" 559 "DFC_CoolingPressureImplausible" 560 "DFC_CoolingPressureRateHigh" 561 "DFC_CoolingPressureTooHigh" 562 "DFC_CoolingPressureTooLow" 563 "DFC_CrntCtrl_Reg_1" 564 "DFC_CrntCtrl_Reg_10" 565 "DFC_CrntCtrl_Reg_11" 566 "DFC_CrntCtrl_Reg_12" 567 "DFC_CrntCtrl_Reg_16" 568 "DFC_CrntCtrl_Reg_17" 569 "DFC_CrntCtrl_Reg_18" 570 "DFC_CrntCtrl_Reg_19" 571 "DFC_CrntCtrl_Reg_2" 572 "DFC_CrntCtrl_Reg_3" 573 "DFC_CrntCtrl_Reg_6" 574 "DFC_CrntCtrl_Reg_7" 575 "DFC_CrntCtrl_Reg_9" 576 "DFC_DSTSpare1" 577 "DFC_DSTSpare2" 578 "DFC_DWCSpare1" 579 "DFC_DWCSpare2" 580 "DFC_DWCSpare3" 581 "DFC_DWCSpare4" 582 "DFC_DWCSpare5" 583 "DFC_DWCSpare6" 584 "DFC_DWCSpare7" 585 "DFC_DoorStatusErrorRx" 586 "DFC_DownSwImplausible" 587 "DFC_DownSwRateHigh" 588 "DFC_DownSwSpare1" 589 "DFC_DownSwSpare2" 590 "DFC_EM1SpeedErrorRx" 591 "DFC_ENGDriveTorqueImplausible" 592 "DFC_ENGEngineProblem" 593 "DFC_ENGIdiotStart" 594 "DFC_ENGSpare1" 595 "DFC_ENGSpare2" 596 "DFC_ESPStatusErrorRx" 597 "DFC_EngineOilTempErrorRx" 598 "DFC_EngineSpeedErrorRx" 599 "DFC_EngineSpeedPWMImplausible1" 600 "DFC_EngineSpeedPWMImplausible2" 601 "DFC_EngineSpeedPWMRateHigh" 602 "DFC_EngineSpeedPWMSpare1" 603 "DFC_EngineSpeedPWMSpare2" 604 "DFC_EngineTorqueErrorRx" 605 "DFC_ExternalTempErrorRx" 606 "DFC_FailStuckNFault" 607 "DFC_FrontLeftWheelSpeedErrorRx" 608 "DFC_FrontRightWheelSpeedErrorRx" 609 "DFC_GearCoolingValveStuck" 610 "DFC_K1PressureImplausible" 611 "DFC_K1PressureRateHigh" 612 "DFC_K1PressureSpare1" 613 "DFC_K1PressureSpare2" 614 "DFC_K1SpeedHigh" 615 "DFC_K1SpeedImplausible" 616 "DFC_K1SpeedSpare1" 617 "DFC_K1SpeedSpare2" 618 "DFC_K2PressureImplausible" 619 "DFC_K2PressureRateHigh" 620 "DFC_K2PressureSpare1" 621 "DFC_K2PressureSpare2" 622 "DFC_K2SpeedHigh" 623 "DFC_K2SpeedImplausible" 624 "DFC_K2SpeedSpare1" 625 "DFC_K2SpeedSpare2" 626 "DFC_L2ClutchPressureVsCurrentOdd" 627 "DFC_L2ClutchTorqueDirection" 628 "DFC_L2DoubleClutchEngagement" 629 "DFC_L2DoubleGearEven" 630 "DFC_L2EM1ShaftOverspeed" 631 "DFC_L2EPBWhenMoving" 632 "DFC_L2EvenClutchGradientInCreep" 633 "DFC_L2ForwardDriveEven" 634 "DFC_L2ForwardDriveOdd" 635 "DFC_L2ForwardGearAndMode" 636 "DFC_L2GearCombinationEM1Overspeed" 637 "DFC_L2GearCombinationRequest" 638 "DFC_L2InputShaftEngineOverspeed" 639 "DFC_L2InsufficientLubrication" 640 "DFC_L2InvalidDownshiftOdd" 641 "DFC_L2InvalidGearControl" 642 "DFC_L2LeaveNeutral" 643 "DFC_L2LeavePark" 644 "DFC_L2ModeDisplay" 645 "DFC_L2ModeSelection" 646 "DFC_L2MovementWithChargeCable" 647 "DFC_L2OddClutchGradientInCreep" 648 "DFC_L2OddShaftAccelerationImplausible" 649 "DFC_L2ParkFailNoEPB" 650 "DFC_L2ParkPosition" 651 "DFC_L2ParkValveOverride" 652 "DFC_L2ParkWhenMoving" 653 "DFC_L2ReferenceSpeedFail" 654 "DFC_L2ReverseDrive" 655 "DFC_L2ShaftOverSpeedFromIP" 656 "DFC_L2ShaftOverSpeedFromOP" 657 "DFC_L2Spare1" 658 "DFC_L2Spare2" 659 "DFC_L2TorqueNoShift" 660 "DFC_L2TorqueRequestCupOfFuel" 661 "DFC_L2VGPOverride" 662 "DFC_L2VKUGLOveride" 663 "DFC_L2VSS1Overirde" 664 "DFC_L2VSS2Overirde" 665 "DFC_LatAccErrorRx" 666 "DFC_LinePressureImplausible" 667 "DFC_LinePressureLeakageHigh" 668 "DFC_LinePressureRateHigh" 669 "DFC_LinePressureSpare1" 670 "DFC_LinePressureSpare2" 671 "DFC_LinePressureTooHigh" 672 "DFC_LinePressureTooLow" 673 "DFC_LongAccErrorRx" 674 "DFC_LubeOilOverTemperature" 675 "DFC_LubeTemperatureImplausible" 676 "DFC_LubeTemperatureRateHigh" 677 "DFC_LubeTemperatureSpare1" 678 "DFC_LubeTemperatureSpare2" 679 "DFC_MOTEngineProblem" 680 "DFC_MOTSpare1" 681 "DFC_MOTSpare2" 682 "DFC_ModeMSwImplausible" 683 "DFC_ModeMSwSpare1" 684 "DFC_ModeMSwSpare2" 685 "DFC_ModeMSwSwRateHigh" 686 "DFC_ModePSwImplausible" 687 "DFC_ModePSwSpare1" 688 "DFC_ModePSwSpare2" 689 "DFC_ModePSwSwRateHigh" 690 "DFC_ModeRSwImplausible" 691 "DFC_ModeRSwSpare1" 692 "DFC_ModeRSwSpare2" 693 "DFC_ModeRSwSwRateHigh" 694 "DFC_ParkLockDisengageFail" 695 "DFC_ParkLockEngageFail" 696 "DFC_ParkLockPosImplausible" 697 "DFC_ParkLockPosRateHigh" 698 "DFC_ParkLockPosSpare1" 699 "DFC_ParkLockPosSpare2" 700 "DFC_PumpResponseFault" 701 "DFC_PumpSpeedError" 702 "DFC_RearLeftWheelSpeedErrorRx" 703 "DFC_RearRightWheelSpeedErrorRx" 704 "DFC_RedSpeedHigh" 705 "DFC_RedSpeedImplausible" 706 "DFC_RedSpeedSpare1" 707 "DFC_RedSpeedSpare2" 708 "DFC_SEQSpare1" 709 "DFC_SEQSpare2" 710 "DFC_SEQTimeout" 711 "DFC_Spare_0" 712 "DFC_Spare_1" 713 "DFC_Spare_2" 714 "DFC_Spare_3" 715 "DFC_Spare_4" 716 "DFC_Spare_5" 717 "DFC_Spare_6" 718 "DFC_Spare_7" 719 "DFC_Spare_8" 720 "DFC_Spare_9" 721 "DFC_SumpOilOverTemperature" 722 "DFC_SumpTemperatureImplausible" 723 "DFC_SumpTemperatureRateHigh" 724 "DFC_SumpTemperatureSpare1" 725 "DFC_SumpTemperatureSpare2" 726 "DFC_SynchroA1EngageFault" 727 "DFC_SynchroA1SpitoutInShiftFault" 728 "DFC_SynchroA1SpitoutNoShiftFault" 729 "DFC_SynchroA1StuckFault" 730 "DFC_SynchroA2EngageFault" 731 "DFC_SynchroA2SpitoutInShiftFault" 732 "DFC_SynchroA2SpitoutNoShiftFault" 733 "DFC_SynchroA2StuckFault" 734 "DFC_SynchroAOutOfNInShiftFault" 735 "DFC_SynchroAOutOfNNoShiftFault" 736 "DFC_SynchroAPosImplausible" 737 "DFC_SynchroAPosRateHigh" 738 "DFC_SynchroAPosSpare1" 739 "DFC_SynchroAPosSpare2" 740 "DFC_SynchroB1EngageFault" 741 "DFC_SynchroB1SpitoutInShiftFault" 742 "DFC_SynchroB1SpitoutNoShiftFault" 743 "DFC_SynchroB1StuckFault" 744 "DFC_SynchroB2EngageFault" 745 "DFC_SynchroB2SpitoutInShiftFault" 746 "DFC_SynchroB2SpitoutNoShiftFault" 747 "DFC_SynchroB2StuckFault" 748 "DFC_SynchroBOutOfNInShiftFault" 749 "DFC_SynchroBOutOfNNoShiftFault" 750 "DFC_SynchroBPosImplausible" 751 "DFC_SynchroBPosRateHigh" 752 "DFC_SynchroBPosSpare1" 753 "DFC_SynchroBPosSpare2" 754 "DFC_SynchroC1EngageFault" 755 "DFC_SynchroC1SpitoutInShiftFault" 756 "DFC_SynchroC1SpitoutNoShiftFault" 757 "DFC_SynchroC1StuckFault" 758 "DFC_SynchroC2EngageFault" 759 "DFC_SynchroC2SpitoutInShiftFault" 760 "DFC_SynchroC2SpitoutNoShiftFault" 761 "DFC_SynchroC2StuckFault" 762 "DFC_SynchroCOutOfNInShiftFault" 763 "DFC_SynchroCOutOfNNoShiftFault" 764 "DFC_SynchroCPosImplausible" 765 "DFC_SynchroCPosRateHigh" 766 "DFC_SynchroCPosSpare1" 767 "DFC_SynchroCPosSpare2" 768 "DFC_SynchroD1EngageFault" 769 "DFC_SynchroD1SpitoutInShiftFault" 770 "DFC_SynchroD1SpitoutNoShiftFault" 771 "DFC_SynchroD1StuckFault" 772 "DFC_SynchroDOutOfNInShiftFault" 773 "DFC_SynchroDOutOfNNoShiftFault" 774 "DFC_SynchroDPosImplausible" 775 "DFC_SynchroDPosRateHigh" 776 "DFC_SynchroDPosSpare1" 777 "DFC_SynchroDPosSpare2" 778 "DFC_SynchroF1EngageFault" 779 "DFC_SynchroF1SpitoutInShiftFault" 780 "DFC_SynchroF1SpitoutNoShiftFault" 781 "DFC_SynchroF1StuckFault" 782 "DFC_SynchroF2EngageFault" 783 "DFC_SynchroF2SpitoutInShiftFault" 784 "DFC_SynchroF2SpitoutNoShiftFault" 785 "DFC_SynchroF2StuckFault" 786 "DFC_SynchroFOutOfNInShiftFault" 787 "DFC_SynchroFOutOfNNoShiftFault" 788 "DFC_SynchroFPosImplausible" 789 "DFC_SynchroFPosRateHigh" 790 "DFC_SynchroFPosSpare1" 791 "DFC_SynchroFPosSpare2" 792 "DFC_UpSwImplausible" 793 "DFC_UpSwRateHigh" 794 "DFC_UpSwSpare1" 795 "DFC_UpSwSpare2" 796 "DFC_VehicleSpeedErrorRx" 797 "DFC_WheelTorqueESPErrorRx" 798 "DFC_YawRateErrorRx" 799 "DFC_Can0Motor_01_TO" 800 "DFC_Can0Motor_02_TO" 801 "DFC_Can0Motor_03_TO" 802 "DFC_Can1BYPASS_TDG1_11_TO" 803 "DFC_Can1BYPASS_TDG1_12_TO" 804 "DFC_Can1BYPASS_TDG1_13_TO" 805 "DFC_Can1BYPASS_TDG1_14_TO" 806 "DFC_Can1BYPASS_TDG1_15_TO" 807 "DFC_Can1BYPASS_TDG1_16_PlaceHolder_TO" 808 "DFC_Can1BYPASS_TDG1_17_PlaceHolder_TO" 809 "DFC_Can1BYPASS_TDG1_18_PlaceHolder_TO" 810 "DFC_Can1BYPASS_TDG1_19_Placeholder_TO" 811 "DFC_Can1BYPASS_TDG1_20_Placeholder_TO" 812 "DFC_Can1BYPASS_TDG1_21_TO" 813 "DFC_Can1BYPASS_TDG1_22_TO" 814 "DFC_Can1Cool_Act_Sts_TO" 815 "DFC_DsmTest0" 816 "DFC_FrAACC_06ISigGroup_ACC_06_TO" 817 "DFC_FrAACC_06_TO" 818 "DFC_FrAACC_07ISigGroup_ACC_07_TO" 819 "DFC_FrAACC_07_TO" 820 "DFC_FrAAirbag_01ISigGroup_Airbag_01_TO" 821 "DFC_FrAAirbag_01_TO" 822 "DFC_FrAAirbag_02ISigGroup_Airbag_02_TO" 823 "DFC_FrAAirbag_02_TO" 824 "DFC_FrABCM_01_TO" 825 "DFC_FrABremse_EV_01ISigGroup_Bremse_EV_01_TO" 826 "DFC_FrABremse_EV_01_TO" 827 "DFC_FrABremse_EV_02ISigGroup_Bremse_EV_02_TO" 828 "DFC_FrABremse_EV_02_TO" 829 "DFC_FrACharisma_01_TO" 830 "DFC_FrADiagnose_01_TO" 831 "DFC_FrAEBKV_01ISigGroup_EBKV_01_TO" 832 "DFC_FrAEBKV_01_TO" 833 "DFC_FrAEM1_HYB_06_TO" 834 "DFC_FrAEM1_HYB_12ISigGroup_EM1_HYB_12_TO" 835 "DFC_FrAEM1_HYB_12_TO" 836 "DFC_FrAEPB_01ISigGroup_EPB_01_TO" 837 "DFC_FrAEPB_01_TO" 838 "DFC_FrAESP_03ISigGroup_ESP_03_TO" 839 "DFC_FrAESP_03_TO" 840 "DFC_FrAESP_05ISigGroup_ESP_05_TO" 841 "DFC_FrAESP_05_TO" 842 "DFC_FrAESP_07ISigGroup_ESP_07_TO" 843 "DFC_FrAESP_07_TO" 844 "DFC_FrAESP_08ISigGroup_ESP_08_TO" 845 "DFC_FrAESP_08_TO" 846 "DFC_FrAESP_15ISigGroup_ESP_15_TO" 847 "DFC_FrAESP_15_TO" 848 "DFC_FrAESP_20ISigGroup_ESP_20_TO" 849 "DFC_FrAESP_20_TO" 850 "DFC_FrAESP_21ISigGroup_ESP_21_TO" 851 "DFC_FrAESP_21_TO" 852 "DFC_FrAESP_22ISigGroup_ESP_22_TO" 853 "DFC_FrAESP_22_TO" 854 "DFC_FrAESP_23ISigGroup_ESP_23_TO" 855 "DFC_FrAESP_23_TO" 856 "DFC_FrAESP_24ISigGroup_ESP_24_TO" 857 "DFC_FrAESP_24_TO" 858 "DFC_FrAESP_26_TO" 859 "DFC_FrAESP_28ISigGroup_ESP_28_TO" 860 "DFC_FrAESP_28_TO" 861 "DFC_FrAESP_31ISigGroup_ESP_31_TO" 862 "DFC_FrAESP_31_TO" 863 "DFC_FrAESP_32ISigGroup_ESP_32_TO" 864 "DFC_FrAESP_32_TO" 865 "DFC_FrAESP_33ISigGroup_ESP_33_TO" 866 "DFC_FrAESP_33_TO" 867 "DFC_FrAESP_41ISigGroup_ESP_41_TO" 868 "DFC_FrAESP_41_TO" 869 "DFC_FrAESP_44ISigGroup_ESP_44_TO" 870 "DFC_FrAESP_44_TO" 871 "DFC_FrAKlemmen_Status_01ISigGroup_Klemmen_Status_01_TO" 872 "DFC_FrAKlemmen_Status_01_TO" 873 "DFC_FrAKlima_11_TO" 874 "DFC_FrAKombi_02_TO" 875 "DFC_FrALCV_01ISigGroup_LCV_01_TO" 876 "DFC_FrALCV_01_TO" 877 "DFC_FrALWI_01ISigGroup_LWI_01_TO" 878 "DFC_FrALWI_01_TO" 879 "DFC_FrAMFL_Tasten_01_TO" 880 "DFC_FrAMSG_EM1_18_TO" 881 "DFC_FrAMSG_EM1_29_TO" 882 "DFC_FrAMotor_07_TO" 883 "DFC_FrAMotor_11ISigGroup_Motor_11_TO" 884 "DFC_FrAMotor_11_TO" 885 "DFC_FrAMotor_12ISigGroup_Motor_12_TO" 886 "DFC_FrAMotor_12_TO" 887 "DFC_FrAMotor_14ISigGroup_Motor_14_TO" 888 "DFC_FrAMotor_14_TO" 889 "DFC_FrAMotor_16_TO" 890 "DFC_FrAMotor_17_TO" 891 "DFC_FrAMotor_18_TO" 892 "DFC_FrAMotor_20ISigGroup_Motor_20_TO" 893 "DFC_FrAMotor_20_TO" 894 "DFC_FrAMotor_27ISigGroup_Motor_27_TO" 895 "DFC_FrAMotor_27_TO" 896 "DFC_FrAMotor_28ISigGroup_Motor_28_TO" 897 "DFC_FrAMotor_28_TO" 898 "DFC_FrAMotor_35_TO" 899 "DFC_FrAMotor_38_LB_TO" 900 "DFC_FrAMotor_47_TO" 901 "DFC_FrAMotor_Code_01ISigGroup_Motor_Code_01_TO" 902 "DFC_FrAMotor_Code_01_TO" 903 "DFC_FrAMotor_Hybrid_11_TO" 904 "DFC_FrAMotor_TS_01ISigGroup_Motor_TS_01_TO" 905 "DFC_FrAMotor_TS_01_TO" 906 "DFC_FrAMotor_TS_02ISigGroup_Motor_TS_02_TO" 907 "DFC_FrAMotor_TS_02_TO" 908 "DFC_FrAMotor_TS_03ISigGroup_Motor_TS_03_TO" 909 "DFC_FrAMotor_TS_03_TO" 910 "DFC_FrANVEM_02_TO" 911 "DFC_FrANVEM_05_TO" 912 "DFC_FrAOBD_01_TO" 913 "DFC_FrAOBD_02_TO" 914 "DFC_FrASARA_06ISigGroup_SARA_06_TO" 915 "DFC_FrASARA_06_TO" 916 "DFC_FrASysteminfo_01_TO" 917 "DFC_FrATSG_FT_02ISigGroup_TSG_FT_02_TO" 918 "DFC_FrATSG_FT_02_TO" 919 "DFC_FrATSK_06ISigGroup_TSK_06_TO" 920 "DFC_FrATSK_06_TO" 921 "DFC_FrATSK_08ISigGroup_TSK_08_TO" 922 "DFC_FrATSK_08_TO" 923 "DFC_FrAVIN_01_0_TO" 924 "DFC_FrAVIN_01_1_TO" 925 "DFC_FrAVIN_01_2_TO" 926 "DFC_IPT" 927 "DFC_L3Error" 928 "DFC_SftyCfgMon" 929 "DFC_SftyShtOff" 930 "DFC_DsmTest4" 931 "DFC_BSWM_E_ACTION_FAILED" 932 "DFC_BSWM_E_INTRPTQUEUE_FULL" 933 "DFC_CANSM_E_BUS_OFF_NETWORK_0" 934 "DFC_CANSM_E_BUS_OFF_NETWORK_1" 935 "DFC_CANSM_E_BUS_OFF_NETWORK_2" 936 "DFC_CANSM_E_BUS_OFF_NETWORK_3" 937 "DFC_FRSM_E_CLUSTER_STARTUP" 938 "DFC_FRTRCV_E_NO_TRCV_CONTROL_0" 939 "DFC_FR_E_ACCESS" 940 "DFC_RBA_IOEXTLIB_KEEPALIVE_DRV" 941 "DFC_RBA_IOEXTLIB_KEEPALIVE_INI" 942 "DFC_rba_MultiStackTrace_Threshold" 943 "DFC_CAN_E_TIMEOUT" 944 "DFC_FRSM_E_CLUSTER_SYNC_LOSS" 945 "DFC_PDUR_E_INIT_FAILED" 946 "DFC_PDUR_E_PDU_INSTANCE_LOST" 947 "DFC_rba_IoSigRtc_StopCounter" 948 "DFC_rba_T15_Diag_ComInVld_Event" 949 "DFC_rba_T15_Diag_ComOff_HwOn_Event" 950 "DFC_rba_T15_Diag_ComOn_HwOff_Event" 951 "DFC_DSMDummy" 952 "DFC_DsmTest3";
