ASAP2_VERSION 1 60
/begin PROJECT LB74x_TCU "5201C535"
/begin HEADER "" VERSION "5201C535" PROJECT_NO LB74x_TCU /end HEADER
/begin MODULE DIM ""
/begin MOD_COMMON "" BYTE_ORDER MSB_LAST ALIGNMENT_BYTE 1 ALIGNMENT_WORD 2 ALIGNMENT_LONG 4 ALIGNMENT_INT64 4 ALIGNMENT_FLOAT32_IEEE 4 ALIGNMENT_FLOAT64_IEEE 4 DATA_SIZE 32 /end MOD_COMMON
/begin CHARACTERISTIC DST_EFLASHB.DST_ModeSelectGeneric.DST_TEMPMANTIME_POSTWHENSTOPPED "" VALUE 0x80606C84 DefaultValueRecordLayout_AUTOSAR_Platform_BaseTypes_uint16 655.35 RB_PT_PCT_SWC_DST_CompuMethods_DST_Time 0.0 655.35 FORMAT "%10.5"
 /begin ANNOTATION ANNOTATION_LABEL "Description (coming from AUTOSAR DESC field)"
  /begin ANNOTATION_TEXT "Normal time in Temporary Manual after single manual shift\r\n" /end ANNOTATION_TEXT
 /end ANNOTATION
/end CHARACTERISTIC
/begin CHARACTERISTIC DST_EFLASHB.DST_ModeSelectGeneric.DST_TEMPMANTIMEMIN_LONGACC "" VALUE 0x80606C7C DefaultValueRecordLayout_AUTOSAR_Platform_BaseTypes_uint16 655.35 RB_PT_PCT_SWC_DST_CompuMethods_DST_Time 0.0 655.35 FORMAT "%10.5"
 /begin ANNOTATION ANNOTATION_LABEL "Description (coming from AUTOSAR DESC field)"
  /begin ANNOTATION_TEXT "Minimum value of temporary manual time remain if accelerating, decelerating or high throttle\r\n" /end ANNOTATION_TEXT
 /end ANNOTATION
/end CHARACTERISTIC
/begin CHARACTERISTIC DST_EFLASHB.DST_ModeSelectGeneric.DST_TEMPMANTIMEMIN_MAPDOWNSHIFT "" VALUE 0x80606C7E DefaultValueRecordLayout_AUTOSAR_Platform_BaseTypes_uint16 655.35 RB_PT_PCT_SWC_DST_CompuMethods_DST_Time 0.0 655.35 FORMAT "%10.5"
 /begin ANNOTATION ANNOTATION_LABEL "Description (coming from AUTOSAR DESC field)"
  /begin ANNOTATION_TEXT "Time to hold temp manual time to if the shift map would request a downshift\r\n" /end ANNOTATION_TEXT
 /end ANNOTATION
/end CHARACTERISTIC
/begin CHARACTERISTIC DST_EFLASHB.DST_ModeSelectGeneric.DST_TEMPMANTIMEMIN_POSTBRAKE "" VAL_BLK 0x8060693C DefaultValueRecordLayout_AUTOSAR_Platform_BaseTypes_uint16 655.35 RB_PT_PCT_SWC_DST_CompuMethods_DST_Time 0.0 655.35 FORMAT "%10.5"
 /begin ANNOTATION ANNOTATION_LABEL "Description (coming from AUTOSAR DESC field)"
  /begin ANNOTATION_TEXT "Min time after the brake pedal is released to maintain temporary manual\r\n" /end ANNOTATION_TEXT
 /end ANNOTATION
 MATRIX_DIM 17 1 1 /end CHARACTERISTIC
/begin CHARACTERISTIC DST_EFLASHB.DST_ModeSelectGeneric.DST_TEMPMANTIMEMIN_POSTLATACC "" VAL_BLK 0x8060695E DefaultValueRecordLayout_AUTOSAR_Platform_BaseTypes_uint16 655.35 RB_PT_PCT_SWC_DST_CompuMethods_DST_Time 0.0 655.35 FORMAT "%10.5"
 /begin ANNOTATION ANNOTATION_LABEL "Description (coming from AUTOSAR DESC field)"
  /begin ANNOTATION_TEXT "Min time after a corner for temporary manual mode to be maintained\r\n" /end ANNOTATION_TEXT
 /end ANNOTATION
 MATRIX_DIM 17 1 1 /end CHARACTERISTIC
/begin CHARACTERISTIC DST_EFLASHB.DST_ModeSelectGeneric.DST_TEMPMANTIMEMIN_POSTZEROTHROTTLE "" VAL_BLK 0x80606980 DefaultValueRecordLayout_AUTOSAR_Platform_BaseTypes_uint16 655.35 RB_PT_PCT_SWC_DST_CompuMethods_DST_Time 0.0 655.35 FORMAT "%10.5"
 /begin ANNOTATION ANNOTATION_LABEL "Description (coming from AUTOSAR DESC field)"
  /begin ANNOTATION_TEXT "Min time after zero throttle that temp manual should be maintained\r\n" /end ANNOTATION_TEXT
 /end ANNOTATION
 MATRIX_DIM 17 1 1 /end CHARACTERISTIC
/begin CHARACTERISTIC DST_EFLASHB.DST_ModeSelectGeneric.DST_TIME_INNBRAKEHOLD "" VALUE 0x80606C98 DefaultValueRecordLayout_AUTOSAR_Platform_BaseTypes_uint16 655.35 RB_PT_PCT_SWC_DST_CompuMethods_DST_Time 0.0 655.35 FORMAT "%10.5"
 /begin ANNOTATION ANNOTATION_LABEL "Description (coming from AUTOSAR DESC field)"
  /begin ANNOTATION_TEXT "Time to hold the shift lock solenoid active when initially selecting Neutral\r\n" /end ANNOTATION_TEXT
 /end ANNOTATION
/end CHARACTERISTIC
/begin CHARACTERISTIC DST_EFLASHB.DST_ModeSelectGeneric.DST_TIMEB4SHIFTLOCKFWDMODE "" VALUE 0x80606C8E DefaultValueRecordLayout_AUTOSAR_Platform_BaseTypes_uint16 655.35 RB_PT_PCT_SWC_DST_CompuMethods_DST_Time 0.0 655.35 FORMAT "%10.5"
 /begin ANNOTATION ANNOTATION_LABEL "Description (coming from AUTOSAR DESC field)" /begin ANNOTATION_TEXT "Time in Neutral before the shift lock becomes active\r\n" /end ANNOTATION_TEXT /end ANNOTATION
/end CHARACTERISTIC
/begin CHARACTERISTIC DST_EFLASHB.DST_ModeSelectGeneric.DST_TIMEB4SHIFTLOCKREVMODE "" VALUE 0x80606C90 DefaultValueRecordLayout_AUTOSAR_Platform_BaseTypes_uint16 655.35 RB_PT_PCT_SWC_DST_CompuMethods_DST_Time 0.0 655.35 FORMAT "%10.5"
 /begin ANNOTATION ANNOTATION_LABEL "Description (coming from AUTOSAR DESC field)" /begin ANNOTATION_TEXT "TIme until shift lock is active when in reverse\r\n" /end ANNOTATION_TEXT /end ANNOTATION
/end CHARACTERISTIC
/begin CHARACTERISTIC DST_EFLASHB.DST_ModeSelectGeneric.DST_TIMEENGINESTOPPEDRESET "" VALUE 0x80606C92 DefaultValueRecordLayout_AUTOSAR_Platform_BaseTypes_uint16 655.35 RB_PT_PCT_SWC_DST_CompuMethods_DST_Time 0.0 655.35 FORMAT "%10.5"
 /begin ANNOTATION ANNOTATION_LABEL "Description (coming from AUTOSAR DESC field)"
  /begin ANNOTATION_TEXT "Time KL15 must be low for Eco to instantly be re-enabled\r\n" /end ANNOTATION_TEXT
 /end ANNOTATION
/end CHARACTERISTIC
/begin CHARACTERISTIC DST_EFLASHB.DST_ModeSelectGeneric.DST_TIMEENGRUNB44ROADDETECTENABLE "" VALUE 0x80606C94 DefaultValueRecordLayout_AUTOSAR_Platform_BaseTypes_uint16 655.35 RB_PT_PCT_SWC_DST_CompuMethods_DST_Time 0.0 655.35 FORMAT "%10.5"
 /begin ANNOTATION ANNOTATION_LABEL "Description (coming from AUTOSAR DESC field)"
  /begin ANNOTATION_TEXT "Time engine must have been running before the road detect timers are allowed to increase\r\n" /end ANNOTATION_TEXT
 /end ANNOTATION
/end CHARACTERISTIC
/begin CHARACTERISTIC DST_EFLASHB.DST_ModeSelectGeneric.DST_TIMEKL15LOW2RESET "" VALUE 0x80606C96 DefaultValueRecordLayout_AUTOSAR_Platform_BaseTypes_uint16 655.35 RB_PT_PCT_SWC_DST_CompuMethods_DST_Time 0.0 655.35 FORMAT "%10.5"
 /begin ANNOTATION ANNOTATION_LABEL "Description (coming from AUTOSAR DESC field)"
  /begin ANNOTATION_TEXT "Time KL15 must be low for Eco to instantly be re-enabled\r\n" /end ANNOTATION_TEXT
 /end ANNOTATION
/end CHARACTERISTIC
/begin CHARACTERISTIC DST_EFLASHB.DST_ModeSelectGeneric.DST_TRANSTEMPOVERHEATRESET "" VALUE 0x80606C9A DefaultValueRecordLayout_AUTOSAR_Platform_BaseTypes_sint16 250.0 RB_PT_PCT_SWC_DST_CompuMethods_ident -50. 200. FORMAT "%10.5"
 /begin ANNOTATION ANNOTATION_LABEL "Description (coming from AUTOSAR DESC field)"
  /begin ANNOTATION_TEXT "Transmission bulk oil temperature to cancel the transmission overheat strategy\r\n" /end ANNOTATION_TEXT
 /end ANNOTATION
/end CHARACTERISTIC
/begin CHARACTERISTIC DST_EFLASHB.DST_ModeSelectGeneric.DST_TRANSTEMPOVERHEATSET "" VALUE 0x80606C9C DefaultValueRecordLayout_AUTOSAR_Platform_BaseTypes_sint16 250.0 RB_PT_PCT_SWC_DST_CompuMethods_ident -50. 200. FORMAT "%10.5"
 /begin ANNOTATION ANNOTATION_LABEL "Description (coming from AUTOSAR DESC field)"
  /begin ANNOTATION_TEXT "Transmission bulk oil temperature to trigger the transmission overheat strategy\r\n" /end ANNOTATION_TEXT
 /end ANNOTATION
/end CHARACTERISTIC
/begin CHARACTERISTIC DST_EFLASHB.DST_ModeSelectGeneric.DST_VEHICLESPEED4DOWNPADDLEENGAGE "" VALUE 0x80606C9E DefaultValueRecordLayout_AUTOSAR_Platform_BaseTypes_uint16 500.0 RB_PT_PCT_SWC_DST_CompuMethods_kph_0p1 0.0 500. FORMAT "%10.5"
 /begin ANNOTATION ANNOTATION_LABEL "Description (coming from AUTOSAR DESC field)"
  /begin ANNOTATION_TEXT "Vehicle speed above which the downshift paddle will engage a forward gear from Neutral\r\n" /end ANNOTATION_TEXT
 /end ANNOTATION
/end CHARACTERISTIC
/begin CHARACTERISTIC DST_EFLASHB.DST_ModeSelectGeneric.DST_VEHICLESPEED4UPPADDLEENGAGE "" VALUE 0x80606CA0 DefaultValueRecordLayout_AUTOSAR_Platform_BaseTypes_uint16 500.0 RB_PT_PCT_SWC_DST_CompuMethods_kph_0p1 0.0 500. FORMAT "%10.5"
 /begin ANNOTATION ANNOTATION_LABEL "Description (coming from AUTOSAR DESC field)"
  /begin ANNOTATION_TEXT "Vehicle speed must be equal to or above this value to allow up-paddle to engage Drive\r\n" /end ANNOTATION_TEXT
 /end ANNOTATION
/end CHARACTERISTIC
/begin CHARACTERISTIC DST_EFLASHB.DST_ModeSelectGeneric.DST_VEHICLESPEEDMAINTAINTEMPMAN "" VALUE 0x80606CA2 DefaultValueRecordLayout_AUTOSAR_Platform_BaseTypes_uint16 500.0 RB_PT_PCT_SWC_DST_CompuMethods_kph_0p1 0.0 500. FORMAT "%10.5"
 /begin ANNOTATION ANNOTATION_LABEL "Description (coming from AUTOSAR DESC field)"
  /begin ANNOTATION_TEXT "Vehicle speed below which the Temp Manual timer will be reset\r\n" /end ANNOTATION_TEXT
 /end ANNOTATION
/end CHARACTERISTIC
/begin CHARACTERISTIC DST_EFLASHB.DST_ModeSelectGeneric.DST_WARMUPBASEDONOIL "" VALUE 0x80606CBD DefaultValueRecordLayout_AUTOSAR_Platform_BaseTypes_boolean 255.0 AUTOSAR_Platform_CompuMethods_boolean 0.0 255. FORMAT "%10.5"
 /begin ANNOTATION ANNOTATION_LABEL "Description (coming from AUTOSAR DESC field)"
  /begin ANNOTATION_TEXT "If true, the warmup temperature thresholds will be compare to engine oil, not coolant temperature\r\n" /end ANNOTATION_TEXT
 /end ANNOTATION
/end CHARACTERISTIC
/begin CHARACTERISTIC DST_EFLASHB.DST_ModeSelectGeneric.DST_WARMUPENGINE_CANCEL "" VAL_BLK 0x80606C18 DefaultValueRecordLayout_AUTOSAR_Platform_BaseTypes_sint16 255.0 RB_PT_PCT_SWC_DST_CompuMethods_ident -60. 195. FORMAT "%10.5"
 /begin ANNOTATION ANNOTATION_LABEL "Description (coming from AUTOSAR DESC field)"
  /begin ANNOTATION_TEXT "Engine tempertuare above which  the warmup will be cancelled\r\n" /end ANNOTATION_TEXT
 /end ANNOTATION
 MATRIX_DIM 6 1 1 /end CHARACTERISTIC
/begin CHARACTERISTIC DST_EFLASHB.DST_ModeSelectGeneric.DST_WARMUPENGINE_MAXTIME "" VAL_BLK 0x80606C24 DefaultValueRecordLayout_AUTOSAR_Platform_BaseTypes_uint16 655.35 RB_PT_PCT_SWC_DST_CompuMethods_DST_Time 0.0 655.35 FORMAT "%10.5"
 /begin ANNOTATION ANNOTATION_LABEL "Description (coming from AUTOSAR DESC field)" /begin ANNOTATION_TEXT "Maximum time the warmup strategy can be active\r\n" /end ANNOTATION_TEXT /end ANNOTATION
 MATRIX_DIM 6 1 1 /end CHARACTERISTIC
/begin CHARACTERISTIC DST_EFLASHB.DST_ModeSelectGeneric.DST_WARMUPENGINE_TRIGGER "" VAL_BLK 0x80606C30 DefaultValueRecordLayout_AUTOSAR_Platform_BaseTypes_sint16 255.0 RB_PT_PCT_SWC_DST_CompuMethods_ident -60. 195. FORMAT "%10.5"
 /begin ANNOTATION ANNOTATION_LABEL "Description (coming from AUTOSAR DESC field)"
  /begin ANNOTATION_TEXT "Engine temperature below which a warm-up will be requested\r\n" /end ANNOTATION_TEXT
 /end ANNOTATION
 MATRIX_DIM 6 1 1 /end CHARACTERISTIC
/begin CHARACTERISTIC DST_EFLASHB.DST_ModeSelectGeneric.DST_WARMUPTRANSCANCEL "" VALUE 0x80606CA4 DefaultValueRecordLayout_AUTOSAR_Platform_BaseTypes_sint16 250.0 RB_PT_PCT_SWC_DST_CompuMethods_ident -50. 200. FORMAT "%10.5"
 /begin ANNOTATION ANNOTATION_LABEL "Description (coming from AUTOSAR DESC field)"
  /begin ANNOTATION_TEXT "Temperature above which the transmission will not request warmup mode\r\n" /end ANNOTATION_TEXT
 /end ANNOTATION
/end CHARACTERISTIC
/begin CHARACTERISTIC DST_EFLASHB.DST_ModeSelectGeneric.DST_WARMUPTRANSTRIGGER "" VALUE 0x80606CA6 DefaultValueRecordLayout_AUTOSAR_Platform_BaseTypes_sint16 250.0 RB_PT_PCT_SWC_DST_CompuMethods_ident -50. 200. FORMAT "%10.5"
 /begin ANNOTATION ANNOTATION_LABEL "Description (coming from AUTOSAR DESC field)"
  /begin ANNOTATION_TEXT "Temperature below which transmission will request warmup mode\r\n" /end ANNOTATION_TEXT
 /end ANNOTATION
/end CHARACTERISTIC
/begin CHARACTERISTIC DST_EFLASHB.DST_PSG.DST_DISABLEPRESELECTFWDGEARS "" VAL_BLK 0x80606DE6 DefaultValueRecordLayout_AUTOSAR_Platform_BaseTypes_boolean 255.0 AUTOSAR_Platform_CompuMethods_boolean 0.0 255. FORMAT "%10.5"
 /begin ANNOTATION ANNOTATION_LABEL "Description (coming from AUTOSAR DESC field)"
  /begin ANNOTATION_TEXT "If set true for the appropriate shift mode, preselect gear will be disabled (set to 0)\r\n" /end ANNOTATION_TEXT
 /end ANNOTATION
 MATRIX_DIM 17 1 1 /end CHARACTERISTIC
/begin CHARACTERISTIC DST_EFLASHB.DST_PSG.DST_DISABLEPRESELECTWITHFAILEDGEAR "" VALUE 0x80606E7E DefaultValueRecordLayout_AUTOSAR_Platform_BaseTypes_boolean 255.0 AUTOSAR_Platform_CompuMethods_boolean 0.0 255. FORMAT "%10.5"
 /begin ANNOTATION ANNOTATION_LABEL "Description (coming from AUTOSAR DESC field)"
  /begin ANNOTATION_TEXT "If true, no gears will be preselected if a single gear has failed\r\n" /end ANNOTATION_TEXT
 /end ANNOTATION
/end CHARACTERISTIC
/begin CHARACTERISTIC DST_EFLASHB.DST_PSG.DST_DONTPREDOWNROLLOUTCLUNK "" VALUE 0x80606E7F DefaultValueRecordLayout_AUTOSAR_Platform_BaseTypes_boolean 255.0 AUTOSAR_Platform_CompuMethods_boolean 0.0 255. FORMAT "%10.5"
 /begin ANNOTATION ANNOTATION_LABEL "Description (coming from AUTOSAR DESC field)"
  /begin ANNOTATION_TEXT "Flag, if true, disable preselecting 1st when 2nd is engaged to prevent rollout clunk as 1st gear engages\r\n" /end ANNOTATION_TEXT
 /end ANNOTATION
/end CHARACTERISTIC
/begin CHARACTERISTIC DST_EFLASHB.DST_PSG.DST_MINRPMB4THROTTLECANCELSHUTTLE "" VALUE 0x80606E4C DefaultValueRecordLayout_AUTOSAR_Platform_BaseTypes_uint16 20000.0 RB_PT_PCT_SWC_DST_CompuMethods_ident 0.0 20000. FORMAT "%10.5"
 /begin ANNOTATION ANNOTATION_LABEL "Description (coming from AUTOSAR DESC field)"
  /begin ANNOTATION_TEXT "Minimum engine speed before the throttle pedal will cancel shutting (prevents throttle press when engine off cancelling shuttling)\r\n" /end ANNOTATION_TEXT
 /end ANNOTATION
/end CHARACTERISTIC
/begin CHARACTERISTIC DST_EFLASHB.DST_PSG.DST_PRE4REVERSE "" VALUE 0x80606E80 DefaultValueRecordLayout_AUTOSAR_Platform_BaseTypes_uint8 11.0 RB_PT_PCT_SWC_DST_CompuMethods_ident 0.0 11. FORMAT "%10.5"
 /begin ANNOTATION ANNOTATION_LABEL "Description (coming from AUTOSAR DESC field)"
  /begin ANNOTATION_TEXT "Gear to be preselected when reverse is the demand gear\r\n" /end ANNOTATION_TEXT
 /end ANNOTATION
/end CHARACTERISTIC
/begin CHARACTERISTIC DST_EFLASHB.DST_PSG.DST_PREDN_ABOUT2UPSHIFTCANCELTIME "" VALUE 0x80606E5A DefaultValueRecordLayout_AUTOSAR_Platform_BaseTypes_uint16 655.35 RB_PT_PCT_SWC_DST_CompuMethods_DST_Time 0.0 655.35 FORMAT "%10.5"
 /begin ANNOTATION ANNOTATION_LABEL "Description (coming from AUTOSAR DESC field)" /begin ANNOTATION_TEXT "Time since preup set conditions true\r\n" /end ANNOTATION_TEXT /end ANNOTATION
/end CHARACTERISTIC
/begin CHARACTERISTIC DST_EFLASHB.DST_PSG.DST_PREDN_ONTHROTTLEMAXTIME "" VALUE 0x80606E5C DefaultValueRecordLayout_AUTOSAR_Platform_BaseTypes_uint16 655.35 RB_PT_PCT_SWC_DST_CompuMethods_DST_Time 0.0 655.35 FORMAT "%10.5"
 /begin ANNOTATION ANNOTATION_LABEL "Description (coming from AUTOSAR DESC field)"
  /begin ANNOTATION_TEXT "Maximum time on throttle before DST_PreDn_OffTHrottle is cancelled\r\n" /end ANNOTATION_TEXT
 /end ANNOTATION
/end CHARACTERISTIC
/begin CHARACTERISTIC DST_EFLASHB.DST_PSG.DST_PREDNABOUT2SHIFT "" VALUE 0x80606E81 DefaultValueRecordLayout_AUTOSAR_Platform_BaseTypes_uint8 255.0 RB_PT_PCT_SWC_DST_CompuMethods_ident 0.0 255. FORMAT "%10.5"
 /begin ANNOTATION ANNOTATION_LABEL "Description (coming from AUTOSAR DESC field)"
  /begin ANNOTATION_TEXT "Preselect priority for preselect down request due to time to shift\r\n" /end ANNOTATION_TEXT
 /end ANNOTATION
/end CHARACTERISTIC
/begin CHARACTERISTIC DST_EFLASHB.DST_PSG.DST_PREDNABOVEIDLESET "" VAL_BLK 0x80606D80 DefaultValueRecordLayout_AUTOSAR_Platform_BaseTypes_uint16 20000.0 RB_PT_PCT_SWC_DST_CompuMethods_ident 0.0 20000. FORMAT "%10.5"
 /begin ANNOTATION ANNOTATION_LABEL "Description (coming from AUTOSAR DESC field)"
  /begin ANNOTATION_TEXT "Rpm above idle speed to set the low revs preselect logic\r\n" /end ANNOTATION_TEXT
 /end ANNOTATION
 MATRIX_DIM 17 1 1 /end CHARACTERISTIC
/begin CHARACTERISTIC DST_EFLASHB.DST_PSG.DST_PREDNABOVELIMITENABLE "" VALUE 0x80606E4E DefaultValueRecordLayout_AUTOSAR_Platform_BaseTypes_sint16 20000.0 RB_PT_PCT_SWC_DST_CompuMethods_DST_Ident 0.0 20000. FORMAT "%10.5"
 /begin ANNOTATION ANNOTATION_LABEL "Description (coming from AUTOSAR DESC field)"
  /begin ANNOTATION_TEXT "Engine speed above the Engine speed limit to enable preselect\r\n" /end ANNOTATION_TEXT
 /end ANNOTATION
/end CHARACTERISTIC
/begin CHARACTERISTIC DST_EFLASHB.DST_PSG.DST_PREDNABOVELIMITUPPERLIMIT "" VALUE 0x80606E50 DefaultValueRecordLayout_AUTOSAR_Platform_BaseTypes_sint16 20000.0 RB_PT_PCT_SWC_DST_CompuMethods_DST_Ident 0.0 20000. FORMAT "%10.5"
 /begin ANNOTATION ANNOTATION_LABEL "Description (coming from AUTOSAR DESC field)"
  /begin ANNOTATION_TEXT "Engine speed above the Engine speed limit to enable preselect\r\n" /end ANNOTATION_TEXT
 /end ANNOTATION
/end CHARACTERISTIC
/begin CHARACTERISTIC DST_EFLASHB.DST_PSG.DST_PREDNDECEL "" VALUE 0x80606E82 DefaultValueRecordLayout_AUTOSAR_Platform_BaseTypes_uint8 255.0 RB_PT_PCT_SWC_DST_CompuMethods_ident 0.0 255. FORMAT "%10.5"
 /begin ANNOTATION ANNOTATION_LABEL "Description (coming from AUTOSAR DESC field)"
  /begin ANNOTATION_TEXT "Preselect priority for preselect down request due deceleration being active\r\n" /end ANNOTATION_TEXT
 /end ANNOTATION
/end CHARACTERISTIC
/begin CHARACTERISTIC DST_EFLASHB.DST_PSG.DST_PREDNHALFPULLDNPAD "" VALUE 0x80606E83 DefaultValueRecordLayout_AUTOSAR_Platform_BaseTypes_uint8 255.0 RB_PT_PCT_SWC_DST_CompuMethods_ident 0.0 255. FORMAT "%10.5"
 /begin ANNOTATION ANNOTATION_LABEL "Description (coming from AUTOSAR DESC field)"
  /begin ANNOTATION_TEXT "Preselect down priority if the two stage down-shift paddle is half pulled\r\n" /end ANNOTATION_TEXT
 /end ANNOTATION
/end CHARACTERISTIC
/begin CHARACTERISTIC DST_EFLASHB.DST_PSG.DST_PREDNJUSTDOWNSHIFTED "" VAL_BLK 0x80606DF7 DefaultValueRecordLayout_AUTOSAR_Platform_BaseTypes_uint8 255.0 RB_PT_PCT_SWC_DST_CompuMethods_ident 0.0 255. FORMAT "%10.5"
 /begin ANNOTATION ANNOTATION_LABEL "Description (coming from AUTOSAR DESC field)"
  /begin ANNOTATION_TEXT "Allows the next lower preselect gear to be enabled based on the driving mode if the transmission has just downshifted\r\n" /end ANNOTATION_TEXT
 /end ANNOTATION
 MATRIX_DIM 17 1 1 /end CHARACTERISTIC
/begin CHARACTERISTIC DST_EFLASHB.DST_PSG.DST_PREDNLOWREVS "" VALUE 0x80606E84 DefaultValueRecordLayout_AUTOSAR_Platform_BaseTypes_uint8 255.0 RB_PT_PCT_SWC_DST_CompuMethods_ident 0.0 255. FORMAT "%10.5"
 /begin ANNOTATION ANNOTATION_LABEL "Description (coming from AUTOSAR DESC field)"
  /begin ANNOTATION_TEXT "Preselect priority for preselect down request due to low input shaft speed\r\n" /end ANNOTATION_TEXT
 /end ANNOTATION
/end CHARACTERISTIC
/begin CHARACTERISTIC DST_EFLASHB.DST_PSG.DST_PREDNLOWRPMHYST "" VALUE 0x80606E52 DefaultValueRecordLayout_AUTOSAR_Platform_BaseTypes_sint16 20000.0 RB_PT_PCT_SWC_DST_CompuMethods_DST_Ident 0.0 20000. FORMAT "%10.5"
 /begin ANNOTATION ANNOTATION_LABEL "Description (coming from AUTOSAR DESC field)"
  /begin ANNOTATION_TEXT "Input speed above which a downshift is not possible and an upshift is immenant (probably)\r\n" /end ANNOTATION_TEXT
 /end ANNOTATION
/end CHARACTERISTIC
/begin CHARACTERISTIC DST_EFLASHB.DST_PSG.DST_PREDNMAXRPMBELOWPRELIMIT "" VALUE 0x80606E54 DefaultValueRecordLayout_AUTOSAR_Platform_BaseTypes_sint16 20000.0 RB_PT_PCT_SWC_DST_CompuMethods_DST_Ident 0.0 20000. FORMAT "%10.5"
 /begin ANNOTATION ANNOTATION_LABEL "Description (coming from AUTOSAR DESC field)"
  /begin ANNOTATION_TEXT "Rpm below DST_PreDownRpmLimit to allow preselection of the next lowest gear\r\n" /end ANNOTATION_TEXT
 /end ANNOTATION
/end CHARACTERISTIC
/begin CHARACTERISTIC DST_EFLASHB.DST_PSG.DST_PREDNOFFTHROTTLE "" VAL_BLK 0x80606E08 DefaultValueRecordLayout_AUTOSAR_Platform_BaseTypes_uint8 255.0 RB_PT_PCT_SWC_DST_CompuMethods_ident 0.0 255. FORMAT "%10.5"
 /begin ANNOTATION ANNOTATION_LABEL "Description (coming from AUTOSAR DESC field)"
  /begin ANNOTATION_TEXT "Priority for preselect down when off throttle, based on shiftmode\r\n" /end ANNOTATION_TEXT
 /end ANNOTATION
 MATRIX_DIM 17 1 1 /end CHARACTERISTIC
/begin CHARACTERISTIC DST_EFLASHB.DST_PSG.DST_PREDNOFFTHROTTLECANCEL "" VALUE 0x80606E85 DefaultValueRecordLayout_AUTOSAR_Platform_BaseTypes_uint8 102.0 RB_PT_PCT_SWC_DST_CompuMethods_ratio_0p4 0.0 102. FORMAT "%10.5"
 /begin ANNOTATION ANNOTATION_LABEL "Description (coming from AUTOSAR DESC field)"
  /begin ANNOTATION_TEXT "Above this throttle angle, DST_PreDn_OffTHrottle will be set to 0\r\n" /end ANNOTATION_TEXT
 /end ANNOTATION
/end CHARACTERISTIC
/begin CHARACTERISTIC DST_EFLASHB.DST_PSG.DST_PREDNOFFTHROTTLECANCELDEBOUNCE "" VALUE 0x80606E86 DefaultValueRecordLayout_AUTOSAR_Platform_BaseTypes_uint8 102.0 RB_PT_PCT_SWC_DST_CompuMethods_ratio_0p4 0.0 102. FORMAT "%10.5"
 /begin ANNOTATION ANNOTATION_LABEL "Description (coming from AUTOSAR DESC field)"
  /begin ANNOTATION_TEXT "Throttle pedal above which on throttle timer will increase\r\n" /end ANNOTATION_TEXT
 /end ANNOTATION
/end CHARACTERISTIC
/begin CHARACTERISTIC DST_EFLASHB.DST_PSG.DST_PREDNOFFTHROTTLECANCELUPSHIFT "" VALUE 0x80606E87 DefaultValueRecordLayout_AUTOSAR_Platform_BaseTypes_uint8 102.0 RB_PT_PCT_SWC_DST_CompuMethods_ratio_0p4 0.0 102. FORMAT "%10.5"
 /begin ANNOTATION ANNOTATION_LABEL "Description (coming from AUTOSAR DESC field)"
  /begin ANNOTATION_TEXT "Throttle pedal equal to and above this will set PreDn_OffThrottle to zero if IOP_UphiftPreFill is true\r\n" /end ANNOTATION_TEXT
 /end ANNOTATION
/end CHARACTERISTIC
/begin CHARACTERISTIC DST_EFLASHB.DST_PSG.DST_PREDNOFFTHROTTLESET "" VALUE 0x80606E88 DefaultValueRecordLayout_AUTOSAR_Platform_BaseTypes_uint8 102.0 RB_PT_PCT_SWC_DST_CompuMethods_ratio_0p4 0.0 102. FORMAT "%10.5"
 /begin ANNOTATION ANNOTATION_LABEL "Description (coming from AUTOSAR DESC field)"
  /begin ANNOTATION_TEXT "Below this threshold is considered off throttle, 0% = Disable function\r\n" /end ANNOTATION_TEXT
 /end ANNOTATION
/end CHARACTERISTIC
/begin CHARACTERISTIC DST_EFLASHB.DST_PSG.DST_PREDNPRECOGHIGHTHROTTLESET "" VALUE 0x80606E89 DefaultValueRecordLayout_AUTOSAR_Platform_BaseTypes_uint8 102.0 RB_PT_PCT_SWC_DST_CompuMethods_ratio_0p4 0.0 102. FORMAT "%10.5"
 /begin ANNOTATION ANNOTATION_LABEL "Description (coming from AUTOSAR DESC field)"
  /begin ANNOTATION_TEXT "Percentage above which pre-cof is cancelled as soon as the paddle is released\r\n" /end ANNOTATION_TEXT
 /end ANNOTATION
/end CHARACTERISTIC
/begin CHARACTERISTIC DST_EFLASHB.DST_PSG.DST_PREDNPRECOGLOWTHROTTLESET "" VALUE 0x80606E8A DefaultValueRecordLayout_AUTOSAR_Platform_BaseTypes_uint8 102.0 RB_PT_PCT_SWC_DST_CompuMethods_ratio_0p4 0.0 102. FORMAT "%10.5"
 /begin ANNOTATION ANNOTATION_LABEL "Description (coming from AUTOSAR DESC field)" /begin ANNOTATION_TEXT "Throttle pedal threshold when precog downshift set\r\n" /end ANNOTATION_TEXT /end ANNOTATION
/end CHARACTERISTIC
/begin CHARACTERISTIC DST_EFLASHB.DST_PSG.DST_PREDNPRECOGTHROTTLECANCEL "" VALUE 0x80606E8B DefaultValueRecordLayout_AUTOSAR_Platform_BaseTypes_uint8 102.0 RB_PT_PCT_SWC_DST_CompuMethods_ratio_0p4 0.0 102. FORMAT "%10.5"
 /begin ANNOTATION ANNOTATION_LABEL "Description (coming from AUTOSAR DESC field)"
  /begin ANNOTATION_TEXT "At or below this threshold, the precog down function is cancelled\r\n" /end ANNOTATION_TEXT
 /end ANNOTATION
/end CHARACTERISTIC
/begin CHARACTERISTIC DST_EFLASHB.DST_PSG.DST_PREDNPWROFFRPMCANCEL "" VALUE 0x80606E56 DefaultValueRecordLayout_AUTOSAR_Platform_BaseTypes_sint16 20000.0 RB_PT_PCT_SWC_DST_CompuMethods_DST_Ident 0.0 20000. FORMAT "%10.5"
 /begin ANNOTATION ANNOTATION_LABEL "Description (coming from AUTOSAR DESC field)"
  /begin ANNOTATION_TEXT "Engine speed in the current gear to allow the preselection of the lower gear\r\n" /end ANNOTATION_TEXT
 /end ANNOTATION
/end CHARACTERISTIC
/begin CHARACTERISTIC DST_EFLASHB.DST_PSG.DST_PREDNPWROFFRPMSET "" VALUE 0x80606E58 DefaultValueRecordLayout_AUTOSAR_Platform_BaseTypes_sint16 20000.0 RB_PT_PCT_SWC_DST_CompuMethods_DST_Ident 0.0 20000. FORMAT "%10.5"
 /begin ANNOTATION ANNOTATION_LABEL "Description (coming from AUTOSAR DESC field)"
  /begin ANNOTATION_TEXT "Engine speed in the current gear to allow the preselection of the lower gear\r\n" /end ANNOTATION_TEXT
 /end ANNOTATION
/end CHARACTERISTIC
/begin CHARACTERISTIC DST_EFLASHB.DST_PSG.DST_PREDNPWROFFTHROTTLEPCANCEL "" VALUE 0x80606E8C DefaultValueRecordLayout_AUTOSAR_Platform_BaseTypes_uint8 102.0 RB_PT_PCT_SWC_DST_CompuMethods_ratio_0p4 0.0 102. FORMAT "%10.5"
 /begin ANNOTATION ANNOTATION_LABEL "Description (coming from AUTOSAR DESC field)"
  /begin ANNOTATION_TEXT "THrottle angle below which the power off down preselect is set\r\n" /end ANNOTATION_TEXT
 /end ANNOTATION
/end CHARACTERISTIC
/begin CHARACTERISTIC DST_EFLASHB.DST_PSG.DST_PREDNPWROFFTHROTTLESET "" VALUE 0x80606E8D DefaultValueRecordLayout_AUTOSAR_Platform_BaseTypes_uint8 102.0 RB_PT_PCT_SWC_DST_CompuMethods_ratio_0p4 0.0 102. FORMAT "%10.5"
 /begin ANNOTATION ANNOTATION_LABEL "Description (coming from AUTOSAR DESC field)"
  /begin ANNOTATION_TEXT "THrottle angle below which the power off down preselect is set\r\n" /end ANNOTATION_TEXT
 /end ANNOTATION
/end CHARACTERISTIC
/begin CHARACTERISTIC DST_EFLASHB.DST_PSG.DST_PREDNTOPGEAR "" VALUE 0x80606E8E DefaultValueRecordLayout_AUTOSAR_Platform_BaseTypes_uint8 255.0 RB_PT_PCT_SWC_DST_CompuMethods_ident 0.0 255. FORMAT "%10.5"
 /begin ANNOTATION ANNOTATION_LABEL "Description (coming from AUTOSAR DESC field)"
  /begin ANNOTATION_TEXT "Preselect down priority if the two stage down-shift paddle is half pulled\r\n" /end ANNOTATION_TEXT
 /end ANNOTATION
/end CHARACTERISTIC
/begin CHARACTERISTIC DST_EFLASHB.DST_PSG.DST_PREFILLRPMCANCEL "" VALUE 0x80606E5E DefaultValueRecordLayout_AUTOSAR_Platform_BaseTypes_sint16 20000.0 RB_PT_PCT_SWC_DST_CompuMethods_DST_Ident 0.0 20000. FORMAT "%10.5"
 /begin ANNOTATION ANNOTATION_LABEL "Description (coming from AUTOSAR DESC field)"
  /begin ANNOTATION_TEXT "rpm in demand below which up-shift prefill will be cancelled\r\n" /end ANNOTATION_TEXT
 /end ANNOTATION
/end CHARACTERISTIC
/begin CHARACTERISTIC DST_EFLASHB.DST_PSG.DST_PREFILLRPMSET "" VALUE 0x80606E60 DefaultValueRecordLayout_AUTOSAR_Platform_BaseTypes_sint16 20000.0 RB_PT_PCT_SWC_DST_CompuMethods_DST_Ident 0.0 20000. FORMAT "%10.5"
 /begin ANNOTATION ANNOTATION_LABEL "Description (coming from AUTOSAR DESC field)"
  /begin ANNOTATION_TEXT "Rpm in demand above which up shift prefill will be set\r\n" /end ANNOTATION_TEXT
 /end ANNOTATION
/end CHARACTERISTIC
/begin CHARACTERISTIC DST_EFLASHB.DST_PSG.DST_PREFILLTHROTTLECANCEL "" VALUE 0x80606E8F DefaultValueRecordLayout_AUTOSAR_Platform_BaseTypes_uint8 102.0 RB_PT_PCT_SWC_DST_CompuMethods_ratio_0p4 0.0 102. FORMAT "%10.5"
 /begin ANNOTATION ANNOTATION_LABEL "Description (coming from AUTOSAR DESC field)" /begin ANNOTATION_TEXT "Percent throttle that will cancel upshift prefill\r\n" /end ANNOTATION_TEXT /end ANNOTATION
/end CHARACTERISTIC
/begin CHARACTERISTIC DST_EFLASHB.DST_PSG.DST_PREFILLTHROTTLESET "" VALUE 0x80606E90 DefaultValueRecordLayout_AUTOSAR_Platform_BaseTypes_uint8 102.0 RB_PT_PCT_SWC_DST_CompuMethods_ratio_0p4 0.0 102. FORMAT "%10.5"
 /begin ANNOTATION ANNOTATION_LABEL "Description (coming from AUTOSAR DESC field)" /begin ANNOTATION_TEXT "Percent throttle that will set upshift prefill\r\n" /end ANNOTATION_TEXT /end ANNOTATION
/end CHARACTERISTIC
/begin CHARACTERISTIC DST_EFLASHB.DST_PSG.DST_PREFWDINREVDISABLE "" VALUE 0x80606E62 DefaultValueRecordLayout_AUTOSAR_Platform_BaseTypes_uint16 500.0 RB_PT_PCT_SWC_DST_CompuMethods_kph_0p1 0.0 500. FORMAT "%10.5"
 /begin ANNOTATION ANNOTATION_LABEL "Description (coming from AUTOSAR DESC field)"
  /begin ANNOTATION_TEXT "Vehicle speed below which in Reverse a forward gear can be selected\r\n" /end ANNOTATION_TEXT
 /end ANNOTATION
/end CHARACTERISTIC
/begin CHARACTERISTIC DST_EFLASHB.DST_PSG.DST_PREFWDINREVENABLE "" VALUE 0x80606E64 DefaultValueRecordLayout_AUTOSAR_Platform_BaseTypes_uint16 500.0 RB_PT_PCT_SWC_DST_CompuMethods_kph_0p1 0.0 500. FORMAT "%10.5"
 /begin ANNOTATION ANNOTATION_LABEL "Description (coming from AUTOSAR DESC field)"
  /begin ANNOTATION_TEXT "Vehicle speed below which in Reverse a forward gear can be selected\r\n" /end ANNOTATION_TEXT
 /end ANNOTATION
/end CHARACTERISTIC
/begin CHARACTERISTIC DST_EFLASHB.DST_PSG.DST_PRESELECTDISABLEGEAR "" VALUE 0x80606E91 DefaultValueRecordLayout_AUTOSAR_Platform_BaseTypes_uint8 11.0 RB_PT_PCT_SWC_DST_CompuMethods_ident 0.0 11. FORMAT "%10.5"
 /begin ANNOTATION ANNOTATION_LABEL "Description (coming from AUTOSAR DESC field)"
  /begin ANNOTATION_TEXT "If DST_DISABLE.....GEARS is true, this gives the option to still allow preselect in the lower gears\r\n" /end ANNOTATION_TEXT
 /end ANNOTATION
/end CHARACTERISTIC
/begin CHARACTERISTIC DST_EFLASHB.DST_PSG.DST_PRESELECTGEARCONF "" VAL_BLK 0x80606E19 DefaultValueRecordLayout_AUTOSAR_Platform_BaseTypes_uint8 10.0 RB_PT_PCT_SWC_DST_CompuMethods_ident 0.0 10. FORMAT "%10.5"
 /begin ANNOTATION ANNOTATION_LABEL "Description (coming from AUTOSAR DESC field)"
  /begin ANNOTATION_TEXT "Configuration of preselect gears.  Row 0 = Preselect down gear, 1 = Preselect up gear\r\n" /end ANNOTATION_TEXT
 /end ANNOTATION
 MATRIX_DIM 17 2 1 /end CHARACTERISTIC
/begin CHARACTERISTIC DST_EFLASHB.DST_PSG.DST_PRESELECTUPINFIRST "" VAL_BLK 0x80606E3B DefaultValueRecordLayout_AUTOSAR_Platform_BaseTypes_boolean 255.0 AUTOSAR_Platform_CompuMethods_boolean 0.0 255. FORMAT "%10.5"
 /begin ANNOTATION ANNOTATION_LABEL "Description (coming from AUTOSAR DESC field)" /begin ANNOTATION_TEXT "Based on shiftmode\r\n" /end ANNOTATION_TEXT /end ANNOTATION
 MATRIX_DIM 17 1 1 /end CHARACTERISTIC
/begin CHARACTERISTIC DST_EFLASHB.DST_PSG.DST_PRESELECTUPMODERPMCANCEL "" VAL_BLK 0x80606DA2 DefaultValueRecordLayout_AUTOSAR_Platform_BaseTypes_sint16 20000.0 RB_PT_PCT_SWC_DST_CompuMethods_DST_Ident 0.0 20000. FORMAT "%10.5"
 /begin ANNOTATION ANNOTATION_LABEL "Description (coming from AUTOSAR DESC field)"
  /begin ANNOTATION_TEXT "Engine speed above which in the mode preselect up will be requested\r\n" /end ANNOTATION_TEXT
 /end ANNOTATION
 MATRIX_DIM 17 1 1 /end CHARACTERISTIC
/begin CHARACTERISTIC DST_EFLASHB.DST_PSG.DST_PRESELECTUPMODERPMTRIGGER "" VAL_BLK 0x80606DC4 DefaultValueRecordLayout_AUTOSAR_Platform_BaseTypes_sint16 20000.0 RB_PT_PCT_SWC_DST_CompuMethods_DST_Ident 0.0 20000. FORMAT "%10.5"
 /begin ANNOTATION ANNOTATION_LABEL "Description (coming from AUTOSAR DESC field)"
  /begin ANNOTATION_TEXT "Engine speed above which in the mode preselect up will be requested\r\n" /end ANNOTATION_TEXT
 /end ANNOTATION
 MATRIX_DIM 17 1 1 /end CHARACTERISTIC
/begin CHARACTERISTIC DST_EFLASHB.DST_PSG.DST_PREUP_ABOUT2UPSHIFTCANCELTIME "" VALUE 0x80606E6E DefaultValueRecordLayout_AUTOSAR_Platform_BaseTypes_uint16 655.35 RB_PT_PCT_SWC_DST_CompuMethods_DST_Time 0.0 655.35 FORMAT "%10.5"
 /begin ANNOTATION ANNOTATION_LABEL "Description (coming from AUTOSAR DESC field)" /begin ANNOTATION_TEXT "Time since preup set conditions true\r\n" /end ANNOTATION_TEXT /end ANNOTATION
/end CHARACTERISTIC
/begin CHARACTERISTIC DST_EFLASHB.DST_PSG.DST_PREUPABOUT2SHIFT "" VALUE 0x80606E92 DefaultValueRecordLayout_AUTOSAR_Platform_BaseTypes_uint8 255.0 RB_PT_PCT_SWC_DST_CompuMethods_ident 0.0 255. FORMAT "%10.5"
 /begin ANNOTATION ANNOTATION_LABEL "Description (coming from AUTOSAR DESC field)"
  /begin ANNOTATION_TEXT "Preselect priority for preselect up request due time to shift\r\n" /end ANNOTATION_TEXT
 /end ANNOTATION
/end CHARACTERISTIC
/begin CHARACTERISTIC DST_EFLASHB.DST_PSG.DST_PREUPFORWARD1STMAXIDLE "" VALUE 0x80606E66 DefaultValueRecordLayout_AUTOSAR_Platform_BaseTypes_uint16 20000.0 RB_PT_PCT_SWC_DST_CompuMethods_ident 0.0 20000. FORMAT "%10.5"
 /begin ANNOTATION ANNOTATION_LABEL "Description (coming from AUTOSAR DESC field)"
  /begin ANNOTATION_TEXT "Idle speed below which 2nd gear will be preselected when the demand gear is 1st\r\n" /end ANNOTATION_TEXT
 /end ANNOTATION
/end CHARACTERISTIC
/begin CHARACTERISTIC DST_EFLASHB.DST_PSG.DST_PREUPFORWARD1STMAXKMH "" VALUE 0x80606E68 DefaultValueRecordLayout_AUTOSAR_Platform_BaseTypes_uint16 500.0 RB_PT_PCT_SWC_DST_CompuMethods_kph_0p1 0.0 500. FORMAT "%10.5"
 /begin ANNOTATION ANNOTATION_LABEL "Description (coming from AUTOSAR DESC field)"
  /begin ANNOTATION_TEXT "Vehicle speed below which 2nd will preselected when 1st gear is requested\r\n" /end ANNOTATION_TEXT
 /end ANNOTATION
/end CHARACTERISTIC
/begin CHARACTERISTIC DST_EFLASHB.DST_PSG.DST_PREUPFORWARDIN1ST "" VALUE 0x80606E93 DefaultValueRecordLayout_AUTOSAR_Platform_BaseTypes_uint8 255.0 RB_PT_PCT_SWC_DST_CompuMethods_ident 0.0 255. FORMAT "%10.5"
 /begin ANNOTATION ANNOTATION_LABEL "Description (coming from AUTOSAR DESC field)"
  /begin ANNOTATION_TEXT "Preselect priority for preselect up request due 1st gear being engaged and the vehicle travelling forwards\r\n" /end ANNOTATION_TEXT
 /end ANNOTATION
/end CHARACTERISTIC
/begin CHARACTERISTIC DST_EFLASHB.DST_PSG.DST_PREUPFORWARDMINTHROTTLE "" VALUE 0x80606E94 DefaultValueRecordLayout_AUTOSAR_Platform_BaseTypes_uint8 102.0 RB_PT_PCT_SWC_DST_CompuMethods_ratio_0p4 0.0 102. FORMAT "%10.5"
 /begin ANNOTATION ANNOTATION_LABEL "Description (coming from AUTOSAR DESC field)"
  /begin ANNOTATION_TEXT "Throttle pedal when not in Neutral above which 2nd gear preselect inhibit due to high idle is prevented\r\n" /end ANNOTATION_TEXT
 /end ANNOTATION
/end CHARACTERISTIC
/begin CHARACTERISTIC DST_EFLASHB.DST_PSG.DST_PREUPHALFPULLUPPAD "" VALUE 0x80606E95 DefaultValueRecordLayout_AUTOSAR_Platform_BaseTypes_uint8 255.0 RB_PT_PCT_SWC_DST_CompuMethods_ident 0.0 255. FORMAT "%10.5"
 /begin ANNOTATION ANNOTATION_LABEL "Description (coming from AUTOSAR DESC field)"
  /begin ANNOTATION_TEXT "Preselect priority if a two stage upshift paddle is half pulled\r\n" /end ANNOTATION_TEXT
 /end ANNOTATION
/end CHARACTERISTIC
/begin CHARACTERISTIC DST_EFLASHB.DST_PSG.DST_PREUPHIGHREVS "" VALUE 0x80606E96 DefaultValueRecordLayout_AUTOSAR_Platform_BaseTypes_uint8 255.0 RB_PT_PCT_SWC_DST_CompuMethods_ident 0.0 255. FORMAT "%10.5"
 /begin ANNOTATION ANNOTATION_LABEL "Description (coming from AUTOSAR DESC field)"
  /begin ANNOTATION_TEXT "Preselect priority for preselect up with high engine speed\r\n" /end ANNOTATION_TEXT
 /end ANNOTATION
/end CHARACTERISTIC
/begin CHARACTERISTIC DST_EFLASHB.DST_PSG.DST_PREUPHIGHRPMCANCEL "" VALUE 0x80606E6A DefaultValueRecordLayout_AUTOSAR_Platform_BaseTypes_sint16 20000.0 RB_PT_PCT_SWC_DST_CompuMethods_DST_Ident 0.0 20000. FORMAT "%10.5"
 /begin ANNOTATION ANNOTATION_LABEL "Description (coming from AUTOSAR DESC field)"
  /begin ANNOTATION_TEXT "Input speed above which a downshift is not possible and an upshift is immenant (probably)\r\n" /end ANNOTATION_TEXT
 /end ANNOTATION
/end CHARACTERISTIC
/begin CHARACTERISTIC DST_EFLASHB.DST_PSG.DST_PREUPHIGHRPMSET "" VALUE 0x80606E6C DefaultValueRecordLayout_AUTOSAR_Platform_BaseTypes_sint16 20000.0 RB_PT_PCT_SWC_DST_CompuMethods_DST_Ident 0.0 20000. FORMAT "%10.5"
 /begin ANNOTATION ANNOTATION_LABEL "Description (coming from AUTOSAR DESC field)"
  /begin ANNOTATION_TEXT "Input speed above which a downshift is not possible and an upshift is immenant (probably)\r\n" /end ANNOTATION_TEXT
 /end ANNOTATION
/end CHARACTERISTIC
/begin CHARACTERISTIC DST_EFLASHB.DST_PSG.DST_PREUPMODE "" VALUE 0x80606E97 DefaultValueRecordLayout_AUTOSAR_Platform_BaseTypes_uint8 255.0 RB_PT_PCT_SWC_DST_CompuMethods_ident 0.0 255. FORMAT "%10.5"
 /begin ANNOTATION ANNOTATION_LABEL "Description (coming from AUTOSAR DESC field)"
  /begin ANNOTATION_TEXT "Preselect priority for preselect up request due to drivin gmode\r\n" /end ANNOTATION_TEXT
 /end ANNOTATION
/end CHARACTERISTIC
/begin CHARACTERISTIC DST_EFLASHB.DST_PSG.DST_PREUPSEQUENTIALUPS "" VALUE 0x80606E98 DefaultValueRecordLayout_AUTOSAR_Platform_BaseTypes_uint8 255.0 RB_PT_PCT_SWC_DST_CompuMethods_ident 0.0 255. FORMAT "%10.5"
 /begin ANNOTATION ANNOTATION_LABEL "Description (coming from AUTOSAR DESC field)"
  /begin ANNOTATION_TEXT "Priority for preselect up when a sequential upshift is expected\r\n" /end ANNOTATION_TEXT
 /end ANNOTATION
/end CHARACTERISTIC
/begin CHARACTERISTIC DST_EFLASHB.DST_PSG.DST_REFSPDTOALLOWPRESELECTDOWN1ST "" VALUE 0x80606E70 DefaultValueRecordLayout_AUTOSAR_Platform_BaseTypes_uint16 500.0 RB_PT_PCT_SWC_DST_CompuMethods_kph_0p1 0.0 500. FORMAT "%10.5"
 /begin ANNOTATION ANNOTATION_LABEL "Description (coming from AUTOSAR DESC field)"
  /begin ANNOTATION_TEXT "Reference speed above which preselecting down to first is disabled\r\n" /end ANNOTATION_TEXT
 /end ANNOTATION
/end CHARACTERISTIC
/begin CHARACTERISTIC DST_EFLASHB.DST_PSG.DST_REFSPDTOBLOCKPRESELECTDOWN1ST "" VALUE 0x80606E72 DefaultValueRecordLayout_AUTOSAR_Platform_BaseTypes_uint16 500.0 RB_PT_PCT_SWC_DST_CompuMethods_kph_0p1 0.0 500. FORMAT "%10.5"
 /begin ANNOTATION ANNOTATION_LABEL "Description (coming from AUTOSAR DESC field)"
  /begin ANNOTATION_TEXT "Reference speed above which preselecting down to first is disabled\r\n" /end ANNOTATION_TEXT
 /end ANNOTATION
/end CHARACTERISTIC
/begin CHARACTERISTIC DST_EFLASHB.DST_PSG.DST_ShiftTimeComp_Preselect.DST_MINRPM2PREDN "" VALUE 0x80606E9C DefaultValueRecordLayout_AUTOSAR_Platform_BaseTypes_uint16 1500.0 RB_PT_PCT_SWC_DST_CompuMethods_ident 0.0 1500. FORMAT "%10.5"
 /begin ANNOTATION ANNOTATION_LABEL "Description (coming from AUTOSAR DESC field)"
  /begin ANNOTATION_TEXT "Minimum engine speed to preselect up, regardless of gradient calc\r\n" /end ANNOTATION_TEXT
 /end ANNOTATION
/end CHARACTERISTIC
/begin CHARACTERISTIC DST_EFLASHB.DST_PSG.DST_ShiftTimeComp_Preselect.DST_MINRPM2PREUP "" VALUE 0x80606E9E DefaultValueRecordLayout_AUTOSAR_Platform_BaseTypes_uint16 1500.0 RB_PT_PCT_SWC_DST_CompuMethods_ident 0.0 1500. FORMAT "%10.5"
 /begin ANNOTATION ANNOTATION_LABEL "Description (coming from AUTOSAR DESC field)"
  /begin ANNOTATION_TEXT "Minimum engine speed to preselect up, regardless of gradient calc\r\n" /end ANNOTATION_TEXT
 /end ANNOTATION
/end CHARACTERISTIC
/begin CHARACTERISTIC DST_EFLASHB.DST_PSG.DST_ShiftTimeComp_Preselect.DST_MINUPSHIFT4PS "" VALUE 0x80606EA0 DefaultValueRecordLayout_AUTOSAR_Platform_BaseTypes_sint16 20000.0 RB_PT_PCT_SWC_DST_CompuMethods_DST_Ident 0.0 20000. FORMAT "%10.5"
 /begin ANNOTATION ANNOTATION_LABEL "Description (coming from AUTOSAR DESC field)"
  /begin ANNOTATION_TEXT "up shift trigger rpm below which preselect will not be requested before the shift\r\n" /end ANNOTATION_TEXT
 /end ANNOTATION
/end CHARACTERISTIC
/begin CHARACTERISTIC DST_EFLASHB.DST_PSG.DST_ShiftTimeComp_Preselect.DST_PRESELECT_HYST "" VALUE 0x80606EA2 DefaultValueRecordLayout_AUTOSAR_Platform_BaseTypes_sint16 20000.0 RB_PT_PCT_SWC_DST_CompuMethods_DST_Ident 0.0 20000. FORMAT "%10.5"
 /begin ANNOTATION ANNOTATION_LABEL "Description (coming from AUTOSAR DESC field)"
  /begin ANNOTATION_TEXT "Hysteresis between preselect set and preselect cancel\r\n" /end ANNOTATION_TEXT
 /end ANNOTATION
/end CHARACTERISTIC
/begin CHARACTERISTIC DST_EFLASHB.DST_PSG.DST_SHUTTLEACTIVEMAXTIME "" VALUE 0x80606E74 DefaultValueRecordLayout_AUTOSAR_Platform_BaseTypes_uint16 655.35 RB_PT_PCT_SWC_DST_CompuMethods_DST_Time 0.0 655.35 FORMAT "%10.5"
 /begin ANNOTATION ANNOTATION_LABEL "Description (coming from AUTOSAR DESC field)"
  /begin ANNOTATION_TEXT "Time since Reverse was selected to cancel Shuttle preselect\r\n" /end ANNOTATION_TEXT
 /end ANNOTATION
/end CHARACTERISTIC
/begin CHARACTERISTIC DST_EFLASHB.DST_PSG.DST_SHUTTLECANCELKMH "" VALUE 0x80606E76 DefaultValueRecordLayout_AUTOSAR_Platform_BaseTypes_uint16 500.0 RB_PT_PCT_SWC_DST_CompuMethods_kph_0p1 0.0 500. FORMAT "%10.5"
 /begin ANNOTATION ANNOTATION_LABEL "Description (coming from AUTOSAR DESC field)"
  /begin ANNOTATION_TEXT "When not in R, vehicle speed above which shuttling flag will be set false\r\n" /end ANNOTATION_TEXT
 /end ANNOTATION
/end CHARACTERISTIC
/begin CHARACTERISTIC DST_EFLASHB.DST_PSG.DST_SHUTTLECANCELTHROTTLE "" VALUE 0x80606E99 DefaultValueRecordLayout_AUTOSAR_Platform_BaseTypes_uint8 102.0 RB_PT_PCT_SWC_DST_CompuMethods_ratio_0p4 0.0 102. FORMAT "%10.5"
 /begin ANNOTATION ANNOTATION_LABEL "Description (coming from AUTOSAR DESC field)"
  /begin ANNOTATION_TEXT "Throttle pedal when not in Reverse above which shuttling is cancelled\r\n" /end ANNOTATION_TEXT
 /end ANNOTATION
/end CHARACTERISTIC
/begin CHARACTERISTIC DST_EFLASHB.DST_PSG.DST_SHUTTLEENABLE "" VALUE 0x80606E9A DefaultValueRecordLayout_AUTOSAR_Platform_BaseTypes_boolean 255.0 AUTOSAR_Platform_CompuMethods_boolean 0.0 255. FORMAT "%10.5"
 /begin ANNOTATION ANNOTATION_LABEL "Description (coming from AUTOSAR DESC field)"
  /begin ANNOTATION_TEXT "Set true if the shuttling preselection logic is to be used\r\n" /end ANNOTATION_TEXT
 /end ANNOTATION
/end CHARACTERISTIC
/begin CHARACTERISTIC DST_EFLASHB.DST_PSG.DST_SHUTTLEINPUTSPEEDDISABLE "" VALUE 0x80606E78 DefaultValueRecordLayout_AUTOSAR_Platform_BaseTypes_uint16 20000.0 RB_PT_PCT_SWC_DST_CompuMethods_ident 0.0 20000. FORMAT "%10.5"
 /begin ANNOTATION ANNOTATION_LABEL "Description (coming from AUTOSAR DESC field)" /begin ANNOTATION_TEXT "Input speed above which shuttling is disabled\r\n" /end ANNOTATION_TEXT /end ANNOTATION
/end CHARACTERISTIC
/begin CHARACTERISTIC DST_EFLASHB.DST_PSG.DST_SHUTTLEINPUTSPEEDENABLE "" VALUE 0x80606E7A DefaultValueRecordLayout_AUTOSAR_Platform_BaseTypes_uint16 20000.0 RB_PT_PCT_SWC_DST_CompuMethods_ident 0.0 20000. FORMAT "%10.5"
 /begin ANNOTATION ANNOTATION_LABEL "Description (coming from AUTOSAR DESC field)" /begin ANNOTATION_TEXT "Input shaft speed below which shuttling is enabled\r\n" /end ANNOTATION_TEXT /end ANNOTATION
/end CHARACTERISTIC
/begin CHARACTERISTIC DST_EFLASHB.DST_PSG.DST_SHUTTLESETKMH1st "" VALUE 0x80606E7C DefaultValueRecordLayout_AUTOSAR_Platform_BaseTypes_uint16 500.0 RB_PT_PCT_SWC_DST_CompuMethods_kph_0p1 0.0 500. FORMAT "%10.5"
 /begin ANNOTATION ANNOTATION_LABEL "Description (coming from AUTOSAR DESC field)"
  /begin ANNOTATION_TEXT "When not in R, vehicle speed above which shuttling flag will be set false\r\n" /end ANNOTATION_TEXT
 /end ANNOTATION
/end CHARACTERISTIC
/begin CHARACTERISTIC DST_EFLASHB.DST_PSG.DST_SHUTTLETRUEINPARK "" VALUE 0x80606E9B DefaultValueRecordLayout_AUTOSAR_Platform_BaseTypes_boolean 255.0 AUTOSAR_Platform_CompuMethods_boolean 0.0 255. FORMAT "%10.5"
 /begin ANNOTATION ANNOTATION_LABEL "Description (coming from AUTOSAR DESC field)" /begin ANNOTATION_TEXT "If true, shutting will be set true in Park\r\n" /end ANNOTATION_TEXT /end ANNOTATION
/end CHARACTERISTIC
/begin CHARACTERISTIC DST_EFLASHB.DST_RefSpdCalc.DST_DECELFROMLATACC "" CURVE 0x80606EB4 RB_PT_PCT_SWC_DST_RecordLayouts_RL_Curve_uint16_3_uint8_3 5.0 RB_PT_PCT_SWC_DST_CompuMethods_ratio_0p01 0.0 5. FORMAT "%10.5"
 /begin ANNOTATION ANNOTATION_LABEL "Description (coming from AUTOSAR DESC field)" /begin ANNOTATION_TEXT "Deceleration limit from Lateral accelerometer\r\n" /end ANNOTATION_TEXT /end ANNOTATION
 /begin AXIS_DESCR STD_AXIS NO_INPUT_QUANTITY RB_PT_PCT_SWC_DST_CompuMethods_ratio_0p01 3 0.0 1.27 FORMAT "%10.5" DEPOSIT ABSOLUTE /end AXIS_DESCR
/end CHARACTERISTIC
/begin CHARACTERISTIC DST_EFLASHB.DST_RefSpdCalc.DST_DECELFROMLONGACC "" CURVE 0x80606EC0 RB_PT_PCT_SWC_DST_RecordLayouts_RL_Curve_uint16_3_sint16_3 5.0 RB_PT_PCT_SWC_DST_CompuMethods_ratio_0p01 0.0 5. FORMAT "%10.5"
 /begin ANNOTATION ANNOTATION_LABEL "Description (coming from AUTOSAR DESC field)"
  /begin ANNOTATION_TEXT "Limit of Reference Speed Deceleration based on Longitudinal acceleration\r\n" /end ANNOTATION_TEXT
 /end ANNOTATION
 /begin AXIS_DESCR STD_AXIS NO_INPUT_QUANTITY RB_PT_PCT_SWC_DST_CompuMethods_ratio_0p03125 3 -16. 15.96875 FORMAT "%10.5" DEPOSIT ABSOLUTE /end AXIS_DESCR
/end CHARACTERISTIC
/begin CHARACTERISTIC DST_EFLASHB.DST_RefSpdCalc.DST_GRADIENTZEROROLLINGROADTIME "" VALUE 0x80606EA4 DefaultValueRecordLayout_AUTOSAR_Platform_BaseTypes_uint16 655.35 RB_PT_PCT_SWC_DST_CompuMethods_DST_Time 0.0 655.35 FORMAT "%10.5"
 /begin ANNOTATION ANNOTATION_LABEL "Description (coming from AUTOSAR DESC field)"
  /begin ANNOTATION_TEXT "Time front to rear error needs to be 10km/h to enable rolling road detection and reset gradient\r\n" /end ANNOTATION_TEXT
 /end ANNOTATION
/end CHARACTERISTIC
/begin CHARACTERISTIC DST_EFLASHB.DST_RefSpdCalc.DST_KL15HIGH2SENSORSOK "" VALUE 0x80606EA6 DefaultValueRecordLayout_AUTOSAR_Platform_BaseTypes_uint16 100.0 RB_PT_PCT_SWC_DST_CompuMethods_DST_Time 0.0 100. FORMAT "%10.5"
 /begin ANNOTATION ANNOTATION_LABEL "Description (coming from AUTOSAR DESC field)" /begin ANNOTATION_TEXT "Time after KL15 is on before the sensors are ok\r\n" /end ANNOTATION_TEXT /end ANNOTATION
/end CHARACTERISTIC
/begin CHARACTERISTIC DST_EFLASHB.DST_RefSpdCalc.DST_MAXACCELFROMLONGACC "" CURVE 0x80606ECE RB_PT_PCT_SWC_DST_RecordLayouts_RL_Curve_uint16_3_sint16_3 5.0 RB_PT_PCT_SWC_DST_CompuMethods_ratio_0p01 0.0 5. FORMAT "%10.5"
 /begin ANNOTATION ANNOTATION_LABEL "Description (coming from AUTOSAR DESC field)" /begin ANNOTATION_TEXT "Maximum acceleration from Long acc sensor\r\n" /end ANNOTATION_TEXT /end ANNOTATION
 /begin AXIS_DESCR STD_AXIS NO_INPUT_QUANTITY RB_PT_PCT_SWC_DST_CompuMethods_ratio_0p03125 3 -16. 15.96875 FORMAT "%10.5" DEPOSIT ABSOLUTE /end AXIS_DESCR
/end CHARACTERISTIC
/begin CHARACTERISTIC DST_EFLASHB.DST_RefSpdCalc.DST_MAXACCELVSREFSPD "" CURVE 0x80606EDC RB_PT_PCT_SWC_DST_RecordLayouts_RL_Curve_uint16_6_uint16_6 5.0 RB_PT_PCT_SWC_DST_CompuMethods_ratio_0p01 0.0 5. FORMAT "%10.5"
 /begin ANNOTATION ANNOTATION_LABEL "Description (coming from AUTOSAR DESC field)"
  /begin ANNOTATION_TEXT "Maximum allowed increase of reference speed based on the current vehicle speed\r\n" /end ANNOTATION_TEXT
 /end ANNOTATION
 /begin AXIS_DESCR STD_AXIS NO_INPUT_QUANTITY RB_PT_PCT_SWC_DST_CompuMethods_ratio_0p01 6 0.0 500. FORMAT "%10.5" DEPOSIT ABSOLUTE /end AXIS_DESCR
/end CHARACTERISTIC
/begin CHARACTERISTIC DST_EFLASHB.DST_RefSpdCalc.DST_MAXDECEL "" VALUE 0x80606EB0 DefaultValueRecordLayout_AUTOSAR_Platform_BaseTypes_uint8 5.0 RB_PT_PCT_SWC_DST_CompuMethods_kph_0p1 0.0 5. FORMAT "%10.5"
 /begin ANNOTATION ANNOTATION_LABEL "Description (coming from AUTOSAR DESC field)" /begin ANNOTATION_TEXT "Limit of Deceleration (1g = 0.353 km/h /100ms)\r\n" /end ANNOTATION_TEXT /end ANNOTATION
/end CHARACTERISTIC
/begin CHARACTERISTIC DST_EFLASHB.DST_RefSpdCalc.DST_MAXSLIPVSSPEED "" CURVE 0x80606EF6 RB_PT_PCT_SWC_DST_RecordLayouts_RL_Curve_uint16_6_uint16_6 1.0 RB_PT_PCT_SWC_DST_CompuMethods_ratio_0p01 0.0 1. FORMAT "%10.5"
 /begin ANNOTATION ANNOTATION_LABEL "Description (coming from AUTOSAR DESC field)"
  /begin ANNOTATION_TEXT "Maximum allowed slip calculation based on reference speed (prevents\r\n" /end ANNOTATION_TEXT
 /end ANNOTATION
 /begin AXIS_DESCR STD_AXIS NO_INPUT_QUANTITY RB_PT_PCT_SWC_DST_CompuMethods_kph_0p1 6 0.0 500. FORMAT "%10.5" DEPOSIT ABSOLUTE /end AXIS_DESCR
/end CHARACTERISTIC
/begin CHARACTERISTIC DST_EFLASHB.DST_RefSpdCalc.DST_REFSPDEXCESSLIPCANCEL "" VALUE 0x80606EA8 DefaultValueRecordLayout_AUTOSAR_Platform_BaseTypes_sint16 200.0 RB_PT_PCT_SWC_DST_CompuMethods_ident -100. 100. FORMAT "%10.5"
 /begin ANNOTATION ANNOTATION_LABEL "Description (coming from AUTOSAR DESC field)"
  /begin ANNOTATION_TEXT "Driven wheel excess slip to set DST_RefSpdExcessSlip to true\r\n" /end ANNOTATION_TEXT
 /end ANNOTATION
/end CHARACTERISTIC
/begin CHARACTERISTIC DST_EFLASHB.DST_RefSpdCalc.DST_REFSPDEXCESSLIPSET "" VALUE 0x80606EAA DefaultValueRecordLayout_AUTOSAR_Platform_BaseTypes_sint16 200.0 RB_PT_PCT_SWC_DST_CompuMethods_ident -100. 100. FORMAT "%10.5"
 /begin ANNOTATION ANNOTATION_LABEL "Description (coming from AUTOSAR DESC field)"
  /begin ANNOTATION_TEXT "Driven wheel excess slip to set DST_RefSpdExcessSlip to true\r\n" /end ANNOTATION_TEXT
 /end ANNOTATION
/end CHARACTERISTIC
/begin CHARACTERISTIC DST_EFLASHB.DST_RefSpdCalc.DST_REFSPDIPSHAFTFILTGAIN "" VALUE 0x80606EB1 DefaultValueRecordLayout_AUTOSAR_Platform_BaseTypes_uint8 1.0 RB_PT_PCT_SWC_DST_CompuMethods_ratio_0p01 0.0 1. FORMAT "%10.5"
 /begin ANNOTATION ANNOTATION_LABEL "Description (coming from AUTOSAR DESC field)" /begin ANNOTATION_TEXT "Filter gain for input shaft filtering\r\n" /end ANNOTATION_TEXT /end ANNOTATION
/end CHARACTERISTIC
/begin CHARACTERISTIC DST_EFLASHB.DST_RefSpdCalc.DST_REFSPDMAXCHANGEvsERROR "" CURVE 0x80606F10 RB_PT_PCT_SWC_DST_RecordLayouts_RL_Curve_uint16_5_sint16_5 5.0 RB_PT_PCT_SWC_DST_CompuMethods_ratio_0p01 0.0 5. FORMAT "%10.5"
 /begin ANNOTATION ANNOTATION_LABEL "Description (coming from AUTOSAR DESC field)"
  /begin ANNOTATION_TEXT "When the reference speed is in back-up, this determines the maximum acceleration based on the speed error\r\n" /end ANNOTATION_TEXT
 /end ANNOTATION
 /begin AXIS_DESCR STD_AXIS NO_INPUT_QUANTITY RB_PT_PCT_SWC_DST_CompuMethods_kph_0p1 5 -500. 500. FORMAT "%10.5" DEPOSIT ABSOLUTE /end AXIS_DESCR
/end CHARACTERISTIC
/begin CHARACTERISTIC DST_EFLASHB.DST_RefSpdCalc.DST_REFSPEEDBLOCKSHIFTS4SLIP "" VALUE 0x80606EAC DefaultValueRecordLayout_AUTOSAR_Platform_BaseTypes_uint16 500.0 RB_PT_PCT_SWC_DST_CompuMethods_ratio_0p01 0.0 500. FORMAT "%10.5"
 /begin ANNOTATION ANNOTATION_LABEL "Description (coming from AUTOSAR DESC field)"
  /begin ANNOTATION_TEXT "Reference speed below which positive slip on the driven wheels can be used to prevent up-shifts\r\n" /end ANNOTATION_TEXT
 /end ANNOTATION
/end CHARACTERISTIC
/begin CHARACTERISTIC DST_EFLASHB.DST_RefSpdCalc.DST_REFSPEEDDIAGSENSITIVITY "" VALUE 0x80606EB2 DefaultValueRecordLayout_AUTOSAR_Platform_BaseTypes_uint8 3.0 RB_PT_PCT_SWC_DST_CompuMethods_ident 0.0 3. FORMAT "%10.5"
 /begin ANNOTATION ANNOTATION_LABEL "Description (coming from AUTOSAR DESC field)"
  /begin ANNOTATION_TEXT "Sensitibity of Ref Speed Status; 0 = Off, 1 = Least sensitive, 3 = Very sensitive, 3 = Least sensitive\r\n" /end ANNOTATION_TEXT
 /end ANNOTATION
/end CHARACTERISTIC
/begin CHARACTERISTIC DST_EFLASHB.DST_RefSpdCalc.DST_TIME2REFSPDFAIL "" VALUE 0x80606EAE DefaultValueRecordLayout_AUTOSAR_Platform_BaseTypes_uint16 100.0 RB_PT_PCT_SWC_DST_CompuMethods_DST_Time 0.0 100. FORMAT "%10.5"
 /begin ANNOTATION ANNOTATION_LABEL "Description (coming from AUTOSAR DESC field)"
  /begin ANNOTATION_TEXT "Time in seconds between the reference speed status flags being faulty and the reference speed status going true (and neutral being selected)\r\n" /end ANNOTATION_TEXT
 /end ANNOTATION
/end CHARACTERISTIC
/begin CHARACTERISTIC DST_EFLASHB.DST_SailingLogic.DST_SAILCANCELBRAKEPRESSURE "" VALUE 0x80606F38 DefaultValueRecordLayout_AUTOSAR_Platform_BaseTypes_uint16 409.5 RB_PT_PCT_SWC_DST_CompuMethods_ratio_0p1 0.0 409.5 FORMAT "%10.5"
 /begin ANNOTATION ANNOTATION_LABEL "Description (coming from AUTOSAR DESC field)" /begin ANNOTATION_TEXT "Brake pressure above this sailing will be disabled\r\n" /end ANNOTATION_TEXT /end ANNOTATION
/end CHARACTERISTIC
/begin CHARACTERISTIC DST_EFLASHB.DST_SailingLogic.DST_SAILCANCELENGSPD "" VALUE 0x80606F3A DefaultValueRecordLayout_AUTOSAR_Platform_BaseTypes_uint16 20000.0 RB_PT_PCT_SWC_DST_CompuMethods_ident 0.0 20000. FORMAT "%10.5"
 /begin ANNOTATION ANNOTATION_LABEL "Description (coming from AUTOSAR DESC field)"
  /begin ANNOTATION_TEXT "Sailing will only be enabled when the engine speed is below this threshold\r\n" /end ANNOTATION_TEXT
 /end ANNOTATION
/end CHARACTERISTIC
/begin CHARACTERISTIC DST_EFLASHB.DST_SailingLogic.DST_SAILCANCELTHROTTLE "" VALUE 0x80606F50 DefaultValueRecordLayout_AUTOSAR_Platform_BaseTypes_uint8 102.0 RB_PT_PCT_SWC_DST_CompuMethods_ratio_0p4 0.0 102. FORMAT "%10.5"
 /begin ANNOTATION ANNOTATION_LABEL "Description (coming from AUTOSAR DESC field)"
  /begin ANNOTATION_TEXT "If the throttle pedal is above this threshold, sailing style down-shifts will be cancelled\r\n" /end ANNOTATION_TEXT
 /end ANNOTATION
/end CHARACTERISTIC
/begin CHARACTERISTIC DST_EFLASHB.DST_SailingLogic.DST_SAILCANCELTIMESINCEBRAKE "" VALUE 0x80606F3C DefaultValueRecordLayout_AUTOSAR_Platform_BaseTypes_uint16 655.35 RB_PT_PCT_SWC_DST_CompuMethods_DST_Time 0.0 655.35 FORMAT "%10.5"
 /begin ANNOTATION ANNOTATION_LABEL "Description (coming from AUTOSAR DESC field)"
  /begin ANNOTATION_TEXT "The foot brake must have been applied this or less seconds ago to enable sailing\r\n" /end ANNOTATION_TEXT
 /end ANNOTATION
/end CHARACTERISTIC
/begin CHARACTERISTIC DST_EFLASHB.DST_SailingLogic.DST_SAILDISABLEGRADHIGH "" VALUE 0x80606F3E DefaultValueRecordLayout_AUTOSAR_Platform_BaseTypes_sint16 65.4 RB_PT_PCT_SWC_DST_CompuMethods_ratio_0p001 -32.7 32.7 FORMAT "%10.5"
 /begin ANNOTATION ANNOTATION_LABEL "Description (coming from AUTOSAR DESC field)"
  /begin ANNOTATION_TEXT "When the gradient is above this value, sailing power-off down-shifts will be disabled\r\n" /end ANNOTATION_TEXT
 /end ANNOTATION
/end CHARACTERISTIC
/begin CHARACTERISTIC DST_EFLASHB.DST_SailingLogic.DST_SAILDISABLEGRADLOW "" VALUE 0x80606F40 DefaultValueRecordLayout_AUTOSAR_Platform_BaseTypes_sint16 65.4 RB_PT_PCT_SWC_DST_CompuMethods_ratio_0p001 -32.7 32.7 FORMAT "%10.5"
 /begin ANNOTATION ANNOTATION_LABEL "Description (coming from AUTOSAR DESC field)"
  /begin ANNOTATION_TEXT "When the gradient is below this value, sailing power-off down-shifts will be disabled\r\n" /end ANNOTATION_TEXT
 /end ANNOTATION
/end CHARACTERISTIC
/begin CHARACTERISTIC DST_EFLASHB.DST_SailingLogic.DST_SAILDISABLELONGACCLOW "" VALUE 0x80606F42 DefaultValueRecordLayout_AUTOSAR_Platform_BaseTypes_sint16 4.0 RB_PT_PCT_SWC_DST_CompuMethods_ratio_0p01 -2. 2. FORMAT "%10.5"
 /begin ANNOTATION ANNOTATION_LABEL "Description (coming from AUTOSAR DESC field)"
  /begin ANNOTATION_TEXT "Longitudinal acceleration below which sailing will be disabled\r\n" /end ANNOTATION_TEXT
 /end ANNOTATION
/end CHARACTERISTIC
/begin CHARACTERISTIC DST_EFLASHB.DST_SailingLogic.DST_SAILENABLEGRADHIGH "" VALUE 0x80606F44 DefaultValueRecordLayout_AUTOSAR_Platform_BaseTypes_sint16 65.4 RB_PT_PCT_SWC_DST_CompuMethods_ratio_0p001 -32.7 32.7 FORMAT "%10.5"
 /begin ANNOTATION ANNOTATION_LABEL "Description (coming from AUTOSAR DESC field)"
  /begin ANNOTATION_TEXT "Upper gradient limit to allow sailing style down-shifts\r\n" /end ANNOTATION_TEXT
 /end ANNOTATION
/end CHARACTERISTIC
/begin CHARACTERISTIC DST_EFLASHB.DST_SailingLogic.DST_SAILENABLEGRADLOW "" VALUE 0x80606F46 DefaultValueRecordLayout_AUTOSAR_Platform_BaseTypes_sint16 65.4 RB_PT_PCT_SWC_DST_CompuMethods_ratio_0p001 -32.7 32.7 FORMAT "%10.5"
 /begin ANNOTATION ANNOTATION_LABEL "Description (coming from AUTOSAR DESC field)"
  /begin ANNOTATION_TEXT "Lower gradient limit to allow sailing style down-shifts\r\n" /end ANNOTATION_TEXT
 /end ANNOTATION
/end CHARACTERISTIC
/begin CHARACTERISTIC DST_EFLASHB.DST_SailingLogic.DST_SAILENABLELONGACC "" VALUE 0x80606F48 DefaultValueRecordLayout_AUTOSAR_Platform_BaseTypes_sint16 4.0 RB_PT_PCT_SWC_DST_CompuMethods_ratio_0p01 -2. 2. FORMAT "%10.5"
 /begin ANNOTATION ANNOTATION_LABEL "Description (coming from AUTOSAR DESC field)"
  /begin ANNOTATION_TEXT "Longitudinal acceleration below which sailing will be disabled\r\n" /end ANNOTATION_TEXT
 /end ANNOTATION
/end CHARACTERISTIC
/begin CHARACTERISTIC DST_EFLASHB.DST_SailingLogic.DST_SAILENABLEMAXGEAR "" VALUE 0x80606F51 DefaultValueRecordLayout_AUTOSAR_Platform_BaseTypes_uint8 11.0 RB_PT_PCT_SWC_DST_CompuMethods_ident 0.0 11. FORMAT "%10.5"
 /begin ANNOTATION ANNOTATION_LABEL "Description (coming from AUTOSAR DESC field)"
  /begin ANNOTATION_TEXT "Lowest target gear that sailing style down-shifts will be enabled\r\n" /end ANNOTATION_TEXT
 /end ANNOTATION
/end CHARACTERISTIC
/begin CHARACTERISTIC DST_EFLASHB.DST_SailingLogic.DST_SAILENABLEMINGEAR "" VALUE 0x80606F52 DefaultValueRecordLayout_AUTOSAR_Platform_BaseTypes_uint8 11.0 RB_PT_PCT_SWC_DST_CompuMethods_ident 0.0 11. FORMAT "%10.5"
 /begin ANNOTATION ANNOTATION_LABEL "Description (coming from AUTOSAR DESC field)"
  /begin ANNOTATION_TEXT "Lowest target gear that sailing style down-shifts will be enabled\r\n" /end ANNOTATION_TEXT
 /end ANNOTATION
/end CHARACTERISTIC
/begin CHARACTERISTIC DST_EFLASHB.DST_SailingLogic.DST_SAILENABLESHIFTMODE "" VAL_BLK 0x80606F26 DefaultValueRecordLayout_AUTOSAR_Platform_BaseTypes_boolean 255.0 AUTOSAR_Platform_CompuMethods_boolean 0.0 255. FORMAT "%10.5"
 /begin ANNOTATION ANNOTATION_LABEL "Description (coming from AUTOSAR DESC field)"
  /begin ANNOTATION_TEXT "If element is true, for that shift mode, open clutch power-off down-shifting will be enabled\r\n" /end ANNOTATION_TEXT
 /end ANNOTATION
 MATRIX_DIM 17 1 1 /end CHARACTERISTIC
/begin CHARACTERISTIC DST_EFLASHB.DST_SailingLogic.DST_SAILTRIGGERBRAKEPRESSURE "" VALUE 0x80606F4A DefaultValueRecordLayout_AUTOSAR_Platform_BaseTypes_uint16 409.5 RB_PT_PCT_SWC_DST_CompuMethods_ratio_0p1 0.0 409.5 FORMAT "%10.5"
 /begin ANNOTATION ANNOTATION_LABEL "Description (coming from AUTOSAR DESC field)" /begin ANNOTATION_TEXT "Brake pressure above this sailing will be disabled\r\n" /end ANNOTATION_TEXT /end ANNOTATION
/end CHARACTERISTIC
/begin CHARACTERISTIC DST_EFLASHB.DST_SailingLogic.DST_SAILTRIGGERTHROTTLE "" VALUE 0x80606F53 DefaultValueRecordLayout_AUTOSAR_Platform_BaseTypes_uint8 102.0 RB_PT_PCT_SWC_DST_CompuMethods_ratio_0p4 0.0 102. FORMAT "%10.5"
 /begin ANNOTATION ANNOTATION_LABEL "Description (coming from AUTOSAR DESC field)"
  /begin ANNOTATION_TEXT "Maximum throttle pedal angle to enable sailing style down-shifts\r\n" /end ANNOTATION_TEXT
 /end ANNOTATION
/end CHARACTERISTIC
/begin CHARACTERISTIC DST_EFLASHB.DST_SailingLogic.DST_SAILTRIGGERTIMESINCEBRAKE "" VALUE 0x80606F4C DefaultValueRecordLayout_AUTOSAR_Platform_BaseTypes_uint16 655.35 RB_PT_PCT_SWC_DST_CompuMethods_DST_Time 0.0 655.35 FORMAT "%10.5"
 /begin ANNOTATION ANNOTATION_LABEL "Description (coming from AUTOSAR DESC field)"
  /begin ANNOTATION_TEXT "The foot brake must have been applied this or less seconds ago to enable sailing\r\n" /end ANNOTATION_TEXT
 /end ANNOTATION
/end CHARACTERISTIC
/begin CHARACTERISTIC DST_EFLASHB.DST_SailingLogic.DST_TIMEOFFTHROTTLE2SAIL "" VALUE 0x80606F4E DefaultValueRecordLayout_AUTOSAR_Platform_BaseTypes_uint16 655.35 RB_PT_PCT_SWC_DST_CompuMethods_DST_Time 0.0 655.35 FORMAT "%10.5"
 /begin ANNOTATION ANNOTATION_LABEL "Description (coming from AUTOSAR DESC field)"
  /begin ANNOTATION_TEXT "Time the throttle must be zero before sailing is triggered\r\n" /end ANNOTATION_TEXT
 /end ANNOTATION
/end CHARACTERISTIC
/begin CHARACTERISTIC DST_EFLASHB_MKT.DST_ModeSelectGeneric.DST_BOBCALSELECT "" VALUE 0x80605F00 DefaultValueRecordLayout_AUTOSAR_Platform_BaseTypes_uint8 6.0 RB_PT_PCT_SWC_DST_CompuMethods_Enumerations_DST_CalSelect 0.0 6. FORMAT "%10.5"
 /begin ANNOTATION ANNOTATION_LABEL "Description (coming from AUTOSAR DESC field)"
  /begin ANNOTATION_TEXT "Used to force the calibration in use.  For testing only\r\n" /end ANNOTATION_TEXT
 /end ANNOTATION
/end CHARACTERISTIC
/begin CHARACTERISTIC DST_EFLASHROMB.DST_DG.DST_ShiftPointsAndComp.DST_ShiftCompensation.DST_CORNERMAXOFFSET "" MAP 0x806044CE RB_PT_PCT_SWC_DST_RecordLayouts_RL_Map_sint16_68_uint8_4_uint8_17 20000.0 RB_PT_PCT_SWC_DST_CompuMethods_DST_Ident -10000. 10000. FORMAT "%10.5"
 /begin ANNOTATION ANNOTATION_LABEL "Description (coming from AUTOSAR DESC field)"
  /begin ANNOTATION_TEXT "Offset to apply to the maximum engine speed after gradient compensation\r\n" /end ANNOTATION_TEXT
 /end ANNOTATION
 /begin AXIS_DESCR STD_AXIS NO_INPUT_QUANTITY RB_PT_PCT_SWC_DST_CompuMethods_ratio_0p01 4 0.0 1.27 FORMAT "%10.5" DEPOSIT ABSOLUTE /end AXIS_DESCR
 /begin AXIS_DESCR STD_AXIS NO_INPUT_QUANTITY RB_PT_PCT_SWC_DST_CompuMethods_ident 17 0.0 16. FORMAT "%10.5" DEPOSIT ABSOLUTE /end AXIS_DESCR
/end CHARACTERISTIC
/begin CHARACTERISTIC DST_EFLASHROMB.DST_DG.DST_ShiftPointsAndComp.DST_ShiftCompensation.DST_CORNERMINOFFSET "" MAP 0x80604570 RB_PT_PCT_SWC_DST_RecordLayouts_RL_Map_sint16_68_uint8_4_uint8_17 20000.0 RB_PT_PCT_SWC_DST_CompuMethods_DST_Ident -10000. 10000. FORMAT "%10.5"
 /begin ANNOTATION ANNOTATION_LABEL "Description (coming from AUTOSAR DESC field)"
  /begin ANNOTATION_TEXT "Offset to apply to the minimum engine speed after gradient compensation\r\n" /end ANNOTATION_TEXT
 /end ANNOTATION
 /begin AXIS_DESCR STD_AXIS NO_INPUT_QUANTITY RB_PT_PCT_SWC_DST_CompuMethods_ratio_0p01 4 0.0 1.27 FORMAT "%10.5" DEPOSIT ABSOLUTE /end AXIS_DESCR
 /begin AXIS_DESCR STD_AXIS NO_INPUT_QUANTITY RB_PT_PCT_SWC_DST_CompuMethods_ident 17 0.0 16. FORMAT "%10.5" DEPOSIT ABSOLUTE /end AXIS_DESCR
/end CHARACTERISTIC
/begin CHARACTERISTIC DST_EFLASHROMB.DST_DG.DST_ShiftPointsAndComp.DST_ShiftCompensation.DST_DECELDOWNSHIFTRPM "" MAP 0x80604612 RB_PT_PCT_SWC_DST_RecordLayouts_RL_Map_sint16_36_sint16_6_uint8_6 20000.0 RB_PT_PCT_SWC_DST_CompuMethods_DST_Ident 0.0 20000. FORMAT "%10.5"
 /begin ANNOTATION ANNOTATION_LABEL "Description (coming from AUTOSAR DESC field)" /begin ANNOTATION_TEXT "Minimum engine speed in each gear in Decel\r\n" /end ANNOTATION_TEXT /end ANNOTATION
 /begin AXIS_DESCR STD_AXIS NO_INPUT_QUANTITY RB_PT_PCT_SWC_DST_CompuMethods_ratio_0p01 6 -5. 5. FORMAT "%10.5" DEPOSIT ABSOLUTE /end AXIS_DESCR
 /begin AXIS_DESCR STD_AXIS NO_INPUT_QUANTITY RB_PT_PCT_SWC_DST_CompuMethods_ident 6 0.0 5. FORMAT "%10.5" DEPOSIT ABSOLUTE /end AXIS_DESCR
/end CHARACTERISTIC
/begin CHARACTERISTIC DST_EFLASHROMB.DST_DG.DST_ShiftPointsAndComp.DST_ShiftCompensation.DST_DECELDOWNSHIFTRPMMAXBRAKE "" MAP 0x80604670 RB_PT_PCT_SWC_DST_RecordLayouts_RL_Map_uint16_60_uint8_6_uint8_10 20000.0 RB_PT_PCT_SWC_DST_CompuMethods_ident 0.0 20000. FORMAT "%10.5"
 /begin ANNOTATION ANNOTATION_LABEL "Description (coming from AUTOSAR DESC field)"
  /begin ANNOTATION_TEXT "When DST_HighBrakingLatched is true and in an automatic mode, these are the downshift points, inputs Decel Aggresssion and forward gear\r\n" /end ANNOTATION_TEXT
 /end ANNOTATION
 /begin AXIS_DESCR STD_AXIS NO_INPUT_QUANTITY RB_PT_PCT_SWC_DST_CompuMethods_ident 6 0.0 5. FORMAT "%10.5" DEPOSIT ABSOLUTE /end AXIS_DESCR
 /begin AXIS_DESCR STD_AXIS NO_INPUT_QUANTITY RB_PT_PCT_SWC_DST_CompuMethods_ident 10 0.0 10. FORMAT "%10.5" DEPOSIT ABSOLUTE /end AXIS_DESCR
/end CHARACTERISTIC
/begin CHARACTERISTIC DST_EFLASHROMB.DST_DG.DST_ShiftPointsAndComp.DST_ShiftCompensation.DST_DECElGEAROFFSET "" MAP 0x806046FC RB_PT_PCT_SWC_DST_RecordLayouts_RL_Map_uint16_60_uint8_6_uint8_10 2.0 RB_PT_PCT_SWC_DST_CompuMethods_ratio_0p001 0.0 2. FORMAT "%10.5"
 /begin ANNOTATION ANNOTATION_LABEL "Description (coming from AUTOSAR DESC field)" /begin ANNOTATION_TEXT "Offset to multiply to the min rpm based on the gear\r\n" /end ANNOTATION_TEXT /end ANNOTATION
 /begin AXIS_DESCR STD_AXIS NO_INPUT_QUANTITY RB_PT_PCT_SWC_DST_CompuMethods_ident 6 0.0 5. FORMAT "%10.5" DEPOSIT ABSOLUTE /end AXIS_DESCR
 /begin AXIS_DESCR STD_AXIS NO_INPUT_QUANTITY RB_PT_PCT_SWC_DST_CompuMethods_ident 10 0.0 10. FORMAT "%10.5" DEPOSIT ABSOLUTE /end AXIS_DESCR
/end CHARACTERISTIC
/begin CHARACTERISTIC DST_EFLASHROMB.DST_DG.DST_ShiftPointsAndComp.DST_ShiftCompensation.DST_DOWNSHIFTABOVEIDLEENGTEMP "" CURVE 0x80604788 RB_PT_PCT_SWC_DST_RecordLayouts_RL_Curve_uint16_7_sint16_7 20000.0 RB_PT_PCT_SWC_DST_CompuMethods_ident 0.0 20000. FORMAT "%10.5"
 /begin ANNOTATION ANNOTATION_LABEL "Description (coming from AUTOSAR DESC field)"
  /begin ANNOTATION_TEXT "Minimum engine speed above idle to request a downshift based on engine temperature\r\n" /end ANNOTATION_TEXT
 /end ANNOTATION
 /begin AXIS_DESCR STD_AXIS NO_INPUT_QUANTITY RB_PT_PCT_SWC_DST_CompuMethods_ident 7 -60. 200. FORMAT "%10.5" DEPOSIT ABSOLUTE /end AXIS_DESCR
/end CHARACTERISTIC
/begin CHARACTERISTIC DST_EFLASHROMB.DST_DG.DST_ShiftPointsAndComp.DST_ShiftCompensation.DST_DOWNSHIFTABOVEIDLEIDLESPEED "" CURVE 0x806047A6 RB_PT_PCT_SWC_DST_RecordLayouts_RL_Curve_uint16_7_uint16_7 20000.0 RB_PT_PCT_SWC_DST_CompuMethods_ident 0.0 20000. FORMAT "%10.5"
 /begin ANNOTATION ANNOTATION_LABEL "Description (coming from AUTOSAR DESC field)"
  /begin ANNOTATION_TEXT "Minimum downshift rpm above idle based on the idle speed flag sent on CAN\r\n" /end ANNOTATION_TEXT
 /end ANNOTATION
 /begin AXIS_DESCR STD_AXIS NO_INPUT_QUANTITY RB_PT_PCT_SWC_DST_CompuMethods_ident 7 0.0 20000. FORMAT "%10.5" DEPOSIT ABSOLUTE /end AXIS_DESCR
/end CHARACTERISTIC
/begin CHARACTERISTIC DST_EFLASHROMB.DST_DG.DST_ShiftPointsAndComp.DST_ShiftCompensation.DST_GRADMAXOFFSET "" MAP 0x806047C4 RB_PT_PCT_SWC_DST_RecordLayouts_RL_Map_sint16_99_sint16_9_uint8_11 20000.0 RB_PT_PCT_SWC_DST_CompuMethods_DST_Ident -10000. 10000. FORMAT "%10.5"
 /begin ANNOTATION ANNOTATION_LABEL "Description (coming from AUTOSAR DESC field)"
  /begin ANNOTATION_TEXT "Offset to add to the maximum engine speed depending on the gradient\r\n" /end ANNOTATION_TEXT
 /end ANNOTATION
 /begin AXIS_DESCR STD_AXIS NO_INPUT_QUANTITY RB_PT_PCT_SWC_DST_CompuMethods_ratio_0p001 9 -32.7 32.7 FORMAT "%10.5" DEPOSIT ABSOLUTE /end AXIS_DESCR
 /begin AXIS_DESCR STD_AXIS NO_INPUT_QUANTITY RB_PT_PCT_SWC_DST_CompuMethods_ident 11 0.0 11. FORMAT "%10.5" DEPOSIT ABSOLUTE /end AXIS_DESCR
/end CHARACTERISTIC
/begin CHARACTERISTIC DST_EFLASHROMB.DST_DG.DST_ShiftPointsAndComp.DST_ShiftCompensation.DST_GRADMINOFFSET "" MAP 0x806048AC RB_PT_PCT_SWC_DST_RecordLayouts_RL_Map_sint16_81_sint16_9_uint8_9 20000.0 RB_PT_PCT_SWC_DST_CompuMethods_DST_Ident -10000. 10000. FORMAT "%10.5"
 /begin ANNOTATION ANNOTATION_LABEL "Description (coming from AUTOSAR DESC field)"
  /begin ANNOTATION_TEXT "Offset to subtract from the minimum engine speed depending on the gradient\r\n" /end ANNOTATION_TEXT
 /end ANNOTATION
 /begin AXIS_DESCR STD_AXIS NO_INPUT_QUANTITY RB_PT_PCT_SWC_DST_CompuMethods_ratio_0p001 9 -32.7 32.7 FORMAT "%10.5" DEPOSIT ABSOLUTE /end AXIS_DESCR
 /begin AXIS_DESCR STD_AXIS NO_INPUT_QUANTITY RB_PT_PCT_SWC_DST_CompuMethods_ident 9 0.0 10. FORMAT "%10.5" DEPOSIT ABSOLUTE /end AXIS_DESCR
/end CHARACTERISTIC
/begin CHARACTERISTIC DST_EFLASHROMB.DST_DG.DST_ShiftPointsAndComp.DST_ShiftCompensation.DST_MINSHIFTHYSTIDLEENGTEMP "" CURVE 0x8060496E RB_PT_PCT_SWC_DST_RecordLayouts_RL_Curve_uint16_7_sint16_7 20000.0 RB_PT_PCT_SWC_DST_CompuMethods_ident 0.0 20000. FORMAT "%10.5"
 /begin ANNOTATION ANNOTATION_LABEL "Description (coming from AUTOSAR DESC field)"
  /begin ANNOTATION_TEXT "Added to IdleMinDownshift to generate the lowest rpm requested after an upshift (DST_IdleMinRpmAfterUpshift)\r\n" /end ANNOTATION_TEXT
 /end ANNOTATION
 /begin AXIS_DESCR STD_AXIS NO_INPUT_QUANTITY RB_PT_PCT_SWC_DST_CompuMethods_ident 7 -60. 200. FORMAT "%10.5" DEPOSIT ABSOLUTE /end AXIS_DESCR
/end CHARACTERISTIC
/begin CHARACTERISTIC DST_EFLASHROMB.DST_DG.DST_ShiftPointsAndComp.DST_ShiftCompensation.DST_MINSHIFTHYSTIDLESPEED "" CURVE 0x8060498C RB_PT_PCT_SWC_DST_RecordLayouts_RL_Curve_uint16_7_uint16_7 20000.0 RB_PT_PCT_SWC_DST_CompuMethods_ident 0.0 20000. FORMAT "%10.5"
 /begin ANNOTATION ANNOTATION_LABEL "Description (coming from AUTOSAR DESC field)"
  /begin ANNOTATION_TEXT "Added to IdleMinDownshift to generate the lowest rpm requested after an upshift (DST_IdleMinRpmAfterUpshift)\r\n" /end ANNOTATION_TEXT
 /end ANNOTATION
 /begin AXIS_DESCR STD_AXIS NO_INPUT_QUANTITY RB_PT_PCT_SWC_DST_CompuMethods_ident 7 0.0 20000. FORMAT "%10.5" DEPOSIT ABSOLUTE /end AXIS_DESCR
/end CHARACTERISTIC
/begin CHARACTERISTIC DST_EFLASHROMB.DST_DG.DST_ShiftPointsAndComp.DST_ShiftCompensation.DST_MINSHIFTHYSTSHIFTMODE "" VAL_BLK 0x806044AC DefaultValueRecordLayout_AUTOSAR_Platform_BaseTypes_uint16 20000.0 RB_PT_PCT_SWC_DST_CompuMethods_ident 0.0 20000. FORMAT "%10.5"
 /begin ANNOTATION ANNOTATION_LABEL "Description (coming from AUTOSAR DESC field)"
  /begin ANNOTATION_TEXT "Value added to idle speed and rpm above idle speed to generate minimum rpm allowed in next highest gear after and upshift\r\n" /end ANNOTATION_TEXT
 /end ANNOTATION
 MATRIX_DIM 17 1 1 /end CHARACTERISTIC
/begin CHARACTERISTIC DST_EFLASHROMB.DST_DG.DST_ShiftPointsAndComp.DST_ShiftMaps.DST_KDMODES "" VAL_BLK 0x806049EE DefaultValueRecordLayout_AUTOSAR_Platform_BaseTypes_boolean 255.0 AUTOSAR_Platform_CompuMethods_boolean 0.0 255. FORMAT "%10.5"
 /begin ANNOTATION ANNOTATION_LABEL "Description (coming from AUTOSAR DESC field)" /begin ANNOTATION_TEXT "If true, Kickdown is allowed in associated  mode\r\n" /end ANNOTATION_TEXT /end ANNOTATION
 MATRIX_DIM 17 1 1 /end CHARACTERISTIC
/begin CHARACTERISTIC DST_EFLASHROMB.DST_DG.DST_ShiftPointsAndComp.DST_ShiftMaps.DST_MAXRPM_AUTO_01 "" MAP 0x80604B26 RB_PT_PCT_SWC_DST_RecordLayouts_RL_Map_sint16_108_uint16_12_uint8_9 20000.0 RB_PT_PCT_SWC_DST_CompuMethods_DST_Ident 0.0 20000. FORMAT "%10.5"
 /begin ANNOTATION ANNOTATION_LABEL "Description (coming from AUTOSAR DESC field)"
  /begin ANNOTATION_TEXT "Min Engine Speed for each gear at a given driver demand\r\n" /end ANNOTATION_TEXT
 /end ANNOTATION
 /begin AXIS_DESCR STD_AXIS NO_INPUT_QUANTITY RB_PT_PCT_SWC_DST_CompuMethods_ratio_0p1 12 0.0 110. FORMAT "%10.5" DEPOSIT ABSOLUTE /end AXIS_DESCR
 /begin AXIS_DESCR STD_AXIS NO_INPUT_QUANTITY RB_PT_PCT_SWC_DST_CompuMethods_ident 9 1. 9. FORMAT "%10.5" DEPOSIT ABSOLUTE /end AXIS_DESCR
/end CHARACTERISTIC
/begin CHARACTERISTIC DST_EFLASHROMB.DST_DG.DST_ShiftPointsAndComp.DST_ShiftMaps.DST_MAXRPM_AUTO_02 "" MAP 0x80604C24 RB_PT_PCT_SWC_DST_RecordLayouts_RL_Map_sint16_108_uint16_12_uint8_9 20000.0 RB_PT_PCT_SWC_DST_CompuMethods_DST_Ident 0.0 20000. FORMAT "%10.5"
 /begin ANNOTATION ANNOTATION_LABEL "Description (coming from AUTOSAR DESC field)"
  /begin ANNOTATION_TEXT "Min Engine Speed for each gear at a given driver demand\r\n" /end ANNOTATION_TEXT
 /end ANNOTATION
 /begin AXIS_DESCR STD_AXIS NO_INPUT_QUANTITY RB_PT_PCT_SWC_DST_CompuMethods_ratio_0p1 12 0.0 110. FORMAT "%10.5" DEPOSIT ABSOLUTE /end AXIS_DESCR
 /begin AXIS_DESCR STD_AXIS NO_INPUT_QUANTITY RB_PT_PCT_SWC_DST_CompuMethods_ident 9 1. 9. FORMAT "%10.5" DEPOSIT ABSOLUTE /end AXIS_DESCR
/end CHARACTERISTIC
/begin CHARACTERISTIC DST_EFLASHROMB.DST_DG.DST_ShiftPointsAndComp.DST_ShiftMaps.DST_MAXRPM_AUTO_03 "" MAP 0x80604D22 RB_PT_PCT_SWC_DST_RecordLayouts_RL_Map_sint16_108_uint16_12_uint8_9 20000.0 RB_PT_PCT_SWC_DST_CompuMethods_DST_Ident 0.0 20000. FORMAT "%10.5"
 /begin ANNOTATION ANNOTATION_LABEL "Description (coming from AUTOSAR DESC field)"
  /begin ANNOTATION_TEXT "Min Engine Speed for each gear at a given driver demand\r\n" /end ANNOTATION_TEXT
 /end ANNOTATION
 /begin AXIS_DESCR STD_AXIS NO_INPUT_QUANTITY RB_PT_PCT_SWC_DST_CompuMethods_ratio_0p1 12 0.0 110. FORMAT "%10.5" DEPOSIT ABSOLUTE /end AXIS_DESCR
 /begin AXIS_DESCR STD_AXIS NO_INPUT_QUANTITY RB_PT_PCT_SWC_DST_CompuMethods_ident 9 1. 9. FORMAT "%10.5" DEPOSIT ABSOLUTE /end AXIS_DESCR
/end CHARACTERISTIC
/begin CHARACTERISTIC DST_EFLASHROMB.DST_DG.DST_ShiftPointsAndComp.DST_ShiftMaps.DST_MAXRPM_AUTO_04 "" MAP 0x80604E20 RB_PT_PCT_SWC_DST_RecordLayouts_RL_Map_sint16_108_uint16_12_uint8_9 20000.0 RB_PT_PCT_SWC_DST_CompuMethods_DST_Ident 0.0 20000. FORMAT "%10.5"
 /begin ANNOTATION ANNOTATION_LABEL "Description (coming from AUTOSAR DESC field)"
  /begin ANNOTATION_TEXT "Min Engine Speed for each gear at a given driver demand\r\n" /end ANNOTATION_TEXT
 /end ANNOTATION
 /begin AXIS_DESCR STD_AXIS NO_INPUT_QUANTITY RB_PT_PCT_SWC_DST_CompuMethods_ratio_0p1 12 0.0 110. FORMAT "%10.5" DEPOSIT ABSOLUTE /end AXIS_DESCR
 /begin AXIS_DESCR STD_AXIS NO_INPUT_QUANTITY RB_PT_PCT_SWC_DST_CompuMethods_ident 9 1. 9. FORMAT "%10.5" DEPOSIT ABSOLUTE /end AXIS_DESCR
/end CHARACTERISTIC
/begin CHARACTERISTIC DST_EFLASHROMB.DST_DG.DST_ShiftPointsAndComp.DST_ShiftMaps.DST_MAXRPM_AUTO_05 "" MAP 0x80604F1E RB_PT_PCT_SWC_DST_RecordLayouts_RL_Map_sint16_108_uint16_12_uint8_9 20000.0 RB_PT_PCT_SWC_DST_CompuMethods_DST_Ident 0.0 20000. FORMAT "%10.5"
 /begin ANNOTATION ANNOTATION_LABEL "Description (coming from AUTOSAR DESC field)"
  /begin ANNOTATION_TEXT "Min Engine Speed for each gear at a given driver demand\r\n" /end ANNOTATION_TEXT
 /end ANNOTATION
 /begin AXIS_DESCR STD_AXIS NO_INPUT_QUANTITY RB_PT_PCT_SWC_DST_CompuMethods_ratio_0p1 12 0.0 110. FORMAT "%10.5" DEPOSIT ABSOLUTE /end AXIS_DESCR
 /begin AXIS_DESCR STD_AXIS NO_INPUT_QUANTITY RB_PT_PCT_SWC_DST_CompuMethods_ident 9 1. 9. FORMAT "%10.5" DEPOSIT ABSOLUTE /end AXIS_DESCR
/end CHARACTERISTIC
/begin CHARACTERISTIC DST_EFLASHROMB.DST_DG.DST_ShiftPointsAndComp.DST_ShiftMaps.DST_MAXRPM_AUTO_06 "" MAP 0x8060501C RB_PT_PCT_SWC_DST_RecordLayouts_RL_Map_sint16_108_uint16_12_uint8_9 20000.0 RB_PT_PCT_SWC_DST_CompuMethods_DST_Ident 0.0 20000. FORMAT "%10.5"
 /begin ANNOTATION ANNOTATION_LABEL "Description (coming from AUTOSAR DESC field)"
  /begin ANNOTATION_TEXT "Min Engine Speed for each gear at a given driver demand\r\n" /end ANNOTATION_TEXT
 /end ANNOTATION
 /begin AXIS_DESCR STD_AXIS NO_INPUT_QUANTITY RB_PT_PCT_SWC_DST_CompuMethods_ratio_0p1 12 0.0 110. FORMAT "%10.5" DEPOSIT ABSOLUTE /end AXIS_DESCR
 /begin AXIS_DESCR STD_AXIS NO_INPUT_QUANTITY RB_PT_PCT_SWC_DST_CompuMethods_ident 9 1. 9. FORMAT "%10.5" DEPOSIT ABSOLUTE /end AXIS_DESCR
/end CHARACTERISTIC
/begin CHARACTERISTIC DST_EFLASHROMB.DST_DG.DST_ShiftPointsAndComp.DST_ShiftMaps.DST_MAXRPM_AUTO_07 "" MAP 0x8060511A RB_PT_PCT_SWC_DST_RecordLayouts_RL_Map_sint16_108_uint16_12_uint8_9 20000.0 RB_PT_PCT_SWC_DST_CompuMethods_DST_Ident 0.0 20000. FORMAT "%10.5"
 /begin ANNOTATION ANNOTATION_LABEL "Description (coming from AUTOSAR DESC field)"
  /begin ANNOTATION_TEXT "Min Engine Speed for each gear at a given driver demand\r\n" /end ANNOTATION_TEXT
 /end ANNOTATION
 /begin AXIS_DESCR STD_AXIS NO_INPUT_QUANTITY RB_PT_PCT_SWC_DST_CompuMethods_ratio_0p1 12 0.0 110. FORMAT "%10.5" DEPOSIT ABSOLUTE /end AXIS_DESCR
 /begin AXIS_DESCR STD_AXIS NO_INPUT_QUANTITY RB_PT_PCT_SWC_DST_CompuMethods_ident 9 1. 9. FORMAT "%10.5" DEPOSIT ABSOLUTE /end AXIS_DESCR
/end CHARACTERISTIC
/begin CHARACTERISTIC DST_EFLASHROMB.DST_DG.DST_ShiftPointsAndComp.DST_ShiftMaps.DST_MAXRPM_AUTO_08 "" MAP 0x80605218 RB_PT_PCT_SWC_DST_RecordLayouts_RL_Map_sint16_108_uint16_12_uint8_9 20000.0 RB_PT_PCT_SWC_DST_CompuMethods_DST_Ident 0.0 20000. FORMAT "%10.5"
 /begin ANNOTATION ANNOTATION_LABEL "Description (coming from AUTOSAR DESC field)"
  /begin ANNOTATION_TEXT "Min Engine Speed for each gear at a given driver demand\r\n" /end ANNOTATION_TEXT
 /end ANNOTATION
 /begin AXIS_DESCR STD_AXIS NO_INPUT_QUANTITY RB_PT_PCT_SWC_DST_CompuMethods_ratio_0p1 12 0.0 110. FORMAT "%10.5" DEPOSIT ABSOLUTE /end AXIS_DESCR
 /begin AXIS_DESCR STD_AXIS NO_INPUT_QUANTITY RB_PT_PCT_SWC_DST_CompuMethods_ident 9 1. 9. FORMAT "%10.5" DEPOSIT ABSOLUTE /end AXIS_DESCR
/end CHARACTERISTIC
/begin CHARACTERISTIC DST_EFLASHROMB.DST_DG.DST_ShiftPointsAndComp.DST_ShiftMaps.DST_MAXRPM_AUTO_09 "" MAP 0x80605316 RB_PT_PCT_SWC_DST_RecordLayouts_RL_Map_sint16_108_uint16_12_uint8_9 20000.0 RB_PT_PCT_SWC_DST_CompuMethods_DST_Ident 0.0 20000. FORMAT "%10.5"
 /begin ANNOTATION ANNOTATION_LABEL "Description (coming from AUTOSAR DESC field)"
  /begin ANNOTATION_TEXT "Min Engine Speed for each gear at a given driver demand\r\n" /end ANNOTATION_TEXT
 /end ANNOTATION
 /begin AXIS_DESCR STD_AXIS NO_INPUT_QUANTITY RB_PT_PCT_SWC_DST_CompuMethods_ratio_0p1 12 0.0 110. FORMAT "%10.5" DEPOSIT ABSOLUTE /end AXIS_DESCR
 /begin AXIS_DESCR STD_AXIS NO_INPUT_QUANTITY RB_PT_PCT_SWC_DST_CompuMethods_ident 9 1. 9. FORMAT "%10.5" DEPOSIT ABSOLUTE /end AXIS_DESCR
/end CHARACTERISTIC
/begin CHARACTERISTIC DST_EFLASHROMB.DST_DG.DST_ShiftPointsAndComp.DST_ShiftMaps.DST_MAXRPM_AUTO_10 "" MAP 0x80605414 RB_PT_PCT_SWC_DST_RecordLayouts_RL_Map_sint16_108_uint16_12_uint8_9 20000.0 RB_PT_PCT_SWC_DST_CompuMethods_DST_Ident 0.0 20000. FORMAT "%10.5"
 /begin ANNOTATION ANNOTATION_LABEL "Description (coming from AUTOSAR DESC field)"
  /begin ANNOTATION_TEXT "Min Engine Speed for each gear at a given driver demand\r\n" /end ANNOTATION_TEXT
 /end ANNOTATION
 /begin AXIS_DESCR STD_AXIS NO_INPUT_QUANTITY RB_PT_PCT_SWC_DST_CompuMethods_ratio_0p1 12 0.0 110. FORMAT "%10.5" DEPOSIT ABSOLUTE /end AXIS_DESCR
 /begin AXIS_DESCR STD_AXIS NO_INPUT_QUANTITY RB_PT_PCT_SWC_DST_CompuMethods_ident 9 1. 9. FORMAT "%10.5" DEPOSIT ABSOLUTE /end AXIS_DESCR
/end CHARACTERISTIC
/begin CHARACTERISTIC DST_EFLASHROMB.DST_DG.DST_ShiftPointsAndComp.DST_ShiftMaps.DST_MAXRPM_LAUNCH "" VAL_BLK 0x80604A9A DefaultValueRecordLayout_AUTOSAR_Platform_BaseTypes_sint16 20000.0 RB_PT_PCT_SWC_DST_CompuMethods_DST_Ident 0.0 20000. FORMAT "%10.5"
 /begin ANNOTATION ANNOTATION_LABEL "Description (coming from AUTOSAR DESC field)" /begin ANNOTATION_TEXT "Maximum engine speed in each gearin manual mode\r\n" /end ANNOTATION_TEXT /end ANNOTATION
 MATRIX_DIM 10 1 1 /end CHARACTERISTIC
/begin CHARACTERISTIC DST_EFLASHROMB.DST_DG.DST_ShiftPointsAndComp.DST_ShiftMaps.DST_MAXRPM_MAN_01 "" VAL_BLK 0x80604AAE DefaultValueRecordLayout_AUTOSAR_Platform_BaseTypes_sint16 20000.0 RB_PT_PCT_SWC_DST_CompuMethods_DST_Ident 0.0 20000. FORMAT "%10.5"
 /begin ANNOTATION ANNOTATION_LABEL "Description (coming from AUTOSAR DESC field)" /begin ANNOTATION_TEXT "Maximum engine speed in each gearin manual mode\r\n" /end ANNOTATION_TEXT /end ANNOTATION
 MATRIX_DIM 10 1 1 /end CHARACTERISTIC
/begin CHARACTERISTIC DST_EFLASHROMB.DST_DG.DST_ShiftPointsAndComp.DST_ShiftMaps.DST_MAXRPM_MAN_02 "" VAL_BLK 0x80604AC2 DefaultValueRecordLayout_AUTOSAR_Platform_BaseTypes_sint16 20000.0 RB_PT_PCT_SWC_DST_CompuMethods_DST_Ident 0.0 20000. FORMAT "%10.5"
 /begin ANNOTATION ANNOTATION_LABEL "Description (coming from AUTOSAR DESC field)" /begin ANNOTATION_TEXT "Maximum engine speed in each gearin manual mode\r\n" /end ANNOTATION_TEXT /end ANNOTATION
 MATRIX_DIM 10 1 1 /end CHARACTERISTIC
/begin CHARACTERISTIC DST_EFLASHROMB.DST_DG.DST_ShiftPointsAndComp.DST_ShiftMaps.DST_MAXRPM_MAN_03 "" VAL_BLK 0x80604AD6 DefaultValueRecordLayout_AUTOSAR_Platform_BaseTypes_sint16 20000.0 RB_PT_PCT_SWC_DST_CompuMethods_DST_Ident 0.0 20000. FORMAT "%10.5"
 /begin ANNOTATION ANNOTATION_LABEL "Description (coming from AUTOSAR DESC field)" /begin ANNOTATION_TEXT "Maximum engine speed in each gearin manual mode\r\n" /end ANNOTATION_TEXT /end ANNOTATION
 MATRIX_DIM 10 1 1 /end CHARACTERISTIC
/begin CHARACTERISTIC DST_EFLASHROMB.DST_DG.DST_ShiftPointsAndComp.DST_ShiftMaps.DST_MAXRPM_MAN_04 "" VAL_BLK 0x80604AEA DefaultValueRecordLayout_AUTOSAR_Platform_BaseTypes_sint16 20000.0 RB_PT_PCT_SWC_DST_CompuMethods_DST_Ident 0.0 20000. FORMAT "%10.5"
 /begin ANNOTATION ANNOTATION_LABEL "Description (coming from AUTOSAR DESC field)" /begin ANNOTATION_TEXT "Maximum engine speed in each gearin manual mode\r\n" /end ANNOTATION_TEXT /end ANNOTATION
 MATRIX_DIM 10 1 1 /end CHARACTERISTIC
/begin CHARACTERISTIC DST_EFLASHROMB.DST_DG.DST_ShiftPointsAndComp.DST_ShiftMaps.DST_MAXRPM_MAN_05 "" VAL_BLK 0x80604AFE DefaultValueRecordLayout_AUTOSAR_Platform_BaseTypes_sint16 20000.0 RB_PT_PCT_SWC_DST_CompuMethods_DST_Ident 0.0 20000. FORMAT "%10.5"
 /begin ANNOTATION ANNOTATION_LABEL "Description (coming from AUTOSAR DESC field)" /begin ANNOTATION_TEXT "Maximum engine speed in each gearin manual mode\r\n" /end ANNOTATION_TEXT /end ANNOTATION
 MATRIX_DIM 10 1 1 /end CHARACTERISTIC
/begin CHARACTERISTIC DST_EFLASHROMB.DST_DG.DST_ShiftPointsAndComp.DST_ShiftMaps.DST_MAXRPM_MAN_06 "" VAL_BLK 0x80604B12 DefaultValueRecordLayout_AUTOSAR_Platform_BaseTypes_sint16 20000.0 RB_PT_PCT_SWC_DST_CompuMethods_DST_Ident 0.0 20000. FORMAT "%10.5"
 /begin ANNOTATION ANNOTATION_LABEL "Description (coming from AUTOSAR DESC field)" /begin ANNOTATION_TEXT "Maximum engine speed in each gearin manual mode\r\n" /end ANNOTATION_TEXT /end ANNOTATION
 MATRIX_DIM 10 1 1 /end CHARACTERISTIC
/begin CHARACTERISTIC DST_EFLASHROMB.DST_DG.DST_ShiftPointsAndComp.DST_ShiftMaps.DST_MINRPM_AUTO_01 "" MAP 0x80605512 RB_PT_PCT_SWC_DST_RecordLayouts_RL_Map_sint16_108_uint16_12_uint8_9 20000.0 RB_PT_PCT_SWC_DST_CompuMethods_DST_Ident 0.0 20000. FORMAT "%10.5"
 /begin ANNOTATION ANNOTATION_LABEL "Description (coming from AUTOSAR DESC field)"
  /begin ANNOTATION_TEXT "Min Engine Speed for each gear at a given driver demand\r\n" /end ANNOTATION_TEXT
 /end ANNOTATION
 /begin AXIS_DESCR STD_AXIS NO_INPUT_QUANTITY RB_PT_PCT_SWC_DST_CompuMethods_ratio_0p1 12 0.0 110. FORMAT "%10.5" DEPOSIT ABSOLUTE /end AXIS_DESCR
 /begin AXIS_DESCR STD_AXIS NO_INPUT_QUANTITY RB_PT_PCT_SWC_DST_CompuMethods_ident 9 2. 10. FORMAT "%10.5" DEPOSIT ABSOLUTE /end AXIS_DESCR
/end CHARACTERISTIC
/begin CHARACTERISTIC DST_EFLASHROMB.DST_DG.DST_ShiftPointsAndComp.DST_ShiftMaps.DST_MINRPM_AUTO_02 "" MAP 0x80605610 RB_PT_PCT_SWC_DST_RecordLayouts_RL_Map_sint16_108_uint16_12_uint8_9 20000.0 RB_PT_PCT_SWC_DST_CompuMethods_DST_Ident 0.0 20000. FORMAT "%10.5"
 /begin ANNOTATION ANNOTATION_LABEL "Description (coming from AUTOSAR DESC field)"
  /begin ANNOTATION_TEXT "Min Engine Speed for each gear at a given driver demand\r\n" /end ANNOTATION_TEXT
 /end ANNOTATION
 /begin AXIS_DESCR STD_AXIS NO_INPUT_QUANTITY RB_PT_PCT_SWC_DST_CompuMethods_ratio_0p1 12 0.0 110. FORMAT "%10.5" DEPOSIT ABSOLUTE /end AXIS_DESCR
 /begin AXIS_DESCR STD_AXIS NO_INPUT_QUANTITY RB_PT_PCT_SWC_DST_CompuMethods_ident 9 2. 10. FORMAT "%10.5" DEPOSIT ABSOLUTE /end AXIS_DESCR
/end CHARACTERISTIC
/begin CHARACTERISTIC DST_EFLASHROMB.DST_DG.DST_ShiftPointsAndComp.DST_ShiftMaps.DST_MINRPM_AUTO_03 "" MAP 0x8060570E RB_PT_PCT_SWC_DST_RecordLayouts_RL_Map_sint16_108_uint16_12_uint8_9 20000.0 RB_PT_PCT_SWC_DST_CompuMethods_DST_Ident 0.0 20000. FORMAT "%10.5"
 /begin ANNOTATION ANNOTATION_LABEL "Description (coming from AUTOSAR DESC field)"
  /begin ANNOTATION_TEXT "Min Engine Speed for each gear at a given driver demand\r\n" /end ANNOTATION_TEXT
 /end ANNOTATION
 /begin AXIS_DESCR STD_AXIS NO_INPUT_QUANTITY RB_PT_PCT_SWC_DST_CompuMethods_ratio_0p1 12 0.0 110. FORMAT "%10.5" DEPOSIT ABSOLUTE /end AXIS_DESCR
 /begin AXIS_DESCR STD_AXIS NO_INPUT_QUANTITY RB_PT_PCT_SWC_DST_CompuMethods_ident 9 2. 10. FORMAT "%10.5" DEPOSIT ABSOLUTE /end AXIS_DESCR
/end CHARACTERISTIC
/begin CHARACTERISTIC DST_EFLASHROMB.DST_DG.DST_ShiftPointsAndComp.DST_ShiftMaps.DST_MINRPM_AUTO_04 "" MAP 0x8060580C RB_PT_PCT_SWC_DST_RecordLayouts_RL_Map_sint16_108_uint16_12_uint8_9 20000.0 RB_PT_PCT_SWC_DST_CompuMethods_DST_Ident 0.0 20000. FORMAT "%10.5"
 /begin ANNOTATION ANNOTATION_LABEL "Description (coming from AUTOSAR DESC field)"
  /begin ANNOTATION_TEXT "Min Engine Speed for each gear at a given driver demand\r\n" /end ANNOTATION_TEXT
 /end ANNOTATION
 /begin AXIS_DESCR STD_AXIS NO_INPUT_QUANTITY RB_PT_PCT_SWC_DST_CompuMethods_ratio_0p1 12 0.0 110. FORMAT "%10.5" DEPOSIT ABSOLUTE /end AXIS_DESCR
 /begin AXIS_DESCR STD_AXIS NO_INPUT_QUANTITY RB_PT_PCT_SWC_DST_CompuMethods_ident 9 2. 10. FORMAT "%10.5" DEPOSIT ABSOLUTE /end AXIS_DESCR
/end CHARACTERISTIC
/begin CHARACTERISTIC DST_EFLASHROMB.DST_DG.DST_ShiftPointsAndComp.DST_ShiftMaps.DST_MINRPM_AUTO_05 "" MAP 0x8060590A RB_PT_PCT_SWC_DST_RecordLayouts_RL_Map_sint16_108_uint16_12_uint8_9 20000.0 RB_PT_PCT_SWC_DST_CompuMethods_DST_Ident 0.0 20000. FORMAT "%10.5"
 /begin ANNOTATION ANNOTATION_LABEL "Description (coming from AUTOSAR DESC field)"
  /begin ANNOTATION_TEXT "Min Engine Speed for each gear at a given driver demand\r\n" /end ANNOTATION_TEXT
 /end ANNOTATION
 /begin AXIS_DESCR STD_AXIS NO_INPUT_QUANTITY RB_PT_PCT_SWC_DST_CompuMethods_ratio_0p1 12 0.0 110. FORMAT "%10.5" DEPOSIT ABSOLUTE /end AXIS_DESCR
 /begin AXIS_DESCR STD_AXIS NO_INPUT_QUANTITY RB_PT_PCT_SWC_DST_CompuMethods_ident 9 2. 10. FORMAT "%10.5" DEPOSIT ABSOLUTE /end AXIS_DESCR
/end CHARACTERISTIC
/begin CHARACTERISTIC DST_EFLASHROMB.DST_DG.DST_ShiftPointsAndComp.DST_ShiftMaps.DST_MINRPM_AUTO_06 "" MAP 0x80605A08 RB_PT_PCT_SWC_DST_RecordLayouts_RL_Map_sint16_108_uint16_12_uint8_9 20000.0 RB_PT_PCT_SWC_DST_CompuMethods_DST_Ident 0.0 20000. FORMAT "%10.5"
 /begin ANNOTATION ANNOTATION_LABEL "Description (coming from AUTOSAR DESC field)"
  /begin ANNOTATION_TEXT "Min Engine Speed for each gear at a given driver demand\r\n" /end ANNOTATION_TEXT
 /end ANNOTATION
 /begin AXIS_DESCR STD_AXIS NO_INPUT_QUANTITY RB_PT_PCT_SWC_DST_CompuMethods_ratio_0p1 12 0.0 110. FORMAT "%10.5" DEPOSIT ABSOLUTE /end AXIS_DESCR
 /begin AXIS_DESCR STD_AXIS NO_INPUT_QUANTITY RB_PT_PCT_SWC_DST_CompuMethods_ident 9 2. 10. FORMAT "%10.5" DEPOSIT ABSOLUTE /end AXIS_DESCR
/end CHARACTERISTIC
/begin CHARACTERISTIC DST_EFLASHROMB.DST_DG.DST_ShiftPointsAndComp.DST_ShiftMaps.DST_MINRPM_AUTO_07 "" MAP 0x80605B06 RB_PT_PCT_SWC_DST_RecordLayouts_RL_Map_sint16_108_uint16_12_uint8_9 20000.0 RB_PT_PCT_SWC_DST_CompuMethods_DST_Ident 0.0 20000. FORMAT "%10.5"
 /begin ANNOTATION ANNOTATION_LABEL "Description (coming from AUTOSAR DESC field)"
  /begin ANNOTATION_TEXT "Min Engine Speed for each gear at a given driver demand\r\n" /end ANNOTATION_TEXT
 /end ANNOTATION
 /begin AXIS_DESCR STD_AXIS NO_INPUT_QUANTITY RB_PT_PCT_SWC_DST_CompuMethods_ratio_0p1 12 0.0 110. FORMAT "%10.5" DEPOSIT ABSOLUTE /end AXIS_DESCR
 /begin AXIS_DESCR STD_AXIS NO_INPUT_QUANTITY RB_PT_PCT_SWC_DST_CompuMethods_ident 9 2. 10. FORMAT "%10.5" DEPOSIT ABSOLUTE /end AXIS_DESCR
/end CHARACTERISTIC
/begin CHARACTERISTIC DST_EFLASHROMB.DST_DG.DST_ShiftPointsAndComp.DST_ShiftMaps.DST_MINRPM_AUTO_08 "" MAP 0x80605C04 RB_PT_PCT_SWC_DST_RecordLayouts_RL_Map_sint16_108_uint16_12_uint8_9 20000.0 RB_PT_PCT_SWC_DST_CompuMethods_DST_Ident 0.0 20000. FORMAT "%10.5"
 /begin ANNOTATION ANNOTATION_LABEL "Description (coming from AUTOSAR DESC field)"
  /begin ANNOTATION_TEXT "Min Engine Speed for each gear at a given driver demand\r\n" /end ANNOTATION_TEXT
 /end ANNOTATION
 /begin AXIS_DESCR STD_AXIS NO_INPUT_QUANTITY RB_PT_PCT_SWC_DST_CompuMethods_ratio_0p1 12 0.0 110. FORMAT "%10.5" DEPOSIT ABSOLUTE /end AXIS_DESCR
 /begin AXIS_DESCR STD_AXIS NO_INPUT_QUANTITY RB_PT_PCT_SWC_DST_CompuMethods_ident 9 2. 10. FORMAT "%10.5" DEPOSIT ABSOLUTE /end AXIS_DESCR
/end CHARACTERISTIC
/begin CHARACTERISTIC DST_EFLASHROMB.DST_DG.DST_ShiftPointsAndComp.DST_ShiftMaps.DST_MINRPM_AUTO_09 "" MAP 0x80605D02 RB_PT_PCT_SWC_DST_RecordLayouts_RL_Map_sint16_108_uint16_12_uint8_9 20000.0 RB_PT_PCT_SWC_DST_CompuMethods_DST_Ident 0.0 20000. FORMAT "%10.5"
 /begin ANNOTATION ANNOTATION_LABEL "Description (coming from AUTOSAR DESC field)"
  /begin ANNOTATION_TEXT "Min Engine Speed for each gear at a given driver demand\r\n" /end ANNOTATION_TEXT
 /end ANNOTATION
 /begin AXIS_DESCR STD_AXIS NO_INPUT_QUANTITY RB_PT_PCT_SWC_DST_CompuMethods_ratio_0p1 12 0.0 110. FORMAT "%10.5" DEPOSIT ABSOLUTE /end AXIS_DESCR
 /begin AXIS_DESCR STD_AXIS NO_INPUT_QUANTITY RB_PT_PCT_SWC_DST_CompuMethods_ident 9 2. 10. FORMAT "%10.5" DEPOSIT ABSOLUTE /end AXIS_DESCR
/end CHARACTERISTIC
/begin CHARACTERISTIC DST_EFLASHROMB.DST_DG.DST_ShiftPointsAndComp.DST_ShiftMaps.DST_MINRPM_AUTO_10 "" MAP 0x80605E00 RB_PT_PCT_SWC_DST_RecordLayouts_RL_Map_sint16_108_uint16_12_uint8_9 20000.0 RB_PT_PCT_SWC_DST_CompuMethods_DST_Ident 0.0 20000. FORMAT "%10.5"
 /begin ANNOTATION ANNOTATION_LABEL "Description (coming from AUTOSAR DESC field)"
  /begin ANNOTATION_TEXT "Min Engine Speed for each gear at a given driver demand\r\n" /end ANNOTATION_TEXT
 /end ANNOTATION
 /begin AXIS_DESCR STD_AXIS NO_INPUT_QUANTITY RB_PT_PCT_SWC_DST_CompuMethods_ratio_0p1 12 0.0 110. FORMAT "%10.5" DEPOSIT ABSOLUTE /end AXIS_DESCR
 /begin AXIS_DESCR STD_AXIS NO_INPUT_QUANTITY RB_PT_PCT_SWC_DST_CompuMethods_ident 9 2. 10. FORMAT "%10.5" DEPOSIT ABSOLUTE /end AXIS_DESCR
/end CHARACTERISTIC
/begin CHARACTERISTIC DST_EFLASHROMB.DST_DG.DST_ShiftPointsAndComp.DST_ShiftMaps.DST_MINRPM_MAN_01 "" VAL_BLK 0x80604A00 DefaultValueRecordLayout_AUTOSAR_Platform_BaseTypes_sint16 20000.0 RB_PT_PCT_SWC_DST_CompuMethods_DST_Ident 0.0 20000. FORMAT "%10.5"
 /begin ANNOTATION ANNOTATION_LABEL "Description (coming from AUTOSAR DESC field)"
  /begin ANNOTATION_TEXT "Minimum engine speed in each gear in manual mode with 0% driver demand\r\n" /end ANNOTATION_TEXT
 /end ANNOTATION
 MATRIX_DIM 11 1 1 /end CHARACTERISTIC
/begin CHARACTERISTIC DST_EFLASHROMB.DST_DG.DST_ShiftPointsAndComp.DST_ShiftMaps.DST_MINRPM_MAN_02 "" VAL_BLK 0x80604A16 DefaultValueRecordLayout_AUTOSAR_Platform_BaseTypes_sint16 20000.0 RB_PT_PCT_SWC_DST_CompuMethods_DST_Ident 0.0 20000. FORMAT "%10.5"
 /begin ANNOTATION ANNOTATION_LABEL "Description (coming from AUTOSAR DESC field)"
  /begin ANNOTATION_TEXT "Minimum engine speed in each gear in manual mode with 0% driver demand\r\n" /end ANNOTATION_TEXT
 /end ANNOTATION
 MATRIX_DIM 11 1 1 /end CHARACTERISTIC
/begin CHARACTERISTIC DST_EFLASHROMB.DST_DG.DST_ShiftPointsAndComp.DST_ShiftMaps.DST_MINRPM_MAN_03 "" VAL_BLK 0x80604A2C DefaultValueRecordLayout_AUTOSAR_Platform_BaseTypes_sint16 20000.0 RB_PT_PCT_SWC_DST_CompuMethods_DST_Ident 0.0 20000. FORMAT "%10.5"
 /begin ANNOTATION ANNOTATION_LABEL "Description (coming from AUTOSAR DESC field)"
  /begin ANNOTATION_TEXT "Minimum engine speed in each gear in manual mode with 0% driver demand\r\n" /end ANNOTATION_TEXT
 /end ANNOTATION
 MATRIX_DIM 11 1 1 /end CHARACTERISTIC
/begin CHARACTERISTIC DST_EFLASHROMB.DST_DG.DST_ShiftPointsAndComp.DST_ShiftMaps.DST_MINRPM_MAN_04_NOTROLLOUT "" VAL_BLK 0x80604A42 DefaultValueRecordLayout_AUTOSAR_Platform_BaseTypes_sint16 20000.0 RB_PT_PCT_SWC_DST_CompuMethods_DST_Ident 0.0 20000. FORMAT "%10.5"
 /begin ANNOTATION ANNOTATION_LABEL "Description (coming from AUTOSAR DESC field)"
  /begin ANNOTATION_TEXT "Minimum engine speed in each gear when the driver demand is above 5%\r\n" /end ANNOTATION_TEXT
 /end ANNOTATION
 MATRIX_DIM 11 1 1 /end CHARACTERISTIC
/begin CHARACTERISTIC DST_EFLASHROMB.DST_DG.DST_ShiftPointsAndComp.DST_ShiftMaps.DST_MINRPM_MAN_04_ROLLOUT "" VAL_BLK 0x80604A58 DefaultValueRecordLayout_AUTOSAR_Platform_BaseTypes_sint16 20000.0 RB_PT_PCT_SWC_DST_CompuMethods_DST_Ident 0.0 20000. FORMAT "%10.5"
 /begin ANNOTATION ANNOTATION_LABEL "Description (coming from AUTOSAR DESC field)"
  /begin ANNOTATION_TEXT "Minimum engine speed in each gear in manual mode with 0% driver demand\r\n" /end ANNOTATION_TEXT
 /end ANNOTATION
 MATRIX_DIM 11 1 1 /end CHARACTERISTIC
/begin CHARACTERISTIC DST_EFLASHROMB.DST_DG.DST_ShiftPointsAndComp.DST_ShiftMaps.DST_MINRPM_MAN_05 "" VAL_BLK 0x80604A6E DefaultValueRecordLayout_AUTOSAR_Platform_BaseTypes_sint16 20000.0 RB_PT_PCT_SWC_DST_CompuMethods_DST_Ident 0.0 20000. FORMAT "%10.5"
 /begin ANNOTATION ANNOTATION_LABEL "Description (coming from AUTOSAR DESC field)"
  /begin ANNOTATION_TEXT "Minimum engine speed in each gear when the driver demand is above 5%\r\n" /end ANNOTATION_TEXT
 /end ANNOTATION
 MATRIX_DIM 11 1 1 /end CHARACTERISTIC
/begin CHARACTERISTIC DST_EFLASHROMB.DST_DG.DST_ShiftPointsAndComp.DST_ShiftMaps.DST_MINRPM_MAN_06 "" VAL_BLK 0x80604A84 DefaultValueRecordLayout_AUTOSAR_Platform_BaseTypes_sint16 20000.0 RB_PT_PCT_SWC_DST_CompuMethods_DST_Ident 0.0 20000. FORMAT "%10.5"
 /begin ANNOTATION ANNOTATION_LABEL "Description (coming from AUTOSAR DESC field)"
  /begin ANNOTATION_TEXT "Minimum engine speed in each gear when the driver demand is above 5%\r\n" /end ANNOTATION_TEXT
 /end ANNOTATION
 MATRIX_DIM 11 1 1 /end CHARACTERISTIC
/begin CHARACTERISTIC DST_EFLASHROMB.DST_DG.DST_ShiftPointsAndComp.DST_ShiftMaps.DST_PULLAWAYMAXSPEED "" VAL_BLK 0x806049AA DefaultValueRecordLayout_AUTOSAR_Platform_BaseTypes_uint16 500.0 RB_PT_PCT_SWC_DST_CompuMethods_kph_0p1 0.0 500. FORMAT "%10.5"
 /begin ANNOTATION ANNOTATION_LABEL "Description (coming from AUTOSAR DESC field)"
  /begin ANNOTATION_TEXT "Vehicle speed in each shift mode below which the pullaway logic is enable (ensure max rpm is greater than a threshold)\r\n" /end ANNOTATION_TEXT
 /end ANNOTATION
 MATRIX_DIM 17 1 1 /end CHARACTERISTIC
/begin CHARACTERISTIC DST_EFLASHROMB.DST_DG.DST_ShiftPointsAndComp.DST_ShiftMaps.DST_REVLIMITBOUNCETIME "" VAL_BLK 0x806049CC DefaultValueRecordLayout_AUTOSAR_Platform_BaseTypes_uint16 655.35 RB_PT_PCT_SWC_DST_CompuMethods_DST_Time 0.0 655.35 FORMAT "%10.5"
 /begin ANNOTATION ANNOTATION_LABEL "Description (coming from AUTOSAR DESC field)"
  /begin ANNOTATION_TEXT "Time in each mode the engine speed must be above the max up-shift line before a shift will be requested\r\n" /end ANNOTATION_TEXT
 /end ANNOTATION
 MATRIX_DIM 17 1 1 /end CHARACTERISTIC
/begin CHARACTERISTIC DST_EFLASHROMB.DST_In_DriverDemand.DST_ZERO "" VALUE 0x80605EFE DefaultValueRecordLayout_AUTOSAR_Platform_BaseTypes_uint16 327.67 RB_PT_PCT_SWC_DST_CompuMethods_DST_Time 0.0 327.67 FORMAT "%10.5"
 /begin ANNOTATION ANNOTATION_LABEL "Description (coming from AUTOSAR DESC field)" /begin ANNOTATION_TEXT "Zero implementation\r\n" /end ANNOTATION_TEXT /end ANNOTATION
/end CHARACTERISTIC
/begin CHARACTERISTIC DST_MINSHIFTHYST "unsigned integer 16bit" VALUE 0x80603F8C DefaultValueRecordLayout_AUTOSAR_Platform_BaseTypes_uint16 20000.0 RB_PT_PCT_SWC_DST_CompuMethods_ident 0.0 20000. FORMAT "%10.5"
 /begin ANNOTATION ANNOTATION_LABEL "Description (coming from AUTOSAR DESC field)"
  /begin ANNOTATION_TEXT "Minimum engine speed between the maximum upshift rpm and maximum downshift rpm\r\n" /end ANNOTATION_TEXT
 /end ANNOTATION
/end CHARACTERISTIC
/begin CHARACTERISTIC DWC_CALIB.BOB_BITLOSSTYPE "" VALUE 0x8060E694 DefaultValueRecordLayout_AUTOSAR_Platform_BaseTypes_uint8 255.0 RB_PT_PCT_SWC_DWC_CompuMethods_ident 0.0 255. FORMAT "%10.5"
 /begin ANNOTATION ANNOTATION_LABEL "Description (coming from AUTOSAR DESC field)" /begin ANNOTATION_TEXT "Break out box override for SEQ Final Target Gear\r\n" /end ANNOTATION_TEXT /end ANNOTATION
/end CHARACTERISTIC
/begin CHARACTERISTIC DWC_CALIB.DWC_37DETECTMININPUTSPD "" VALUE 0x8060E66C DefaultValueRecordLayout_AUTOSAR_Platform_BaseTypes_uint16 20000.0 RB_PT_PCT_SWC_DWC_CompuMethods_ident 0.0 20000. FORMAT "%10.5"
 /begin ANNOTATION ANNOTATION_LABEL "Description (coming from AUTOSAR DESC field)" /begin ANNOTATION_TEXT "Min input speed required for 37 detect.\r\n" /end ANNOTATION_TEXT /end ANNOTATION
/end CHARACTERISTIC
/begin CHARACTERISTIC DWC_CALIB.DWC_37DETECTRESETFAOBD "" VALUE 0x8060E695 DefaultValueRecordLayout_AUTOSAR_Platform_BaseTypes_uint8 255.0 DefaultIdenticalCompu 0.0 255. FORMAT "%10.5"
 /begin ANNOTATION ANNOTATION_LABEL "Description (coming from AUTOSAR DESC field)"
  /begin ANNOTATION_TEXT "Calibration to enable the reset of failure action associated with 37 detect.\r\n" /end ANNOTATION_TEXT
 /end ANNOTATION
/end CHARACTERISTIC
/begin CHARACTERISTIC DWC_CALIB.DWC_37FixedTimer "" VALUE 0x8060E66E DefaultValueRecordLayout_AUTOSAR_Platform_BaseTypes_uint16 327.675 RB_PT_PCT_SWC_DWC_CompuMethods_ratio_0p005 0.0 327.675 FORMAT "%10.5"
 /begin ANNOTATION ANNOTATION_LABEL "Description (coming from AUTOSAR DESC field)" /begin ANNOTATION_TEXT "Timeto detect an issue withthe 37 gear\r\n" /end ANNOTATION_TEXT /end ANNOTATION
/end CHARACTERISTIC
/begin CHARACTERISTIC DWC_CALIB.DWC_37MAX37SLIP "" VALUE 0x8060E670 DefaultValueRecordLayout_AUTOSAR_Platform_BaseTypes_uint16 20000.0 RB_PT_PCT_SWC_DWC_CompuMethods_ident 0.0 20000. FORMAT "%10.5"
 /begin ANNOTATION ANNOTATION_LABEL "Description (coming from AUTOSAR DESC field)" /begin ANNOTATION_TEXT "Max Slip to enable 37 detect\r\n" /end ANNOTATION_TEXT /end ANNOTATION
/end CHARACTERISTIC
/begin CHARACTERISTIC DWC_CALIB.DWC_37MAXAPOS "" VALUE 0x8060E672 DefaultValueRecordLayout_AUTOSAR_Platform_BaseTypes_sint16 40.0 RB_PT_PCT_SWC_DWC_CompuMethods_ratio_0p001__2 -20. 20. FORMAT "%10.5"
 /begin ANNOTATION ANNOTATION_LABEL "Description (coming from AUTOSAR DESC field)" /begin ANNOTATION_TEXT "Max sync A for 37 detect\r\n" /end ANNOTATION_TEXT /end ANNOTATION
/end CHARACTERISTIC
/begin CHARACTERISTIC DWC_CALIB.DWC_37MaxRatio "" VALUE 0x8060E67A DefaultValueRecordLayout_AUTOSAR_Platform_BaseTypes_uint16 65.535 RB_PT_PCT_SWC_DWC_CompuMethods_ratio_0p001__2 0.0 65.535 FORMAT "%10.5"
 /begin ANNOTATION ANNOTATION_LABEL "Description (coming from AUTOSAR DESC field)" /begin ANNOTATION_TEXT "Max ratio to determine 37 slipping\r\n" /end ANNOTATION_TEXT /end ANNOTATION
/end CHARACTERISTIC
/begin CHARACTERISTIC DWC_CALIB.DWC_37MINOILTEMP "" VALUE 0x8060E674 DefaultValueRecordLayout_AUTOSAR_Platform_BaseTypes_sint16 250.0 RB_PT_PCT_SWC_DWC_CompuMethods_ident -50. 200. FORMAT "%10.5"
 /begin ANNOTATION ANNOTATION_LABEL "Description (coming from AUTOSAR DESC field)" /begin ANNOTATION_TEXT "Min oil temp for for 37 detect.\r\n" /end ANNOTATION_TEXT /end ANNOTATION
/end CHARACTERISTIC
/begin CHARACTERISTIC DWC_CALIB.DWC_37MinRatio "" VALUE 0x8060E67C DefaultValueRecordLayout_AUTOSAR_Platform_BaseTypes_uint16 65.535 RB_PT_PCT_SWC_DWC_CompuMethods_ratio_0p001__2 0.0 65.535 FORMAT "%10.5"
 /begin ANNOTATION ANNOTATION_LABEL "Description (coming from AUTOSAR DESC field)" /begin ANNOTATION_TEXT "Max ratio to determine 37 slipping\r\n" /end ANNOTATION_TEXT /end ANNOTATION
/end CHARACTERISTIC
/begin CHARACTERISTIC DWC_CALIB.DWC_37MINSECSLIP "" VALUE 0x8060E676 DefaultValueRecordLayout_AUTOSAR_Platform_BaseTypes_uint16 20000.0 RB_PT_PCT_SWC_DWC_CompuMethods_ident 0.0 20000. FORMAT "%10.5"
 /begin ANNOTATION ANNOTATION_LABEL "Description (coming from AUTOSAR DESC field)" /begin ANNOTATION_TEXT "Max Slip to enable 37 detect\r\n" /end ANNOTATION_TEXT /end ANNOTATION
/end CHARACTERISTIC
/begin CHARACTERISTIC DWC_CALIB.DWC_37MINSPEEDDETECT "" VALUE 0x8060E678 DefaultValueRecordLayout_AUTOSAR_Platform_BaseTypes_uint16 500.0 RB_PT_PCT_SWC_DWC_CompuMethods_ratio_0p01 0.0 500. FORMAT "%10.5"
 /begin ANNOTATION ANNOTATION_LABEL "Description (coming from AUTOSAR DESC field)" /begin ANNOTATION_TEXT "Min speed for 37 detect.\r\n" /end ANNOTATION_TEXT /end ANNOTATION
/end CHARACTERISTIC
/begin CHARACTERISTIC DWC_CALIB.DWC_BALANCEBOOSTFACTRANSTEMP "" CURVE 0x8060FF18 RB_PT_PCT_SWC_DWC_RecordLayouts_RL_Curve_uint16_6_sint16_6 2.0 RB_PT_PCT_SWC_DWC_CompuMethods_ratio_0p01 0.0 2. FORMAT "%10.5"
 /begin ANNOTATION ANNOTATION_LABEL "Description (coming from AUTOSAR DESC field)" /begin ANNOTATION_TEXT "Balance boost modifier in relation to transoil temp.\r\n" /end ANNOTATION_TEXT /end ANNOTATION
 /begin AXIS_DESCR STD_AXIS NO_INPUT_QUANTITY RB_PT_PCT_SWC_DWC_CompuMethods_ident 6 -50. 200. FORMAT "%10.5" DEPOSIT ABSOLUTE /end AXIS_DESCR
/end CHARACTERISTIC
/begin CHARACTERISTIC DWC_CALIB.DWC_BALANCEBOOSTFACTVEHICLESPEED "" CURVE 0x8060FF32 RB_PT_PCT_SWC_DWC_RecordLayouts_RL_Curve_uint16_6_uint16_6 2.0 RB_PT_PCT_SWC_DWC_CompuMethods_ratio_0p01 0.0 2. FORMAT "%10.5"
 /begin ANNOTATION ANNOTATION_LABEL "Description (coming from AUTOSAR DESC field)" /begin ANNOTATION_TEXT "Balance boost modifier in relation to transoil temp.\r\n" /end ANNOTATION_TEXT /end ANNOTATION
 /begin AXIS_DESCR STD_AXIS NO_INPUT_QUANTITY RB_PT_PCT_SWC_DWC_CompuMethods_ratio_0p01 6 0.0 500. FORMAT "%10.5" DEPOSIT ABSOLUTE /end AXIS_DESCR
/end CHARACTERISTIC
/begin CHARACTERISTIC DWC_CALIB.DWC_BALANCEBOOSTFLOW2D "" MAP 0x8060FF4C RB_PT_PCT_SWC_DWC_RecordLayouts_RL_Map_uint16_25_uint16_5_uint16_5 127.5 RB_PT_PCT_SWC_DWC_CompuMethods_flow_0p01 0.0 127.5 FORMAT "%10.5"
 /begin ANNOTATION ANNOTATION_LABEL "Description (coming from AUTOSAR DESC field)"
  /begin ANNOTATION_TEXT "Balance chamber cooling flow boost WRT x-time since engine stop y-time engine off\r\n" /end ANNOTATION_TEXT
 /end ANNOTATION
 /begin AXIS_DESCR STD_AXIS NO_INPUT_QUANTITY RB_PT_PCT_SWC_DWC_CompuMethods_ratio_0p05 5 0.0 3276.75 FORMAT "%10.5" DEPOSIT ABSOLUTE /end AXIS_DESCR
 /begin AXIS_DESCR STD_AXIS NO_INPUT_QUANTITY RB_PT_PCT_SWC_DWC_CompuMethods_ratio_0p05 5 0.0 3276.75 FORMAT "%10.5" DEPOSIT ABSOLUTE /end AXIS_DESCR
/end CHARACTERISTIC
/begin CHARACTERISTIC DWC_CALIB.DWC_BOBENBLIDLOSSTYPE "" VALUE 0x8060E696 DefaultValueRecordLayout_AUTOSAR_Platform_BaseTypes_uint8 255.0 DefaultIdenticalCompu 0.0 255. FORMAT "%10.5"
 /begin ANNOTATION ANNOTATION_LABEL "Description (coming from AUTOSAR DESC field)" /begin ANNOTATION_TEXT "temporary flag to indicate vehicle is hybrid layout\r\n" /end ANNOTATION_TEXT /end ANNOTATION
/end CHARACTERISTIC
/begin CHARACTERISTIC DWC_CALIB.DWC_BOBROUTINEREQUEST "" VALUE 0x8060E697 DefaultValueRecordLayout_AUTOSAR_Platform_BaseTypes_uint8 59.0 RB_PT_PCT_SWC_DWC_CompuMethods_Enumerations_OBD_RoutineCommand_PCCU 0.0 59. FORMAT "%10.5"
 /begin ANNOTATION ANNOTATION_LABEL "Description (coming from AUTOSAR DESC field)" /begin ANNOTATION_TEXT "BOBed routine request to DWC\r\n" /end ANNOTATION_TEXT /end ANNOTATION
/end CHARACTERISTIC
/begin CHARACTERISTIC DWC_CALIB.DWC_CLEARMAXTEMPS "" VALUE 0x8060E698 DefaultValueRecordLayout_AUTOSAR_Platform_BaseTypes_boolean 255.0 AUTOSAR_Platform_CompuMethods_boolean 0.0 255. FORMAT "%10.5"
 /begin ANNOTATION ANNOTATION_LABEL "Description (coming from AUTOSAR DESC field)" /begin ANNOTATION_TEXT "Flag to clear only the maximum stored temperatures.\r\n" /end ANNOTATION_TEXT /end ANNOTATION
/end CHARACTERISTIC
/begin CHARACTERISTIC DWC_CALIB.DWC_CURRENTIVSS1 "" VALUE 0x8060E67E DefaultValueRecordLayout_AUTOSAR_Platform_BaseTypes_uint16 5000.0 RB_PT_PCT_SWC_DWC_CompuMethods_ident 0.0 5000. FORMAT "%10.5"
 /begin ANNOTATION ANNOTATION_LABEL "Description (coming from AUTOSAR DESC field)" /begin ANNOTATION_TEXT "Current demand to IVSS1 when fill is not active\r\n" /end ANNOTATION_TEXT /end ANNOTATION
/end CHARACTERISTIC
/begin CHARACTERISTIC DWC_CALIB.DWC_CURRENTSTEPIVSS1 "" VALUE 0x8060E680 DefaultValueRecordLayout_AUTOSAR_Platform_BaseTypes_uint16 5000.0 RB_PT_PCT_SWC_DWC_CompuMethods_ident 0.0 5000. FORMAT "%10.5"
 /begin ANNOTATION ANNOTATION_LABEL "Description (coming from AUTOSAR DESC field)" /begin ANNOTATION_TEXT "Current change each dT when fill complete\r\n" /end ANNOTATION_TEXT /end ANNOTATION
/end CHARACTERISTIC
/begin CHARACTERISTIC DWC_CALIB.DWC_DISABLEGEAROILOBDFLAG "" VALUE 0x8060E699 DefaultValueRecordLayout_AUTOSAR_Platform_BaseTypes_boolean 255.0 AUTOSAR_Platform_CompuMethods_boolean 0.0 255. FORMAT "%10.5"
 /begin ANNOTATION ANNOTATION_LABEL "Description (coming from AUTOSAR DESC field)"
  /begin ANNOTATION_TEXT "Flag to disable gear oil over temperature warning flag\r\n" /end ANNOTATION_TEXT
 /end ANNOTATION
/end CHARACTERISTIC
/begin CHARACTERISTIC DWC_CALIB.DWC_DISABLELOCATIONSPECIFICCLEAR "" VALUE 0x8060E69A DefaultValueRecordLayout_AUTOSAR_Platform_BaseTypes_boolean 255.0 AUTOSAR_Platform_CompuMethods_boolean 0.0 255. FORMAT "%10.5"
 /begin ANNOTATION ANNOTATION_LABEL "Description (coming from AUTOSAR DESC field)" /begin ANNOTATION_TEXT "Flag to disable nv location specific clearing.\r\n" /end ANNOTATION_TEXT /end ANNOTATION
/end CHARACTERISTIC
/begin CHARACTERISTIC DWC_CALIB.DWC_FLGALLOWWRITEFROMUDS "" VALUE 0x8060E69B DefaultValueRecordLayout_AUTOSAR_Platform_BaseTypes_boolean 255.0 AUTOSAR_Platform_CompuMethods_boolean 0.0 255. FORMAT "%10.5"
 /begin ANNOTATION ANNOTATION_LABEL "Description (coming from AUTOSAR DESC field)" /begin ANNOTATION_TEXT "Flag to enable WDBI via UDS.\r\n" /end ANNOTATION_TEXT /end ANNOTATION
/end CHARACTERISTIC
/begin CHARACTERISTIC DWC_CALIB.DWC_FLGBLOCKYELLOWTEMPWARNING4LAUNCH "" VALUE 0x8060E69C DefaultValueRecordLayout_AUTOSAR_Platform_BaseTypes_boolean 255.0 AUTOSAR_Platform_CompuMethods_boolean 0.0 255. FORMAT "%10.5"
 /begin ANNOTATION ANNOTATION_LABEL "Description (coming from AUTOSAR DESC field)"
  /begin ANNOTATION_TEXT "Block yellow temperature warning during launch control.\r\n" /end ANNOTATION_TEXT
 /end ANNOTATION
/end CHARACTERISTIC
/begin CHARACTERISTIC DWC_CALIB.DWC_FLGBOBENABLEROUTINEREQUEST "" VALUE 0x8060E69D DefaultValueRecordLayout_AUTOSAR_Platform_BaseTypes_boolean 255.0 AUTOSAR_Platform_CompuMethods_boolean 0.0 255. FORMAT "%10.5"
 /begin ANNOTATION ANNOTATION_LABEL "Description (coming from AUTOSAR DESC field)" /begin ANNOTATION_TEXT "Enable BOBed routine request to DWC\r\n" /end ANNOTATION_TEXT /end ANNOTATION
/end CHARACTERISTIC
/begin CHARACTERISTIC DWC_CALIB.DWC_FLGBOTHSOFAILEDFORDFC "" VALUE 0x8060E69E DefaultValueRecordLayout_AUTOSAR_Platform_BaseTypes_boolean 255.0 AUTOSAR_Platform_CompuMethods_boolean 0.0 255. FORMAT "%10.5"
 /begin ANNOTATION ANNOTATION_LABEL "Description (coming from AUTOSAR DESC field)" /begin ANNOTATION_TEXT "Require both SO routines to fail before raising DFC.\r\n" /end ANNOTATION_TEXT /end ANNOTATION
/end CHARACTERISTIC
/begin CHARACTERISTIC DWC_CALIB.DWC_FLGDRVOUTNOTRDYBLNK "" VALUE 0x8060E69F DefaultValueRecordLayout_AUTOSAR_Platform_BaseTypes_boolean 255.0 AUTOSAR_Platform_CompuMethods_boolean 0.0 255. FORMAT "%10.5"
 /begin ANNOTATION ANNOTATION_LABEL "Description (coming from AUTOSAR DESC field)" /begin ANNOTATION_TEXT "Blank system status when drive outputs not ready\r\n" /end ANNOTATION_TEXT /end ANNOTATION
/end CHARACTERISTIC
/begin CHARACTERISTIC DWC_CALIB.DWC_FLGENABLEAUTOVALVERINSEINGEAR "" VALUE 0x8060E6A0 DefaultValueRecordLayout_AUTOSAR_Platform_BaseTypes_uint8 255.0 DefaultIdenticalCompu 0.0 255. FORMAT "%10.5"
 /begin ANNOTATION ANNOTATION_LABEL "Description (coming from AUTOSAR DESC field)" /begin ANNOTATION_TEXT "Enable automatic valve rinsing when in gear\r\n" /end ANNOTATION_TEXT /end ANNOTATION
/end CHARACTERISTIC
/begin CHARACTERISTIC DWC_CALIB.DWC_FLGENABLEAUTOVALVERINSENEUTRAL "" VALUE 0x8060E6A1 DefaultValueRecordLayout_AUTOSAR_Platform_BaseTypes_uint8 255.0 DefaultIdenticalCompu 0.0 255. FORMAT "%10.5"
 /begin ANNOTATION ANNOTATION_LABEL "Description (coming from AUTOSAR DESC field)" /begin ANNOTATION_TEXT "Enable automatic valve rinsing when in neutral\r\n" /end ANNOTATION_TEXT /end ANNOTATION
/end CHARACTERISTIC
/begin CHARACTERISTIC DWC_CALIB.DWC_FLGENABLEAUTOVALVERINSESHUTOFF "" VALUE 0x8060E6A2 DefaultValueRecordLayout_AUTOSAR_Platform_BaseTypes_uint8 255.0 DefaultIdenticalCompu 0.0 255. FORMAT "%10.5"
 /begin ANNOTATION ANNOTATION_LABEL "Description (coming from AUTOSAR DESC field)" /begin ANNOTATION_TEXT "Enable automatic valve rinsing when in shutoff\r\n" /end ANNOTATION_TEXT /end ANNOTATION
/end CHARACTERISTIC
/begin CHARACTERISTIC DWC_CALIB.DWC_FLGENABLEDEPRESSURE "" VALUE 0x8060E6A3 DefaultValueRecordLayout_AUTOSAR_Platform_BaseTypes_boolean 255.0 AUTOSAR_Platform_CompuMethods_boolean 0.0 255. FORMAT "%10.5"
 /begin ANNOTATION ANNOTATION_LABEL "Description (coming from AUTOSAR DESC field)" /begin ANNOTATION_TEXT "Set true to enable depressure routine\r\n" /end ANNOTATION_TEXT /end ANNOTATION
/end CHARACTERISTIC
/begin CHARACTERISTIC DWC_CALIB.DWC_FLGFAILP2ODDANDEVEN "" VALUE 0x8060E6A4 DefaultValueRecordLayout_AUTOSAR_Platform_BaseTypes_uint8 255.0 DefaultIdenticalCompu 0.0 255. FORMAT "%10.5"
 /begin ANNOTATION ANNOTATION_LABEL "Description (coming from AUTOSAR DESC field)"
  /begin ANNOTATION_TEXT "Flag to enable the logic that will fail P2 odd and even if both singular hybrid modes are failed.\r\n" /end ANNOTATION_TEXT
 /end ANNOTATION
/end CHARACTERISTIC
/begin CHARACTERISTIC DWC_CALIB.DWC_FLGIGNOREVSS1STATUS "" VALUE 0x8060E6A5 DefaultValueRecordLayout_AUTOSAR_Platform_BaseTypes_boolean 255.0 AUTOSAR_Platform_CompuMethods_boolean 0.0 255. FORMAT "%10.5"
 /begin ANNOTATION ANNOTATION_LABEL "Description (coming from AUTOSAR DESC field)" /begin ANNOTATION_TEXT "Ignore VSS1 status when allowing depressure\r\n" /end ANNOTATION_TEXT /end ANNOTATION
/end CHARACTERISTIC
/begin CHARACTERISTIC DWC_CALIB.DWC_FLGMONITORSTATUSANDINSTERR "" VALUE 0x8060E6A6 DefaultValueRecordLayout_AUTOSAR_Platform_BaseTypes_boolean 255.0 AUTOSAR_Platform_CompuMethods_boolean 0.0 255. FORMAT "%10.5"
 /begin ANNOTATION ANNOTATION_LABEL "Description (coming from AUTOSAR DESC field)"
  /begin ANNOTATION_TEXT "Flag to enable monitoring of status and instant error for thermal model.\r\n" /end ANNOTATION_TEXT
 /end ANNOTATION
/end CHARACTERISTIC
/begin CHARACTERISTIC DWC_CALIB.DWC_FLGOVERRIDESYSTEMSTATUS "" VALUE 0x8060E6A7 DefaultValueRecordLayout_AUTOSAR_Platform_BaseTypes_boolean 255.0 AUTOSAR_Platform_CompuMethods_boolean 0.0 255. FORMAT "%10.5"
 /begin ANNOTATION ANNOTATION_LABEL "Description (coming from AUTOSAR DESC field)" /begin ANNOTATION_TEXT "Flag to force the system status to zero.\r\n" /end ANNOTATION_TEXT /end ANNOTATION
/end CHARACTERISTIC
/begin CHARACTERISTIC DWC_CALIB.DWC_FLGSSUSEHYBRIDDISENGAGEMAPS "" VALUE 0x8060E6A8 DefaultValueRecordLayout_AUTOSAR_Platform_BaseTypes_boolean 255.0 AUTOSAR_Platform_CompuMethods_boolean 0.0 255. FORMAT "%10.5"
 /begin ANNOTATION ANNOTATION_LABEL "Description (coming from AUTOSAR DESC field)" /begin ANNOTATION_TEXT "Flag to use hybrid specific disengage rate maps.\r\n" /end ANNOTATION_TEXT /end ANNOTATION
/end CHARACTERISTIC
/begin CHARACTERISTIC DWC_CALIB.DWC_FLGUSECLEANTODEPRESSURE "" VALUE 0x8060E6A9 DefaultValueRecordLayout_AUTOSAR_Platform_BaseTypes_uint8 255.0 DefaultIdenticalCompu 0.0 255. FORMAT "%10.5"
 /begin ANNOTATION ANNOTATION_LABEL "Description (coming from AUTOSAR DESC field)" /begin ANNOTATION_TEXT "Use clutch cleaning to start depressure procedure\r\n" /end ANNOTATION_TEXT /end ANNOTATION
/end CHARACTERISTIC
/begin CHARACTERISTIC DWC_CALIB.DWC_FLGUSEGACCOUPLINGLOSSID "" VALUE 0x8060E6AA DefaultValueRecordLayout_AUTOSAR_Platform_BaseTypes_uint8 255.0 DefaultIdenticalCompu 0.0 255. FORMAT "%10.5"
 /begin ANNOTATION ANNOTATION_LABEL "Description (coming from AUTOSAR DESC field)"
  /begin ANNOTATION_TEXT "Use torque demand =/ -2000 instead of gac state for loss ID\r\n" /end ANNOTATION_TEXT
 /end ANNOTATION
/end CHARACTERISTIC
/begin CHARACTERISTIC DWC_CALIB.DWC_FLGUSESIGNEDSPEEDS "" VALUE 0x8060E6AB DefaultValueRecordLayout_AUTOSAR_Platform_BaseTypes_boolean 255.0 AUTOSAR_Platform_CompuMethods_boolean 0.0 255. FORMAT "%10.5"
 /begin ANNOTATION ANNOTATION_LABEL "Description (coming from AUTOSAR DESC field)"
  /begin ANNOTATION_TEXT "Set true to import signed speeds into DWC_InputProcessing\r\n" /end ANNOTATION_TEXT
 /end ANNOTATION
/end CHARACTERISTIC
/begin CHARACTERISTIC DWC_CALIB.DWC_FLGUSETORQUEREQLOSSID "" VALUE 0x8060E6AC DefaultValueRecordLayout_AUTOSAR_Platform_BaseTypes_uint8 255.0 DefaultIdenticalCompu 0.0 255. FORMAT "%10.5"
 /begin ANNOTATION ANNOTATION_LABEL "Description (coming from AUTOSAR DESC field)"
  /begin ANNOTATION_TEXT "Use torque demand =/ -2000 instead of gac state for loss ID\r\n" /end ANNOTATION_TEXT
 /end ANNOTATION
/end CHARACTERISTIC
/begin CHARACTERISTIC DWC_CALIB.DWC_InputProcessing.DWC_ENABLEDELAYEDSPEEDSIGNAL "" VALUE 0x8060E6B0 DefaultValueRecordLayout_AUTOSAR_Platform_BaseTypes_boolean 255.0 AUTOSAR_Platform_CompuMethods_boolean 0.0 255. FORMAT "%10.5"
 /begin ANNOTATION ANNOTATION_LABEL "Description (coming from AUTOSAR DESC field)"
  /begin ANNOTATION_TEXT "Enable delayed speed signals when engine speed goes to backup.\r\n" /end ANNOTATION_TEXT
 /end ANNOTATION
/end CHARACTERISTIC
/begin CHARACTERISTIC DWC_CALIB.DWC_InputProcessing.DWC_EnableHighBrakePressureEPB "" VALUE 0x8060E6B1 DefaultValueRecordLayout_AUTOSAR_Platform_BaseTypes_uint8 255.0 DefaultIdenticalCompu 0.0 255. FORMAT "%10.5"
 /begin ANNOTATION ANNOTATION_LABEL "Description (coming from AUTOSAR DESC field)" /begin ANNOTATION_TEXT "flag to enable high brake pressure when EPB ON.\r\n" /end ANNOTATION_TEXT /end ANNOTATION
/end CHARACTERISTIC
/begin CHARACTERISTIC DWC_CALIB.DWC_InputProcessing.DWC_INPUT1SPEEDDELAYCYCLES "" VALUE 0x8060E6B2 DefaultValueRecordLayout_AUTOSAR_Platform_BaseTypes_uint8 28.0 RB_PT_PCT_SWC_DWC_CompuMethods_ident 0.0 28. FORMAT "%10.5"
 /begin ANNOTATION ANNOTATION_LABEL "Description (coming from AUTOSAR DESC field)" /begin ANNOTATION_TEXT "Number of cycles to delay input 1 speed.\r\n" /end ANNOTATION_TEXT /end ANNOTATION
/end CHARACTERISTIC
/begin CHARACTERISTIC DWC_CALIB.DWC_InputProcessing.DWC_INPUT2SPEEDDELAYCYCLES "" VALUE 0x8060E6B3 DefaultValueRecordLayout_AUTOSAR_Platform_BaseTypes_uint8 28.0 RB_PT_PCT_SWC_DWC_CompuMethods_ident 0.0 28. FORMAT "%10.5"
 /begin ANNOTATION ANNOTATION_LABEL "Description (coming from AUTOSAR DESC field)" /begin ANNOTATION_TEXT "Number of cycles to delay input 1 speed.\r\n" /end ANNOTATION_TEXT /end ANNOTATION
/end CHARACTERISTIC
/begin CHARACTERISTIC DWC_CALIB.DWC_InputProcessing.DWC_K1PressureCorrect.DWC_FLGENABLEFAULTLATCH "" VALUE 0x8060E6B6 DefaultValueRecordLayout_AUTOSAR_Platform_BaseTypes_uint8 255.0 DefaultIdenticalCompu 0.0 255. FORMAT "%10.5"
 /begin ANNOTATION ANNOTATION_LABEL "Description (coming from AUTOSAR DESC field)" /begin ANNOTATION_TEXT "Flag to enable pressure adaption fault to latch.\r\n" /end ANNOTATION_TEXT /end ANNOTATION
/end CHARACTERISTIC
/begin CHARACTERISTIC DWC_CALIB.DWC_InputProcessing.DWC_K1PressureCorrect.DWC_PIAutoReset "" VALUE 0x8060E6B7 DefaultValueRecordLayout_AUTOSAR_Platform_BaseTypes_uint8 255.0 DefaultIdenticalCompu 0.0 255. FORMAT "%10.5"
 /begin ANNOTATION ANNOTATION_LABEL "Description (coming from AUTOSAR DESC field)"
  /begin ANNOTATION_TEXT "will fore a reset if the pi adaption hits max or min allowable limits.\r\n" /end ANNOTATION_TEXT
 /end ANNOTATION
/end CHARACTERISTIC
/begin CHARACTERISTIC DWC_CALIB.DWC_InputProcessing.DWC_K2PressureCorrect.DWC_FLGENABLEFAULTLATCH "" VALUE 0x8060E6B8 DefaultValueRecordLayout_AUTOSAR_Platform_BaseTypes_uint8 255.0 DefaultIdenticalCompu 0.0 255. FORMAT "%10.5"
 /begin ANNOTATION ANNOTATION_LABEL "Description (coming from AUTOSAR DESC field)" /begin ANNOTATION_TEXT "Flag to enable pressure adaption fault to latch.\r\n" /end ANNOTATION_TEXT /end ANNOTATION
/end CHARACTERISTIC
/begin CHARACTERISTIC DWC_CALIB.DWC_InputProcessing.DWC_K2PressureCorrect.DWC_PIAutoReset "" VALUE 0x8060E6B9 DefaultValueRecordLayout_AUTOSAR_Platform_BaseTypes_uint8 255.0 DefaultIdenticalCompu 0.0 255. FORMAT "%10.5"
 /begin ANNOTATION ANNOTATION_LABEL "Description (coming from AUTOSAR DESC field)"
  /begin ANNOTATION_TEXT "will fore a reset if the pi adaption hits max or min allowable limits.\r\n" /end ANNOTATION_TEXT
 /end ANNOTATION
/end CHARACTERISTIC
/begin CHARACTERISTIC DWC_CALIB.DWC_InputProcessing.DWC_MaxThrotEPBEnggaged "" VALUE 0x8060E6B4 DefaultValueRecordLayout_AUTOSAR_Platform_BaseTypes_uint8 102.0 RB_PT_PCT_SWC_DWC_CompuMethods_ratio_0p4 0.0 102. FORMAT "%10.5"
 /begin ANNOTATION ANNOTATION_LABEL "Description (coming from AUTOSAR DESC field)" /begin ANNOTATION_TEXT "limit throttle input in DWC when EPB engaged.\r\n" /end ANNOTATION_TEXT /end ANNOTATION
/end CHARACTERISTIC
/begin CHARACTERISTIC DWC_CALIB.DWC_InputProcessing.DWC_VirtualK1Pressure.DWC_FLGCAPVPRESTOLINEPRES "" VALUE 0x8060E6BA DefaultValueRecordLayout_AUTOSAR_Platform_BaseTypes_boolean 255.0 AUTOSAR_Platform_CompuMethods_boolean 0.0 255. FORMAT "%10.5"
 /begin ANNOTATION ANNOTATION_LABEL "Description (coming from AUTOSAR DESC field)"
  /begin ANNOTATION_TEXT "Flag to enable virtual pressure to be capped by line pressure.\r\n" /end ANNOTATION_TEXT
 /end ANNOTATION
/end CHARACTERISTIC
/begin CHARACTERISTIC DWC_CALIB.DWC_InputProcessing.DWC_VirtualK2Pressure.DWC_FLGCAPVPRESTOLINEPRES "" VALUE 0x8060E6BB DefaultValueRecordLayout_AUTOSAR_Platform_BaseTypes_boolean 255.0 AUTOSAR_Platform_CompuMethods_boolean 0.0 255. FORMAT "%10.5"
 /begin ANNOTATION ANNOTATION_LABEL "Description (coming from AUTOSAR DESC field)"
  /begin ANNOTATION_TEXT "Flag to enable virtual pressure to be capped by line pressure.\r\n" /end ANNOTATION_TEXT
 /end ANNOTATION
/end CHARACTERISTIC
/begin CHARACTERISTIC DWC_CALIB.DWC_K1DeviceControl.DWC_BOBFLGRQBLIPGAC "" VALUE 0x8060E6D8 DefaultValueRecordLayout_AUTOSAR_Platform_BaseTypes_boolean 255.0 AUTOSAR_Platform_CompuMethods_boolean 0.0 255. FORMAT "%10.5"
 /begin ANNOTATION ANNOTATION_LABEL "Description (coming from AUTOSAR DESC field)" /begin ANNOTATION_TEXT "GAC Clutch blip request\r\n" /end ANNOTATION_TEXT /end ANNOTATION
/end CHARACTERISTIC
/begin CHARACTERISTIC DWC_CALIB.DWC_K1DeviceControl.DWC_BOBGACBLIPENABRQ "" VALUE 0x8060E6D9 DefaultValueRecordLayout_AUTOSAR_Platform_BaseTypes_boolean 255.0 AUTOSAR_Platform_CompuMethods_boolean 0.0 255. FORMAT "%10.5"
 /begin ANNOTATION ANNOTATION_LABEL "Description (coming from AUTOSAR DESC field)" /begin ANNOTATION_TEXT "GAC clutch blip BOB enable.\r\n" /end ANNOTATION_TEXT /end ANNOTATION
/end CHARACTERISTIC
/begin CHARACTERISTIC DWC_CALIB.DWC_K1DeviceControl.DWC_BypassPreparePulse.DWC_BYPASSPULSEPROFILE "" CURVE 0x8060E704 RB_PT_PCT_SWC_DWC_RecordLayouts_RL_Curve_uint8_11_uint16_11 1.0 RB_PT_PCT_SWC_DWC_CompuMethods_ratio_0p01 0.0 1. FORMAT "%10.5"
 /begin ANNOTATION ANNOTATION_LABEL "Description (coming from AUTOSAR DESC field)"
  /begin ANNOTATION_TEXT "Remap bypass pulse time remaining into a profile shape.\r\n" /end ANNOTATION_TEXT
 /end ANNOTATION
 /begin AXIS_DESCR STD_AXIS NO_INPUT_QUANTITY RB_PT_PCT_SWC_DWC_CompuMethods_ratio_0p001__2 11 0.0 1. FORMAT "%10.5" DEPOSIT ABSOLUTE /end AXIS_DESCR
/end CHARACTERISTIC
/begin CHARACTERISTIC DWC_CALIB.DWC_K1DeviceControl.DWC_BypassPreparePulse.DWC_BYPASSREINITCYCLES "" VALUE 0x8060E6FE DefaultValueRecordLayout_AUTOSAR_Platform_BaseTypes_uint8 6.0 RB_PT_PCT_SWC_DWC_CompuMethods_ident 0.0 6. FORMAT "%10.5"
 /begin ANNOTATION ANNOTATION_LABEL "Description (coming from AUTOSAR DESC field)" /begin ANNOTATION_TEXT "How many cycles the bypass pulse should reinit for.\r\n" /end ANNOTATION_TEXT /end ANNOTATION
/end CHARACTERISTIC
/begin CHARACTERISTIC DWC_CALIB.DWC_K1DeviceControl.DWC_BypassPreparePulse.DWC_ENGINERUNTIMEFACTOR2D "" MAP 0x8060E728 RB_PT_PCT_SWC_DWC_RecordLayouts_RL_Map_uint16_40_uint16_5_uint16_8 2.0 RB_PT_PCT_SWC_DWC_CompuMethods_ratio_0p001__2 0.0 2. FORMAT "%10.5"
 /begin ANNOTATION ANNOTATION_LABEL "Description (coming from AUTOSAR DESC field)"
  /begin ANNOTATION_TEXT "factor applied to increase fill time wrt time engine off and engine running to compensate for balance chamber volume.\r\n" /end ANNOTATION_TEXT
 /end ANNOTATION
 /begin AXIS_DESCR STD_AXIS NO_INPUT_QUANTITY RB_PT_PCT_SWC_DWC_CompuMethods_ratio_0p05 5 0.0 3276.75 FORMAT "%10.5" DEPOSIT ABSOLUTE /end AXIS_DESCR
 /begin AXIS_DESCR STD_AXIS NO_INPUT_QUANTITY RB_PT_PCT_SWC_DWC_CompuMethods_ratio_0p1 8 0.0 6553.5 FORMAT "%10.5" DEPOSIT ABSOLUTE /end AXIS_DESCR
/end CHARACTERISTIC
/begin CHARACTERISTIC DWC_CALIB.DWC_K1DeviceControl.DWC_BypassPreparePulse.DWC_FILLADAPTMAX "" VALUE 0x8060E6F2 DefaultValueRecordLayout_AUTOSAR_Platform_BaseTypes_uint16 2.0 RB_PT_PCT_SWC_DWC_CompuMethods_ratio_0p001__2 0.0 2. FORMAT "%10.5"
 /begin ANNOTATION ANNOTATION_LABEL "Description (coming from AUTOSAR DESC field)" /begin ANNOTATION_TEXT "Max value fill adapt value\r\n" /end ANNOTATION_TEXT /end ANNOTATION
/end CHARACTERISTIC
/begin CHARACTERISTIC DWC_CALIB.DWC_K1DeviceControl.DWC_BypassPreparePulse.DWC_FILLADAPTMIN "" VALUE 0x8060E6F4 DefaultValueRecordLayout_AUTOSAR_Platform_BaseTypes_uint16 2.0 RB_PT_PCT_SWC_DWC_CompuMethods_ratio_0p001__2 0.0 2. FORMAT "%10.5"
 /begin ANNOTATION ANNOTATION_LABEL "Description (coming from AUTOSAR DESC field)" /begin ANNOTATION_TEXT "Min value fill adapt value\r\n" /end ANNOTATION_TEXT /end ANNOTATION
/end CHARACTERISTIC
/begin CHARACTERISTIC DWC_CALIB.DWC_K1DeviceControl.DWC_BypassPreparePulse.DWC_FLGCLEARMAXFILLOVERSHTENGOFF "" VALUE 0x8060E6FF DefaultValueRecordLayout_AUTOSAR_Platform_BaseTypes_uint8 255.0 DefaultIdenticalCompu 0.0 255. FORMAT "%10.5"
 /begin ANNOTATION ANNOTATION_LABEL "Description (coming from AUTOSAR DESC field)" /begin ANNOTATION_TEXT "Reset DWC_FillMaxOvershoot when engine is off.\r\n" /end ANNOTATION_TEXT /end ANNOTATION
/end CHARACTERISTIC
/begin CHARACTERISTIC DWC_CALIB.DWC_K1DeviceControl.DWC_BypassPreparePulse.DWC_FLGENABLEBYPASSPROFILE "" VALUE 0x8060E700 DefaultValueRecordLayout_AUTOSAR_Platform_BaseTypes_boolean 255.0 AUTOSAR_Platform_CompuMethods_boolean 0.0 255. FORMAT "%10.5"
 /begin ANNOTATION ANNOTATION_LABEL "Description (coming from AUTOSAR DESC field)"
  /begin ANNOTATION_TEXT "Flag to enable the bypass pulse profile to be modified.\r\n" /end ANNOTATION_TEXT
 /end ANNOTATION
/end CHARACTERISTIC
/begin CHARACTERISTIC DWC_CALIB.DWC_K1DeviceControl.DWC_BypassPreparePulse.DWC_FLGENABLEBYPASSREINITLOOP "" VALUE 0x8060E701 DefaultValueRecordLayout_AUTOSAR_Platform_BaseTypes_boolean 255.0 AUTOSAR_Platform_CompuMethods_boolean 0.0 255. FORMAT "%10.5"
 /begin ANNOTATION ANNOTATION_LABEL "Description (coming from AUTOSAR DESC field)" /begin ANNOTATION_TEXT "Flag to reinit the bypass pulse more than once.\r\n" /end ANNOTATION_TEXT /end ANNOTATION
/end CHARACTERISTIC
/begin CHARACTERISTIC DWC_CALIB.DWC_K1DeviceControl.DWC_BypassPreparePulse.DWC_MAXFILLSPD4FILLADAPT "" VALUE 0x8060E6F6 DefaultValueRecordLayout_AUTOSAR_Platform_BaseTypes_uint16 20000.0 RB_PT_PCT_SWC_DWC_CompuMethods_ident 0.0 20000. FORMAT "%10.5"
 /begin ANNOTATION ANNOTATION_LABEL "Description (coming from AUTOSAR DESC field)" /begin ANNOTATION_TEXT "Max fill engine speed to enable a fill adapt.\r\n" /end ANNOTATION_TEXT /end ANNOTATION
/end CHARACTERISTIC
/begin CHARACTERISTIC DWC_CALIB.DWC_K1DeviceControl.DWC_BypassPreparePulse.DWC_MAXFILLTRQ4FILLADAPT "" VALUE 0x8060E6F8 DefaultValueRecordLayout_AUTOSAR_Platform_BaseTypes_sint16 4000.0 RB_PT_PCT_SWC_DWC_CompuMethods_ratio_0p1 -2000. 2000. FORMAT "%10.5"
 /begin ANNOTATION ANNOTATION_LABEL "Description (coming from AUTOSAR DESC field)" /begin ANNOTATION_TEXT "Max fill torque to enable a fill adapt.\r\n" /end ANNOTATION_TEXT /end ANNOTATION
/end CHARACTERISTIC
/begin CHARACTERISTIC DWC_CALIB.DWC_K1DeviceControl.DWC_BypassPreparePulse.DWC_MINPRESS2FFCOMPLETE "" VALUE 0x8060E6FA DefaultValueRecordLayout_AUTOSAR_Platform_BaseTypes_sint16 34.0 RB_PT_PCT_SWC_DWC_CompuMethods_ratio_0p001__2 -2. 32. FORMAT "%10.5"
 /begin ANNOTATION ANNOTATION_LABEL "Description (coming from AUTOSAR DESC field)"
  /begin ANNOTATION_TEXT "min pressure to disable first fill flag with engine running.\r\n" /end ANNOTATION_TEXT
 /end ANNOTATION
/end CHARACTERISTIC
/begin CHARACTERISTIC DWC_CALIB.DWC_K1DeviceControl.DWC_BypassPreparePulse.DWC_MINTEMP4FILLADAPT "" VALUE 0x8060E6FC DefaultValueRecordLayout_AUTOSAR_Platform_BaseTypes_sint16 250.0 RB_PT_PCT_SWC_DWC_CompuMethods_ident -50. 200. FORMAT "%10.5"
 /begin ANNOTATION ANNOTATION_LABEL "Description (coming from AUTOSAR DESC field)" /begin ANNOTATION_TEXT "min transoiltemp to allow filladaption\r\n" /end ANNOTATION_TEXT /end ANNOTATION
/end CHARACTERISTIC
/begin CHARACTERISTIC DWC_CALIB.DWC_K1DeviceControl.DWC_BypassPreparePulse.DWC_PULSEPRESSTEMPOFFSET "" CURVE 0x8060E796 RB_PT_PCT_SWC_DWC_RecordLayouts_RL_Curve_sint8_4_sint16_4 2.0 RB_PT_PCT_SWC_DWC_CompuMethods_ratio_0p01 -1. 1. FORMAT "%10.5"
 /begin ANNOTATION ANNOTATION_LABEL "Description (coming from AUTOSAR DESC field)"
  /begin ANNOTATION_TEXT "Temperature related offset to be applied to pulse pressure.\r\n" /end ANNOTATION_TEXT
 /end ANNOTATION
 /begin AXIS_DESCR STD_AXIS NO_INPUT_QUANTITY RB_PT_PCT_SWC_DWC_CompuMethods_ident 4 -50. 200. FORMAT "%10.5" DEPOSIT ABSOLUTE /end AXIS_DESCR
/end CHARACTERISTIC
/begin CHARACTERISTIC DWC_CALIB.DWC_K1DeviceControl.DWC_BypassPreparePulse.DWC_RESETTIMEOFFPRESSHIGH "" VALUE 0x8060E702 DefaultValueRecordLayout_AUTOSAR_Platform_BaseTypes_boolean 255.0 AUTOSAR_Platform_CompuMethods_boolean 0.0 255. FORMAT "%10.5" /end CHARACTERISTIC
/begin CHARACTERISTIC DWC_CALIB.DWC_K1DeviceControl.DWC_ClosedPressureDiag.DWC_ENABLEHYSTERESISFORDITHER "" VALUE 0x8060E7A4 DefaultValueRecordLayout_AUTOSAR_Platform_BaseTypes_boolean 255.0 AUTOSAR_Platform_CompuMethods_boolean 0.0 255. FORMAT "%10.5"
 /begin ANNOTATION ANNOTATION_LABEL "Description (coming from AUTOSAR DESC field)"
  /begin ANNOTATION_TEXT "Use hysteresis when enabling dither in a pressure error scenario.\r\n" /end ANNOTATION_TEXT
 /end ANNOTATION
/end CHARACTERISTIC
/begin CHARACTERISTIC DWC_CALIB.DWC_K1DeviceControl.DWC_CLUBLIPABORTSPEED "" VALUE 0x8060E6BC DefaultValueRecordLayout_AUTOSAR_Platform_BaseTypes_sint16 40000.0 RB_PT_PCT_SWC_DWC_CompuMethods_ident -20000. 20000. FORMAT "%10.5"
 /begin ANNOTATION ANNOTATION_LABEL "Description (coming from AUTOSAR DESC field)" /begin ANNOTATION_TEXT "Input speed at which to abort blip.\r\n" /end ANNOTATION_TEXT /end ANNOTATION
/end CHARACTERISTIC
/begin CHARACTERISTIC DWC_CALIB.DWC_K1DeviceControl.DWC_CLUBLIPSPDMONTYPE "" VALUE 0x8060E6DA DefaultValueRecordLayout_AUTOSAR_Platform_BaseTypes_uint8 2.0 RB_PT_PCT_SWC_DWC_CompuMethods_ident 0.0 2. FORMAT "%10.5"
 /begin ANNOTATION ANNOTATION_LABEL "Description (coming from AUTOSAR DESC field)"
  /begin ANNOTATION_TEXT "Speed monitoring type, 0 = OFF, 1 = Abort above input speed, 2 = wait at KP until speed seen.\r\n" /end ANNOTATION_TEXT
 /end ANNOTATION
/end CHARACTERISTIC
/begin CHARACTERISTIC DWC_CALIB.DWC_K1DeviceControl.DWC_CLUBLIPTIMEOUT "" VALUE 0x8060E6BE DefaultValueRecordLayout_AUTOSAR_Platform_BaseTypes_uint16 1.0 RB_PT_PCT_SWC_DWC_CompuMethods_ratio_0p001__2 0.0 1. FORMAT "%10.5"
 /begin ANNOTATION ANNOTATION_LABEL "Description (coming from AUTOSAR DESC field)" /begin ANNOTATION_TEXT "Timeout for clutch blip.\r\n" /end ANNOTATION_TEXT /end ANNOTATION
/end CHARACTERISTIC
/begin CHARACTERISTIC DWC_CALIB.DWC_K1DeviceControl.DWC_CLUBLIPTMFACTPROF "" CURVE 0x8060EA08 RB_PT_PCT_SWC_DWC_RecordLayouts_RL_Curve_uint8_11_uint8_11 1.0 RB_PT_PCT_SWC_DWC_CompuMethods_ratio_0p01 0.0 1. FORMAT "%10.5"
 /begin ANNOTATION ANNOTATION_LABEL "Description (coming from AUTOSAR DESC field)" /begin ANNOTATION_TEXT "Clutch blip profile based on time factor.\r\n" /end ANNOTATION_TEXT /end ANNOTATION
 /begin AXIS_DESCR STD_AXIS NO_INPUT_QUANTITY RB_PT_PCT_SWC_DWC_CompuMethods_ratio_0p01 11 0.0 1. FORMAT "%10.5" DEPOSIT ABSOLUTE /end AXIS_DESCR
/end CHARACTERISTIC
/begin CHARACTERISTIC DWC_CALIB.DWC_K1DeviceControl.DWC_Clutch "" VALUE 0x8060E6DB DefaultValueRecordLayout_AUTOSAR_Platform_BaseTypes_uint8 2.0 RB_PT_PCT_SWC_DWC_CompuMethods_ident 0.0 2. FORMAT "%10.5"
 /begin ANNOTATION ANNOTATION_LABEL "Description (coming from AUTOSAR DESC field)"
  /begin ANNOTATION_TEXT "Indication of which clutch is assigned to device controller dataset.\r\n" /end ANNOTATION_TEXT
 /end ANNOTATION
/end CHARACTERISTIC
/begin CHARACTERISTIC DWC_CALIB.DWC_K1DeviceControl.DWC_CLUTCHBLIPHIGHPRESS "" VALUE 0x8060E6C0 DefaultValueRecordLayout_AUTOSAR_Platform_BaseTypes_sint16 34.0 RB_PT_PCT_SWC_DWC_CompuMethods_ratio_0p001__2 -2. 32. FORMAT "%10.5"
 /begin ANNOTATION ANNOTATION_LABEL "Description (coming from AUTOSAR DESC field)"
  /begin ANNOTATION_TEXT "Pressure threshold for potential torque transfer during gear engagements.\r\n" /end ANNOTATION_TEXT
 /end ANNOTATION
/end CHARACTERISTIC
/begin CHARACTERISTIC DWC_CALIB.DWC_K1DeviceControl.DWC_CLUTCHBLIPTIME "" CURVE 0x8060EA20 RB_PT_PCT_SWC_DWC_RecordLayouts_RL_Curve_uint8_4_sint16_4 1.0 RB_PT_PCT_SWC_DWC_CompuMethods_ratio_0p01 0.0 1. FORMAT "%10.5"
 /begin ANNOTATION ANNOTATION_LABEL "Description (coming from AUTOSAR DESC field)" /begin ANNOTATION_TEXT "Time for clutch blip\r\n" /end ANNOTATION_TEXT /end ANNOTATION
 /begin AXIS_DESCR STD_AXIS NO_INPUT_QUANTITY RB_PT_PCT_SWC_DWC_CompuMethods_ident 4 -50. 200. FORMAT "%10.5" DEPOSIT ABSOLUTE /end AXIS_DESCR
/end CHARACTERISTIC
/begin CHARACTERISTIC DWC_CALIB.DWC_K1DeviceControl.DWC_ENABLEFAIL37GEARSTATUS "" VALUE 0x8060E6DC DefaultValueRecordLayout_AUTOSAR_Platform_BaseTypes_uint8 255.0 DefaultIdenticalCompu 0.0 255. FORMAT "%10.5"
 /begin ANNOTATION ANNOTATION_LABEL "Description (coming from AUTOSAR DESC field)"
  /begin ANNOTATION_TEXT "flag to enable failing of bank of gears for 37 gear status\r\n" /end ANNOTATION_TEXT
 /end ANNOTATION
/end CHARACTERISTIC
/begin CHARACTERISTIC DWC_CALIB.DWC_K1DeviceControl.DWC_ENABLEFAILEDSTATUSFORUSERABORT "" VALUE 0x8060E6DD DefaultValueRecordLayout_AUTOSAR_Platform_BaseTypes_boolean 255.0 AUTOSAR_Platform_CompuMethods_boolean 0.0 255. FORMAT "%10.5"
 /begin ANNOTATION ANNOTATION_LABEL "Description (coming from AUTOSAR DESC field)"
  /begin ANNOTATION_TEXT "Allow the reported status to say 'failed' if the user aborts a routine.\r\n" /end ANNOTATION_TEXT
 /end ANNOTATION
/end CHARACTERISTIC
/begin CHARACTERISTIC DWC_CALIB.DWC_K1DeviceControl.DWC_ENABLESELFTESTDIAGNOSTIC "" VALUE 0x8060E6DE DefaultValueRecordLayout_AUTOSAR_Platform_BaseTypes_boolean 255.0 AUTOSAR_Platform_CompuMethods_boolean 0.0 255. FORMAT "%10.5"
 /begin ANNOTATION ANNOTATION_LABEL "Description (coming from AUTOSAR DESC field)"
  /begin ANNOTATION_TEXT "Flag to enable diagnostics when in self test and no routine running.\r\n" /end ANNOTATION_TEXT
 /end ANNOTATION
/end CHARACTERISTIC
/begin CHARACTERISTIC DWC_CALIB.DWC_K1DeviceControl.DWC_ENGOFFPRESS "" CURVE 0x8060EA2E RB_PT_PCT_SWC_DWC_RecordLayouts_RL_Curve_sint16_4_uint8_4 34.0 RB_PT_PCT_SWC_DWC_CompuMethods_ratio_0p001__2 -2. 32. FORMAT "%10.5"
 /begin ANNOTATION ANNOTATION_LABEL "Description (coming from AUTOSAR DESC field)" /begin ANNOTATION_TEXT "Pressure request when engine is off.\r\n" /end ANNOTATION_TEXT /end ANNOTATION
 /begin AXIS_DESCR STD_AXIS NO_INPUT_QUANTITY RB_PT_PCT_SWC_DWC_CompuMethods_ratio_0p005 4 0.0 1. FORMAT "%10.5" DEPOSIT ABSOLUTE /end AXIS_DESCR
/end CHARACTERISTIC
/begin CHARACTERISTIC DWC_CALIB.DWC_K1DeviceControl.DWC_FillController.DWC_FLGENABLEFILLTEST "" VALUE 0x8060E7A8 DefaultValueRecordLayout_AUTOSAR_Platform_BaseTypes_boolean 255.0 AUTOSAR_Platform_CompuMethods_boolean 0.0 255. FORMAT "%10.5"
 /begin ANNOTATION ANNOTATION_LABEL "Description (coming from AUTOSAR DESC field)"
  /begin ANNOTATION_TEXT "Set true to use a single parameter for fill pressure for testing/characterisation work\r\n" /end ANNOTATION_TEXT
 /end ANNOTATION
/end CHARACTERISTIC
/begin CHARACTERISTIC DWC_CALIB.DWC_K1DeviceControl.DWC_FillController.DWC_PRESFILLTEST "" VALUE 0x8060E7A6 DefaultValueRecordLayout_AUTOSAR_Platform_BaseTypes_uint16 32.0 RB_PT_PCT_SWC_DWC_CompuMethods_ratio_0p001__2 0.0 32. FORMAT "%10.5"
 /begin ANNOTATION ANNOTATION_LABEL "Description (coming from AUTOSAR DESC field)" /begin ANNOTATION_TEXT "Pressure for fill test\r\n" /end ANNOTATION_TEXT /end ANNOTATION
/end CHARACTERISTIC
/begin CHARACTERISTIC DWC_CALIB.DWC_K1DeviceControl.DWC_FLGCLUTCHBLIPENABLED "" VALUE 0x8060E6DF DefaultValueRecordLayout_AUTOSAR_Platform_BaseTypes_boolean 255.0 AUTOSAR_Platform_CompuMethods_boolean 0.0 255. FORMAT "%10.5"
 /begin ANNOTATION ANNOTATION_LABEL "Description (coming from AUTOSAR DESC field)" /begin ANNOTATION_TEXT "Flag to enable clutch blip requests from GAC.\r\n" /end ANNOTATION_TEXT /end ANNOTATION
/end CHARACTERISTIC
/begin CHARACTERISTIC DWC_CALIB.DWC_K1DeviceControl.DWC_FLGDISABLEDIAG4DEPRESSURE "" VALUE 0x8060E6E0 DefaultValueRecordLayout_AUTOSAR_Platform_BaseTypes_boolean 255.0 AUTOSAR_Platform_CompuMethods_boolean 0.0 255. FORMAT "%10.5"
 /begin ANNOTATION ANNOTATION_LABEL "Description (coming from AUTOSAR DESC field)"
  /begin ANNOTATION_TEXT "Disable DWC diagnostics when a depressure routine is active.\r\n" /end ANNOTATION_TEXT
 /end ANNOTATION
/end CHARACTERISTIC
/begin CHARACTERISTIC DWC_CALIB.DWC_K1DeviceControl.DWC_FLGENABLEAUTOVALVECLOSEDCLEAN "" VALUE 0x8060E6E1 DefaultValueRecordLayout_AUTOSAR_Platform_BaseTypes_uint8 255.0 DefaultIdenticalCompu 0.0 255. FORMAT "%10.5"
 /begin ANNOTATION ANNOTATION_LABEL "Description (coming from AUTOSAR DESC field)" /begin ANNOTATION_TEXT "Enable automatic cleaning on a closed clutch\r\n" /end ANNOTATION_TEXT /end ANNOTATION
/end CHARACTERISTIC
/begin CHARACTERISTIC DWC_CALIB.DWC_K1DeviceControl.DWC_FLGENABLEAUTOVALVEOPENCLEAN "" VALUE 0x8060E6E2 DefaultValueRecordLayout_AUTOSAR_Platform_BaseTypes_uint8 255.0 DefaultIdenticalCompu 0.0 255. FORMAT "%10.5"
 /begin ANNOTATION ANNOTATION_LABEL "Description (coming from AUTOSAR DESC field)" /begin ANNOTATION_TEXT "Enable automatic cleaning on an open clutch\r\n" /end ANNOTATION_TEXT /end ANNOTATION
/end CHARACTERISTIC
/begin CHARACTERISTIC DWC_CALIB.DWC_K1DeviceControl.DWC_FLGENABLEAUTOVALVERINSE "" VALUE 0x8060E6E3 DefaultValueRecordLayout_AUTOSAR_Platform_BaseTypes_uint8 255.0 DefaultIdenticalCompu 0.0 255. FORMAT "%10.5"
 /begin ANNOTATION ANNOTATION_LABEL "Description (coming from AUTOSAR DESC field)" /begin ANNOTATION_TEXT "Enable automatic rinsing on the clutch valve\r\n" /end ANNOTATION_TEXT /end ANNOTATION
/end CHARACTERISTIC
/begin CHARACTERISTIC DWC_CALIB.DWC_K1DeviceControl.DWC_FLGENABLEENGOFFPRES "" VALUE 0x8060E6E4 DefaultValueRecordLayout_AUTOSAR_Platform_BaseTypes_boolean 255.0 AUTOSAR_Platform_CompuMethods_boolean 0.0 255. FORMAT "%10.5"
 /begin ANNOTATION ANNOTATION_LABEL "Description (coming from AUTOSAR DESC field)"
  /begin ANNOTATION_TEXT "Flag to enable seperate engine off pressure for rinsing.\r\n" /end ANNOTATION_TEXT
 /end ANNOTATION
/end CHARACTERISTIC
/begin CHARACTERISTIC DWC_CALIB.DWC_K1DeviceControl.DWC_FLGENABLEFAILEDHYBMDTABLE "" VALUE 0x8060E6E5 DefaultValueRecordLayout_AUTOSAR_Platform_BaseTypes_boolean 255.0 AUTOSAR_Platform_CompuMethods_boolean 0.0 255. FORMAT "%10.5"
 /begin ANNOTATION ANNOTATION_LABEL "Description (coming from AUTOSAR DESC field)"
  /begin ANNOTATION_TEXT "Flag to enable DWC device controller to write to failed hybrid mode table.\r\n" /end ANNOTATION_TEXT
 /end ANNOTATION
/end CHARACTERISTIC
/begin CHARACTERISTIC DWC_CALIB.DWC_K1DeviceControl.DWC_FLGFORCETPRESET "" VALUE 0x8060E6E6 DefaultValueRecordLayout_AUTOSAR_Platform_BaseTypes_boolean 255.0 AUTOSAR_Platform_CompuMethods_boolean 0.0 255. FORMAT "%10.5"
 /begin ANNOTATION ANNOTATION_LABEL "Description (coming from AUTOSAR DESC field)" /begin ANNOTATION_TEXT "Set true to force torque to pressure reset\r\n" /end ANNOTATION_TEXT /end ANNOTATION
/end CHARACTERISTIC
/begin CHARACTERISTIC DWC_CALIB.DWC_K1DeviceControl.DWC_FLGFORCEZEROPRSFAILGEAR "" VALUE 0x8060E6E7 DefaultValueRecordLayout_AUTOSAR_Platform_BaseTypes_boolean 255.0 AUTOSAR_Platform_CompuMethods_boolean 0.0 255. FORMAT "%10.5"
 /begin ANNOTATION ANNOTATION_LABEL "Description (coming from AUTOSAR DESC field)"
  /begin ANNOTATION_TEXT "Flag to force pressure demand to zero when gears are failed.\r\n" /end ANNOTATION_TEXT
 /end ANNOTATION
/end CHARACTERISTIC
/begin CHARACTERISTIC DWC_CALIB.DWC_K1DeviceControl.DWC_FORCENOPREFILLBEFORESO "" VALUE 0x8060E6E8 DefaultValueRecordLayout_AUTOSAR_Platform_BaseTypes_uint8 255.0 DefaultIdenticalCompu 0.0 255. FORMAT "%10.5" /end CHARACTERISTIC
/begin CHARACTERISTIC DWC_CALIB.DWC_K1DeviceControl.DWC_L2MaxDoubleSeqTime "" VALUE 0x8060E6C2 DefaultValueRecordLayout_AUTOSAR_Platform_BaseTypes_uint16 327.675 RB_PT_PCT_SWC_DWC_CompuMethods_ratio_0p005 0.0 327.675 FORMAT "%10.5"
 /begin ANNOTATION ANNOTATION_LABEL "Description (coming from AUTOSAR DESC field)"
  /begin ANNOTATION_TEXT "Time the L2 sequence will stop and open both clutches\r\n" /end ANNOTATION_TEXT
 /end ANNOTATION
/end CHARACTERISTIC
/begin CHARACTERISTIC DWC_CALIB.DWC_K1DeviceControl.DWC_L2SetTroque "" CURVE 0x8060EA3C RB_PT_PCT_SWC_DWC_RecordLayouts_RL_Curve_sint16_50_uint16_50 4000.0 RB_PT_PCT_SWC_DWC_CompuMethods_ratio_0p1 -2000. 2000. FORMAT "%10.5"
 /begin ANNOTATION ANNOTATION_LABEL "Description (coming from AUTOSAR DESC field)" /begin ANNOTATION_TEXT "Torque sequence in relation to time.\r\n" /end ANNOTATION_TEXT /end ANNOTATION
 /begin AXIS_DESCR STD_AXIS NO_INPUT_QUANTITY RB_PT_PCT_SWC_DWC_CompuMethods_ratio_0p005 50 0.0 327.675 FORMAT "%10.5" DEPOSIT ABSOLUTE /end AXIS_DESCR
/end CHARACTERISTIC
/begin CHARACTERISTIC DWC_CALIB.DWC_K1DeviceControl.DWC_LINEPRESSUREDIAGDISABLE "" VALUE 0x8060E6C4 DefaultValueRecordLayout_AUTOSAR_Platform_BaseTypes_sint16 105.0 RB_PT_PCT_SWC_DWC_CompuMethods_ratio_0p005 -5. 100. FORMAT "%10.5"
 /begin ANNOTATION ANNOTATION_LABEL "Description (coming from AUTOSAR DESC field)" /begin ANNOTATION_TEXT "Lower line pressure at which diags become disabled.\r\n" /end ANNOTATION_TEXT /end ANNOTATION
/end CHARACTERISTIC
/begin CHARACTERISTIC DWC_CALIB.DWC_K1DeviceControl.DWC_MAXOUTPUTSPDFORCLUTCHBLIP "" VALUE 0x8060E6C6 DefaultValueRecordLayout_AUTOSAR_Platform_BaseTypes_sint16 40000.0 RB_PT_PCT_SWC_DWC_CompuMethods_ident -20000. 20000. FORMAT "%10.5"
 /begin ANNOTATION ANNOTATION_LABEL "Description (coming from AUTOSAR DESC field)" /begin ANNOTATION_TEXT "Minimum outspeed to allow for clutch blip\r\n" /end ANNOTATION_TEXT /end ANNOTATION
/end CHARACTERISTIC
/begin CHARACTERISTIC DWC_CALIB.DWC_K1DeviceControl.DWC_MINLINEPRESSURE4DIAG "" VALUE 0x8060E6C8 DefaultValueRecordLayout_AUTOSAR_Platform_BaseTypes_sint16 105.0 RB_PT_PCT_SWC_DWC_CompuMethods_ratio_0p005 -5. 100. FORMAT "%10.5"
 /begin ANNOTATION ANNOTATION_LABEL "Description (coming from AUTOSAR DESC field)"
  /begin ANNOTATION_TEXT "Minimum line pressure to be seen to enable DC diagnostics.\r\n" /end ANNOTATION_TEXT
 /end ANNOTATION
/end CHARACTERISTIC
/begin CHARACTERISTIC DWC_CALIB.DWC_K1DeviceControl.DWC_MINSOHLINEPRESSURE "" VALUE 0x8060E6CA DefaultValueRecordLayout_AUTOSAR_Platform_BaseTypes_sint16 105.0 RB_PT_PCT_SWC_DWC_CompuMethods_ratio_0p005 -5. 100. FORMAT "%10.5"
 /begin ANNOTATION ANNOTATION_LABEL "Description (coming from AUTOSAR DESC field)" /begin ANNOTATION_TEXT "Minimum line pressure to allow shut off test.\r\n" /end ANNOTATION_TEXT /end ANNOTATION
/end CHARACTERISTIC
/begin CHARACTERISTIC DWC_CALIB.DWC_K1DeviceControl.DWC_OPENDEMANDKICK "" CURVE 0x8060EB06 RB_PT_PCT_SWC_DWC_RecordLayouts_RL_Curve_sint16_4_sint16_4 34.0 RB_PT_PCT_SWC_DWC_CompuMethods_ratio_0p001__2 -2. 32. FORMAT "%10.5"
 /begin ANNOTATION ANNOTATION_LABEL "Description (coming from AUTOSAR DESC field)" /begin ANNOTATION_TEXT "Temperature dependancy on prefill kick.\r\n" /end ANNOTATION_TEXT /end ANNOTATION
 /begin AXIS_DESCR STD_AXIS NO_INPUT_QUANTITY RB_PT_PCT_SWC_DWC_CompuMethods_ident 4 -50. 200. FORMAT "%10.5" DEPOSIT ABSOLUTE /end AXIS_DESCR
/end CHARACTERISTIC
/begin CHARACTERISTIC DWC_CALIB.DWC_K1DeviceControl.DWC_OpenPressureDiag.DWC_ENABLEHYSTERESISFORDITHER "" VALUE 0x8060E7AA DefaultValueRecordLayout_AUTOSAR_Platform_BaseTypes_boolean 255.0 AUTOSAR_Platform_CompuMethods_boolean 0.0 255. FORMAT "%10.5"
 /begin ANNOTATION ANNOTATION_LABEL "Description (coming from AUTOSAR DESC field)"
  /begin ANNOTATION_TEXT "Use hysteresis when enabling dither in a pressure error scenario.\r\n" /end ANNOTATION_TEXT
 /end ANNOTATION
/end CHARACTERISTIC
/begin CHARACTERISTIC DWC_CALIB.DWC_K1DeviceControl.DWC_PKFILTENGVSPRESRATE "" MAP 0x8060EB18 RB_PT_PCT_SWC_DWC_RecordLayouts_RL_Map_uint16_48_uint16_6_sint16_8 1.0 RB_PT_PCT_SWC_DWC_CompuMethods_ratio_0p01 0.0 1. FORMAT "%10.5"
 /begin ANNOTATION ANNOTATION_LABEL "Description (coming from AUTOSAR DESC field)"
  /begin ANNOTATION_TEXT "Filter PK in relation to engine speed and rate of change target pressure\r\n" /end ANNOTATION_TEXT
 /end ANNOTATION
 /begin AXIS_DESCR STD_AXIS NO_INPUT_QUANTITY RB_PT_PCT_SWC_DWC_CompuMethods_ident 6 0.0 20000. FORMAT "%10.5" DEPOSIT ABSOLUTE /end AXIS_DESCR
 /begin AXIS_DESCR STD_AXIS NO_INPUT_QUANTITY RB_PT_PCT_SWC_DWC_CompuMethods_pressure_0p1 8 -3200. 3200. FORMAT "%10.5" DEPOSIT ABSOLUTE /end AXIS_DESCR
/end CHARACTERISTIC
/begin CHARACTERISTIC DWC_CALIB.DWC_K1DeviceControl.DWC_POSTFILLTIME "" VALUE 0x8060E6CC DefaultValueRecordLayout_AUTOSAR_Platform_BaseTypes_uint16 655.35 RB_PT_PCT_SWC_DWC_CompuMethods_DST_Time 0.0 655.35 FORMAT "%10.5"
 /begin ANNOTATION ANNOTATION_LABEL "Description (coming from AUTOSAR DESC field)"
  /begin ANNOTATION_TEXT "Time used to postpone pK filter after any form of fill.\r\n" /end ANNOTATION_TEXT
 /end ANNOTATION
/end CHARACTERISTIC
/begin CHARACTERISTIC DWC_CALIB.DWC_K1DeviceControl.DWC_PREFILLKICKMODE "" VALUE 0x8060E6E9 DefaultValueRecordLayout_AUTOSAR_Platform_BaseTypes_uint8 2.0 RB_PT_PCT_SWC_DWC_CompuMethods_ident 0.0 2. FORMAT "%10.5" /end CHARACTERISTIC
/begin CHARACTERISTIC DWC_CALIB.DWC_K1DeviceControl.DWC_PRES2CLUBLIPMAG "" MAP 0x8060EB98 RB_PT_PCT_SWC_DWC_RecordLayouts_RL_Map_uint8_24_sint16_6_sint16_4 15.0 RB_PT_PCT_SWC_DWC_CompuMethods_ratio_0p1 0.0 15. FORMAT "%10.5"
 /begin ANNOTATION ANNOTATION_LABEL "Description (coming from AUTOSAR DESC field)" /begin ANNOTATION_TEXT "Pressure to clutch blip magnitude.\r\n" /end ANNOTATION_TEXT /end ANNOTATION
 /begin AXIS_DESCR STD_AXIS NO_INPUT_QUANTITY RB_PT_PCT_SWC_DWC_CompuMethods_ratio_0p001__2 6 -2. 32. FORMAT "%10.5" DEPOSIT ABSOLUTE /end AXIS_DESCR
 /begin AXIS_DESCR STD_AXIS NO_INPUT_QUANTITY RB_PT_PCT_SWC_DWC_CompuMethods_ident 4 -50. 200. FORMAT "%10.5" DEPOSIT ABSOLUTE /end AXIS_DESCR
/end CHARACTERISTIC
/begin CHARACTERISTIC DWC_CALIB.DWC_K1DeviceControl.DWC_PressCurrent.DWC_HYSTERESISBANDWIDTH "" MAP 0x8060E7B4 RB_PT_PCT_SWC_DWC_RecordLayouts_RL_Map_uint16_55_sint16_11_sint16_5 1.0 RB_PT_PCT_SWC_DWC_CompuMethods_ratio_0p0001 0.0 1. FORMAT "%10.5"
 /begin AXIS_DESCR STD_AXIS NO_INPUT_QUANTITY RB_PT_PCT_SWC_DWC_CompuMethods_ratio_0p001__2 11 -2. 32. FORMAT "%10.5" DEPOSIT ABSOLUTE /end AXIS_DESCR
 /begin AXIS_DESCR STD_AXIS NO_INPUT_QUANTITY RB_PT_PCT_SWC_DWC_CompuMethods_ident 5 -50. 200. FORMAT "%10.5" DEPOSIT ABSOLUTE /end AXIS_DESCR
/end CHARACTERISTIC
/begin CHARACTERISTIC DWC_CALIB.DWC_K1DeviceControl.DWC_PressCurrent.DWC_MAXCURDEMFORADAPTION "" VALUE 0x8060E7AC DefaultValueRecordLayout_AUTOSAR_Platform_BaseTypes_uint16 5000.0 RB_PT_PCT_SWC_DWC_CompuMethods_ident 0.0 5000. FORMAT "%10.5"
 /begin ANNOTATION ANNOTATION_LABEL "Description (coming from AUTOSAR DESC field)" /begin ANNOTATION_TEXT "Maximum allowed current demand to allow adaption.\r\n" /end ANNOTATION_TEXT /end ANNOTATION
/end CHARACTERISTIC
/begin CHARACTERISTIC DWC_CALIB.DWC_K1DeviceControl.DWC_PressCurrent.DWC_MINDYNAMICPCTEMP "" VALUE 0x8060E7AE DefaultValueRecordLayout_AUTOSAR_Platform_BaseTypes_sint16 250.0 RB_PT_PCT_SWC_DWC_CompuMethods_ident -50. 200. FORMAT "%10.5"
 /begin ANNOTATION ANNOTATION_LABEL "Description (coming from AUTOSAR DESC field)"
  /begin ANNOTATION_TEXT "Temperature condition for dynamic pressure to current.\r\n" /end ANNOTATION_TEXT
 /end ANNOTATION
/end CHARACTERISTIC
/begin CHARACTERISTIC DWC_CALIB.DWC_K1DeviceControl.DWC_PressCurrent.DWC_MINLINEPRESSADAPT "" VALUE 0x8060E7B0 DefaultValueRecordLayout_AUTOSAR_Platform_BaseTypes_sint16 105.0 RB_PT_PCT_SWC_DWC_CompuMethods_ratio_0p005 -5. 100. FORMAT "%10.5"
 /begin ANNOTATION ANNOTATION_LABEL "Description (coming from AUTOSAR DESC field)" /begin ANNOTATION_TEXT "Minimum line pressure for adaption to run.\r\n" /end ANNOTATION_TEXT /end ANNOTATION
/end CHARACTERISTIC
/begin CHARACTERISTIC DWC_CALIB.DWC_K1DeviceControl.DWC_PressCurrent.DWC_PIAdaptAutoReset "" VALUE 0x8060E7B2 DefaultValueRecordLayout_AUTOSAR_Platform_BaseTypes_uint8 255.0 DefaultIdenticalCompu 0.0 255. FORMAT "%10.5"
 /begin ANNOTATION ANNOTATION_LABEL "Description (coming from AUTOSAR DESC field)"
  /begin ANNOTATION_TEXT "Allow auto reset if PI adaption hits the max allowable limits.\r\n" /end ANNOTATION_TEXT
 /end ANNOTATION
/end CHARACTERISTIC
/begin CHARACTERISTIC DWC_CALIB.DWC_K1DeviceControl.DWC_PressCurrent.DWC_PIDFEEDFORWARD "" MAP 0x8060E846 RB_PT_PCT_SWC_DWC_RecordLayouts_RL_Map_sint16_49_sint16_7_sint16_7 2000.0 RB_PT_PCT_SWC_DWC_CompuMethods_ident -1000. 1000. FORMAT "%10.5"
 /begin AXIS_DESCR STD_AXIS NO_INPUT_QUANTITY RB_PT_PCT_SWC_DWC_CompuMethods_ratio_0p001__2 7 -32. 32. FORMAT "%10.5" DEPOSIT ABSOLUTE /end AXIS_DESCR
 /begin AXIS_DESCR STD_AXIS NO_INPUT_QUANTITY RB_PT_PCT_SWC_DWC_CompuMethods_ratio_0p001__2 7 -32. 32. FORMAT "%10.5" DEPOSIT ABSOLUTE /end AXIS_DESCR
/end CHARACTERISTIC
/begin CHARACTERISTIC DWC_CALIB.DWC_K1DeviceControl.DWC_PressCurrent.DWC_VALVEINTEGRALTEMPFACTOR "" CURVE 0x8060E8C8 RB_PT_PCT_SWC_DWC_RecordLayouts_RL_Curve_uint8_7_sint16_7 1.0 RB_PT_PCT_SWC_DWC_CompuMethods_ratio_0p01 0.0 1. FORMAT "%10.5"
 /begin ANNOTATION ANNOTATION_LABEL "Description (coming from AUTOSAR DESC field)" /begin ANNOTATION_TEXT "Temperature based factor for valve integral gain.\r\n" /end ANNOTATION_TEXT /end ANNOTATION
 /begin AXIS_DESCR STD_AXIS NO_INPUT_QUANTITY RB_PT_PCT_SWC_DWC_CompuMethods_ident 7 -50. 200. FORMAT "%10.5" DEPOSIT ABSOLUTE /end AXIS_DESCR
/end CHARACTERISTIC
/begin CHARACTERISTIC DWC_CALIB.DWC_K1DeviceControl.DWC_PRESSUREDELAYRATECALC "" VALUE 0x8060E6EA DefaultValueRecordLayout_AUTOSAR_Platform_BaseTypes_uint8 30.0 RB_PT_PCT_SWC_DWC_CompuMethods_ident 0.0 30. FORMAT "%10.5"
 /begin ANNOTATION ANNOTATION_LABEL "Description (coming from AUTOSAR DESC field)" /begin ANNOTATION_TEXT "sample period to calc pressure tgt rate of change\r\n" /end ANNOTATION_TEXT /end ANNOTATION
/end CHARACTERISTIC
/begin CHARACTERISTIC DWC_CALIB.DWC_K1DeviceControl.DWC_PtoCSequence.DWC_MAXSLIP4TXISSUE "" VALUE 0x8060E8E0 DefaultValueRecordLayout_AUTOSAR_Platform_BaseTypes_sint16 40000.0 RB_PT_PCT_SWC_DWC_CompuMethods_ident -20000. 20000. FORMAT "%10.5"
 /begin ANNOTATION ANNOTATION_LABEL "Description (coming from AUTOSAR DESC field)"
  /begin ANNOTATION_TEXT "Max permissible slip during a PI adaption when adapting PI\r\n" /end ANNOTATION_TEXT
 /end ANNOTATION
/end CHARACTERISTIC
/begin CHARACTERISTIC DWC_CALIB.DWC_K1DeviceControl.DWC_PtoCSequence.DWC_MINOPSPEEDFORDYNAMICPC "" VALUE 0x8060E8E2 DefaultValueRecordLayout_AUTOSAR_Platform_BaseTypes_sint16 40000.0 RB_PT_PCT_SWC_DWC_CompuMethods_ident -20000. 20000. FORMAT "%10.5"
 /begin ANNOTATION ANNOTATION_LABEL "Description (coming from AUTOSAR DESC field)"
  /begin ANNOTATION_TEXT "Minimum output speed required to run dynamic pc. Logic added to prevent stationary pc learn in neutral/park\r\n" /end ANNOTATION_TEXT
 /end ANNOTATION
/end CHARACTERISTIC
/begin CHARACTERISTIC DWC_CALIB.DWC_K1DeviceControl.DWC_RESETPICLOSEDSTATUS "" VALUE 0x8060E6EB DefaultValueRecordLayout_AUTOSAR_Platform_BaseTypes_uint8 255.0 DefaultIdenticalCompu 0.0 255. FORMAT "%10.5"
 /begin ANNOTATION ANNOTATION_LABEL "Description (coming from AUTOSAR DESC field)" /begin ANNOTATION_TEXT "Flag to enable the reset of PI on closed status.\r\n" /end ANNOTATION_TEXT /end ANNOTATION
/end CHARACTERISTIC
/begin CHARACTERISTIC DWC_CALIB.DWC_K1DeviceControl.DWC_RESETPIOPENSTATUS "" VALUE 0x8060E6EC DefaultValueRecordLayout_AUTOSAR_Platform_BaseTypes_uint8 255.0 DefaultIdenticalCompu 0.0 255. FORMAT "%10.5"
 /begin ANNOTATION ANNOTATION_LABEL "Description (coming from AUTOSAR DESC field)" /begin ANNOTATION_TEXT "Flag to enable the reset of PI on open status.\r\n" /end ANNOTATION_TEXT /end ANNOTATION
/end CHARACTERISTIC
/begin CHARACTERISTIC DWC_CALIB.DWC_K1DeviceControl.DWC_SEQTORQUE "" CURVE 0x8060EBC8 RB_PT_PCT_SWC_DWC_RecordLayouts_RL_Curve_sint16_50_uint16_50 4000.0 RB_PT_PCT_SWC_DWC_CompuMethods_ratio_0p1 -2000. 2000. FORMAT "%10.5"
 /begin ANNOTATION ANNOTATION_LABEL "Description (coming from AUTOSAR DESC field)" /begin ANNOTATION_TEXT "Torque sequence in relation to time.\r\n" /end ANNOTATION_TEXT /end ANNOTATION
 /begin AXIS_DESCR STD_AXIS NO_INPUT_QUANTITY RB_PT_PCT_SWC_DWC_CompuMethods_ratio_0p005 50 0.0 327.675 FORMAT "%10.5" DEPOSIT ABSOLUTE /end AXIS_DESCR
/end CHARACTERISTIC
/begin CHARACTERISTIC DWC_CALIB.DWC_K1DeviceControl.DWC_ShutOffHandler.DWC_FLGALLOWAUTOPASSSOH "" VALUE 0x8060E8E6 DefaultValueRecordLayout_AUTOSAR_Platform_BaseTypes_boolean 255.0 AUTOSAR_Platform_CompuMethods_boolean 0.0 255. FORMAT "%10.5"
 /begin ANNOTATION ANNOTATION_LABEL "Description (coming from AUTOSAR DESC field)" /begin ANNOTATION_TEXT "Flag to enable the SOH auto pass logic.\r\n" /end ANNOTATION_TEXT /end ANNOTATION
/end CHARACTERISTIC
/begin CHARACTERISTIC DWC_CALIB.DWC_K1DeviceControl.DWC_ShutOffHandler.DWC_FLGALLOWSLAVESOTEST "" VALUE 0x8060E8E7 DefaultValueRecordLayout_AUTOSAR_Platform_BaseTypes_boolean 255.0 AUTOSAR_Platform_CompuMethods_boolean 0.0 255. FORMAT "%10.5"
 /begin ANNOTATION ANNOTATION_LABEL "Description (coming from AUTOSAR DESC field)"
  /begin ANNOTATION_TEXT "Flag to enable slave to run SO test if master is failed.\r\n" /end ANNOTATION_TEXT
 /end ANNOTATION
/end CHARACTERISTIC
/begin CHARACTERISTIC DWC_CALIB.DWC_K1DeviceControl.DWC_ShutOffHandler.DWC_FLGENABLEAUTOFAIL "" VALUE 0x8060E8E8 DefaultValueRecordLayout_AUTOSAR_Platform_BaseTypes_boolean 255.0 AUTOSAR_Platform_CompuMethods_boolean 0.0 255. FORMAT "%10.5"
 /begin ANNOTATION ANNOTATION_LABEL "Description (coming from AUTOSAR DESC field)" /begin ANNOTATION_TEXT "Flag to enable auto fail logic.\r\n" /end ANNOTATION_TEXT /end ANNOTATION
/end CHARACTERISTIC
/begin CHARACTERISTIC DWC_CALIB.DWC_K1DeviceControl.DWC_ShutOffHandler.DWC_FLGENABLEFIRSTSTATETIMEOUT "" VALUE 0x8060E8E9 DefaultValueRecordLayout_AUTOSAR_Platform_BaseTypes_boolean 255.0 AUTOSAR_Platform_CompuMethods_boolean 0.0 255. FORMAT "%10.5"
 /begin ANNOTATION ANNOTATION_LABEL "Description (coming from AUTOSAR DESC field)" /begin ANNOTATION_TEXT "Flag to enable a timeout in the first state.\r\n" /end ANNOTATION_TEXT /end ANNOTATION
/end CHARACTERISTIC
/begin CHARACTERISTIC DWC_CALIB.DWC_K1DeviceControl.DWC_ShutOffHandler.DWC_FLGOVRDDEVCHECK "" VALUE 0x8060E8EA DefaultValueRecordLayout_AUTOSAR_Platform_BaseTypes_boolean 255.0 AUTOSAR_Platform_CompuMethods_boolean 0.0 255. FORMAT "%10.5"
 /begin ANNOTATION ANNOTATION_LABEL "Description (coming from AUTOSAR DESC field)"
  /begin ANNOTATION_TEXT "Flag to override device check in auto fail. Required to fix bug\r\n" /end ANNOTATION_TEXT
 /end ANNOTATION
/end CHARACTERISTIC
/begin CHARACTERISTIC DWC_CALIB.DWC_K1DeviceControl.DWC_ShutOffHandler.DWC_FLGUSESOMASTERRULE1FIX "" VALUE 0x8060E8EB DefaultValueRecordLayout_AUTOSAR_Platform_BaseTypes_boolean 255.0 AUTOSAR_Platform_CompuMethods_boolean 0.0 255. FORMAT "%10.5"
 /begin ANNOTATION ANNOTATION_LABEL "Description (coming from AUTOSAR DESC field)"
  /begin ANNOTATION_TEXT "Flag to use the functionality described in the comment for master rule 1.\r\n" /end ANNOTATION_TEXT
 /end ANNOTATION
/end CHARACTERISTIC
/begin CHARACTERISTIC DWC_CALIB.DWC_K1DeviceControl.DWC_ShutOffHandler.DWC_REINITSOHTEST "" VALUE 0x8060E8E4 DefaultValueRecordLayout_AUTOSAR_Platform_BaseTypes_uint16 65535.0 RB_PT_PCT_SWC_DWC_CompuMethods_ident 0.0 65535. FORMAT "%10.5"
 /begin ANNOTATION ANNOTATION_LABEL "Description (coming from AUTOSAR DESC field)" /begin ANNOTATION_TEXT "Parameter to reinitialise the SOH test.\r\n" /end ANNOTATION_TEXT /end ANNOTATION
/end CHARACTERISTIC
/begin CHARACTERISTIC DWC_CALIB.DWC_K1DeviceControl.DWC_ShutOffHandler.DWC_RERUNONLYIFFAILED "" VALUE 0x8060E8EC DefaultValueRecordLayout_AUTOSAR_Platform_BaseTypes_boolean 255.0 AUTOSAR_Platform_CompuMethods_boolean 0.0 255. FORMAT "%10.5"
 /begin ANNOTATION ANNOTATION_LABEL "Description (coming from AUTOSAR DESC field)"
  /begin ANNOTATION_TEXT "Flag to re run SO test from diag reset only if the test has previously failed.\r\n" /end ANNOTATION_TEXT
 /end ANNOTATION
/end CHARACTERISTIC
/begin CHARACTERISTIC DWC_CALIB.DWC_K1DeviceControl.DWC_ShutOffHandler.DWC_SHUTOFFONLYFOR2FAILEDBANKS "" VALUE 0x8060E8ED DefaultValueRecordLayout_AUTOSAR_Platform_BaseTypes_boolean 255.0 AUTOSAR_Platform_CompuMethods_boolean 0.0 255. FORMAT "%10.5"
 /begin ANNOTATION ANNOTATION_LABEL "Description (coming from AUTOSAR DESC field)" /begin ANNOTATION_TEXT "Trigger the shut off only when 2 banks have failed.\r\n" /end ANNOTATION_TEXT /end ANNOTATION
/end CHARACTERISTIC
/begin CHARACTERISTIC DWC_CALIB.DWC_K1DeviceControl.DWC_ShutOffHandler.DWC_SOALLOWEDINSELFTEST "" VALUE 0x8060E8EE DefaultValueRecordLayout_AUTOSAR_Platform_BaseTypes_boolean 255.0 AUTOSAR_Platform_CompuMethods_boolean 0.0 255. FORMAT "%10.5"
 /begin ANNOTATION ANNOTATION_LABEL "Description (coming from AUTOSAR DESC field)"
  /begin ANNOTATION_TEXT "Flag to enabe log that allows shut off when clutch is in self test.\r\n" /end ANNOTATION_TEXT
 /end ANNOTATION
/end CHARACTERISTIC
/begin CHARACTERISTIC DWC_CALIB.DWC_K1DeviceControl.DWC_ShutOffHandler.DWC_SOHPRESSURENORESPONSETIMEMAP "" CURVE 0x8060E8F0 RB_PT_PCT_SWC_DWC_RecordLayouts_RL_Curve_uint16_4_sint16_4 10.0 RB_PT_PCT_SWC_DWC_CompuMethods_ratio_0p001__2 0.0 10. FORMAT "%10.5"
 /begin ANNOTATION ANNOTATION_LABEL "Description (coming from AUTOSAR DESC field)"
  /begin ANNOTATION_TEXT "Maximum time, after which the clutch main pressure valve is considered failed/cut off valve failed on, against temp.\r\n" /end ANNOTATION_TEXT
 /end ANNOTATION
 /begin AXIS_DESCR STD_AXIS NO_INPUT_QUANTITY RB_PT_PCT_SWC_DWC_CompuMethods_ident 4 -50. 200. FORMAT "%10.5" DEPOSIT ABSOLUTE /end AXIS_DESCR
/end CHARACTERISTIC
/begin CHARACTERISTIC DWC_CALIB.DWC_K1DeviceControl.DWC_ShutOffHandler.DWC_SOHPRESSURESLOWRESPONSETIMEMAP "" CURVE 0x8060E902 RB_PT_PCT_SWC_DWC_RecordLayouts_RL_Curve_uint16_4_sint16_4 10.0 RB_PT_PCT_SWC_DWC_CompuMethods_ratio_0p001__2 0.0 10. FORMAT "%10.5"
 /begin ANNOTATION ANNOTATION_LABEL "Description (coming from AUTOSAR DESC field)"
  /begin ANNOTATION_TEXT "Maximum time, after which the clutch main pressure valve is considered slow, and a larger request will be applied (also, starting diagnostics on that valve), against temp.\r\n" /end ANNOTATION_TEXT
 /end ANNOTATION
 /begin AXIS_DESCR STD_AXIS NO_INPUT_QUANTITY RB_PT_PCT_SWC_DWC_CompuMethods_ident 4 -50. 200. FORMAT "%10.5" DEPOSIT ABSOLUTE /end AXIS_DESCR
/end CHARACTERISTIC
/begin CHARACTERISTIC DWC_CALIB.DWC_K1DeviceControl.DWC_ShutOffHandler.DWC_SOHVALVERESPONSEMAXTIMEMAP "" CURVE 0x8060E914 RB_PT_PCT_SWC_DWC_RecordLayouts_RL_Curve_uint16_4_sint16_4 10.0 RB_PT_PCT_SWC_DWC_CompuMethods_ratio_0p001__2 0.0 10. FORMAT "%10.5"
 /begin ANNOTATION ANNOTATION_LABEL "Description (coming from AUTOSAR DESC field)"
  /begin ANNOTATION_TEXT "Maximum time for shut off valve to respond, after which it will be marked as failed, against temp.\r\n" /end ANNOTATION_TEXT
 /end ANNOTATION
 /begin AXIS_DESCR STD_AXIS NO_INPUT_QUANTITY RB_PT_PCT_SWC_DWC_CompuMethods_ident 4 -50. 200. FORMAT "%10.5" DEPOSIT ABSOLUTE /end AXIS_DESCR
/end CHARACTERISTIC
/begin CHARACTERISTIC DWC_CALIB.DWC_K1DeviceControl.DWC_TEMPMAXVALVECLEAN "" VALUE 0x8060E6CE DefaultValueRecordLayout_AUTOSAR_Platform_BaseTypes_sint16 250.0 RB_PT_PCT_SWC_DWC_CompuMethods_ident -50. 200. FORMAT "%10.5"
 /begin ANNOTATION ANNOTATION_LABEL "Description (coming from AUTOSAR DESC field)" /begin ANNOTATION_TEXT "Maximum temperature to allow valve clean\r\n" /end ANNOTATION_TEXT /end ANNOTATION
/end CHARACTERISTIC
/begin CHARACTERISTIC DWC_CALIB.DWC_K1DeviceControl.DWC_TEMPMAXVALVERINSE "" VALUE 0x8060E6D0 DefaultValueRecordLayout_AUTOSAR_Platform_BaseTypes_sint16 250.0 RB_PT_PCT_SWC_DWC_CompuMethods_ident -50. 200. FORMAT "%10.5"
 /begin ANNOTATION ANNOTATION_LABEL "Description (coming from AUTOSAR DESC field)" /begin ANNOTATION_TEXT "Maximum temperature to allow valve rinse\r\n" /end ANNOTATION_TEXT /end ANNOTATION
/end CHARACTERISTIC
/begin CHARACTERISTIC DWC_CALIB.DWC_K1DeviceControl.DWC_TEMPMINBLIP "" VALUE 0x8060E6D2 DefaultValueRecordLayout_AUTOSAR_Platform_BaseTypes_sint16 250.0 RB_PT_PCT_SWC_DWC_CompuMethods_ident -50. 200. FORMAT "%10.5"
 /begin ANNOTATION ANNOTATION_LABEL "Description (coming from AUTOSAR DESC field)"
  /begin ANNOTATION_TEXT "Minimum blip temperature cal when temperature status is true.\r\n" /end ANNOTATION_TEXT
 /end ANNOTATION
/end CHARACTERISTIC
/begin CHARACTERISTIC DWC_CALIB.DWC_K1DeviceControl.DWC_TEMPMINVALVECLEAN "" VALUE 0x8060E6D4 DefaultValueRecordLayout_AUTOSAR_Platform_BaseTypes_sint16 250.0 RB_PT_PCT_SWC_DWC_CompuMethods_ident -50. 200. FORMAT "%10.5"
 /begin ANNOTATION ANNOTATION_LABEL "Description (coming from AUTOSAR DESC field)" /begin ANNOTATION_TEXT "Minimum temperature to allow valve clean\r\n" /end ANNOTATION_TEXT /end ANNOTATION
/end CHARACTERISTIC
/begin CHARACTERISTIC DWC_CALIB.DWC_K1DeviceControl.DWC_TEMPMINVALVERINSE "" VALUE 0x8060E6D6 DefaultValueRecordLayout_AUTOSAR_Platform_BaseTypes_sint16 250.0 RB_PT_PCT_SWC_DWC_CompuMethods_ident -50. 200. FORMAT "%10.5"
 /begin ANNOTATION ANNOTATION_LABEL "Description (coming from AUTOSAR DESC field)" /begin ANNOTATION_TEXT "Minimum temperature to allow valve rinse\r\n" /end ANNOTATION_TEXT /end ANNOTATION
/end CHARACTERISTIC
/begin CHARACTERISTIC DWC_CALIB.DWC_K1DeviceControl.DWC_TrqPress.DWC_ENABLEKPSTATEMIN "" VALUE 0x8060E926 DefaultValueRecordLayout_AUTOSAR_Platform_BaseTypes_uint8 255.0 DefaultIdenticalCompu 0.0 255. FORMAT "%10.5"
 /begin ANNOTATION ANNOTATION_LABEL "Description (coming from AUTOSAR DESC field)" /begin ANNOTATION_TEXT "use to enable TP adaption fault for KP hit min limit\r\n" /end ANNOTATION_TEXT /end ANNOTATION
/end CHARACTERISTIC
/begin CHARACTERISTIC DWC_CALIB.DWC_K1DeviceControl.DWC_TrqPress.DWC_ENABLEMAXTPSTATEMAX "" VALUE 0x8060E927 DefaultValueRecordLayout_AUTOSAR_Platform_BaseTypes_uint8 255.0 DefaultIdenticalCompu 0.0 255. FORMAT "%10.5"
 /begin ANNOTATION ANNOTATION_LABEL "Description (coming from AUTOSAR DESC field)"
  /begin ANNOTATION_TEXT "use to enable TP adaption fault for max torque max limit hit\r\n" /end ANNOTATION_TEXT
 /end ANNOTATION
/end CHARACTERISTIC
/begin CHARACTERISTIC DWC_CALIB.DWC_K1DeviceControl.DWC_TrqPress.DWC_ENABLEMAXTPSTATEMIN "" VALUE 0x8060E928 DefaultValueRecordLayout_AUTOSAR_Platform_BaseTypes_uint8 255.0 DefaultIdenticalCompu 0.0 255. FORMAT "%10.5"
 /begin ANNOTATION ANNOTATION_LABEL "Description (coming from AUTOSAR DESC field)"
  /begin ANNOTATION_TEXT "use to enable TP adaption fault for max torque min limit hit\r\n" /end ANNOTATION_TEXT
 /end ANNOTATION
/end CHARACTERISTIC
/begin CHARACTERISTIC DWC_CALIB.DWC_K1DeviceControl.DWC_TrqPress.DWC_EnableTP67Copy "" VALUE 0x8060E92A DefaultValueRecordLayout_AUTOSAR_Platform_BaseTypes_uint8 255.0 DefaultIdenticalCompu 0.0 255. FORMAT "%10.5"
 /begin ANNOTATION ANNOTATION_LABEL "Description (coming from AUTOSAR DESC field)" /begin ANNOTATION_TEXT "flag to copy adaption from position 6 to 7\r\n" /end ANNOTATION_TEXT /end ANNOTATION
/end CHARACTERISTIC
/begin CHARACTERISTIC DWC_CALIB.DWC_K1DeviceControl.DWC_TrqPress.DWC_ENABLKPSTATEMAX "" VALUE 0x8060E929 DefaultValueRecordLayout_AUTOSAR_Platform_BaseTypes_uint8 255.0 DefaultIdenticalCompu 0.0 255. FORMAT "%10.5"
 /begin ANNOTATION ANNOTATION_LABEL "Description (coming from AUTOSAR DESC field)" /begin ANNOTATION_TEXT "use to enable TP adaption fault for KP hit max limit\r\n" /end ANNOTATION_TEXT /end ANNOTATION
/end CHARACTERISTIC
/begin CHARACTERISTIC DWC_CALIB.DWC_K1DeviceControl.DWC_TrqPress.DWC_KisspointSequencer.DWC_BOBSTATICKPSMFIX "" VALUE 0x8060E930 DefaultValueRecordLayout_AUTOSAR_Platform_BaseTypes_boolean 255.0 AUTOSAR_Platform_CompuMethods_boolean 0.0 255. FORMAT "%10.5"
 /begin ANNOTATION ANNOTATION_LABEL "Description (coming from AUTOSAR DESC field)"
  /begin ANNOTATION_TEXT "Parameter to enable to fix that will allow static adaptions to cancel when OBD_NOTEST is seen.\r\n" /end ANNOTATION_TEXT
 /end ANNOTATION
/end CHARACTERISTIC
/begin CHARACTERISTIC DWC_CALIB.DWC_K1DeviceControl.DWC_TrqPress.DWC_KisspointSequencer.DWC_FLGABORTFORGEARTIMEOUT "" VALUE 0x8060E931 DefaultValueRecordLayout_AUTOSAR_Platform_BaseTypes_boolean 255.0 AUTOSAR_Platform_CompuMethods_boolean 0.0 255. FORMAT "%10.5"
 /begin ANNOTATION ANNOTATION_LABEL "Description (coming from AUTOSAR DESC field)" /begin ANNOTATION_TEXT "Flag to enable KP learn due to gear engage timeout.\r\n" /end ANNOTATION_TEXT /end ANNOTATION
/end CHARACTERISTIC
/begin CHARACTERISTIC DWC_CALIB.DWC_K1DeviceControl.DWC_TrqPress.DWC_KisspointSequencer.DWC_KPABORTTRUETIME "" VALUE 0x8060E92C DefaultValueRecordLayout_AUTOSAR_Platform_BaseTypes_uint16 10.0 RB_PT_PCT_SWC_DWC_CompuMethods_ratio_0p001__2 0.0 10. FORMAT "%10.5"
 /begin ANNOTATION ANNOTATION_LABEL "Description (coming from AUTOSAR DESC field)" /begin ANNOTATION_TEXT "Time for which abort flag should be true.\r\n" /end ANNOTATION_TEXT /end ANNOTATION
/end CHARACTERISTIC
/begin CHARACTERISTIC DWC_CALIB.DWC_K1DeviceControl.DWC_TrqPress.DWC_KisspointSequencer.DWC_KPMAXTIMEFORENGAGINGGEAR "" VALUE 0x8060E92E DefaultValueRecordLayout_AUTOSAR_Platform_BaseTypes_uint16 10.0 RB_PT_PCT_SWC_DWC_CompuMethods_ratio_0p001__2 0.0 10. FORMAT "%10.5"
 /begin ANNOTATION ANNOTATION_LABEL "Description (coming from AUTOSAR DESC field)" /begin ANNOTATION_TEXT "Max allowable timeout for gear engagement\r\n" /end ANNOTATION_TEXT /end ANNOTATION
/end CHARACTERISTIC
/begin CHARACTERISTIC DWC_CALIB.DWC_K1DeviceControl.DWC_TrqPress.DWC_MAXADAPTSTATUSINDEX "" VALUE 0x8060E92B DefaultValueRecordLayout_AUTOSAR_Platform_BaseTypes_uint8 8.0 RB_PT_PCT_SWC_DWC_CompuMethods_ident 0.0 8. FORMAT "%10.5"
 /begin ANNOTATION ANNOTATION_LABEL "Description (coming from AUTOSAR DESC field)"
  /begin ANNOTATION_TEXT "Index of TP adaption to monitor for out of bounds errors.\r\n" /end ANNOTATION_TEXT
 /end ANNOTATION
/end CHARACTERISTIC
/begin CHARACTERISTIC DWC_CALIB.DWC_K1DeviceControl.DWC_USEIOPPRESSUREFORDIAG "" VALUE 0x8060E6ED DefaultValueRecordLayout_AUTOSAR_Platform_BaseTypes_boolean 255.0 AUTOSAR_Platform_CompuMethods_boolean 0.0 255. FORMAT "%10.5"
 /begin ANNOTATION ANNOTATION_LABEL "Description (coming from AUTOSAR DESC field)"
  /begin ANNOTATION_TEXT "Set true to use 'raw' pressure signal from IOP rather than from DWC input processing.\r\n" /end ANNOTATION_TEXT
 /end ANNOTATION
/end CHARACTERISTIC
/begin CHARACTERISTIC DWC_CALIB.DWC_K1DeviceControl.DWC_USELINEPRESSUREFOROSG "" VALUE 0x8060E6EE DefaultValueRecordLayout_AUTOSAR_Platform_BaseTypes_boolean 255.0 AUTOSAR_Platform_CompuMethods_boolean 0.0 255. FORMAT "%10.5"
 /begin ANNOTATION ANNOTATION_LABEL "Description (coming from AUTOSAR DESC field)"
  /begin ANNOTATION_TEXT "Flag to use line pressure for 'Oil Supply Good' flag.\r\n" /end ANNOTATION_TEXT
 /end ANNOTATION
/end CHARACTERISTIC
/begin CHARACTERISTIC DWC_CALIB.DWC_K1DeviceControl.DWC_USEVALVECLEANDEMANDS "" VALUE 0x8060E6EF DefaultValueRecordLayout_AUTOSAR_Platform_BaseTypes_uint8 255.0 DefaultIdenticalCompu 0.0 255. FORMAT "%10.5"
 /begin ANNOTATION ANNOTATION_LABEL "Description (coming from AUTOSAR DESC field)"
  /begin ANNOTATION_TEXT "Set true to use pressure demands that have been passed through the valve clean class\r\n" /end ANNOTATION_TEXT
 /end ANNOTATION
/end CHARACTERISTIC
/begin CHARACTERISTIC DWC_CALIB.DWC_K1DeviceControl.DWC_USEVCPRESDEMWHENCLEANING "" VALUE 0x8060E6F0 DefaultValueRecordLayout_AUTOSAR_Platform_BaseTypes_boolean 255.0 AUTOSAR_Platform_CompuMethods_boolean 0.0 255. FORMAT "%10.5"
 /begin ANNOTATION ANNOTATION_LABEL "Description (coming from AUTOSAR DESC field)"
  /begin ANNOTATION_TEXT "Flag to use VC pressure demand when a clean is active.\r\n" /end ANNOTATION_TEXT
 /end ANNOTATION
/end CHARACTERISTIC
/begin CHARACTERISTIC DWC_CALIB.DWC_K1DeviceControl.DWC_ValveClean.DWC_PCTVALVECLOSEDCLEANEARLYCOMPLETE "" VALUE 0x8060E94E DefaultValueRecordLayout_AUTOSAR_Platform_BaseTypes_uint8 1.0 RB_PT_PCT_SWC_DWC_CompuMethods_ratio_0p01 0.0 1. FORMAT "%10.5"
 /begin ANNOTATION ANNOTATION_LABEL "Description (coming from AUTOSAR DESC field)"
  /begin ANNOTATION_TEXT "Percentage of full rinse time where an early abortion still leads to a timeout condition\r\n" /end ANNOTATION_TEXT
 /end ANNOTATION
/end CHARACTERISTIC
/begin CHARACTERISTIC DWC_CALIB.DWC_K1DeviceControl.DWC_ValveClean.DWC_PCTVALVEOPENCLEANEARLYCOMPLETE "" VALUE 0x8060E94F DefaultValueRecordLayout_AUTOSAR_Platform_BaseTypes_uint8 1.0 RB_PT_PCT_SWC_DWC_CompuMethods_ratio_0p01 0.0 1. FORMAT "%10.5"
 /begin ANNOTATION ANNOTATION_LABEL "Description (coming from AUTOSAR DESC field)"
  /begin ANNOTATION_TEXT "Percentage of full rinse time where an early abortion still leads to a timeout condition\r\n" /end ANNOTATION_TEXT
 /end ANNOTATION
/end CHARACTERISTIC
/begin CHARACTERISTIC DWC_CALIB.DWC_K1DeviceControl.DWC_ValveClean.DWC_PCTVALVERINSEEARLYCOMPLETE "" VALUE 0x8060E950 DefaultValueRecordLayout_AUTOSAR_Platform_BaseTypes_uint8 1.0 RB_PT_PCT_SWC_DWC_CompuMethods_ratio_0p01 0.0 1. FORMAT "%10.5"
 /begin ANNOTATION ANNOTATION_LABEL "Description (coming from AUTOSAR DESC field)"
  /begin ANNOTATION_TEXT "Percentage of full rinse time where an early abortion still leads to a timeout condition\r\n" /end ANNOTATION_TEXT
 /end ANNOTATION
/end CHARACTERISTIC
/begin CHARACTERISTIC DWC_CALIB.DWC_K1DeviceControl.DWC_ValveClean.DWC_PRESSURECLOSEDCLEANMAX "" CURVE 0x8060E952 RB_PT_PCT_SWC_DWC_RecordLayouts_RL_Curve_sint16_5_sint16_5 34.0 RB_PT_PCT_SWC_DWC_CompuMethods_ratio_0p001__2 -2. 32. FORMAT "%10.5"
 /begin ANNOTATION ANNOTATION_LABEL "Description (coming from AUTOSAR DESC field)" /begin ANNOTATION_TEXT "Lower limit lookup\r\n" /end ANNOTATION_TEXT /end ANNOTATION
 /begin AXIS_DESCR STD_AXIS NO_INPUT_QUANTITY RB_PT_PCT_SWC_DWC_CompuMethods_ratio_0p001__2 5 -2. 32. FORMAT "%10.5" DEPOSIT ABSOLUTE /end AXIS_DESCR
/end CHARACTERISTIC
/begin CHARACTERISTIC DWC_CALIB.DWC_K1DeviceControl.DWC_ValveClean.DWC_PRESSUREOPENCLEANMAX "" CURVE 0x8060E968 RB_PT_PCT_SWC_DWC_RecordLayouts_RL_Curve_sint16_5_sint16_5 34.0 RB_PT_PCT_SWC_DWC_CompuMethods_ratio_0p001__2 -2. 32. FORMAT "%10.5"
 /begin ANNOTATION ANNOTATION_LABEL "Description (coming from AUTOSAR DESC field)" /begin ANNOTATION_TEXT "Lower limit lookup\r\n" /end ANNOTATION_TEXT /end ANNOTATION
 /begin AXIS_DESCR STD_AXIS NO_INPUT_QUANTITY RB_PT_PCT_SWC_DWC_CompuMethods_ratio_0p001__2 5 -2. 32. FORMAT "%10.5" DEPOSIT ABSOLUTE /end AXIS_DESCR
/end CHARACTERISTIC
/begin CHARACTERISTIC DWC_CALIB.DWC_K1DeviceControl.DWC_ValveClean.DWC_PRESSUREOVERHEADMAX "" CURVE 0x8060E97E RB_PT_PCT_SWC_DWC_RecordLayouts_RL_Curve_sint16_5_sint16_5 34.0 RB_PT_PCT_SWC_DWC_CompuMethods_ratio_0p001__2 -2. 32. FORMAT "%10.5"
 /begin ANNOTATION ANNOTATION_LABEL "Description (coming from AUTOSAR DESC field)" /begin ANNOTATION_TEXT "Lower limit lookup\r\n" /end ANNOTATION_TEXT /end ANNOTATION
 /begin AXIS_DESCR STD_AXIS NO_INPUT_QUANTITY RB_PT_PCT_SWC_DWC_CompuMethods_ratio_0p001__2 5 -2. 32. FORMAT "%10.5" DEPOSIT ABSOLUTE /end AXIS_DESCR
/end CHARACTERISTIC
/begin CHARACTERISTIC DWC_CALIB.DWC_K1DeviceControl.DWC_ValveClean.DWC_PRESSUREOVERHEADMIN "" CURVE 0x8060E994 RB_PT_PCT_SWC_DWC_RecordLayouts_RL_Curve_sint16_5_sint16_5 34.0 RB_PT_PCT_SWC_DWC_CompuMethods_ratio_0p001__2 -2. 32. FORMAT "%10.5"
 /begin ANNOTATION ANNOTATION_LABEL "Description (coming from AUTOSAR DESC field)" /begin ANNOTATION_TEXT "Lower limit lookup\r\n" /end ANNOTATION_TEXT /end ANNOTATION
 /begin AXIS_DESCR STD_AXIS NO_INPUT_QUANTITY RB_PT_PCT_SWC_DWC_CompuMethods_ratio_0p001__2 5 -2. 32. FORMAT "%10.5" DEPOSIT ABSOLUTE /end AXIS_DESCR
/end CHARACTERISTIC
/begin CHARACTERISTIC DWC_CALIB.DWC_K1DeviceControl.DWC_ValveClean.DWC_TF_FCTROPENCLEANCURRENT "" CURVE 0x8060E9AA RB_PT_PCT_SWC_DWC_RecordLayouts_RL_Curve_uint16_11_uint16_11 1.0 RB_PT_PCT_SWC_DWC_CompuMethods_Ratio_0p001 0.0 1. FORMAT "%10.5"
 /begin ANNOTATION ANNOTATION_LABEL "Description (coming from AUTOSAR DESC field)" /begin ANNOTATION_TEXT "Depressure fctr\r\n" /end ANNOTATION_TEXT /end ANNOTATION
 /begin AXIS_DESCR STD_AXIS NO_INPUT_QUANTITY RB_PT_PCT_SWC_DWC_CompuMethods_DST_Time 11 0.0 655.35 FORMAT "%10.5" DEPOSIT ABSOLUTE /end AXIS_DESCR
/end CHARACTERISTIC
/begin CHARACTERISTIC DWC_CALIB.DWC_K1DeviceControl.DWC_ValveClean.DWC_TF_FCTRROUTINECLEANCURRENT "" CURVE 0x8060E9D8 RB_PT_PCT_SWC_DWC_RecordLayouts_RL_Curve_uint16_11_uint16_11 1.0 RB_PT_PCT_SWC_DWC_CompuMethods_Ratio_0p001 0.0 1. FORMAT "%10.5"
 /begin ANNOTATION ANNOTATION_LABEL "Description (coming from AUTOSAR DESC field)" /begin ANNOTATION_TEXT "Depressure fctr\r\n" /end ANNOTATION_TEXT /end ANNOTATION
 /begin AXIS_DESCR STD_AXIS NO_INPUT_QUANTITY RB_PT_PCT_SWC_DWC_CompuMethods_DST_Time 11 0.0 655.35 FORMAT "%10.5" DEPOSIT ABSOLUTE /end AXIS_DESCR
/end CHARACTERISTIC
/begin CHARACTERISTIC DWC_CALIB.DWC_K1DeviceControl.DWC_ValveClean.DWC_TIMEROUTINECLEAN "" VALUE 0x8060E940 DefaultValueRecordLayout_AUTOSAR_Platform_BaseTypes_uint16 65.535 RB_PT_PCT_SWC_DWC_CompuMethods_ratio_0p001__2 0.0 65.535 FORMAT "%10.5"
 /begin ANNOTATION ANNOTATION_LABEL "Description (coming from AUTOSAR DESC field)" /begin ANNOTATION_TEXT "Maximum time before valve clean timeout\r\n" /end ANNOTATION_TEXT /end ANNOTATION
/end CHARACTERISTIC
/begin CHARACTERISTIC DWC_CALIB.DWC_K1DeviceControl.DWC_ValveClean.DWC_TIMEVALVECLEANHALFCYCLE "" VALUE 0x8060E951 DefaultValueRecordLayout_AUTOSAR_Platform_BaseTypes_uint8 1.275 RB_PT_PCT_SWC_DWC_CompuMethods_ratio_0p005 0.0 1.275 FORMAT "%10.5"
 /begin ANNOTATION ANNOTATION_LABEL "Description (coming from AUTOSAR DESC field)" /begin ANNOTATION_TEXT "Half period of valve cycle\r\n" /end ANNOTATION_TEXT /end ANNOTATION
/end CHARACTERISTIC
/begin CHARACTERISTIC DWC_CALIB.DWC_K1DeviceControl.DWC_ValveClean.DWC_TIMEVALVECLOSEDCLEAN "" VALUE 0x8060E942 DefaultValueRecordLayout_AUTOSAR_Platform_BaseTypes_uint16 65.535 RB_PT_PCT_SWC_DWC_CompuMethods_ratio_0p001__2 0.0 65.535 FORMAT "%10.5"
 /begin ANNOTATION ANNOTATION_LABEL "Description (coming from AUTOSAR DESC field)" /begin ANNOTATION_TEXT "Maximum time before valve clean timeout\r\n" /end ANNOTATION_TEXT /end ANNOTATION
/end CHARACTERISTIC
/begin CHARACTERISTIC DWC_CALIB.DWC_K1DeviceControl.DWC_ValveClean.DWC_TIMEVALVECLOSEDCLEANRESET "" VALUE 0x8060E934 DefaultValueRecordLayout_AUTOSAR_Platform_BaseTypes_uint32 4294967.295 RB_PT_PCT_SWC_DWC_CompuMethods_ratio_0p001__2 0.0 4294967.295 FORMAT "%10.5"
 /begin ANNOTATION ANNOTATION_LABEL "Description (coming from AUTOSAR DESC field)" /begin ANNOTATION_TEXT "Maximum time before valve rinse timeout\r\n" /end ANNOTATION_TEXT /end ANNOTATION
/end CHARACTERISTIC
/begin CHARACTERISTIC DWC_CALIB.DWC_K1DeviceControl.DWC_ValveClean.DWC_TIMEVALVEOPENCLEAN "" VALUE 0x8060E944 DefaultValueRecordLayout_AUTOSAR_Platform_BaseTypes_uint16 65.535 RB_PT_PCT_SWC_DWC_CompuMethods_ratio_0p001__2 0.0 65.535 FORMAT "%10.5"
 /begin ANNOTATION ANNOTATION_LABEL "Description (coming from AUTOSAR DESC field)" /begin ANNOTATION_TEXT "Maximum time before valve clean timeout\r\n" /end ANNOTATION_TEXT /end ANNOTATION
/end CHARACTERISTIC
/begin CHARACTERISTIC DWC_CALIB.DWC_K1DeviceControl.DWC_ValveClean.DWC_TIMEVALVEOPENCLEANRESET "" VALUE 0x8060E938 DefaultValueRecordLayout_AUTOSAR_Platform_BaseTypes_uint32 4294967.295 RB_PT_PCT_SWC_DWC_CompuMethods_ratio_0p001__2 0.0 4294967.295 FORMAT "%10.5"
 /begin ANNOTATION ANNOTATION_LABEL "Description (coming from AUTOSAR DESC field)" /begin ANNOTATION_TEXT "Maximum time before valve rinse timeout\r\n" /end ANNOTATION_TEXT /end ANNOTATION
/end CHARACTERISTIC
/begin CHARACTERISTIC DWC_CALIB.DWC_K1DeviceControl.DWC_ValveClean.DWC_TIMEVALVEPRECLOSEDCLEAN "" VALUE 0x8060E946 DefaultValueRecordLayout_AUTOSAR_Platform_BaseTypes_uint16 65.535 RB_PT_PCT_SWC_DWC_CompuMethods_ratio_0p001__2 0.0 65.535 FORMAT "%10.5"
 /begin ANNOTATION ANNOTATION_LABEL "Description (coming from AUTOSAR DESC field)" /begin ANNOTATION_TEXT "Maximum time before valve clean timeout\r\n" /end ANNOTATION_TEXT /end ANNOTATION
/end CHARACTERISTIC
/begin CHARACTERISTIC DWC_CALIB.DWC_K1DeviceControl.DWC_ValveClean.DWC_TIMEVALVEPREOPENCLEAN "" VALUE 0x8060E948 DefaultValueRecordLayout_AUTOSAR_Platform_BaseTypes_uint16 65.535 RB_PT_PCT_SWC_DWC_CompuMethods_ratio_0p001__2 0.0 65.535 FORMAT "%10.5"
 /begin ANNOTATION ANNOTATION_LABEL "Description (coming from AUTOSAR DESC field)" /begin ANNOTATION_TEXT "Maximum time before valve clean timeout\r\n" /end ANNOTATION_TEXT /end ANNOTATION
/end CHARACTERISTIC
/begin CHARACTERISTIC DWC_CALIB.DWC_K1DeviceControl.DWC_ValveClean.DWC_TIMEVALVEPRERINSE "" VALUE 0x8060E94A DefaultValueRecordLayout_AUTOSAR_Platform_BaseTypes_uint16 65.535 RB_PT_PCT_SWC_DWC_CompuMethods_ratio_0p001__2 0.0 65.535 FORMAT "%10.5"
 /begin ANNOTATION ANNOTATION_LABEL "Description (coming from AUTOSAR DESC field)" /begin ANNOTATION_TEXT "Maximum time before valve clean timeout\r\n" /end ANNOTATION_TEXT /end ANNOTATION
/end CHARACTERISTIC
/begin CHARACTERISTIC DWC_CALIB.DWC_K1DeviceControl.DWC_ValveClean.DWC_TIMEVALVERINSE "" VALUE 0x8060E94C DefaultValueRecordLayout_AUTOSAR_Platform_BaseTypes_uint16 65.535 RB_PT_PCT_SWC_DWC_CompuMethods_ratio_0p001__2 0.0 65.535 FORMAT "%10.5"
 /begin ANNOTATION ANNOTATION_LABEL "Description (coming from AUTOSAR DESC field)" /begin ANNOTATION_TEXT "Maximum time before valve clean timeout\r\n" /end ANNOTATION_TEXT /end ANNOTATION
/end CHARACTERISTIC
/begin CHARACTERISTIC DWC_CALIB.DWC_K1DeviceControl.DWC_ValveClean.DWC_TIMEVALVERINSERESET "" VALUE 0x8060E93C DefaultValueRecordLayout_AUTOSAR_Platform_BaseTypes_uint32 4294967.295 RB_PT_PCT_SWC_DWC_CompuMethods_ratio_0p001__2 0.0 4294967.295 FORMAT "%10.5"
 /begin ANNOTATION ANNOTATION_LABEL "Description (coming from AUTOSAR DESC field)" /begin ANNOTATION_TEXT "Maximum time before valve rinse timeout\r\n" /end ANNOTATION_TEXT /end ANNOTATION
/end CHARACTERISTIC
/begin CHARACTERISTIC DWC_CALIB.DWC_K2DeviceControl.DWC_BOBFLGRQBLIPGAC "" VALUE 0x8060ECB0 DefaultValueRecordLayout_AUTOSAR_Platform_BaseTypes_boolean 255.0 AUTOSAR_Platform_CompuMethods_boolean 0.0 255. FORMAT "%10.5"
 /begin ANNOTATION ANNOTATION_LABEL "Description (coming from AUTOSAR DESC field)" /begin ANNOTATION_TEXT "GAC Clutch blip request\r\n" /end ANNOTATION_TEXT /end ANNOTATION
/end CHARACTERISTIC
/begin CHARACTERISTIC DWC_CALIB.DWC_K2DeviceControl.DWC_BOBGACBLIPENABRQ "" VALUE 0x8060ECB1 DefaultValueRecordLayout_AUTOSAR_Platform_BaseTypes_boolean 255.0 AUTOSAR_Platform_CompuMethods_boolean 0.0 255. FORMAT "%10.5"
 /begin ANNOTATION ANNOTATION_LABEL "Description (coming from AUTOSAR DESC field)" /begin ANNOTATION_TEXT "GAC clutch blip BOB enable.\r\n" /end ANNOTATION_TEXT /end ANNOTATION
/end CHARACTERISTIC
/begin CHARACTERISTIC DWC_CALIB.DWC_K2DeviceControl.DWC_BypassPreparePulse.DWC_BYPASSPULSEPROFILE "" CURVE 0x8060ECDC RB_PT_PCT_SWC_DWC_RecordLayouts_RL_Curve_uint8_11_uint16_11 1.0 RB_PT_PCT_SWC_DWC_CompuMethods_ratio_0p01 0.0 1. FORMAT "%10.5"
 /begin ANNOTATION ANNOTATION_LABEL "Description (coming from AUTOSAR DESC field)"
  /begin ANNOTATION_TEXT "Remap bypass pulse time remaining into a profile shape.\r\n" /end ANNOTATION_TEXT
 /end ANNOTATION
 /begin AXIS_DESCR STD_AXIS NO_INPUT_QUANTITY RB_PT_PCT_SWC_DWC_CompuMethods_ratio_0p001__2 11 0.0 1. FORMAT "%10.5" DEPOSIT ABSOLUTE /end AXIS_DESCR
/end CHARACTERISTIC
/begin CHARACTERISTIC DWC_CALIB.DWC_K2DeviceControl.DWC_BypassPreparePulse.DWC_BYPASSREINITCYCLES "" VALUE 0x8060ECD6 DefaultValueRecordLayout_AUTOSAR_Platform_BaseTypes_uint8 6.0 RB_PT_PCT_SWC_DWC_CompuMethods_ident 0.0 6. FORMAT "%10.5"
 /begin ANNOTATION ANNOTATION_LABEL "Description (coming from AUTOSAR DESC field)" /begin ANNOTATION_TEXT "How many cycles the bypass pulse should reinit for.\r\n" /end ANNOTATION_TEXT /end ANNOTATION
/end CHARACTERISTIC
/begin CHARACTERISTIC DWC_CALIB.DWC_K2DeviceControl.DWC_BypassPreparePulse.DWC_ENGINERUNTIMEFACTOR2D "" MAP 0x8060ED00 RB_PT_PCT_SWC_DWC_RecordLayouts_RL_Map_uint16_40_uint16_5_uint16_8 2.0 RB_PT_PCT_SWC_DWC_CompuMethods_ratio_0p001__2 0.0 2. FORMAT "%10.5"
 /begin ANNOTATION ANNOTATION_LABEL "Description (coming from AUTOSAR DESC field)"
  /begin ANNOTATION_TEXT "factor applied to increase fill time wrt time engine off and engine running to compensate for balance chamber volume.\r\n" /end ANNOTATION_TEXT
 /end ANNOTATION
 /begin AXIS_DESCR STD_AXIS NO_INPUT_QUANTITY RB_PT_PCT_SWC_DWC_CompuMethods_ratio_0p05 5 0.0 3276.75 FORMAT "%10.5" DEPOSIT ABSOLUTE /end AXIS_DESCR
 /begin AXIS_DESCR STD_AXIS NO_INPUT_QUANTITY RB_PT_PCT_SWC_DWC_CompuMethods_ratio_0p1 8 0.0 6553.5 FORMAT "%10.5" DEPOSIT ABSOLUTE /end AXIS_DESCR
/end CHARACTERISTIC
/begin CHARACTERISTIC DWC_CALIB.DWC_K2DeviceControl.DWC_BypassPreparePulse.DWC_FILLADAPTMAX "" VALUE 0x8060ECCA DefaultValueRecordLayout_AUTOSAR_Platform_BaseTypes_uint16 2.0 RB_PT_PCT_SWC_DWC_CompuMethods_ratio_0p001__2 0.0 2. FORMAT "%10.5"
 /begin ANNOTATION ANNOTATION_LABEL "Description (coming from AUTOSAR DESC field)" /begin ANNOTATION_TEXT "Max value fill adapt value\r\n" /end ANNOTATION_TEXT /end ANNOTATION
/end CHARACTERISTIC
/begin CHARACTERISTIC DWC_CALIB.DWC_K2DeviceControl.DWC_BypassPreparePulse.DWC_FILLADAPTMIN "" VALUE 0x8060ECCC DefaultValueRecordLayout_AUTOSAR_Platform_BaseTypes_uint16 2.0 RB_PT_PCT_SWC_DWC_CompuMethods_ratio_0p001__2 0.0 2. FORMAT "%10.5"
 /begin ANNOTATION ANNOTATION_LABEL "Description (coming from AUTOSAR DESC field)" /begin ANNOTATION_TEXT "Min value fill adapt value\r\n" /end ANNOTATION_TEXT /end ANNOTATION
/end CHARACTERISTIC
/begin CHARACTERISTIC DWC_CALIB.DWC_K2DeviceControl.DWC_BypassPreparePulse.DWC_FLGCLEARMAXFILLOVERSHTENGOFF "" VALUE 0x8060ECD7 DefaultValueRecordLayout_AUTOSAR_Platform_BaseTypes_uint8 255.0 DefaultIdenticalCompu 0.0 255. FORMAT "%10.5"
 /begin ANNOTATION ANNOTATION_LABEL "Description (coming from AUTOSAR DESC field)" /begin ANNOTATION_TEXT "Reset DWC_FillMaxOvershoot when engine is off.\r\n" /end ANNOTATION_TEXT /end ANNOTATION
/end CHARACTERISTIC
/begin CHARACTERISTIC DWC_CALIB.DWC_K2DeviceControl.DWC_BypassPreparePulse.DWC_FLGENABLEBYPASSPROFILE "" VALUE 0x8060ECD8 DefaultValueRecordLayout_AUTOSAR_Platform_BaseTypes_boolean 255.0 AUTOSAR_Platform_CompuMethods_boolean 0.0 255. FORMAT "%10.5"
 /begin ANNOTATION ANNOTATION_LABEL "Description (coming from AUTOSAR DESC field)"
  /begin ANNOTATION_TEXT "Flag to enable the bypass pulse profile to be modified.\r\n" /end ANNOTATION_TEXT
 /end ANNOTATION
/end CHARACTERISTIC
/begin CHARACTERISTIC DWC_CALIB.DWC_K2DeviceControl.DWC_BypassPreparePulse.DWC_FLGENABLEBYPASSREINITLOOP "" VALUE 0x8060ECD9 DefaultValueRecordLayout_AUTOSAR_Platform_BaseTypes_boolean 255.0 AUTOSAR_Platform_CompuMethods_boolean 0.0 255. FORMAT "%10.5"
 /begin ANNOTATION ANNOTATION_LABEL "Description (coming from AUTOSAR DESC field)" /begin ANNOTATION_TEXT "Flag to reinit the bypass pulse more than once.\r\n" /end ANNOTATION_TEXT /end ANNOTATION
/end CHARACTERISTIC
/begin CHARACTERISTIC DWC_CALIB.DWC_K2DeviceControl.DWC_BypassPreparePulse.DWC_MAXFILLSPD4FILLADAPT "" VALUE 0x8060ECCE DefaultValueRecordLayout_AUTOSAR_Platform_BaseTypes_uint16 20000.0 RB_PT_PCT_SWC_DWC_CompuMethods_ident 0.0 20000. FORMAT "%10.5"
 /begin ANNOTATION ANNOTATION_LABEL "Description (coming from AUTOSAR DESC field)" /begin ANNOTATION_TEXT "Max fill engine speed to enable a fill adapt.\r\n" /end ANNOTATION_TEXT /end ANNOTATION
/end CHARACTERISTIC
/begin CHARACTERISTIC DWC_CALIB.DWC_K2DeviceControl.DWC_BypassPreparePulse.DWC_MAXFILLTRQ4FILLADAPT "" VALUE 0x8060ECD0 DefaultValueRecordLayout_AUTOSAR_Platform_BaseTypes_sint16 4000.0 RB_PT_PCT_SWC_DWC_CompuMethods_ratio_0p1 -2000. 2000. FORMAT "%10.5"
 /begin ANNOTATION ANNOTATION_LABEL "Description (coming from AUTOSAR DESC field)" /begin ANNOTATION_TEXT "Max fill torque to enable a fill adapt.\r\n" /end ANNOTATION_TEXT /end ANNOTATION
/end CHARACTERISTIC
/begin CHARACTERISTIC DWC_CALIB.DWC_K2DeviceControl.DWC_BypassPreparePulse.DWC_MINPRESS2FFCOMPLETE "" VALUE 0x8060ECD2 DefaultValueRecordLayout_AUTOSAR_Platform_BaseTypes_sint16 34.0 RB_PT_PCT_SWC_DWC_CompuMethods_ratio_0p001__2 -2. 32. FORMAT "%10.5"
 /begin ANNOTATION ANNOTATION_LABEL "Description (coming from AUTOSAR DESC field)"
  /begin ANNOTATION_TEXT "min pressure to disable first fill flag with engine running.\r\n" /end ANNOTATION_TEXT
 /end ANNOTATION
/end CHARACTERISTIC
/begin CHARACTERISTIC DWC_CALIB.DWC_K2DeviceControl.DWC_BypassPreparePulse.DWC_MINTEMP4FILLADAPT "" VALUE 0x8060ECD4 DefaultValueRecordLayout_AUTOSAR_Platform_BaseTypes_sint16 250.0 RB_PT_PCT_SWC_DWC_CompuMethods_ident -50. 200. FORMAT "%10.5"
 /begin ANNOTATION ANNOTATION_LABEL "Description (coming from AUTOSAR DESC field)" /begin ANNOTATION_TEXT "min transoiltemp to allow filladaption\r\n" /end ANNOTATION_TEXT /end ANNOTATION
/end CHARACTERISTIC
/begin CHARACTERISTIC DWC_CALIB.DWC_K2DeviceControl.DWC_BypassPreparePulse.DWC_PULSEPRESSTEMPOFFSET "" CURVE 0x8060ED6E RB_PT_PCT_SWC_DWC_RecordLayouts_RL_Curve_sint8_4_sint16_4 2.0 RB_PT_PCT_SWC_DWC_CompuMethods_ratio_0p01 -1. 1. FORMAT "%10.5"
 /begin ANNOTATION ANNOTATION_LABEL "Description (coming from AUTOSAR DESC field)"
  /begin ANNOTATION_TEXT "Temperature related offset to be applied to pulse pressure.\r\n" /end ANNOTATION_TEXT
 /end ANNOTATION
 /begin AXIS_DESCR STD_AXIS NO_INPUT_QUANTITY RB_PT_PCT_SWC_DWC_CompuMethods_ident 4 -50. 200. FORMAT "%10.5" DEPOSIT ABSOLUTE /end AXIS_DESCR
/end CHARACTERISTIC
/begin CHARACTERISTIC DWC_CALIB.DWC_K2DeviceControl.DWC_BypassPreparePulse.DWC_RESETTIMEOFFPRESSHIGH "" VALUE 0x8060ECDA DefaultValueRecordLayout_AUTOSAR_Platform_BaseTypes_boolean 255.0 AUTOSAR_Platform_CompuMethods_boolean 0.0 255. FORMAT "%10.5" /end CHARACTERISTIC
/begin CHARACTERISTIC DWC_CALIB.DWC_K2DeviceControl.DWC_ClosedPressureDiag.DWC_ENABLEHYSTERESISFORDITHER "" VALUE 0x8060ED7C DefaultValueRecordLayout_AUTOSAR_Platform_BaseTypes_boolean 255.0 AUTOSAR_Platform_CompuMethods_boolean 0.0 255. FORMAT "%10.5"
 /begin ANNOTATION ANNOTATION_LABEL "Description (coming from AUTOSAR DESC field)"
  /begin ANNOTATION_TEXT "Use hysteresis when enabling dither in a pressure error scenario.\r\n" /end ANNOTATION_TEXT
 /end ANNOTATION
/end CHARACTERISTIC
/begin CHARACTERISTIC DWC_CALIB.DWC_K2DeviceControl.DWC_CLUBLIPABORTSPEED "" VALUE 0x8060EC94 DefaultValueRecordLayout_AUTOSAR_Platform_BaseTypes_sint16 40000.0 RB_PT_PCT_SWC_DWC_CompuMethods_ident -20000. 20000. FORMAT "%10.5"
 /begin ANNOTATION ANNOTATION_LABEL "Description (coming from AUTOSAR DESC field)" /begin ANNOTATION_TEXT "Input speed at which to abort blip.\r\n" /end ANNOTATION_TEXT /end ANNOTATION
/end CHARACTERISTIC
/begin CHARACTERISTIC DWC_CALIB.DWC_K2DeviceControl.DWC_CLUBLIPSPDMONTYPE "" VALUE 0x8060ECB2 DefaultValueRecordLayout_AUTOSAR_Platform_BaseTypes_uint8 2.0 RB_PT_PCT_SWC_DWC_CompuMethods_ident 0.0 2. FORMAT "%10.5"
 /begin ANNOTATION ANNOTATION_LABEL "Description (coming from AUTOSAR DESC field)"
  /begin ANNOTATION_TEXT "Speed monitoring type, 0 = OFF, 1 = Abort above input speed, 2 = wait at KP until speed seen.\r\n" /end ANNOTATION_TEXT
 /end ANNOTATION
/end CHARACTERISTIC
/begin CHARACTERISTIC DWC_CALIB.DWC_K2DeviceControl.DWC_CLUBLIPTIMEOUT "" VALUE 0x8060EC96 DefaultValueRecordLayout_AUTOSAR_Platform_BaseTypes_uint16 1.0 RB_PT_PCT_SWC_DWC_CompuMethods_ratio_0p001__2 0.0 1. FORMAT "%10.5"
 /begin ANNOTATION ANNOTATION_LABEL "Description (coming from AUTOSAR DESC field)" /begin ANNOTATION_TEXT "Timeout for clutch blip.\r\n" /end ANNOTATION_TEXT /end ANNOTATION
/end CHARACTERISTIC
/begin CHARACTERISTIC DWC_CALIB.DWC_K2DeviceControl.DWC_CLUBLIPTMFACTPROF "" CURVE 0x8060EFE0 RB_PT_PCT_SWC_DWC_RecordLayouts_RL_Curve_uint8_11_uint8_11 1.0 RB_PT_PCT_SWC_DWC_CompuMethods_ratio_0p01 0.0 1. FORMAT "%10.5"
 /begin ANNOTATION ANNOTATION_LABEL "Description (coming from AUTOSAR DESC field)" /begin ANNOTATION_TEXT "Clutch blip profile based on time factor.\r\n" /end ANNOTATION_TEXT /end ANNOTATION
 /begin AXIS_DESCR STD_AXIS NO_INPUT_QUANTITY RB_PT_PCT_SWC_DWC_CompuMethods_ratio_0p01 11 0.0 1. FORMAT "%10.5" DEPOSIT ABSOLUTE /end AXIS_DESCR
/end CHARACTERISTIC
/begin CHARACTERISTIC DWC_CALIB.DWC_K2DeviceControl.DWC_Clutch "" VALUE 0x8060ECB3 DefaultValueRecordLayout_AUTOSAR_Platform_BaseTypes_uint8 2.0 RB_PT_PCT_SWC_DWC_CompuMethods_ident 0.0 2. FORMAT "%10.5"
 /begin ANNOTATION ANNOTATION_LABEL "Description (coming from AUTOSAR DESC field)"
  /begin ANNOTATION_TEXT "Indication of which clutch is assigned to device controller dataset.\r\n" /end ANNOTATION_TEXT
 /end ANNOTATION
/end CHARACTERISTIC
/begin CHARACTERISTIC DWC_CALIB.DWC_K2DeviceControl.DWC_CLUTCHBLIPHIGHPRESS "" VALUE 0x8060EC98 DefaultValueRecordLayout_AUTOSAR_Platform_BaseTypes_sint16 34.0 RB_PT_PCT_SWC_DWC_CompuMethods_ratio_0p001__2 -2. 32. FORMAT "%10.5"
 /begin ANNOTATION ANNOTATION_LABEL "Description (coming from AUTOSAR DESC field)"
  /begin ANNOTATION_TEXT "Pressure threshold for potential torque transfer during gear engagements.\r\n" /end ANNOTATION_TEXT
 /end ANNOTATION
/end CHARACTERISTIC
/begin CHARACTERISTIC DWC_CALIB.DWC_K2DeviceControl.DWC_CLUTCHBLIPTIME "" CURVE 0x8060EFF8 RB_PT_PCT_SWC_DWC_RecordLayouts_RL_Curve_uint8_4_sint16_4 1.0 RB_PT_PCT_SWC_DWC_CompuMethods_ratio_0p01 0.0 1. FORMAT "%10.5"
 /begin ANNOTATION ANNOTATION_LABEL "Description (coming from AUTOSAR DESC field)" /begin ANNOTATION_TEXT "Time for clutch blip\r\n" /end ANNOTATION_TEXT /end ANNOTATION
 /begin AXIS_DESCR STD_AXIS NO_INPUT_QUANTITY RB_PT_PCT_SWC_DWC_CompuMethods_ident 4 -50. 200. FORMAT "%10.5" DEPOSIT ABSOLUTE /end AXIS_DESCR
/end CHARACTERISTIC
/begin CHARACTERISTIC DWC_CALIB.DWC_K2DeviceControl.DWC_ENABLEFAIL37GEARSTATUS "" VALUE 0x8060ECB4 DefaultValueRecordLayout_AUTOSAR_Platform_BaseTypes_uint8 255.0 DefaultIdenticalCompu 0.0 255. FORMAT "%10.5"
 /begin ANNOTATION ANNOTATION_LABEL "Description (coming from AUTOSAR DESC field)"
  /begin ANNOTATION_TEXT "flag to enable failing of bank of gears for 37 gear status\r\n" /end ANNOTATION_TEXT
 /end ANNOTATION
/end CHARACTERISTIC
/begin CHARACTERISTIC DWC_CALIB.DWC_K2DeviceControl.DWC_ENABLEFAILEDSTATUSFORUSERABORT "" VALUE 0x8060ECB5 DefaultValueRecordLayout_AUTOSAR_Platform_BaseTypes_boolean 255.0 AUTOSAR_Platform_CompuMethods_boolean 0.0 255. FORMAT "%10.5"
 /begin ANNOTATION ANNOTATION_LABEL "Description (coming from AUTOSAR DESC field)"
  /begin ANNOTATION_TEXT "Allow the reported status to say 'failed' if the user aborts a routine.\r\n" /end ANNOTATION_TEXT
 /end ANNOTATION
/end CHARACTERISTIC
/begin CHARACTERISTIC DWC_CALIB.DWC_K2DeviceControl.DWC_ENABLESELFTESTDIAGNOSTIC "" VALUE 0x8060ECB6 DefaultValueRecordLayout_AUTOSAR_Platform_BaseTypes_boolean 255.0 AUTOSAR_Platform_CompuMethods_boolean 0.0 255. FORMAT "%10.5"
 /begin ANNOTATION ANNOTATION_LABEL "Description (coming from AUTOSAR DESC field)"
  /begin ANNOTATION_TEXT "Flag to enable diagnostics when in self test and no routine running.\r\n" /end ANNOTATION_TEXT
 /end ANNOTATION
/end CHARACTERISTIC
/end MODULE
/end PROJECT
