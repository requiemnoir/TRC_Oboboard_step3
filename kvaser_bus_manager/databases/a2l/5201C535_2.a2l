ASAP2_VERSION 1 60
/begin PROJECT LB74x_TCU "5201C535"
/begin HEADER "" VERSION "5201C535" PROJECT_NO LB74x_TCU /end HEADER
/begin MODULE DIM ""
/begin MOD_COMMON "" BYTE_ORDER MSB_LAST ALIGNMENT_BYTE 1 ALIGNMENT_WORD 2 ALIGNMENT_LONG 4 ALIGNMENT_INT64 4 ALIGNMENT_FLOAT32_IEEE 4 ALIGNMENT_FLOAT64_IEEE 4 DATA_SIZE 32 /end MOD_COMMON
/begin CHARACTERISTIC DWC_EFLASHB.DWC_K2DeviceControl.DWC_TrqPress.DWC_KisspointSequencer.DWC_KPFILLPULSETIME "" VALUE 0x8060A592 DefaultValueRecordLayout_AUTOSAR_Platform_BaseTypes_uint16 10.0 RB_PT_PCT_SWC_DWC_CompuMethods_ratio_0p001__2 0.0 10. FORMAT "%10.5"
 /begin ANNOTATION ANNOTATION_LABEL "Description (coming from AUTOSAR DESC field)"
  /begin ANNOTATION_TEXT "Time for which fill pulse is used to aid kisspoint learn speed\r\n" /end ANNOTATION_TEXT
 /end ANNOTATION
/end CHARACTERISTIC
/begin CHARACTERISTIC DWC_EFLASHB.DWC_K2DeviceControl.DWC_TrqPress.DWC_KisspointSequencer.DWC_KPInputGradient.DWC_IIRCOEFF "" VALUE 0x8060A5A3 DefaultValueRecordLayout_AUTOSAR_Platform_BaseTypes_uint8 1.0 RB_PT_PCT_SWC_DWC_CompuMethods_ratio_0p01 0.0 1. FORMAT "%10.5"
 /begin ANNOTATION ANNOTATION_LABEL "Description (coming from AUTOSAR DESC field)" /begin ANNOTATION_TEXT "Filter co-efficient\r\n" /end ANNOTATION_TEXT /end ANNOTATION
/end CHARACTERISTIC
/begin CHARACTERISTIC DWC_EFLASHB.DWC_K2DeviceControl.DWC_TrqPress.DWC_KisspointSequencer.DWC_KPLATACCHYSTADAPT "" VALUE 0x8060A59E DefaultValueRecordLayout_AUTOSAR_Platform_BaseTypes_uint8 1.27 RB_PT_PCT_SWC_DWC_CompuMethods_ratio_0p01 0.0 1.27 FORMAT "%10.5"
 /begin ANNOTATION ANNOTATION_LABEL "Description (coming from AUTOSAR DESC field)"
  /begin ANNOTATION_TEXT "Lateral acceleration limit above which kisspoint adaption is blocked\r\n" /end ANNOTATION_TEXT
 /end ANNOTATION
/end CHARACTERISTIC
/begin CHARACTERISTIC DWC_EFLASHB.DWC_K2DeviceControl.DWC_TrqPress.DWC_KisspointSequencer.DWC_KPLATACCMAXADAPT "" VALUE 0x8060A59F DefaultValueRecordLayout_AUTOSAR_Platform_BaseTypes_uint8 1.27 RB_PT_PCT_SWC_DWC_CompuMethods_ratio_0p01 0.0 1.27 FORMAT "%10.5"
 /begin ANNOTATION ANNOTATION_LABEL "Description (coming from AUTOSAR DESC field)"
  /begin ANNOTATION_TEXT "Lateral acceleration limit above which kisspoint adaption is blocked\r\n" /end ANNOTATION_TEXT
 /end ANNOTATION
/end CHARACTERISTIC
/begin CHARACTERISTIC DWC_EFLASHB.DWC_K2DeviceControl.DWC_TrqPress.DWC_KisspointSequencer.DWC_KPOFFSETFIRSTSTEP "" VALUE 0x8060A594 DefaultValueRecordLayout_AUTOSAR_Platform_BaseTypes_sint16 64.0 RB_PT_PCT_SWC_DWC_CompuMethods_ratio_0p001__2 -32. 32. FORMAT "%10.5"
 /begin ANNOTATION ANNOTATION_LABEL "Description (coming from AUTOSAR DESC field)"
  /begin ANNOTATION_TEXT "Demand position (lower than kisspoint) for first step in kisspoint approach\r\n" /end ANNOTATION_TEXT
 /end ANNOTATION
/end CHARACTERISTIC
/begin CHARACTERISTIC DWC_EFLASHB.DWC_K2DeviceControl.DWC_TrqPress.DWC_KisspointSequencer.DWC_KPSTABLEPRESSURETIME "" VALUE 0x8060A596 DefaultValueRecordLayout_AUTOSAR_Platform_BaseTypes_uint16 10.0 RB_PT_PCT_SWC_DWC_CompuMethods_ratio_0p001__2 0.0 10. FORMAT "%10.5"
 /begin ANNOTATION ANNOTATION_LABEL "Description (coming from AUTOSAR DESC field)"
  /begin ANNOTATION_TEXT "Time to achieve stable pressure on clutch during loading clutch state\r\n" /end ANNOTATION_TEXT
 /end ANNOTATION
/end CHARACTERISTIC
/begin CHARACTERISTIC DWC_EFLASHB.DWC_K2DeviceControl.DWC_TrqPress.DWC_KisspointSequencer.DWC_KPSTATICLEARNMIN "" VALUE 0x8060A5A0 DefaultValueRecordLayout_AUTOSAR_Platform_BaseTypes_uint8 255.0 RB_PT_PCT_SWC_DWC_CompuMethods_ident 0.0 255. FORMAT "%10.5"
 /begin ANNOTATION ANNOTATION_LABEL "Description (coming from AUTOSAR DESC field)"
  /begin ANNOTATION_TEXT "Minimum number of static learns to perform when OBD request is made\r\n" /end ANNOTATION_TEXT
 /end ANNOTATION
/end CHARACTERISTIC
/begin CHARACTERISTIC DWC_EFLASHB.DWC_K2DeviceControl.DWC_TrqPress.DWC_KisspointSequencer.DWC_KPSTATICSTABLECOMPLETE "" VALUE 0x8060A5A1 DefaultValueRecordLayout_AUTOSAR_Platform_BaseTypes_uint8 255.0 RB_PT_PCT_SWC_DWC_CompuMethods_ident 0.0 255. FORMAT "%10.5"
 /begin ANNOTATION ANNOTATION_LABEL "Description (coming from AUTOSAR DESC field)"
  /begin ANNOTATION_TEXT "Number of static learns with no change before completion\r\n" /end ANNOTATION_TEXT
 /end ANNOTATION
/end CHARACTERISTIC
/begin CHARACTERISTIC DWC_EFLASHB.DWC_K2DeviceControl.DWC_TrqPress.DWC_KisspointSequencer.DWC_KPSTATLOCKFASTTIME "" VALUE 0x8060A598 DefaultValueRecordLayout_AUTOSAR_Platform_BaseTypes_uint16 10.0 RB_PT_PCT_SWC_DWC_CompuMethods_ratio_0p001__2 0.0 10. FORMAT "%10.5"
 /begin ANNOTATION ANNOTATION_LABEL "Description (coming from AUTOSAR DESC field)" /begin ANNOTATION_TEXT "Time considered to be too fast for kisspoint\r\n" /end ANNOTATION_TEXT /end ANNOTATION
/end CHARACTERISTIC
/begin CHARACTERISTIC DWC_EFLASHB.DWC_K2DeviceControl.DWC_TrqPress.DWC_KisspointSequencer.DWC_KPSTATLOCKSLOWTIME "" VALUE 0x8060A59A DefaultValueRecordLayout_AUTOSAR_Platform_BaseTypes_uint16 10.0 RB_PT_PCT_SWC_DWC_CompuMethods_ratio_0p001__2 0.0 10. FORMAT "%10.5"
 /begin ANNOTATION ANNOTATION_LABEL "Description (coming from AUTOSAR DESC field)" /begin ANNOTATION_TEXT "Time considered too slow to be kisspoint\r\n" /end ANNOTATION_TEXT /end ANNOTATION
/end CHARACTERISTIC
/begin CHARACTERISTIC DWC_EFLASHB.DWC_K2DeviceControl.DWC_TrqPress.DWC_KisspointSequencer.DWC_KPSTATLOCKUPDETECTSLIP "" VALUE 0x8060A59C DefaultValueRecordLayout_AUTOSAR_Platform_BaseTypes_uint16 20000.0 RB_PT_PCT_SWC_DWC_CompuMethods_ident 0.0 20000. FORMAT "%10.5"
 /begin ANNOTATION ANNOTATION_LABEL "Description (coming from AUTOSAR DESC field)" /begin ANNOTATION_TEXT "Slip for detecting clutch lock up\r\n" /end ANNOTATION_TEXT /end ANNOTATION
/end CHARACTERISTIC
/begin CHARACTERISTIC DWC_EFLASHB.DWC_K2DeviceControl.DWC_TrqPress.DWC_KisspointSequencer.DXC_BLOCKINTERNALSCHEDULER "" VALUE 0x8060A5A2 DefaultValueRecordLayout_AUTOSAR_Platform_BaseTypes_boolean 255.0 AUTOSAR_Platform_CompuMethods_boolean 0.0 255. FORMAT "%10.5"
 /begin ANNOTATION ANNOTATION_LABEL "Description (coming from AUTOSAR DESC field)"
  /begin ANNOTATION_TEXT "Flag to cause internal scheduler to be blocked from requesting learns\r\n" /end ANNOTATION_TEXT
 /end ANNOTATION
/end CHARACTERISTIC
/begin CHARACTERISTIC DWC_EFLASHB.DWC_K2DeviceControl.DWC_TrqPress.DWC_TIDEMARKTORQUEHYST "" VALUE 0x8060A510 DefaultValueRecordLayout_AUTOSAR_Platform_BaseTypes_uint16 2000.0 RB_PT_PCT_SWC_DWC_CompuMethods_ratio_0p1 0.0 2000. FORMAT "%10.5"
 /begin ANNOTATION ANNOTATION_LABEL "Description (coming from AUTOSAR DESC field)"
  /begin ANNOTATION_TEXT "Tidemark hysterisis - size of bootstrap on falling demand\r\n" /end ANNOTATION_TEXT
 /end ANNOTATION
/end CHARACTERISTIC
/begin CHARACTERISTIC DWC_EFLASHB.DWC_K2DeviceControl.DWC_TrqPress.DWC_TIDEMARKTORQUEPROXIMITY "" VALUE 0x8060A512 DefaultValueRecordLayout_AUTOSAR_Platform_BaseTypes_uint16 2000.0 RB_PT_PCT_SWC_DWC_CompuMethods_ratio_0p1 0.0 2000. FORMAT "%10.5"
 /begin ANNOTATION ANNOTATION_LABEL "Description (coming from AUTOSAR DESC field)"
  /begin ANNOTATION_TEXT "Tidemark proximity to allow adaption - torque demand needs to be within this margin of tidemark to allow adaption\r\n" /end ANNOTATION_TEXT
 /end ANNOTATION
/end CHARACTERISTIC
/begin CHARACTERISTIC DWC_EFLASHB.DWC_K2DeviceControl.DWC_TrqPress.DWC_TPADAPTVSCORRECTPOSITION "" MAP 0x8060A5BC RB_PT_PCT_SWC_DWC_RecordLayouts_RL_Map_sint16_15_sint16_5_sint16_3 6.4 RB_PT_PCT_SWC_DWC_CompuMethods_ratio_0p0001 -3.2 3.2 FORMAT "%10.5"
 /begin ANNOTATION ANNOTATION_LABEL "Description (coming from AUTOSAR DESC field)"
  /begin ANNOTATION_TEXT "Correction to make based on adaption request, and position in range between two points\r\n" /end ANNOTATION_TEXT
 /end ANNOTATION
 /begin AXIS_DESCR STD_AXIS NO_INPUT_QUANTITY RB_PT_PCT_SWC_DWC_CompuMethods_ratio_0p1 5 -2000. 2000. FORMAT "%10.5" DEPOSIT ABSOLUTE /end AXIS_DESCR
 /begin AXIS_DESCR STD_AXIS NO_INPUT_QUANTITY RB_PT_PCT_SWC_DWC_CompuMethods_ratio_0p001__2 3 0.0 1. FORMAT "%10.5" DEPOSIT ABSOLUTE /end AXIS_DESCR
/end CHARACTERISTIC
/begin CHARACTERISTIC DWC_EFLASHB.DWC_K2DeviceControl.DWC_TrqPress.DXC_TORQUEPOINTADAPTSCHED "" VAL_BLK 0x8060A480 DefaultValueRecordLayout_AUTOSAR_Platform_BaseTypes_uint16 1.0 RB_PT_PCT_SWC_DWC_CompuMethods_ratio_0p001__2 0.0 1. FORMAT "%10.5"
 /begin ANNOTATION ANNOTATION_LABEL "Description (coming from AUTOSAR DESC field)" /begin ANNOTATION_TEXT "Adaption factor for each point from microslip\r\n" /end ANNOTATION_TEXT /end ANNOTATION
 MATRIX_DIM 8 1 1 /end CHARACTERISTIC
/begin CHARACTERISTIC DWC_EFLASHB.DWC_K2DeviceControl.DWC_TrqPress.DXC_TORQUEPOINTRULES "" VAL_BLK 0x8060A490 DefaultValueRecordLayout_AUTOSAR_Platform_BaseTypes_sint16 64.0 RB_PT_PCT_SWC_DWC_CompuMethods_ratio_0p001__2 -32. 32. FORMAT "%10.5"
 /begin ANNOTATION ANNOTATION_LABEL "Description (coming from AUTOSAR DESC field)"
  /begin ANNOTATION_TEXT "Rules for torque points. X = torque point, y1=max, y2=min,y3=default,y4=max wrt lower, y5=min wrt lower, y6=max wrt upper, y7=min wrt upper\r\n" /end ANNOTATION_TEXT
 /end ANNOTATION
 MATRIX_DIM 8 4 1 /end CHARACTERISTIC
/begin CHARACTERISTIC DWC_EFLASHB.DWC_K2DeviceControl.DWC_TrqPress.DXC_TORQUEPOINTS "" VAL_BLK 0x8060A4D0 DefaultValueRecordLayout_AUTOSAR_Platform_BaseTypes_sint16 4000.0 RB_PT_PCT_SWC_DWC_CompuMethods_ratio_0p1 -2000. 2000. FORMAT "%10.5"
 /begin ANNOTATION ANNOTATION_LABEL "Description (coming from AUTOSAR DESC field)"
  /begin ANNOTATION_TEXT "Torque data for individual points in the clutch characteristic. MINIMUM +5Nm BETWEEN POINTS!!!!\r\n" /end ANNOTATION_TEXT
 /end ANNOTATION
 MATRIX_DIM 8 1 1 /end CHARACTERISTIC
/begin CHARACTERISTIC DWC_EFLASHB.DWC_K2DeviceControl.DWC_TrqPress.DXC_TORQUEPOINTSDEFAULT "" VAL_BLK 0x8060A4E0 DefaultValueRecordLayout_AUTOSAR_Platform_BaseTypes_sint16 64.0 RB_PT_PCT_SWC_DWC_CompuMethods_ratio_0p001__2 -32. 32. FORMAT "%10.5"
 /begin ANNOTATION ANNOTATION_LABEL "Description (coming from AUTOSAR DESC field)"
  /begin ANNOTATION_TEXT "Maximum limit of pressure/position for each torque point\r\n" /end ANNOTATION_TEXT
 /end ANNOTATION
 MATRIX_DIM 8 1 1 /end CHARACTERISTIC
/begin CHARACTERISTIC DWC_EFLASHB.DWC_K2DeviceControl.DWC_TrqPress.DXC_TORQUEPOINTSMAX "" VAL_BLK 0x8060A4F0 DefaultValueRecordLayout_AUTOSAR_Platform_BaseTypes_sint16 64.0 RB_PT_PCT_SWC_DWC_CompuMethods_ratio_0p001__2 -32. 32. FORMAT "%10.5"
 /begin ANNOTATION ANNOTATION_LABEL "Description (coming from AUTOSAR DESC field)"
  /begin ANNOTATION_TEXT "Maximum limit of pressure/position for each torque point\r\n" /end ANNOTATION_TEXT
 /end ANNOTATION
 MATRIX_DIM 8 1 1 /end CHARACTERISTIC
/begin CHARACTERISTIC DWC_EFLASHB.DWC_K2DeviceControl.DWC_TrqPress.DXC_TORQUEPOINTSMIN "" VAL_BLK 0x8060A500 DefaultValueRecordLayout_AUTOSAR_Platform_BaseTypes_sint16 64.0 RB_PT_PCT_SWC_DWC_CompuMethods_ratio_0p001__2 -32. 32. FORMAT "%10.5"
 /begin ANNOTATION ANNOTATION_LABEL "Description (coming from AUTOSAR DESC field)"
  /begin ANNOTATION_TEXT "Maximum limit of pressure/position for each torque point\r\n" /end ANNOTATION_TEXT
 /end ANNOTATION
 MATRIX_DIM 8 1 1 /end CHARACTERISTIC
/begin CHARACTERISTIC DWC_EFLASHB.DWC_K2DeviceControl.DWC_VOLUMEPULSEBYPASSTYPE "" VALUE 0x8060A01E DefaultValueRecordLayout_AUTOSAR_Platform_BaseTypes_uint8 2.0 RB_PT_PCT_SWC_DWC_CompuMethods_ident 0.0 2. FORMAT "%10.5"
 /begin ANNOTATION ANNOTATION_LABEL "Description (coming from AUTOSAR DESC field)"
  /begin ANNOTATION_TEXT "Request for volume bypass - 0 = none, 1 = max(pdemand,pbypass), 2 = sum(pdemand, pbypass)\r\n" /end ANNOTATION_TEXT
 /end ANNOTATION
/end CHARACTERISTIC
/begin CHARACTERISTIC DWC_EFLASHB.DWC_K2DeviceControl.DWC_ZEROPRESSKPADAPT "" VALUE 0x8060A01F DefaultValueRecordLayout_AUTOSAR_Platform_BaseTypes_boolean 255.0 AUTOSAR_Platform_CompuMethods_boolean 0.0 255. FORMAT "%10.5"
 /begin ANNOTATION ANNOTATION_LABEL "Description (coming from AUTOSAR DESC field)"
  /begin ANNOTATION_TEXT "Flag requesting zero pressure on clutch during non-active part of KP adaptation\r\n" /end ANNOTATION_TEXT
 /end ANNOTATION
/end CHARACTERISTIC
/begin CHARACTERISTIC DWC_EFLASHB.DWC_K2DeviceControl.DWC_ZEROPRESSTIMEOUT "" VALUE 0x8060A012 DefaultValueRecordLayout_AUTOSAR_Platform_BaseTypes_uint16 327.675 RB_PT_PCT_SWC_DWC_CompuMethods_ratio_0p005 0.0 327.675 FORMAT "%10.5"
 /begin ANNOTATION ANNOTATION_LABEL "Description (coming from AUTOSAR DESC field)"
  /begin ANNOTATION_TEXT "Timeout between zero pressure events (0.0 = don't use)\r\n" /end ANNOTATION_TEXT
 /end ANNOTATION
/end CHARACTERISTIC
/begin CHARACTERISTIC DWC_EFLASHB.DWC_K2DeviceControl.DWC_ZeroPressureMonostable.DWC_DELAYTIME "" VALUE 0x8060A5EE DefaultValueRecordLayout_AUTOSAR_Platform_BaseTypes_uint16 10.0 RB_PT_PCT_SWC_DWC_CompuMethods_ratio_0p001__2 0.0 10. FORMAT "%10.5"
 /begin ANNOTATION ANNOTATION_LABEL "Description (coming from AUTOSAR DESC field)" /begin ANNOTATION_TEXT "Event delay time\r\n" /end ANNOTATION_TEXT /end ANNOTATION
/end CHARACTERISTIC
/begin CHARACTERISTIC DWC_EFLASHB.DWC_K2DeviceControl.DWC_ZEROPRESSURETIMEVSTEMP "" CURVE 0x8060A630 RB_PT_PCT_SWC_DWC_RecordLayouts_RL_Curve_uint16_3_sint16_3 10.0 RB_PT_PCT_SWC_DWC_CompuMethods_ratio_0p001__2 0.0 10. FORMAT "%10.5"
 /begin ANNOTATION ANNOTATION_LABEL "Description (coming from AUTOSAR DESC field)"
  /begin ANNOTATION_TEXT "Time for zero pressure on clutch against oil temperature\r\n" /end ANNOTATION_TEXT
 /end ANNOTATION
 /begin AXIS_DESCR STD_AXIS NO_INPUT_QUANTITY RB_PT_PCT_SWC_DWC_CompuMethods_ident 3 -50. 200. FORMAT "%10.5" DEPOSIT ABSOLUTE /end AXIS_DESCR
/end CHARACTERISTIC
/begin CHARACTERISTIC DWC_EFLASHB.DWC_K2StateMachine.DWC_ENABLEBYPASSPREPAREASG "" VALUE 0x8060A644 DefaultValueRecordLayout_AUTOSAR_Platform_BaseTypes_boolean 255.0 AUTOSAR_Platform_CompuMethods_boolean 0.0 255. FORMAT "%10.5"
 /begin ANNOTATION ANNOTATION_LABEL "Description (coming from AUTOSAR DESC field)" /begin ANNOTATION_TEXT "Flag to enable bypass of prepare on ASG shifts\r\n" /end ANNOTATION_TEXT /end ANNOTATION
/end CHARACTERISTIC
/begin CHARACTERISTIC DWC_EFLASHB.DWC_K2StateMachine.DWC_SPEEDPHASEMAXTIME "" VALUE 0x8060A640 DefaultValueRecordLayout_AUTOSAR_Platform_BaseTypes_uint16 10.0 RB_PT_PCT_SWC_DWC_CompuMethods_ratio_0p001__2 0.0 10. FORMAT "%10.5"
 /begin ANNOTATION ANNOTATION_LABEL "Description (coming from AUTOSAR DESC field)" /begin ANNOTATION_TEXT "Maximum time for speed phase\r\n" /end ANNOTATION_TEXT /end ANNOTATION
/end CHARACTERISTIC
/begin CHARACTERISTIC DWC_EFLASHB.DWC_K2StateMachine.DWC_Timer.DWC_TIMERDT "" VALUE 0x8060A646 DefaultValueRecordLayout_AUTOSAR_Platform_BaseTypes_uint16 10.0 RB_PT_PCT_SWC_DWC_CompuMethods_ratio_0p001__2 0.0 10. FORMAT "%10.5"
 /begin ANNOTATION ANNOTATION_LABEL "Description (coming from AUTOSAR DESC field)"
  /begin ANNOTATION_TEXT "Count down rate of timer (call rate of timed out task)\r\n" /end ANNOTATION_TEXT
 /end ANNOTATION
/end CHARACTERISTIC
/begin CHARACTERISTIC DWC_EFLASHB.DWC_K2StateMachine.DWC_TORQUEPHASEMAXTIME "" VALUE 0x8060A642 DefaultValueRecordLayout_AUTOSAR_Platform_BaseTypes_uint16 10.0 RB_PT_PCT_SWC_DWC_CompuMethods_ratio_0p001__2 0.0 10. FORMAT "%10.5"
 /begin ANNOTATION ANNOTATION_LABEL "Description (coming from AUTOSAR DESC field)" /begin ANNOTATION_TEXT "Maximum time for torque phase\r\n" /end ANNOTATION_TEXT /end ANNOTATION
/end CHARACTERISTIC
/begin CHARACTERISTIC DWC_EFLASHB.DWC_L2MINSPEEDDBLCLUTCH "" VALUE 0x806097F6 DefaultValueRecordLayout_AUTOSAR_Platform_BaseTypes_uint16 20000.0 RB_PT_PCT_SWC_DWC_CompuMethods_ident 0.0 20000. FORMAT "%10.5"
 /begin ANNOTATION ANNOTATION_LABEL "Description (coming from AUTOSAR DESC field)" /begin ANNOTATION_TEXT "Miniumum speed for clutch oscillation warning\r\n" /end ANNOTATION_TEXT /end ANNOTATION
/end CHARACTERISTIC
/begin CHARACTERISTIC DWC_EFLASHB.DWC_L2OUTLETTEMPERATUREMAX "" VALUE 0x806097F8 DefaultValueRecordLayout_AUTOSAR_Platform_BaseTypes_uint16 499.0 RB_PT_PCT_SWC_DWC_CompuMethods_ratio_0p01 1. 500. FORMAT "%10.5"
 /begin ANNOTATION ANNOTATION_LABEL "Description (coming from AUTOSAR DESC field)" /begin ANNOTATION_TEXT "L2 Outlet temperature to abort double clutch engage\r\n" /end ANNOTATION_TEXT /end ANNOTATION
/end CHARACTERISTIC
/begin CHARACTERISTIC DWC_EFLASHB.DWC_L2PLATETEMPERATUREMAX "" VALUE 0x806097FA DefaultValueRecordLayout_AUTOSAR_Platform_BaseTypes_uint16 499.0 RB_PT_PCT_SWC_DWC_CompuMethods_ratio_0p01 1. 500. FORMAT "%10.5"
 /begin ANNOTATION ANNOTATION_LABEL "Description (coming from AUTOSAR DESC field)" /begin ANNOTATION_TEXT "L2 plate temperature to abort double clutch engage\r\n" /end ANNOTATION_TEXT /end ANNOTATION
/end CHARACTERISTIC
/begin CHARACTERISTIC DWC_EFLASHB.DWC_MASKENABLECLEAN "" VALUE 0x806097E8 DefaultValueRecordLayout_AUTOSAR_Platform_BaseTypes_uint32 4.294967295E9 RB_PT_PCT_SWC_DWC_CompuMethods_ident 0.0 4.294967295E9 FORMAT "%10.5"
 /begin ANNOTATION ANNOTATION_LABEL "Description (coming from AUTOSAR DESC field)" /begin ANNOTATION_TEXT "Mask to enable cutch blip.\r\n" /end ANNOTATION_TEXT /end ANNOTATION
/end CHARACTERISTIC
/begin CHARACTERISTIC DWC_EFLASHB.DWC_MAXCLUTCHCOOLINGTEMPERATURE "" VALUE 0x806097FC DefaultValueRecordLayout_AUTOSAR_Platform_BaseTypes_uint16 199.0 RB_PT_PCT_SWC_DWC_CompuMethods_ratio_0p01 1. 200. FORMAT "%10.5"
 /begin ANNOTATION ANNOTATION_LABEL "Description (coming from AUTOSAR DESC field)"
  /begin ANNOTATION_TEXT "Maximum clutch sump temperature, above which no gear is allowed.\r\n" /end ANNOTATION_TEXT
 /end ANNOTATION
/end CHARACTERISTIC
/begin CHARACTERISTIC DWC_EFLASHB.DWC_MAXCLUTCHOSCILLATEWARNTIME "" VALUE 0x806097FE DefaultValueRecordLayout_AUTOSAR_Platform_BaseTypes_uint16 14.5 RB_PT_PCT_SWC_DWC_CompuMethods_time_0p005 0.0 14.5 FORMAT "%10.5"
 /begin ANNOTATION ANNOTATION_LABEL "Description (coming from AUTOSAR DESC field)"
  /begin ANNOTATION_TEXT "Maximum time for clutch oscillation warn time before clutch overheat is flagged anyway\r\n" /end ANNOTATION_TEXT
 /end ANNOTATION
/end CHARACTERISTIC
/begin CHARACTERISTIC DWC_EFLASHB.DWC_MAXCLUTCHSUMPTEMPERATURE "" VALUE 0x80609800 DefaultValueRecordLayout_AUTOSAR_Platform_BaseTypes_uint16 199.0 RB_PT_PCT_SWC_DWC_CompuMethods_ratio_0p01 1. 200. FORMAT "%10.5"
 /begin ANNOTATION ANNOTATION_LABEL "Description (coming from AUTOSAR DESC field)"
  /begin ANNOTATION_TEXT "Maximum clutch sump temperature, above which no gear is allowed.\r\n" /end ANNOTATION_TEXT
 /end ANNOTATION
/end CHARACTERISTIC
/begin CHARACTERISTIC DWC_EFLASHB.DWC_MAXENGINETORQUEOILOVERTEMP "" VALUE 0x80609802 DefaultValueRecordLayout_AUTOSAR_Platform_BaseTypes_uint16 2000.0 RB_PT_PCT_SWC_DWC_CompuMethods_ratio_0p1 0.0 2000. FORMAT "%10.5"
 /begin ANNOTATION ANNOTATION_LABEL "Description (coming from AUTOSAR DESC field)"
  /begin ANNOTATION_TEXT "Maximum limp home engine toruqe to allow when the gearbox lubrication oil temperature is over the limit\r\n" /end ANNOTATION_TEXT
 /end ANNOTATION
/end CHARACTERISTIC
/begin CHARACTERISTIC DWC_EFLASHB.DWC_MAXENGINETORQUEOUTLETOILENGFALL "" MAP 0x8060E3FA RB_PT_PCT_SWC_DWC_RecordLayouts_RL_Map_uint16_60_uint16_6_uint16_10 2000.0 RB_PT_PCT_SWC_DWC_CompuMethods_ratio_0p1 0.0 2000. FORMAT "%10.5"
 /begin ANNOTATION ANNOTATION_LABEL "Description (coming from AUTOSAR DESC field)" /begin ANNOTATION_TEXT "Max torque falling in launch\r\n" /end ANNOTATION_TEXT /end ANNOTATION
 /begin AXIS_DESCR STD_AXIS NO_INPUT_QUANTITY RB_PT_PCT_SWC_DWC_CompuMethods_ratio_0p01 6 0.0 100. FORMAT "%10.5" DEPOSIT ABSOLUTE /end AXIS_DESCR
 /begin AXIS_DESCR STD_AXIS NO_INPUT_QUANTITY RB_PT_PCT_SWC_DWC_CompuMethods_ident 10 0.0 20000. FORMAT "%10.5" DEPOSIT ABSOLUTE /end AXIS_DESCR
/end CHARACTERISTIC
/begin CHARACTERISTIC DWC_EFLASHB.DWC_MAXENGINETORQUEOUTLETOILENGFALLSHIFTING "" MAP 0x8060E496 RB_PT_PCT_SWC_DWC_RecordLayouts_RL_Map_uint16_60_uint16_6_uint16_10 2000.0 RB_PT_PCT_SWC_DWC_CompuMethods_ratio_0p1 0.0 2000. FORMAT "%10.5"
 /begin ANNOTATION ANNOTATION_LABEL "Description (coming from AUTOSAR DESC field)" /begin ANNOTATION_TEXT "Max torque falling outside of launch\r\n" /end ANNOTATION_TEXT /end ANNOTATION
 /begin AXIS_DESCR STD_AXIS NO_INPUT_QUANTITY RB_PT_PCT_SWC_DWC_CompuMethods_ratio_0p01 6 0.0 100. FORMAT "%10.5" DEPOSIT ABSOLUTE /end AXIS_DESCR
 /begin AXIS_DESCR STD_AXIS NO_INPUT_QUANTITY RB_PT_PCT_SWC_DWC_CompuMethods_ident 10 0.0 20000. FORMAT "%10.5" DEPOSIT ABSOLUTE /end AXIS_DESCR
/end CHARACTERISTIC
/begin CHARACTERISTIC DWC_EFLASHB.DWC_MAXENGINETORQUEOUTLETOILENGRISE "" MAP 0x8060E532 RB_PT_PCT_SWC_DWC_RecordLayouts_RL_Map_uint16_60_uint16_6_uint16_10 2000.0 RB_PT_PCT_SWC_DWC_CompuMethods_ratio_0p1 0.0 2000. FORMAT "%10.5"
 /begin ANNOTATION ANNOTATION_LABEL "Description (coming from AUTOSAR DESC field)" /begin ANNOTATION_TEXT "Max torque rising in launch\r\n" /end ANNOTATION_TEXT /end ANNOTATION
 /begin AXIS_DESCR STD_AXIS NO_INPUT_QUANTITY RB_PT_PCT_SWC_DWC_CompuMethods_ratio_0p01 6 0.0 100. FORMAT "%10.5" DEPOSIT ABSOLUTE /end AXIS_DESCR
 /begin AXIS_DESCR STD_AXIS NO_INPUT_QUANTITY RB_PT_PCT_SWC_DWC_CompuMethods_ident 10 0.0 20000. FORMAT "%10.5" DEPOSIT ABSOLUTE /end AXIS_DESCR
/end CHARACTERISTIC
/begin CHARACTERISTIC DWC_EFLASHB.DWC_MAXENGINETORQUEOUTLETOILENGRISESHIFTING "" MAP 0x8060E5CE RB_PT_PCT_SWC_DWC_RecordLayouts_RL_Map_uint16_60_uint16_6_uint16_10 2000.0 RB_PT_PCT_SWC_DWC_CompuMethods_ratio_0p1 0.0 2000. FORMAT "%10.5"
 /begin ANNOTATION ANNOTATION_LABEL "Description (coming from AUTOSAR DESC field)" /begin ANNOTATION_TEXT "Max torque rising outside of launch.\r\n" /end ANNOTATION_TEXT /end ANNOTATION
 /begin AXIS_DESCR STD_AXIS NO_INPUT_QUANTITY RB_PT_PCT_SWC_DWC_CompuMethods_ratio_0p01 6 0.0 100. FORMAT "%10.5" DEPOSIT ABSOLUTE /end AXIS_DESCR
 /begin AXIS_DESCR STD_AXIS NO_INPUT_QUANTITY RB_PT_PCT_SWC_DWC_CompuMethods_ident 10 0.0 20000. FORMAT "%10.5" DEPOSIT ABSOLUTE /end AXIS_DESCR
/end CHARACTERISTIC
/begin CHARACTERISTIC DWC_EFLASHB.DWC_MAXENGTRQRATLIMDECCLUTCHOIL "" VALUE 0x80609804 DefaultValueRecordLayout_AUTOSAR_Platform_BaseTypes_uint16 2000.0 RB_PT_PCT_SWC_DWC_CompuMethods_ratio_0p1 0.0 2000. FORMAT "%10.5"
 /begin ANNOTATION ANNOTATION_LABEL "Description (coming from AUTOSAR DESC field)"
  /begin ANNOTATION_TEXT "Rate limit of engine torque max demand for clutch oil interventions - decrease\r\n" /end ANNOTATION_TEXT
 /end ANNOTATION
/end CHARACTERISTIC
/begin CHARACTERISTIC DWC_EFLASHB.DWC_MAXENGTRQRATLIMDECGEAROIL "" VALUE 0x80609806 DefaultValueRecordLayout_AUTOSAR_Platform_BaseTypes_uint16 2000.0 RB_PT_PCT_SWC_DWC_CompuMethods_ratio_0p1 0.0 2000. FORMAT "%10.5"
 /begin ANNOTATION ANNOTATION_LABEL "Description (coming from AUTOSAR DESC field)"
  /begin ANNOTATION_TEXT "Rate limit of engine torque max demand for gear oil interventions - decrease\r\n" /end ANNOTATION_TEXT
 /end ANNOTATION
/end CHARACTERISTIC
/begin CHARACTERISTIC DWC_EFLASHB.DWC_MAXENGTRQRATLIMDECMODEL "" VALUE 0x80609808 DefaultValueRecordLayout_AUTOSAR_Platform_BaseTypes_uint16 2000.0 RB_PT_PCT_SWC_DWC_CompuMethods_ratio_0p1 0.0 2000. FORMAT "%10.5"
 /begin ANNOTATION ANNOTATION_LABEL "Description (coming from AUTOSAR DESC field)"
  /begin ANNOTATION_TEXT "Rate limit of engine torque max demand for thermal model interventions - decrease\r\n" /end ANNOTATION_TEXT
 /end ANNOTATION
/end CHARACTERISTIC
/begin CHARACTERISTIC DWC_EFLASHB.DWC_MAXENGTRQRATLIMINCCLUTCHOIL "" VALUE 0x8060980A DefaultValueRecordLayout_AUTOSAR_Platform_BaseTypes_uint16 2000.0 RB_PT_PCT_SWC_DWC_CompuMethods_ratio_0p1 0.0 2000. FORMAT "%10.5"
 /begin ANNOTATION ANNOTATION_LABEL "Description (coming from AUTOSAR DESC field)"
  /begin ANNOTATION_TEXT "Rate limit of engine torque max demand for clutch oil interventions - increase\r\n" /end ANNOTATION_TEXT
 /end ANNOTATION
/end CHARACTERISTIC
/begin CHARACTERISTIC DWC_EFLASHB.DWC_MAXENGTRQRATLIMINCDEFAULT "" VALUE 0x8060980C DefaultValueRecordLayout_AUTOSAR_Platform_BaseTypes_uint16 2000.0 RB_PT_PCT_SWC_DWC_CompuMethods_ratio_0p1 0.0 2000. FORMAT "%10.5"
 /begin ANNOTATION ANNOTATION_LABEL "Description (coming from AUTOSAR DESC field)"
  /begin ANNOTATION_TEXT "Default rate limit of engine torque max demand - increase\r\n" /end ANNOTATION_TEXT
 /end ANNOTATION
/end CHARACTERISTIC
/begin CHARACTERISTIC DWC_EFLASHB.DWC_MAXENGTRQRATLIMINCMODEL "" VALUE 0x8060980E DefaultValueRecordLayout_AUTOSAR_Platform_BaseTypes_uint16 2000.0 RB_PT_PCT_SWC_DWC_CompuMethods_ratio_0p1 0.0 2000. FORMAT "%10.5"
 /begin ANNOTATION ANNOTATION_LABEL "Description (coming from AUTOSAR DESC field)"
  /begin ANNOTATION_TEXT "Rate limit of engine torque max demand for thermal model interventions - increase\r\n" /end ANNOTATION_TEXT
 /end ANNOTATION
/end CHARACTERISTIC
/begin CHARACTERISTIC DWC_EFLASHB.DWC_MAXGEAROILTEMPLOWER "" VALUE 0x80609810 DefaultValueRecordLayout_AUTOSAR_Platform_BaseTypes_uint16 399.0 RB_PT_PCT_SWC_DWC_CompuMethods_ratio_0p01 1. 400. FORMAT "%10.5"
 /begin ANNOTATION ANNOTATION_LABEL "Description (coming from AUTOSAR DESC field)"
  /begin ANNOTATION_TEXT "Maximum gear oil temperature above which a maximum time at this temperature is allowed\r\n" /end ANNOTATION_TEXT
 /end ANNOTATION
/end CHARACTERISTIC
/begin CHARACTERISTIC DWC_EFLASHB.DWC_MAXGEAROILTEMPUPPER "" VALUE 0x80609812 DefaultValueRecordLayout_AUTOSAR_Platform_BaseTypes_uint16 399.0 RB_PT_PCT_SWC_DWC_CompuMethods_ratio_0p01 1. 400. FORMAT "%10.5"
 /begin ANNOTATION ANNOTATION_LABEL "Description (coming from AUTOSAR DESC field)"
  /begin ANNOTATION_TEXT "Maximum gear oil temperature above which a maximum time at this temperature is allowed\r\n" /end ANNOTATION_TEXT
 /end ANNOTATION
/end CHARACTERISTIC
/begin CHARACTERISTIC DWC_EFLASHB.DWC_MAXOUTLETTEMPERATURE "" VALUE 0x80609814 DefaultValueRecordLayout_AUTOSAR_Platform_BaseTypes_uint16 399.0 RB_PT_PCT_SWC_DWC_CompuMethods_ratio_0p01 1. 400. FORMAT "%10.5"
 /begin ANNOTATION ANNOTATION_LABEL "Description (coming from AUTOSAR DESC field)"
  /begin ANNOTATION_TEXT "Maximum outlet temperature, above which no gear on that clutch is allowed.\r\n" /end ANNOTATION_TEXT
 /end ANNOTATION
/end CHARACTERISTIC
/begin CHARACTERISTIC DWC_EFLASHB.DWC_MAXOUTLETTEMPERATURESHIFTING "" VALUE 0x80609816 DefaultValueRecordLayout_AUTOSAR_Platform_BaseTypes_uint16 399.0 RB_PT_PCT_SWC_DWC_CompuMethods_ratio_0p01 1. 400. FORMAT "%10.5"
 /begin ANNOTATION ANNOTATION_LABEL "Description (coming from AUTOSAR DESC field)"
  /begin ANNOTATION_TEXT "Maximum outlet temperature, above which no gear on that clutch is allowed OUTSIDE OF LAUNCH\r\n" /end ANNOTATION_TEXT
 /end ANNOTATION
/end CHARACTERISTIC
/begin CHARACTERISTIC DWC_EFLASHB.DWC_MAXSEPERATORTEMPERATURE "" VALUE 0x80609818 DefaultValueRecordLayout_AUTOSAR_Platform_BaseTypes_uint16 499.0 RB_PT_PCT_SWC_DWC_CompuMethods_ratio_0p01 1. 500. FORMAT "%10.5"
 /begin ANNOTATION ANNOTATION_LABEL "Description (coming from AUTOSAR DESC field)"
  /begin ANNOTATION_TEXT "Maximum seperator plate temperature, above which no gear on that clutch is allowed.\r\n" /end ANNOTATION_TEXT
 /end ANNOTATION
/end CHARACTERISTIC
/begin CHARACTERISTIC DWC_EFLASHB.DWC_MAXSEPERATORTEMPERATURESHIFTING "" VALUE 0x8060981A DefaultValueRecordLayout_AUTOSAR_Platform_BaseTypes_uint16 499.0 RB_PT_PCT_SWC_DWC_CompuMethods_ratio_0p01 1. 500. FORMAT "%10.5"
 /begin ANNOTATION ANNOTATION_LABEL "Description (coming from AUTOSAR DESC field)"
  /begin ANNOTATION_TEXT "Maximum seperator plate temperature outside of launch\r\n" /end ANNOTATION_TEXT
 /end ANNOTATION
/end CHARACTERISTIC
/begin CHARACTERISTIC DWC_EFLASHB.DWC_MINIUMUMOVERHEATTIME "" VALUE 0x8060981C DefaultValueRecordLayout_AUTOSAR_Platform_BaseTypes_uint16 10.0 RB_PT_PCT_SWC_DWC_CompuMethods_time_0p005 0.0 10. FORMAT "%10.5"
 /begin ANNOTATION ANNOTATION_LABEL "Description (coming from AUTOSAR DESC field)"
  /begin ANNOTATION_TEXT "Minimum time for a clutch to be declared as overeheated\r\n" /end ANNOTATION_TEXT
 /end ANNOTATION
/end CHARACTERISTIC
/begin CHARACTERISTIC DWC_EFLASHB.DWC_MINSPEEDFOROSCILLATEWARN "" VALUE 0x8060981E DefaultValueRecordLayout_AUTOSAR_Platform_BaseTypes_uint16 20000.0 RB_PT_PCT_SWC_DWC_CompuMethods_ident 0.0 20000. FORMAT "%10.5"
 /begin ANNOTATION ANNOTATION_LABEL "Description (coming from AUTOSAR DESC field)" /begin ANNOTATION_TEXT "Miniumum speed for clutch oscillation warning\r\n" /end ANNOTATION_TEXT /end ANNOTATION
/end CHARACTERISTIC
/begin CHARACTERISTIC DWC_EFLASHB.DWC_NOFILLINAUTO "" VALUE 0x80609842 DefaultValueRecordLayout_AUTOSAR_Platform_BaseTypes_boolean 255.0 AUTOSAR_Platform_CompuMethods_boolean 0.0 255. FORMAT "%10.5"
 /begin ANNOTATION ANNOTATION_LABEL "Description (coming from AUTOSAR DESC field)"
  /begin ANNOTATION_TEXT "Remove clutch fill time from auto mode shift time data\r\n" /end ANNOTATION_TEXT
 /end ANNOTATION
/end CHARACTERISTIC
/begin CHARACTERISTIC DWC_EFLASHB.DWC_OUTLETOILDELTAFACTOR "" VALUE 0x80609820 DefaultValueRecordLayout_AUTOSAR_Platform_BaseTypes_uint16 50.0 RB_PT_PCT_SWC_DWC_CompuMethods_ratio_0p1 0.0 50. FORMAT "%10.5"
 /begin ANNOTATION ANNOTATION_LABEL "Description (coming from AUTOSAR DESC field)"
  /begin ANNOTATION_TEXT "Factor used to account for differing rates of change of the clutch modelled temperatures\r\n" /end ANNOTATION_TEXT
 /end ANNOTATION
/end CHARACTERISTIC
/begin CHARACTERISTIC DWC_EFLASHB.DWC_OUTLETTEMPERATUREREENABLE "" VALUE 0x80609822 DefaultValueRecordLayout_AUTOSAR_Platform_BaseTypes_uint16 499.0 RB_PT_PCT_SWC_DWC_CompuMethods_ratio_0p01 1. 500. FORMAT "%10.5"
 /begin ANNOTATION ANNOTATION_LABEL "Description (coming from AUTOSAR DESC field)"
  /begin ANNOTATION_TEXT "Outlet temperature for clutch use to be re-allowed after overheat\r\n" /end ANNOTATION_TEXT
 /end ANNOTATION
/end CHARACTERISTIC
/begin CHARACTERISTIC DWC_EFLASHB.DWC_OUTLETTEMPHIGHDEBOUNCETIME "" VALUE 0x80609843 DefaultValueRecordLayout_AUTOSAR_Platform_BaseTypes_uint8 1.275 RB_PT_PCT_SWC_DWC_CompuMethods_time_0p005 0.0 1.275 FORMAT "%10.5"
 /begin ANNOTATION ANNOTATION_LABEL "Description (coming from AUTOSAR DESC field)" /begin ANNOTATION_TEXT "Debounce time for outlet oil temperature\r\n" /end ANNOTATION_TEXT /end ANNOTATION
/end CHARACTERISTIC
/begin CHARACTERISTIC DWC_EFLASHB.DWC_ParasticTorqueLossFilter.DWC_FIRSTORDERLPCOEFF "" VALUE 0x8060A648 DefaultValueRecordLayout_AUTOSAR_Platform_BaseTypes_uint8 1.0 RB_PT_PCT_SWC_DWC_CompuMethods_ratio_0p01 0.0 1. FORMAT "%10.5"
 /begin ANNOTATION ANNOTATION_LABEL "Description (coming from AUTOSAR DESC field)" /begin ANNOTATION_TEXT "Coefficient for low pass IIR filter\r\n" /end ANNOTATION_TEXT /end ANNOTATION
/end CHARACTERISTIC
/begin CHARACTERISTIC DWC_EFLASHB.DWC_PRESSUREENABLECLEANROUTINE "" VALUE 0x80609824 DefaultValueRecordLayout_AUTOSAR_Platform_BaseTypes_sint16 105.0 RB_PT_PCT_SWC_DWC_CompuMethods_ratio_0p005 -5. 100. FORMAT "%10.5"
 /begin ANNOTATION ANNOTATION_LABEL "Description (coming from AUTOSAR DESC field)"
  /begin ANNOTATION_TEXT "Pressure offset from kisspoint, below which clutch is flagged as open (0.0 - use absolute parameter instead)\r\n" /end ANNOTATION_TEXT
 /end ANNOTATION
/end CHARACTERISTIC
/begin CHARACTERISTIC DWC_EFLASHB.DWC_PRESSUREENABLERINSE "" VALUE 0x80609826 DefaultValueRecordLayout_AUTOSAR_Platform_BaseTypes_sint16 105.0 RB_PT_PCT_SWC_DWC_CompuMethods_ratio_0p005 -5. 100. FORMAT "%10.5"
 /begin ANNOTATION ANNOTATION_LABEL "Description (coming from AUTOSAR DESC field)"
  /begin ANNOTATION_TEXT "Pressure offset from kisspoint, below which clutch is flagged as open (0.0 - use absolute parameter instead)\r\n" /end ANNOTATION_TEXT
 /end ANNOTATION
/end CHARACTERISTIC
/begin CHARACTERISTIC DWC_EFLASHB.DWC_PUMPVOLTAGEDEMAND "" VALUE 0x80609828 DefaultValueRecordLayout_AUTOSAR_Platform_BaseTypes_uint16 35.0 RB_PT_PCT_SWC_DWC_CompuMethods_ratio_0p001__2 0.0 35. FORMAT "%10.5"
 /begin ANNOTATION ANNOTATION_LABEL "Description (coming from AUTOSAR DESC field)" /begin ANNOTATION_TEXT "Voltage demand\r\n" /end ANNOTATION_TEXT /end ANNOTATION
/end CHARACTERISTIC
/begin CHARACTERISTIC DWC_EFLASHB.DWC_SEPERATORPLATETEMPERATUREREENABLE "" VALUE 0x8060982A DefaultValueRecordLayout_AUTOSAR_Platform_BaseTypes_uint16 499.0 RB_PT_PCT_SWC_DWC_CompuMethods_ratio_0p01 1. 500. FORMAT "%10.5"
 /begin ANNOTATION ANNOTATION_LABEL "Description (coming from AUTOSAR DESC field)"
  /begin ANNOTATION_TEXT "Seperator plate temperature for clutch use to be re-allowed after overheat\r\n" /end ANNOTATION_TEXT
 /end ANNOTATION
/end CHARACTERISTIC
/begin CHARACTERISTIC DWC_EFLASHB.DWC_SpeedPhaseControl.DWC_CylinderCutMonostable.DWC_DELAYTIME "" VALUE 0x8060A652 DefaultValueRecordLayout_AUTOSAR_Platform_BaseTypes_uint16 10.0 RB_PT_PCT_SWC_DWC_CompuMethods_ratio_0p001__2 0.0 10. FORMAT "%10.5"
 /begin ANNOTATION ANNOTATION_LABEL "Description (coming from AUTOSAR DESC field)" /begin ANNOTATION_TEXT "Event delay time\r\n" /end ANNOTATION_TEXT /end ANNOTATION
/end CHARACTERISTIC
/begin CHARACTERISTIC DWC_EFLASHB.DWC_SpeedPhaseControl.DWC_CYLINDERCUTRESETVSSPEED "" CURVE 0x8060B1F6 RB_PT_PCT_SWC_DWC_RecordLayouts_RL_Curve_uint16_2_uint16_2 10.0 RB_PT_PCT_SWC_DWC_CompuMethods_ratio_0p001__2 0.0 10. FORMAT "%10.5"
 /begin ANNOTATION ANNOTATION_LABEL "Description (coming from AUTOSAR DESC field)"
  /begin ANNOTATION_TEXT "Duration of post cylinder cut reset against engine speed\r\n" /end ANNOTATION_TEXT
 /end ANNOTATION
 /begin AXIS_DESCR STD_AXIS NO_INPUT_QUANTITY RB_PT_PCT_SWC_DWC_CompuMethods_ident 2 0.0 20000. FORMAT "%10.5" DEPOSIT ABSOLUTE /end AXIS_DESCR
/end CHARACTERISTIC
/begin CHARACTERISTIC DWC_EFLASHB.DWC_SpeedPhaseControl.DWC_CYLINDERCUTRESETVSSPEEDGT "" MAP 0x8060B200 RB_PT_PCT_SWC_DWC_RecordLayouts_RL_Map_uint16_28_uint16_7_sint8_4 10.0 RB_PT_PCT_SWC_DWC_CompuMethods_ratio_0p001__2 0.0 10. FORMAT "%10.5"
 /begin ANNOTATION ANNOTATION_LABEL "Description (coming from AUTOSAR DESC field)"
  /begin ANNOTATION_TEXT "Duration of post cylinder cut reset against engine speed for GT style shifts\r\n" /end ANNOTATION_TEXT
 /end ANNOTATION
 /begin AXIS_DESCR STD_AXIS NO_INPUT_QUANTITY RB_PT_PCT_SWC_DWC_CompuMethods_ident 7 0.0 20000. FORMAT "%10.5" DEPOSIT ABSOLUTE /end AXIS_DESCR
 /begin AXIS_DESCR STD_AXIS NO_INPUT_QUANTITY RB_PT_PCT_SWC_DWC_CompuMethods_ident 4 -100. 100. FORMAT "%10.5" DEPOSIT ABSOLUTE /end AXIS_DESCR
/end CHARACTERISTIC
/begin CHARACTERISTIC DWC_EFLASHB.DWC_SpeedPhaseControl.DWC_dOutputSpeedCalc.DWC_ROCCYCLES "" VALUE 0x8060B1F4 DefaultValueRecordLayout_AUTOSAR_Platform_BaseTypes_uint8 8.0 RB_PT_PCT_SWC_DWC_CompuMethods_ident 1. 9. FORMAT "%10.5"
 /begin ANNOTATION ANNOTATION_LABEL "Description (coming from AUTOSAR DESC field)" /begin ANNOTATION_TEXT "Cycles over which the ROC is done\r\n" /end ANNOTATION_TEXT /end ANNOTATION
/end CHARACTERISTIC
/begin CHARACTERISTIC DWC_EFLASHB.DWC_SpeedPhaseControl.DWC_dOutputSpeedCalc.DWC_ROCIIRCOEFF "" VALUE 0x8060B1F5 DefaultValueRecordLayout_AUTOSAR_Platform_BaseTypes_uint8 1.0 RB_PT_PCT_SWC_DWC_CompuMethods_ratio_0p01 0.0 1. FORMAT "%10.5"
 /begin ANNOTATION ANNOTATION_LABEL "Description (coming from AUTOSAR DESC field)" /begin ANNOTATION_TEXT "Coefficient for low pass IIR filter\r\n" /end ANNOTATION_TEXT /end ANNOTATION
/end CHARACTERISTIC
/begin CHARACTERISTIC DWC_EFLASHB.DWC_SpeedPhaseControl.DWC_ENGAGETOGEARRATE "" CURVE 0x8060B24E RB_PT_PCT_SWC_DWC_RecordLayouts_RL_Curve_sint16_5_sint16_5 64000.0 RB_PT_PCT_SWC_DWC_CompuMethods_ident -32000. 32000. FORMAT "%10.5"
 /begin ANNOTATION ANNOTATION_LABEL "Description (coming from AUTOSAR DESC field)" /begin ANNOTATION_TEXT "Engagement rate of clutch - slip reduction\r\n" /end ANNOTATION_TEXT /end ANNOTATION
 /begin AXIS_DESCR STD_AXIS NO_INPUT_QUANTITY RB_PT_PCT_SWC_DWC_CompuMethods_ratio_0p1 5 -2000. 2000. FORMAT "%10.5" DEPOSIT ABSOLUTE /end AXIS_DESCR
/end CHARACTERISTIC
/begin CHARACTERISTIC DWC_EFLASHB.DWC_SpeedPhaseControl.DWC_FILTEREDINPUTGRADIENTCORRECT "" VALUE 0x8060A64A DefaultValueRecordLayout_AUTOSAR_Platform_BaseTypes_uint16 1.0 RB_PT_PCT_SWC_DWC_CompuMethods_ratio_0p001__2 0.0 1. FORMAT "%10.5"
 /begin ANNOTATION ANNOTATION_LABEL "Description (coming from AUTOSAR DESC field)"
  /begin ANNOTATION_TEXT "Time delay for correction of filtered input speed based on shaft gradient\r\n" /end ANNOTATION_TEXT
 /end ANNOTATION
/end CHARACTERISTIC
/begin CHARACTERISTIC DWC_EFLASHB.DWC_SpeedPhaseControl.DWC_FilteredSpeedDLCorrect.DWC_IIRCOEFF "" VALUE 0x8060A654 DefaultValueRecordLayout_AUTOSAR_Platform_BaseTypes_uint8 1.0 RB_PT_PCT_SWC_DWC_CompuMethods_ratio_0p01 0.0 1. FORMAT "%10.5"
 /begin ANNOTATION ANNOTATION_LABEL "Description (coming from AUTOSAR DESC field)" /begin ANNOTATION_TEXT "Filter co-efficient\r\n" /end ANNOTATION_TEXT /end ANNOTATION
/end CHARACTERISTIC
/begin CHARACTERISTIC DWC_EFLASHB.DWC_SpeedPhaseControl.DWC_FORCESLIPINIT "" VALUE 0x8060A64E DefaultValueRecordLayout_AUTOSAR_Platform_BaseTypes_boolean 255.0 AUTOSAR_Platform_CompuMethods_boolean 0.0 255. FORMAT "%10.5"
 /begin ANNOTATION ANNOTATION_LABEL "Description (coming from AUTOSAR DESC field)"
  /begin ANNOTATION_TEXT "Flag to force slip target init to current slip on entry to In gear\r\n" /end ANNOTATION_TEXT
 /end ANNOTATION
/end CHARACTERISTIC
/begin CHARACTERISTIC DWC_EFLASHB.DWC_SpeedPhaseControl.DWC_GradientProfiler.DWC_CLUTCHCLEARTIME "" VALUE 0x8060A656 DefaultValueRecordLayout_AUTOSAR_Platform_BaseTypes_uint16 10.0 RB_PT_PCT_SWC_DWC_CompuMethods_ratio_0p001__2 0.0 10. FORMAT "%10.5"
 /begin ANNOTATION ANNOTATION_LABEL "Description (coming from AUTOSAR DESC field)"
  /begin ANNOTATION_TEXT "Time for which the engine ahead gradient can be less (more) than clutch gradient and the clutch is not asked to respond\r\n" /end ANNOTATION_TEXT
 /end ANNOTATION
/end CHARACTERISTIC
/begin CHARACTERISTIC DWC_EFLASHB.DWC_SpeedPhaseControl.DWC_GradientProfiler.DWC_CLUTCHLAGOFFGOINGDOWN "" VALUE 0x8060A658 DefaultValueRecordLayout_AUTOSAR_Platform_BaseTypes_uint16 1.0 RB_PT_PCT_SWC_DWC_CompuMethods_ratio_0p001__2 0.0 1. FORMAT "%10.5"
 /begin ANNOTATION ANNOTATION_LABEL "Description (coming from AUTOSAR DESC field)" /begin ANNOTATION_TEXT "Time lag of clutch for offgoing down shift\r\n" /end ANNOTATION_TEXT /end ANNOTATION
/end CHARACTERISTIC
/begin CHARACTERISTIC DWC_EFLASHB.DWC_SpeedPhaseControl.DWC_GradientProfiler.DWC_CUTFUTUREPREDICTIONTIME "" CURVE 0x8060A67A RB_PT_PCT_SWC_DWC_RecordLayouts_RL_Curve_uint16_2_uint16_2 10.0 RB_PT_PCT_SWC_DWC_CompuMethods_ratio_0p001__2 0.0 10. FORMAT "%10.5"
 /begin ANNOTATION ANNOTATION_LABEL "Description (coming from AUTOSAR DESC field)"
  /begin ANNOTATION_TEXT "Lead time to use for creation of target engine speed during fuel cut.\r\n" /end ANNOTATION_TEXT
 /end ANNOTATION
 /begin AXIS_DESCR STD_AXIS NO_INPUT_QUANTITY RB_PT_PCT_SWC_DWC_CompuMethods_ident 2 0.0 20000. FORMAT "%10.5" DEPOSIT ABSOLUTE /end AXIS_DESCR
/end CHARACTERISTIC
/begin CHARACTERISTIC DWC_EFLASHB.DWC_SpeedPhaseControl.DWC_GradientProfiler.DWC_CUTFUTUREPREDICTIONTIMEGT "" CURVE 0x8060A684 RB_PT_PCT_SWC_DWC_RecordLayouts_RL_Curve_uint16_4_uint16_4 10.0 RB_PT_PCT_SWC_DWC_CompuMethods_ratio_0p001__2 0.0 10. FORMAT "%10.5"
 /begin ANNOTATION ANNOTATION_LABEL "Description (coming from AUTOSAR DESC field)"
  /begin ANNOTATION_TEXT "Lead time to use for creation of target engine speed during fuel cut in GT style shift\r\n" /end ANNOTATION_TEXT
 /end ANNOTATION
 /begin AXIS_DESCR STD_AXIS NO_INPUT_QUANTITY RB_PT_PCT_SWC_DWC_CompuMethods_ident 4 0.0 20000. FORMAT "%10.5" DEPOSIT ABSOLUTE /end AXIS_DESCR
/end CHARACTERISTIC
/begin CHARACTERISTIC DWC_EFLASHB.DWC_SpeedPhaseControl.DWC_GradientProfiler.DWC_DOWNSHIFTBLENDFACTOREND "" MAP 0x8060A696 RB_PT_PCT_SWC_DWC_RecordLayouts_RL_Map_uint8_49_sint16_7_sint16_7 1.0 RB_PT_PCT_SWC_DWC_CompuMethods_ratio_0p01 0.0 1. FORMAT "%10.5"
 /begin ANNOTATION ANNOTATION_LABEL "Description (coming from AUTOSAR DESC field)"
  /begin ANNOTATION_TEXT "Blend factor to nbe used to interpoolate between maximum gradient and target input shaft gradient during upshift - must be 1.0 at target\r\n" /end ANNOTATION_TEXT
 /end ANNOTATION
 /begin AXIS_DESCR STD_AXIS NO_INPUT_QUANTITY RB_PT_PCT_SWC_DWC_CompuMethods_ident 7 -32000. 32000. FORMAT "%10.5" DEPOSIT ABSOLUTE /end AXIS_DESCR
 /begin AXIS_DESCR STD_AXIS NO_INPUT_QUANTITY RB_PT_PCT_SWC_DWC_CompuMethods_ident 7 -20000. 20000. FORMAT "%10.5" DEPOSIT ABSOLUTE /end AXIS_DESCR
/end CHARACTERISTIC
/begin CHARACTERISTIC DWC_EFLASHB.DWC_SpeedPhaseControl.DWC_GradientProfiler.DWC_DOWNSHIFTBLENDFACTORSTART "" MAP 0x8060A6E8 RB_PT_PCT_SWC_DWC_RecordLayouts_RL_Map_uint8_49_sint16_7_sint16_7 1.0 RB_PT_PCT_SWC_DWC_CompuMethods_ratio_0p01 0.0 1. FORMAT "%10.5"
 /begin ANNOTATION ANNOTATION_LABEL "Description (coming from AUTOSAR DESC field)"
  /begin ANNOTATION_TEXT "Blend factor to ne used to interpoolate between maximum gradient and target input shaft gradient during upshift\r\n" /end ANNOTATION_TEXT
 /end ANNOTATION
 /begin AXIS_DESCR STD_AXIS NO_INPUT_QUANTITY RB_PT_PCT_SWC_DWC_CompuMethods_ident 7 -32000. 32000. FORMAT "%10.5" DEPOSIT ABSOLUTE /end AXIS_DESCR
 /begin AXIS_DESCR STD_AXIS NO_INPUT_QUANTITY RB_PT_PCT_SWC_DWC_CompuMethods_ident 7 -20000. 20000. FORMAT "%10.5" DEPOSIT ABSOLUTE /end AXIS_DESCR
/end CHARACTERISTIC
/begin CHARACTERISTIC DWC_EFLASHB.DWC_SpeedPhaseControl.DWC_GradientProfiler.DWC_DOWNSHIFTDECREASE "" MAP 0x8060A73A RB_PT_PCT_SWC_DWC_RecordLayouts_RL_Map_uint16_56_sint8_7_sint8_8 1000000.0 RB_PT_PCT_SWC_DWC_CompuMethods_Speed_50p0 0.0 1000000. FORMAT "%10.5"
 /begin ANNOTATION ANNOTATION_LABEL "Description (coming from AUTOSAR DESC field)"
  /begin ANNOTATION_TEXT "Rate of increase of downshift speed phase gradient against aggression and mode\r\n" /end ANNOTATION_TEXT
 /end ANNOTATION
 /begin AXIS_DESCR STD_AXIS NO_INPUT_QUANTITY RB_PT_PCT_SWC_DWC_CompuMethods_ident 7 -100. 100. FORMAT "%10.5" DEPOSIT ABSOLUTE /end AXIS_DESCR
 /begin AXIS_DESCR STD_AXIS NO_INPUT_QUANTITY RB_PT_PCT_SWC_DWC_CompuMethods_ident 8 0.0 7. FORMAT "%10.5" DEPOSIT ABSOLUTE /end AXIS_DESCR
/end CHARACTERISTIC
/begin CHARACTERISTIC DWC_EFLASHB.DWC_SpeedPhaseControl.DWC_GradientProfiler.DWC_DOWNSHIFTDECREASEINTER "" CURVE 0x8060A7BE RB_PT_PCT_SWC_DWC_RecordLayouts_RL_Curve_uint16_7_sint8_7 1000000.0 RB_PT_PCT_SWC_DWC_CompuMethods_Speed_50p0 0.0 1000000. FORMAT "%10.5"
 /begin ANNOTATION ANNOTATION_LABEL "Description (coming from AUTOSAR DESC field)"
  /begin ANNOTATION_TEXT "Intermediate (supporting) gear approach when preselect is in\r\n" /end ANNOTATION_TEXT
 /end ANNOTATION
 /begin AXIS_DESCR STD_AXIS NO_INPUT_QUANTITY RB_PT_PCT_SWC_DWC_CompuMethods_ident 7 -100. 100. FORMAT "%10.5" DEPOSIT ABSOLUTE /end AXIS_DESCR
/end CHARACTERISTIC
/begin CHARACTERISTIC DWC_EFLASHB.DWC_SpeedPhaseControl.DWC_GradientProfiler.DWC_DOWNSHIFTDECREASENOTARGET "" MAP 0x8060A7D6 RB_PT_PCT_SWC_DWC_RecordLayouts_RL_Map_uint16_56_sint8_7_sint8_8 1000000.0 RB_PT_PCT_SWC_DWC_CompuMethods_Speed_50p0 0.0 1000000. FORMAT "%10.5"
 /begin ANNOTATION ANNOTATION_LABEL "Description (coming from AUTOSAR DESC field)"
  /begin ANNOTATION_TEXT "Rate of increase of downshift speed phase gradient against aggression and mode\r\n" /end ANNOTATION_TEXT
 /end ANNOTATION
 /begin AXIS_DESCR STD_AXIS NO_INPUT_QUANTITY RB_PT_PCT_SWC_DWC_CompuMethods_ident 7 -100. 100. FORMAT "%10.5" DEPOSIT ABSOLUTE /end AXIS_DESCR
 /begin AXIS_DESCR STD_AXIS NO_INPUT_QUANTITY RB_PT_PCT_SWC_DWC_CompuMethods_ident 8 0.0 7. FORMAT "%10.5" DEPOSIT ABSOLUTE /end AXIS_DESCR
/end CHARACTERISTIC
/begin CHARACTERISTIC DWC_EFLASHB.DWC_SpeedPhaseControl.DWC_GradientProfiler.DWC_DOWNSHIFTINCREASE "" MAP 0x8060A85A RB_PT_PCT_SWC_DWC_RecordLayouts_RL_Map_uint16_56_sint8_7_sint8_8 1000000.0 RB_PT_PCT_SWC_DWC_CompuMethods_Speed_50p0 0.0 1000000. FORMAT "%10.5"
 /begin ANNOTATION ANNOTATION_LABEL "Description (coming from AUTOSAR DESC field)"
  /begin ANNOTATION_TEXT "Rate of increase of downshift speed phase gradient against aggression and mode\r\n" /end ANNOTATION_TEXT
 /end ANNOTATION
 /begin AXIS_DESCR STD_AXIS NO_INPUT_QUANTITY RB_PT_PCT_SWC_DWC_CompuMethods_ident 7 -100. 100. FORMAT "%10.5" DEPOSIT ABSOLUTE /end AXIS_DESCR
 /begin AXIS_DESCR STD_AXIS NO_INPUT_QUANTITY RB_PT_PCT_SWC_DWC_CompuMethods_ident 8 0.0 7. FORMAT "%10.5" DEPOSIT ABSOLUTE /end AXIS_DESCR
/end CHARACTERISTIC
/begin CHARACTERISTIC DWC_EFLASHB.DWC_SpeedPhaseControl.DWC_GradientProfiler.DWC_DOWNSHIFTMAXGRADIENTENGINETORQUE "" CURVE 0x8060A8DE RB_PT_PCT_SWC_DWC_RecordLayouts_RL_Curve_sint16_5_sint16_5 64000.0 RB_PT_PCT_SWC_DWC_CompuMethods_ident -32000. 32000. FORMAT "%10.5"
 /begin ANNOTATION ANNOTATION_LABEL "Description (coming from AUTOSAR DESC field)"
  /begin ANNOTATION_TEXT "Maximum rate of change of engine speed based on engine torque\r\n" /end ANNOTATION_TEXT
 /end ANNOTATION
 /begin AXIS_DESCR STD_AXIS NO_INPUT_QUANTITY RB_PT_PCT_SWC_DWC_CompuMethods_ratio_0p1 5 -2000. 2000. FORMAT "%10.5" DEPOSIT ABSOLUTE /end AXIS_DESCR
/end CHARACTERISTIC
/begin CHARACTERISTIC DWC_EFLASHB.DWC_SpeedPhaseControl.DWC_GradientProfiler.DWC_DOWNSHIFTSUPPORTHIGHINCTIME "" VALUE 0x8060A65A DefaultValueRecordLayout_AUTOSAR_Platform_BaseTypes_uint16 10.0 RB_PT_PCT_SWC_DWC_CompuMethods_ratio_0p001__2 0.0 10. FORMAT "%10.5"
 /begin ANNOTATION ANNOTATION_LABEL "Description (coming from AUTOSAR DESC field)" /begin ANNOTATION_TEXT "Time for which high increase rate is allowed\r\n" /end ANNOTATION_TEXT /end ANNOTATION
/end CHARACTERISTIC
/begin CHARACTERISTIC DWC_EFLASHB.DWC_SpeedPhaseControl.DWC_GradientProfiler.DWC_ENABLEHOVERATINTERMEDIATE "" VALUE 0x8060A66E DefaultValueRecordLayout_AUTOSAR_Platform_BaseTypes_boolean 255.0 AUTOSAR_Platform_CompuMethods_boolean 0.0 255. FORMAT "%10.5"
 /begin ANNOTATION ANNOTATION_LABEL "Description (coming from AUTOSAR DESC field)"
  /begin ANNOTATION_TEXT "Flag to force power on downs to hover at intermediate until torque phase is complete\r\n" /end ANNOTATION_TEXT
 /end ANNOTATION
/end CHARACTERISTIC
/begin CHARACTERISTIC DWC_EFLASHB.DWC_SpeedPhaseControl.DWC_GradientProfiler.DWC_ENABLEPUSHDURINGLAUNCH "" VALUE 0x8060A66F DefaultValueRecordLayout_AUTOSAR_Platform_BaseTypes_boolean 255.0 AUTOSAR_Platform_CompuMethods_boolean 0.0 255. FORMAT "%10.5"
 /begin ANNOTATION ANNOTATION_LABEL "Description (coming from AUTOSAR DESC field)" /begin ANNOTATION_TEXT "Flag to enable push during launch mode\r\n" /end ANNOTATION_TEXT /end ANNOTATION
/end CHARACTERISTIC
/begin CHARACTERISTIC DWC_EFLASHB.DWC_SpeedPhaseControl.DWC_GradientProfiler.DWC_ENABLERESETSLIPTARGETSPEEDUPSHIFT "" VALUE 0x8060A670 DefaultValueRecordLayout_AUTOSAR_Platform_BaseTypes_boolean 255.0 AUTOSAR_Platform_CompuMethods_boolean 0.0 255. FORMAT "%10.5"
 /begin ANNOTATION ANNOTATION_LABEL "Description (coming from AUTOSAR DESC field)"
  /begin ANNOTATION_TEXT "Flag to reset slip target at start of speed phase for engine speed control upshift\r\n" /end ANNOTATION_TEXT
 /end ANNOTATION
/end CHARACTERISTIC
/begin CHARACTERISTIC DWC_EFLASHB.DWC_SpeedPhaseControl.DWC_GradientProfiler.DWC_ENABLESLIPTGTRESET "" VALUE 0x8060A671 DefaultValueRecordLayout_AUTOSAR_Platform_BaseTypes_boolean 255.0 AUTOSAR_Platform_CompuMethods_boolean 0.0 255. FORMAT "%10.5"
 /begin ANNOTATION ANNOTATION_LABEL "Description (coming from AUTOSAR DESC field)"
  /begin ANNOTATION_TEXT "Flag to enable the reset of the target slip when end gradient < start gradient.\r\n" /end ANNOTATION_TEXT
 /end ANNOTATION
/end CHARACTERISTIC
/begin CHARACTERISTIC DWC_EFLASHB.DWC_SpeedPhaseControl.DWC_GradientProfiler.DWC_ENGINELAGTIMEVSSPEED "" CURVE 0x8060A8F4 RB_PT_PCT_SWC_DWC_RecordLayouts_RL_Curve_uint16_2_uint16_2 10.0 RB_PT_PCT_SWC_DWC_CompuMethods_ratio_0p001__2 0.0 10. FORMAT "%10.5"
 /begin ANNOTATION ANNOTATION_LABEL "Description (coming from AUTOSAR DESC field)"
  /begin ANNOTATION_TEXT "Lag time of engine torque down response vs engine speed\r\n" /end ANNOTATION_TEXT
 /end ANNOTATION
 /begin AXIS_DESCR STD_AXIS NO_INPUT_QUANTITY RB_PT_PCT_SWC_DWC_CompuMethods_ident 2 0.0 20000. FORMAT "%10.5" DEPOSIT ABSOLUTE /end AXIS_DESCR
/end CHARACTERISTIC
/begin CHARACTERISTIC DWC_EFLASHB.DWC_SpeedPhaseControl.DWC_GradientProfiler.DWC_INERTIACANCELMINRATE "" VALUE 0x8060A65C DefaultValueRecordLayout_AUTOSAR_Platform_BaseTypes_sint16 64000.0 RB_PT_PCT_SWC_DWC_CompuMethods_ident -32000. 32000. FORMAT "%10.5"
 /begin ANNOTATION ANNOTATION_LABEL "Description (coming from AUTOSAR DESC field)" /begin ANNOTATION_TEXT "Minimum rate for speed phase (while not at target)\r\n" /end ANNOTATION_TEXT /end ANNOTATION
/end CHARACTERISTIC
/begin CHARACTERISTIC DWC_EFLASHB.DWC_SpeedPhaseControl.DWC_GradientProfiler.DWC_OFFGOINGDOWNMINRATE "" VALUE 0x8060A65E DefaultValueRecordLayout_AUTOSAR_Platform_BaseTypes_sint16 64000.0 RB_PT_PCT_SWC_DWC_CompuMethods_ident -32000. 32000. FORMAT "%10.5"
 /begin ANNOTATION ANNOTATION_LABEL "Description (coming from AUTOSAR DESC field)" /begin ANNOTATION_TEXT "Minimum rate for speed phase (while not at target)\r\n" /end ANNOTATION_TEXT /end ANNOTATION
/end CHARACTERISTIC
/begin CHARACTERISTIC DWC_EFLASHB.DWC_SpeedPhaseControl.DWC_GradientProfiler.DWC_OFFGOINGUPMINRATE "" VALUE 0x8060A660 DefaultValueRecordLayout_AUTOSAR_Platform_BaseTypes_sint16 64000.0 RB_PT_PCT_SWC_DWC_CompuMethods_ident -32000. 32000. FORMAT "%10.5"
 /begin ANNOTATION ANNOTATION_LABEL "Description (coming from AUTOSAR DESC field)" /begin ANNOTATION_TEXT "Minimum rate for speed phase (while not at target)\r\n" /end ANNOTATION_TEXT /end ANNOTATION
/end CHARACTERISTIC
/begin CHARACTERISTIC DWC_EFLASHB.DWC_SpeedPhaseControl.DWC_GradientProfiler.DWC_ONCOMINGDOWNMINRATE "" VALUE 0x8060A662 DefaultValueRecordLayout_AUTOSAR_Platform_BaseTypes_sint16 64000.0 RB_PT_PCT_SWC_DWC_CompuMethods_ident -32000. 32000. FORMAT "%10.5"
 /begin ANNOTATION ANNOTATION_LABEL "Description (coming from AUTOSAR DESC field)" /begin ANNOTATION_TEXT "Minimum rate for speed phase (while not at target)\r\n" /end ANNOTATION_TEXT /end ANNOTATION
/end CHARACTERISTIC
/begin CHARACTERISTIC DWC_EFLASHB.DWC_SpeedPhaseControl.DWC_GradientProfiler.DWC_ONCOMINGUPMINRATE "" VALUE 0x8060A664 DefaultValueRecordLayout_AUTOSAR_Platform_BaseTypes_sint16 64000.0 RB_PT_PCT_SWC_DWC_CompuMethods_ident -32000. 32000. FORMAT "%10.5"
 /begin ANNOTATION ANNOTATION_LABEL "Description (coming from AUTOSAR DESC field)" /begin ANNOTATION_TEXT "Minimum rate for speed phase (while not at target)\r\n" /end ANNOTATION_TEXT /end ANNOTATION
/end CHARACTERISTIC
/begin CHARACTERISTIC DWC_EFLASHB.DWC_SpeedPhaseControl.DWC_GradientProfiler.DWC_POWERONDOWNSLIPHISTORY "" VALUE 0x8060A672 DefaultValueRecordLayout_AUTOSAR_Platform_BaseTypes_boolean 255.0 AUTOSAR_Platform_CompuMethods_boolean 0.0 255. FORMAT "%10.5"
 /begin ANNOTATION ANNOTATION_LABEL "Description (coming from AUTOSAR DESC field)"
  /begin ANNOTATION_TEXT "Flag to force power on down shift to only use maximum of historic slip and current\r\n" /end ANNOTATION_TEXT
 /end ANNOTATION
/end CHARACTERISTIC
/begin CHARACTERISTIC DWC_EFLASHB.DWC_SpeedPhaseControl.DWC_GradientProfiler.DWC_PUSHUPSHIFTCLAMPOFFSETMAX "" VALUE 0x8060A666 DefaultValueRecordLayout_AUTOSAR_Platform_BaseTypes_sint16 64000.0 RB_PT_PCT_SWC_DWC_CompuMethods_ident -32000. 32000. FORMAT "%10.5"
 /begin ANNOTATION ANNOTATION_LABEL "Description (coming from AUTOSAR DESC field)" /begin ANNOTATION_TEXT "Maximum clamp gradient for push up shifts\r\n" /end ANNOTATION_TEXT /end ANNOTATION
/end CHARACTERISTIC
/begin CHARACTERISTIC DWC_EFLASHB.DWC_SpeedPhaseControl.DWC_GradientProfiler.DWC_RESTARTPROFILEPOWERONTOOFFUP "" VALUE 0x8060A673 DefaultValueRecordLayout_AUTOSAR_Platform_BaseTypes_boolean 255.0 AUTOSAR_Platform_CompuMethods_boolean 0.0 255. FORMAT "%10.5"
 /begin ANNOTATION ANNOTATION_LABEL "Description (coming from AUTOSAR DESC field)"
  /begin ANNOTATION_TEXT "Flag to force restart of gradient profile on shift change\r\n" /end ANNOTATION_TEXT
 /end ANNOTATION
/end CHARACTERISTIC
/begin CHARACTERISTIC DWC_EFLASHB.DWC_SpeedPhaseControl.DWC_GradientProfiler.DWC_UPSHIFTBLENDFACTOREND_0 "" MAP 0x8060A8FE RB_PT_PCT_SWC_DWC_RecordLayouts_RL_Map_uint8_36_sint16_6_sint16_6 1.0 RB_PT_PCT_SWC_DWC_CompuMethods_ratio_0p01 0.0 1. FORMAT "%10.5"
 /begin ANNOTATION ANNOTATION_LABEL "Description (coming from AUTOSAR DESC field)"
  /begin ANNOTATION_TEXT "Blend factor to ne used to interpoolate between maximum gradient and target input shaft gradient during upshift\r\n" /end ANNOTATION_TEXT
 /end ANNOTATION
 /begin AXIS_DESCR STD_AXIS NO_INPUT_QUANTITY RB_PT_PCT_SWC_DWC_CompuMethods_ident 6 -32000. 32000. FORMAT "%10.5" DEPOSIT ABSOLUTE /end AXIS_DESCR
 /begin AXIS_DESCR STD_AXIS NO_INPUT_QUANTITY RB_PT_PCT_SWC_DWC_CompuMethods_ident 6 -20000. 20000. FORMAT "%10.5" DEPOSIT ABSOLUTE /end AXIS_DESCR
/end CHARACTERISTIC
/begin CHARACTERISTIC DWC_EFLASHB.DWC_SpeedPhaseControl.DWC_GradientProfiler.DWC_UPSHIFTBLENDFACTOREND_1 "" MAP 0x8060A93E RB_PT_PCT_SWC_DWC_RecordLayouts_RL_Map_uint8_36_sint16_6_sint16_6 1.0 RB_PT_PCT_SWC_DWC_CompuMethods_ratio_0p01 0.0 1. FORMAT "%10.5"
 /begin ANNOTATION ANNOTATION_LABEL "Description (coming from AUTOSAR DESC field)"
  /begin ANNOTATION_TEXT "Blend factor to ne used to interpoolate between maximum gradient and target input shaft gradient during upshift\r\n" /end ANNOTATION_TEXT
 /end ANNOTATION
 /begin AXIS_DESCR STD_AXIS NO_INPUT_QUANTITY RB_PT_PCT_SWC_DWC_CompuMethods_ident 6 -32000. 32000. FORMAT "%10.5" DEPOSIT ABSOLUTE /end AXIS_DESCR
 /begin AXIS_DESCR STD_AXIS NO_INPUT_QUANTITY RB_PT_PCT_SWC_DWC_CompuMethods_ident 6 -20000. 20000. FORMAT "%10.5" DEPOSIT ABSOLUTE /end AXIS_DESCR
/end CHARACTERISTIC
/begin CHARACTERISTIC DWC_EFLASHB.DWC_SpeedPhaseControl.DWC_GradientProfiler.DWC_UPSHIFTBLENDFACTOREND_2 "" MAP 0x8060A97E RB_PT_PCT_SWC_DWC_RecordLayouts_RL_Map_uint8_36_sint16_6_sint16_6 1.0 RB_PT_PCT_SWC_DWC_CompuMethods_ratio_0p01 0.0 1. FORMAT "%10.5"
 /begin ANNOTATION ANNOTATION_LABEL "Description (coming from AUTOSAR DESC field)"
  /begin ANNOTATION_TEXT "Blend factor to ne used to interpoolate between maximum gradient and target input shaft gradient during upshift\r\n" /end ANNOTATION_TEXT
 /end ANNOTATION
 /begin AXIS_DESCR STD_AXIS NO_INPUT_QUANTITY RB_PT_PCT_SWC_DWC_CompuMethods_ident 6 -32000. 32000. FORMAT "%10.5" DEPOSIT ABSOLUTE /end AXIS_DESCR
 /begin AXIS_DESCR STD_AXIS NO_INPUT_QUANTITY RB_PT_PCT_SWC_DWC_CompuMethods_ident 6 -20000. 20000. FORMAT "%10.5" DEPOSIT ABSOLUTE /end AXIS_DESCR
/end CHARACTERISTIC
/begin CHARACTERISTIC DWC_EFLASHB.DWC_SpeedPhaseControl.DWC_GradientProfiler.DWC_UPSHIFTBLENDFACTOREND_3 "" MAP 0x8060A9BE RB_PT_PCT_SWC_DWC_RecordLayouts_RL_Map_uint8_36_sint16_6_sint16_6 1.0 RB_PT_PCT_SWC_DWC_CompuMethods_ratio_0p01 0.0 1. FORMAT "%10.5"
 /begin ANNOTATION ANNOTATION_LABEL "Description (coming from AUTOSAR DESC field)"
  /begin ANNOTATION_TEXT "Blend factor to ne used to interpoolate between maximum gradient and target input shaft gradient during upshift\r\n" /end ANNOTATION_TEXT
 /end ANNOTATION
 /begin AXIS_DESCR STD_AXIS NO_INPUT_QUANTITY RB_PT_PCT_SWC_DWC_CompuMethods_ident 6 -32000. 32000. FORMAT "%10.5" DEPOSIT ABSOLUTE /end AXIS_DESCR
 /begin AXIS_DESCR STD_AXIS NO_INPUT_QUANTITY RB_PT_PCT_SWC_DWC_CompuMethods_ident 6 -20000. 20000. FORMAT "%10.5" DEPOSIT ABSOLUTE /end AXIS_DESCR
/end CHARACTERISTIC
/begin CHARACTERISTIC DWC_EFLASHB.DWC_SpeedPhaseControl.DWC_GradientProfiler.DWC_UPSHIFTCLUTCHFACTOR "" VALUE 0x8060A674 DefaultValueRecordLayout_AUTOSAR_Platform_BaseTypes_uint8 1.0 RB_PT_PCT_SWC_DWC_CompuMethods_ratio_0p1 0.0 1. FORMAT "%10.5"
 /begin ANNOTATION ANNOTATION_LABEL "Description (coming from AUTOSAR DESC field)"
  /begin ANNOTATION_TEXT "Clutch reduction factor for power on up speed phase gradient\r\n" /end ANNOTATION_TEXT
 /end ANNOTATION
/end CHARACTERISTIC
/begin CHARACTERISTIC DWC_EFLASHB.DWC_SpeedPhaseControl.DWC_GradientProfiler.DWC_UPSHIFTCLUTCHSTARTTIME "" VALUE 0x8060A668 DefaultValueRecordLayout_AUTOSAR_Platform_BaseTypes_uint16 10.0 RB_PT_PCT_SWC_DWC_CompuMethods_ratio_0p001__2 0.0 10. FORMAT "%10.5"
 /begin ANNOTATION ANNOTATION_LABEL "Description (coming from AUTOSAR DESC field)"
  /begin ANNOTATION_TEXT "Start delay time of clutch gradient demand after engine demand\r\n" /end ANNOTATION_TEXT
 /end ANNOTATION
/end CHARACTERISTIC
/begin CHARACTERISTIC DWC_EFLASHB.DWC_SpeedPhaseControl.DWC_GradientProfiler.DWC_UPSHIFTDECREASE "" MAP 0x8060A9FE RB_PT_PCT_SWC_DWC_RecordLayouts_RL_Map_uint16_56_sint8_7_sint8_8 1000000.0 RB_PT_PCT_SWC_DWC_CompuMethods_Speed_50p0 0.0 1000000. FORMAT "%10.5"
 /begin ANNOTATION ANNOTATION_LABEL "Description (coming from AUTOSAR DESC field)"
  /begin ANNOTATION_TEXT "Rate of increase of downshift speed phase gradient against aggression and mode\r\n" /end ANNOTATION_TEXT
 /end ANNOTATION
 /begin AXIS_DESCR STD_AXIS NO_INPUT_QUANTITY RB_PT_PCT_SWC_DWC_CompuMethods_ident 7 -100. 100. FORMAT "%10.5" DEPOSIT ABSOLUTE /end AXIS_DESCR
 /begin AXIS_DESCR STD_AXIS NO_INPUT_QUANTITY RB_PT_PCT_SWC_DWC_CompuMethods_ident 8 0.0 7. FORMAT "%10.5" DEPOSIT ABSOLUTE /end AXIS_DESCR
/end CHARACTERISTIC
/begin CHARACTERISTIC DWC_EFLASHB.DWC_SpeedPhaseControl.DWC_GradientProfiler.DWC_UPSHIFTEARLYCOMPLETETIME "" VALUE 0x8060A66A DefaultValueRecordLayout_AUTOSAR_Platform_BaseTypes_uint16 10.0 RB_PT_PCT_SWC_DWC_CompuMethods_ratio_0p001__2 0.0 10. FORMAT "%10.5"
 /begin ANNOTATION ANNOTATION_LABEL "Description (coming from AUTOSAR DESC field)"
  /begin ANNOTATION_TEXT "Time for which the engine ahead gradient can be zero before early completion of speed phase is allowed\r\n" /end ANNOTATION_TEXT
 /end ANNOTATION
/end CHARACTERISTIC
/begin CHARACTERISTIC DWC_EFLASHB.DWC_SpeedPhaseControl.DWC_GradientProfiler.DWC_UPSHIFTENDINC "" VALUE 0x8060A66C DefaultValueRecordLayout_AUTOSAR_Platform_BaseTypes_uint16 1000000.0 RB_PT_PCT_SWC_DWC_CompuMethods_Speed_50p0 0.0 1000000. FORMAT "%10.5"
 /begin ANNOTATION ANNOTATION_LABEL "Description (coming from AUTOSAR DESC field)"
  /begin ANNOTATION_TEXT "Increase rate of upshift gradient in the event of a re-increase of gradient due to early termination of torque down\r\n" /end ANNOTATION_TEXT
 /end ANNOTATION
/end CHARACTERISTIC
/begin CHARACTERISTIC DWC_EFLASHB.DWC_SpeedPhaseControl.DWC_GradientProfiler.DWC_UPSHIFTINCREASE "" MAP 0x8060AA82 RB_PT_PCT_SWC_DWC_RecordLayouts_RL_Map_uint16_56_sint8_7_sint8_8 1000000.0 RB_PT_PCT_SWC_DWC_CompuMethods_Speed_50p0 0.0 1000000. FORMAT "%10.5"
 /begin ANNOTATION ANNOTATION_LABEL "Description (coming from AUTOSAR DESC field)"
  /begin ANNOTATION_TEXT "Rate of increase of downshift speed phase gradient against aggression and mode\r\n" /end ANNOTATION_TEXT
 /end ANNOTATION
 /begin AXIS_DESCR STD_AXIS NO_INPUT_QUANTITY RB_PT_PCT_SWC_DWC_CompuMethods_ident 7 -100. 100. FORMAT "%10.5" DEPOSIT ABSOLUTE /end AXIS_DESCR
 /begin AXIS_DESCR STD_AXIS NO_INPUT_QUANTITY RB_PT_PCT_SWC_DWC_CompuMethods_ident 8 0.0 7. FORMAT "%10.5" DEPOSIT ABSOLUTE /end AXIS_DESCR
/end CHARACTERISTIC
/begin CHARACTERISTIC DWC_EFLASHB.DWC_SpeedPhaseControl.DWC_GradientProfiler.DWC_USEACTUALSLIPFORSPEEDPROFILEDOWNEND "" VALUE 0x8060A675 DefaultValueRecordLayout_AUTOSAR_Platform_BaseTypes_boolean 255.0 AUTOSAR_Platform_CompuMethods_boolean 0.0 255. FORMAT "%10.5"
 /begin ANNOTATION ANNOTATION_LABEL "Description (coming from AUTOSAR DESC field)"
  /begin ANNOTATION_TEXT "Flag to use the actual slip to profile the target engine speed towards the oncoming shaft speed at the end of a downshift\r\n" /end ANNOTATION_TEXT
 /end ANNOTATION
/end CHARACTERISTIC
/begin CHARACTERISTIC DWC_EFLASHB.DWC_SpeedPhaseControl.DWC_GradientProfiler.DWC_USEACTUALSLIPFORSPEEDPROFILEDOWNSTART "" VALUE 0x8060A676 DefaultValueRecordLayout_AUTOSAR_Platform_BaseTypes_boolean 255.0 AUTOSAR_Platform_CompuMethods_boolean 0.0 255. FORMAT "%10.5"
 /begin ANNOTATION ANNOTATION_LABEL "Description (coming from AUTOSAR DESC field)"
  /begin ANNOTATION_TEXT "Flag to use the actual slip to profile the target engine speed towards the oncoming shaft speed at the start of a downshift\r\n" /end ANNOTATION_TEXT
 /end ANNOTATION
/end CHARACTERISTIC
/begin CHARACTERISTIC DWC_EFLASHB.DWC_SpeedPhaseControl.DWC_GradientProfiler.DWC_USEACTUALSLIPFORSPEEDPROFILEUP "" VALUE 0x8060A677 DefaultValueRecordLayout_AUTOSAR_Platform_BaseTypes_boolean 255.0 AUTOSAR_Platform_CompuMethods_boolean 0.0 255. FORMAT "%10.5"
 /begin ANNOTATION ANNOTATION_LABEL "Description (coming from AUTOSAR DESC field)"
  /begin ANNOTATION_TEXT "Flag to use the actual slip to profile the target engine speed towards the oncoming shaft speed at the end of an upshift\r\n" /end ANNOTATION_TEXT
 /end ANNOTATION
/end CHARACTERISTIC
/begin CHARACTERISTIC DWC_EFLASHB.DWC_SpeedPhaseControl.DWC_GradientProfiler.DWC_USEFILTEREDINPUTSPEEDFORTARGET "" VALUE 0x8060A678 DefaultValueRecordLayout_AUTOSAR_Platform_BaseTypes_boolean 255.0 AUTOSAR_Platform_CompuMethods_boolean 0.0 255. FORMAT "%10.5"
 /begin ANNOTATION ANNOTATION_LABEL "Description (coming from AUTOSAR DESC field)" /begin ANNOTATION_TEXT "Flag to use filtered input shaft speed for target\r\n" /end ANNOTATION_TEXT /end ANNOTATION
/end CHARACTERISTIC
/begin CHARACTERISTIC DWC_EFLASHB.DWC_SpeedPhaseControl.DWC_MaxGradient.DWC_CONTINUOUSUPDATE "" VALUE 0x8060AB28 DefaultValueRecordLayout_AUTOSAR_Platform_BaseTypes_boolean 255.0 AUTOSAR_Platform_CompuMethods_boolean 0.0 255. FORMAT "%10.5"
 /begin ANNOTATION ANNOTATION_LABEL "Description (coming from AUTOSAR DESC field)"
  /begin ANNOTATION_TEXT "Flag to request that gradient are continually updated during speed phases\r\n" /end ANNOTATION_TEXT
 /end ANNOTATION
/end CHARACTERISTIC
/begin CHARACTERISTIC DWC_EFLASHB.DWC_SpeedPhaseControl.DWC_MaxGradient.DWC_DOWNSHIFTGRADIENTNORMAL "" MAP 0x8060AB2A RB_PT_PCT_SWC_DWC_RecordLayouts_RL_Map_sint16_77_sint8_7_sint8_11 64000.0 RB_PT_PCT_SWC_DWC_CompuMethods_ident -32000. 32000. FORMAT "%10.5"
 /begin ANNOTATION ANNOTATION_LABEL "Description (coming from AUTOSAR DESC field)"
  /begin ANNOTATION_TEXT "Rate of change of slip (gradient) demand maximum target or time to complete speed phase\r\n" /end ANNOTATION_TEXT
 /end ANNOTATION
 /begin AXIS_DESCR STD_AXIS NO_INPUT_QUANTITY RB_PT_PCT_SWC_DWC_CompuMethods_ident 7 -100. 100. FORMAT "%10.5" DEPOSIT ABSOLUTE /end AXIS_DESCR
 /begin AXIS_DESCR STD_AXIS NO_INPUT_QUANTITY RB_PT_PCT_SWC_DWC_CompuMethods_ident 11 0.0 13. FORMAT "%10.5" DEPOSIT ABSOLUTE /end AXIS_DESCR
/end CHARACTERISTIC
/begin CHARACTERISTIC DWC_EFLASHB.DWC_SpeedPhaseControl.DWC_MaxGradient.DWC_DOWNSHIFTGRADIENTSPORT "" MAP 0x8060ABDA RB_PT_PCT_SWC_DWC_RecordLayouts_RL_Map_sint16_77_sint8_7_sint8_11 64000.0 RB_PT_PCT_SWC_DWC_CompuMethods_ident -32000. 32000. FORMAT "%10.5"
 /begin ANNOTATION ANNOTATION_LABEL "Description (coming from AUTOSAR DESC field)"
  /begin ANNOTATION_TEXT "Rate of change of slip (gradient) demand maximum target or time to complete speed phase\r\n" /end ANNOTATION_TEXT
 /end ANNOTATION
 /begin AXIS_DESCR STD_AXIS NO_INPUT_QUANTITY RB_PT_PCT_SWC_DWC_CompuMethods_ident 7 -100. 100. FORMAT "%10.5" DEPOSIT ABSOLUTE /end AXIS_DESCR
 /begin AXIS_DESCR STD_AXIS NO_INPUT_QUANTITY RB_PT_PCT_SWC_DWC_CompuMethods_ident 11 0.0 13. FORMAT "%10.5" DEPOSIT ABSOLUTE /end AXIS_DESCR
/end CHARACTERISTIC
/begin CHARACTERISTIC DWC_EFLASHB.DWC_SpeedPhaseControl.DWC_MaxGradient.DWC_DOWNSHIFTGRADIENTTRACK "" MAP 0x8060AC8A RB_PT_PCT_SWC_DWC_RecordLayouts_RL_Map_sint16_77_sint8_7_sint8_11 64000.0 RB_PT_PCT_SWC_DWC_CompuMethods_ident -32000. 32000. FORMAT "%10.5"
 /begin ANNOTATION ANNOTATION_LABEL "Description (coming from AUTOSAR DESC field)"
  /begin ANNOTATION_TEXT "Rate of change of slip (gradient) demand maximum target or time to complete speed phase\r\n" /end ANNOTATION_TEXT
 /end ANNOTATION
 /begin AXIS_DESCR STD_AXIS NO_INPUT_QUANTITY RB_PT_PCT_SWC_DWC_CompuMethods_ident 7 -100. 100. FORMAT "%10.5" DEPOSIT ABSOLUTE /end AXIS_DESCR
 /begin AXIS_DESCR STD_AXIS NO_INPUT_QUANTITY RB_PT_PCT_SWC_DWC_CompuMethods_ident 11 0.0 13. FORMAT "%10.5" DEPOSIT ABSOLUTE /end AXIS_DESCR
/end CHARACTERISTIC
/begin CHARACTERISTIC DWC_EFLASHB.DWC_SpeedPhaseControl.DWC_MaxGradient.DWC_ENGINEGRADIENTCORRECTION "" VALUE 0x8060AB26 DefaultValueRecordLayout_AUTOSAR_Platform_BaseTypes_uint16 1.0 RB_PT_PCT_SWC_DWC_CompuMethods_ratio_0p001__2 0.0 1. FORMAT "%10.5"
 /begin ANNOTATION ANNOTATION_LABEL "Description (coming from AUTOSAR DESC field)"
  /begin ANNOTATION_TEXT "Correction factor of engine torque down gradient - 0.0 = Not physics ----  1.0 = Physics\r\n" /end ANNOTATION_TEXT
 /end ANNOTATION
/end CHARACTERISTIC
/begin CHARACTERISTIC DWC_EFLASHB.DWC_SpeedPhaseControl.DWC_MaxGradient.DWC_KICKDOWN3STEP "" MAP 0x8060AD3A RB_PT_PCT_SWC_DWC_RecordLayouts_RL_Map_sint16_21_sint8_3_sint8_7 64000.0 RB_PT_PCT_SWC_DWC_CompuMethods_ident -32000. 32000. FORMAT "%10.5"
 /begin ANNOTATION ANNOTATION_LABEL "Description (coming from AUTOSAR DESC field)"
  /begin ANNOTATION_TEXT "Gradient for power on down shifts for kickdown - 3 step\r\n" /end ANNOTATION_TEXT
 /end ANNOTATION
 /begin AXIS_DESCR STD_AXIS NO_INPUT_QUANTITY RB_PT_PCT_SWC_DWC_CompuMethods_ident 3 -100. 100. FORMAT "%10.5" DEPOSIT ABSOLUTE /end AXIS_DESCR
 /begin AXIS_DESCR STD_AXIS NO_INPUT_QUANTITY RB_PT_PCT_SWC_DWC_CompuMethods_ident 7 0.0 13. FORMAT "%10.5" DEPOSIT ABSOLUTE /end AXIS_DESCR
/end CHARACTERISTIC
/begin CHARACTERISTIC DWC_EFLASHB.DWC_SpeedPhaseControl.DWC_MaxGradient.DWC_KICKDOWN3STEPEMODE "" MAP 0x8060AD72 RB_PT_PCT_SWC_DWC_RecordLayouts_RL_Map_sint16_12_sint8_3_sint8_4 64000.0 RB_PT_PCT_SWC_DWC_CompuMethods_ident -32000. 32000. FORMAT "%10.5"
 /begin ANNOTATION ANNOTATION_LABEL "Description (coming from AUTOSAR DESC field)"
  /begin ANNOTATION_TEXT "Gradient for power on down shifts for kickdown - 3 step\r\n" /end ANNOTATION_TEXT
 /end ANNOTATION
 /begin AXIS_DESCR STD_AXIS NO_INPUT_QUANTITY RB_PT_PCT_SWC_DWC_CompuMethods_ident 3 -100. 100. FORMAT "%10.5" DEPOSIT ABSOLUTE /end AXIS_DESCR
 /begin AXIS_DESCR STD_AXIS NO_INPUT_QUANTITY RB_PT_PCT_SWC_DWC_CompuMethods_ident 4 0.0 13. FORMAT "%10.5" DEPOSIT ABSOLUTE /end AXIS_DESCR
/end CHARACTERISTIC
/begin CHARACTERISTIC DWC_EFLASHB.DWC_SpeedPhaseControl.DWC_MaxGradient.DWC_MINAGGRESSIONKICKDOWN "" VALUE 0x8060AB29 DefaultValueRecordLayout_AUTOSAR_Platform_BaseTypes_sint8 200.0 RB_PT_PCT_SWC_DWC_CompuMethods_ident -100. 100. FORMAT "%10.5"
 /begin ANNOTATION ANNOTATION_LABEL "Description (coming from AUTOSAR DESC field)" /begin ANNOTATION_TEXT "Minimum aggression for kickdown shifts\r\n" /end ANNOTATION_TEXT /end ANNOTATION
/end CHARACTERISTIC
/begin CHARACTERISTIC DWC_EFLASHB.DWC_SpeedPhaseControl.DWC_MaxGradient.DWC_PUSHFACTORECO "" CURVE 0x8060AD96 RB_PT_PCT_SWC_DWC_RecordLayouts_RL_Curve_uint16_7_uint8_7 1.0 RB_PT_PCT_SWC_DWC_CompuMethods_ratio_0p001__2 0.0 1. FORMAT "%10.5"
 /begin ANNOTATION ANNOTATION_LABEL "Description (coming from AUTOSAR DESC field)" /begin ANNOTATION_TEXT "Push factor to use for ECO mode shifts\r\n" /end ANNOTATION_TEXT /end ANNOTATION
 /begin AXIS_DESCR STD_AXIS NO_INPUT_QUANTITY RB_PT_PCT_SWC_DWC_CompuMethods_ident 7 0.0 11. FORMAT "%10.5" DEPOSIT ABSOLUTE /end AXIS_DESCR
/end CHARACTERISTIC
/begin CHARACTERISTIC DWC_EFLASHB.DWC_SpeedPhaseControl.DWC_MaxGradient.DWC_PUSHFACTORVSGEAR "" MAP 0x8060ADAE RB_PT_PCT_SWC_DWC_RecordLayouts_RL_Map_uint16_42_sint8_6_sint8_7 1.0 RB_PT_PCT_SWC_DWC_CompuMethods_ratio_0p001__2 0.0 1. FORMAT "%10.5"
 /begin ANNOTATION ANNOTATION_LABEL "Description (coming from AUTOSAR DESC field)"
  /begin ANNOTATION_TEXT "Push factor for upshift against aggression and engine speed\r\n" /end ANNOTATION_TEXT
 /end ANNOTATION
 /begin AXIS_DESCR STD_AXIS NO_INPUT_QUANTITY RB_PT_PCT_SWC_DWC_CompuMethods_ratio_0p01 6 -1. 1. FORMAT "%10.5" DEPOSIT ABSOLUTE /end AXIS_DESCR
 /begin AXIS_DESCR STD_AXIS NO_INPUT_QUANTITY RB_PT_PCT_SWC_DWC_CompuMethods_ident 7 0.0 11. FORMAT "%10.5" DEPOSIT ABSOLUTE /end AXIS_DESCR
/end CHARACTERISTIC
/begin CHARACTERISTIC DWC_EFLASHB.DWC_SpeedPhaseControl.DWC_MaxGradient.DWC_UPSHIFTGRADIENT1 "" MAP 0x8060AE14 RB_PT_PCT_SWC_DWC_RecordLayouts_RL_Map_sint16_49_uint16_7_sint8_7 64000.0 RB_PT_PCT_SWC_DWC_CompuMethods_ident -32000. 32000. FORMAT "%10.5"
 /begin ANNOTATION ANNOTATION_LABEL "Description (coming from AUTOSAR DESC field)"
  /begin ANNOTATION_TEXT "Rate of change of slip (gradient) demand maximum target or time to complete speed phase\r\n" /end ANNOTATION_TEXT
 /end ANNOTATION
 /begin AXIS_DESCR STD_AXIS NO_INPUT_QUANTITY RB_PT_PCT_SWC_DWC_CompuMethods_ident 7 0.0 20000. FORMAT "%10.5" DEPOSIT ABSOLUTE /end AXIS_DESCR
 /begin AXIS_DESCR STD_AXIS NO_INPUT_QUANTITY RB_PT_PCT_SWC_DWC_CompuMethods_ident 7 -100. 100. FORMAT "%10.5" DEPOSIT ABSOLUTE /end AXIS_DESCR
/end CHARACTERISTIC
/begin CHARACTERISTIC DWC_EFLASHB.DWC_SpeedPhaseControl.DWC_MaxGradient.DWC_UPSHIFTGRADIENT2 "" MAP 0x8060AE90 RB_PT_PCT_SWC_DWC_RecordLayouts_RL_Map_sint16_49_uint16_7_sint8_7 64000.0 RB_PT_PCT_SWC_DWC_CompuMethods_ident -32000. 32000. FORMAT "%10.5"
 /begin ANNOTATION ANNOTATION_LABEL "Description (coming from AUTOSAR DESC field)"
  /begin ANNOTATION_TEXT "Rate of change of slip (gradient) demand maximum target or time to complete speed phase\r\n" /end ANNOTATION_TEXT
 /end ANNOTATION
 /begin AXIS_DESCR STD_AXIS NO_INPUT_QUANTITY RB_PT_PCT_SWC_DWC_CompuMethods_ident 7 0.0 20000. FORMAT "%10.5" DEPOSIT ABSOLUTE /end AXIS_DESCR
 /begin AXIS_DESCR STD_AXIS NO_INPUT_QUANTITY RB_PT_PCT_SWC_DWC_CompuMethods_ident 7 -100. 100. FORMAT "%10.5" DEPOSIT ABSOLUTE /end AXIS_DESCR
/end CHARACTERISTIC
/begin CHARACTERISTIC DWC_EFLASHB.DWC_SpeedPhaseControl.DWC_MaxGradient.DWC_UPSHIFTGRADIENT3 "" MAP 0x8060AF0C RB_PT_PCT_SWC_DWC_RecordLayouts_RL_Map_sint16_49_uint16_7_sint8_7 64000.0 RB_PT_PCT_SWC_DWC_CompuMethods_ident -32000. 32000. FORMAT "%10.5"
 /begin ANNOTATION ANNOTATION_LABEL "Description (coming from AUTOSAR DESC field)"
  /begin ANNOTATION_TEXT "Rate of change of slip (gradient) demand maximum target or time to complete speed phase\r\n" /end ANNOTATION_TEXT
 /end ANNOTATION
 /begin AXIS_DESCR STD_AXIS NO_INPUT_QUANTITY RB_PT_PCT_SWC_DWC_CompuMethods_ident 7 0.0 20000. FORMAT "%10.5" DEPOSIT ABSOLUTE /end AXIS_DESCR
 /begin AXIS_DESCR STD_AXIS NO_INPUT_QUANTITY RB_PT_PCT_SWC_DWC_CompuMethods_ident 7 -100. 100. FORMAT "%10.5" DEPOSIT ABSOLUTE /end AXIS_DESCR
/end CHARACTERISTIC
/begin CHARACTERISTIC DWC_EFLASHB.DWC_SpeedPhaseControl.DWC_MaxGradient.DWC_UPSHIFTGRADIENT4 "" MAP 0x8060AF88 RB_PT_PCT_SWC_DWC_RecordLayouts_RL_Map_sint16_49_uint16_7_sint8_7 64000.0 RB_PT_PCT_SWC_DWC_CompuMethods_ident -32000. 32000. FORMAT "%10.5"
 /begin ANNOTATION ANNOTATION_LABEL "Description (coming from AUTOSAR DESC field)"
  /begin ANNOTATION_TEXT "Rate of change of slip (gradient) demand maximum target or time to complete speed phase\r\n" /end ANNOTATION_TEXT
 /end ANNOTATION
 /begin AXIS_DESCR STD_AXIS NO_INPUT_QUANTITY RB_PT_PCT_SWC_DWC_CompuMethods_ident 7 0.0 20000. FORMAT "%10.5" DEPOSIT ABSOLUTE /end AXIS_DESCR
 /begin AXIS_DESCR STD_AXIS NO_INPUT_QUANTITY RB_PT_PCT_SWC_DWC_CompuMethods_ident 7 -100. 100. FORMAT "%10.5" DEPOSIT ABSOLUTE /end AXIS_DESCR
/end CHARACTERISTIC
/begin CHARACTERISTIC DWC_EFLASHB.DWC_SpeedPhaseControl.DWC_MaxGradient.DWC_UPSHIFTGRADIENTINDEXFACTOR "" MAP 0x8060B004 RB_PT_PCT_SWC_DWC_RecordLayouts_RL_Map_uint16_70_sint8_10_sint8_7 20.0 RB_PT_PCT_SWC_DWC_CompuMethods_ratio_0p1 0.0 20. FORMAT "%10.5"
 /begin ANNOTATION ANNOTATION_LABEL "Description (coming from AUTOSAR DESC field)"
  /begin ANNOTATION_TEXT "Map of factor for ushift gradient based on shift index and demand gear\r\n" /end ANNOTATION_TEXT
 /end ANNOTATION
 /begin AXIS_DESCR STD_AXIS NO_INPUT_QUANTITY RB_PT_PCT_SWC_DWC_CompuMethods_ratio_0p01 10 -1. 1. FORMAT "%10.5" DEPOSIT ABSOLUTE /end AXIS_DESCR
 /begin AXIS_DESCR STD_AXIS NO_INPUT_QUANTITY RB_PT_PCT_SWC_DWC_CompuMethods_ident 7 0.0 13. FORMAT "%10.5" DEPOSIT ABSOLUTE /end AXIS_DESCR
/end CHARACTERISTIC
/begin CHARACTERISTIC DWC_EFLASHB.DWC_SpeedPhaseControl.DWC_MaxGradient.DWC_UPSHIFTGRADIENTLAUNCH "" CURVE 0x8060B0A6 RB_PT_PCT_SWC_DWC_RecordLayouts_RL_Curve_sint16_11_uint8_11 64000.0 RB_PT_PCT_SWC_DWC_CompuMethods_ident -32000. 32000. FORMAT "%10.5"
 /begin ANNOTATION ANNOTATION_LABEL "Description (coming from AUTOSAR DESC field)" /begin ANNOTATION_TEXT "Rate of change engine speed - launch control\r\n" /end ANNOTATION_TEXT /end ANNOTATION
 /begin AXIS_DESCR STD_AXIS NO_INPUT_QUANTITY RB_PT_PCT_SWC_DWC_CompuMethods_ident 11 0.0 13. FORMAT "%10.5" DEPOSIT ABSOLUTE /end AXIS_DESCR
/end CHARACTERISTIC
/begin CHARACTERISTIC DWC_EFLASHB.DWC_SpeedPhaseControl.DWC_MaxGradient.DWC_UPSHIFTGRADIENTMAPSELECT "" VAL_BLK 0x8060AB1E DefaultValueRecordLayout_AUTOSAR_Platform_BaseTypes_uint8 3.0 RB_PT_PCT_SWC_DWC_CompuMethods_ident 1. 4. FORMAT "%10.5"
 /begin ANNOTATION ANNOTATION_LABEL "Description (coming from AUTOSAR DESC field)"
  /begin ANNOTATION_TEXT "Array of upshift gradient map to select vs. DWC-ShiftModeUDisc\r\n" /end ANNOTATION_TEXT
 /end ANNOTATION
 MATRIX_DIM 8 1 1 /end CHARACTERISTIC
/begin CHARACTERISTIC DWC_EFLASHB.DWC_SpeedPhaseControl.DWC_MaxGradient.DWC_UPSHIFTPUSHAGGMAXFACTLAUNCH "" VAL_BLK 0x8060AB06 DefaultValueRecordLayout_AUTOSAR_Platform_BaseTypes_uint16 1.0 RB_PT_PCT_SWC_DWC_CompuMethods_ratio_0p001__2 0.0 1. FORMAT "%10.5"
 /begin ANNOTATION ANNOTATION_LABEL "Description (coming from AUTOSAR DESC field)"
  /begin ANNOTATION_TEXT "Push factor at maximum aggression against demand gear\r\n" /end ANNOTATION_TEXT
 /end ANNOTATION
 MATRIX_DIM 12 1 1 /end CHARACTERISTIC
/begin CHARACTERISTIC DWC_EFLASHB.DWC_SpeedPhaseControl.DWC_SLCMICROSLIPTARGET "" VALUE 0x8060A64C DefaultValueRecordLayout_AUTOSAR_Platform_BaseTypes_sint16 40000.0 RB_PT_PCT_SWC_DWC_CompuMethods_ident -20000. 20000. FORMAT "%10.5"
 /begin ANNOTATION ANNOTATION_LABEL "Description (coming from AUTOSAR DESC field)" /begin ANNOTATION_TEXT "Target speed for microslip operation\r\n" /end ANNOTATION_TEXT /end ANNOTATION
/end CHARACTERISTIC
/begin CHARACTERISTIC DWC_EFLASHB.DWC_SpeedPhaseControl.DWC_SlipTargetCalc.DWC_DOWNSHIFTCORRECTIONRATIO "" CURVE 0x8060B0CC RB_PT_PCT_SWC_DWC_RecordLayouts_RL_Curve_uint16_5_uint16_5 1.0 RB_PT_PCT_SWC_DWC_CompuMethods_ratio_0p001__2 0.0 1. FORMAT "%10.5"
 /begin ANNOTATION ANNOTATION_LABEL "Description (coming from AUTOSAR DESC field)"
  /begin ANNOTATION_TEXT "Coming input shaft rate of change correction factor to apply to speed phase gradient. Input ratio approaches 1 as coming shaft is approached.\r\n" /end ANNOTATION_TEXT
 /end ANNOTATION
 /begin AXIS_DESCR STD_AXIS NO_INPUT_QUANTITY RB_PT_PCT_SWC_DWC_CompuMethods_ratio_0p001__2 5 0.0 1. FORMAT "%10.5" DEPOSIT ABSOLUTE /end AXIS_DESCR
/end CHARACTERISTIC
/begin CHARACTERISTIC DWC_EFLASHB.DWC_SpeedPhaseControl.DWC_SlipTargetCalc.DWC_FINALSLIPVSTORQUEOFFGOINGDOWN "" CURVE 0x8060B0E2 RB_PT_PCT_SWC_DWC_RecordLayouts_RL_Curve_sint16_5_sint16_5 40000.0 RB_PT_PCT_SWC_DWC_CompuMethods_ident -20000. 20000. FORMAT "%10.5"
 /begin ANNOTATION ANNOTATION_LABEL "Description (coming from AUTOSAR DESC field)" /begin ANNOTATION_TEXT "Final slip offset vs engine torque for shift type\r\n" /end ANNOTATION_TEXT /end ANNOTATION
 /begin AXIS_DESCR STD_AXIS NO_INPUT_QUANTITY RB_PT_PCT_SWC_DWC_CompuMethods_ratio_0p1 5 -2000. 2000. FORMAT "%10.5" DEPOSIT ABSOLUTE /end AXIS_DESCR
/end CHARACTERISTIC
/begin CHARACTERISTIC DWC_EFLASHB.DWC_SpeedPhaseControl.DWC_SlipTargetCalc.DWC_FINALSLIPVSTORQUEOFFGOINGUP "" CURVE 0x8060B0F8 RB_PT_PCT_SWC_DWC_RecordLayouts_RL_Curve_sint16_5_sint16_5 40000.0 RB_PT_PCT_SWC_DWC_CompuMethods_ident -20000. 20000. FORMAT "%10.5"
 /begin ANNOTATION ANNOTATION_LABEL "Description (coming from AUTOSAR DESC field)" /begin ANNOTATION_TEXT "Final slip offset vs engine torque for shift type\r\n" /end ANNOTATION_TEXT /end ANNOTATION
 /begin AXIS_DESCR STD_AXIS NO_INPUT_QUANTITY RB_PT_PCT_SWC_DWC_CompuMethods_ratio_0p1 5 -2000. 2000. FORMAT "%10.5" DEPOSIT ABSOLUTE /end AXIS_DESCR
/end CHARACTERISTIC
/begin CHARACTERISTIC DWC_EFLASHB.DWC_SpeedPhaseControl.DWC_SlipTargetCalc.DWC_FINALSLIPVSTORQUEONCOMINGDOWN "" CURVE 0x8060B10E RB_PT_PCT_SWC_DWC_RecordLayouts_RL_Curve_sint16_5_sint16_5 40000.0 RB_PT_PCT_SWC_DWC_CompuMethods_ident -20000. 20000. FORMAT "%10.5"
 /begin ANNOTATION ANNOTATION_LABEL "Description (coming from AUTOSAR DESC field)" /begin ANNOTATION_TEXT "Final slip offset vs engine torque for shift type\r\n" /end ANNOTATION_TEXT /end ANNOTATION
 /begin AXIS_DESCR STD_AXIS NO_INPUT_QUANTITY RB_PT_PCT_SWC_DWC_CompuMethods_ratio_0p1 5 -2000. 2000. FORMAT "%10.5" DEPOSIT ABSOLUTE /end AXIS_DESCR
/end CHARACTERISTIC
/begin CHARACTERISTIC DWC_EFLASHB.DWC_SpeedPhaseControl.DWC_SlipTargetCalc.DWC_FINALSLIPVSTORQUEONCOMINGUP "" CURVE 0x8060B124 RB_PT_PCT_SWC_DWC_RecordLayouts_RL_Curve_sint16_5_sint16_5 40000.0 RB_PT_PCT_SWC_DWC_CompuMethods_ident -20000. 20000. FORMAT "%10.5"
 /begin ANNOTATION ANNOTATION_LABEL "Description (coming from AUTOSAR DESC field)" /begin ANNOTATION_TEXT "Final slip offset vs engine torque for shift type\r\n" /end ANNOTATION_TEXT /end ANNOTATION
 /begin AXIS_DESCR STD_AXIS NO_INPUT_QUANTITY RB_PT_PCT_SWC_DWC_CompuMethods_ratio_0p1 5 -2000. 2000. FORMAT "%10.5" DEPOSIT ABSOLUTE /end AXIS_DESCR
/end CHARACTERISTIC
/begin CHARACTERISTIC DWC_EFLASHB.DWC_SpeedPhaseControl.DWC_SlipTargetCalc.DWC_OFFGOINGDOWNBYPASSINPUTSPEED "" VALUE 0x8060B0CA DefaultValueRecordLayout_AUTOSAR_Platform_BaseTypes_boolean 255.0 AUTOSAR_Platform_CompuMethods_boolean 0.0 255. FORMAT "%10.5"
 /begin ANNOTATION ANNOTATION_LABEL "Description (coming from AUTOSAR DESC field)"
  /begin ANNOTATION_TEXT "Flag to prevent final target shaft speed from including input shaft speed\r\n" /end ANNOTATION_TEXT
 /end ANNOTATION
/end CHARACTERISTIC
/begin CHARACTERISTIC DWC_EFLASHB.DWC_SpeedPhaseControl.DWC_SlipTargetCalc.DWC_UPSHIFTCORRECTIONRATIO "" CURVE 0x8060B13A RB_PT_PCT_SWC_DWC_RecordLayouts_RL_Curve_uint16_5_uint16_5 1.0 RB_PT_PCT_SWC_DWC_CompuMethods_ratio_0p001__2 0.0 1. FORMAT "%10.5"
 /begin ANNOTATION ANNOTATION_LABEL "Description (coming from AUTOSAR DESC field)"
  /begin ANNOTATION_TEXT "Coming input shaft rate of change correction factor to apply to speed phase gradient. Input ratio approaches 1 as coming shaft is approached.\r\n" /end ANNOTATION_TEXT
 /end ANNOTATION
 /begin AXIS_DESCR STD_AXIS NO_INPUT_QUANTITY RB_PT_PCT_SWC_DWC_CompuMethods_ratio_0p001__2 5 0.0 1. FORMAT "%10.5" DEPOSIT ABSOLUTE /end AXIS_DESCR
/end CHARACTERISTIC
/begin CHARACTERISTIC DWC_EFLASHB.DWC_SpeedPhaseControl.DWC_SlipTargetCalc.DWC_UPSHIFTCORRECTIONRATIOGT "" CURVE 0x8060B150 RB_PT_PCT_SWC_DWC_RecordLayouts_RL_Curve_uint16_5_uint16_5 1.0 RB_PT_PCT_SWC_DWC_CompuMethods_ratio_0p001__2 0.0 1. FORMAT "%10.5"
 /begin ANNOTATION ANNOTATION_LABEL "Description (coming from AUTOSAR DESC field)"
  /begin ANNOTATION_TEXT "Coming input shaft rate of change correction factor to apply to speed phase gradient for GT style shifts. Input ratio approaches 1 as coming shaft is approached\r\n" /end ANNOTATION_TEXT
 /end ANNOTATION
 /begin AXIS_DESCR STD_AXIS NO_INPUT_QUANTITY RB_PT_PCT_SWC_DWC_CompuMethods_ratio_0p001__2 5 0.0 1. FORMAT "%10.5" DEPOSIT ABSOLUTE /end AXIS_DESCR
/end CHARACTERISTIC
/begin CHARACTERISTIC DWC_EFLASHB.DWC_SpeedPhaseControl.DWC_SlipTargetCalc.DWC_USEFILTEREDINPUTSPEEDFORTARGET "" VALUE 0x8060B0CB DefaultValueRecordLayout_AUTOSAR_Platform_BaseTypes_boolean 255.0 AUTOSAR_Platform_CompuMethods_boolean 0.0 255. FORMAT "%10.5"
 /begin ANNOTATION ANNOTATION_LABEL "Description (coming from AUTOSAR DESC field)"
  /begin ANNOTATION_TEXT "Flag to use input shaft speeds filtered for target speeds\r\n" /end ANNOTATION_TEXT
 /end ANNOTATION
/end CHARACTERISTIC
/begin CHARACTERISTIC DWC_EFLASHB.DWC_SpeedPhaseControl.DWC_SpeedPhaseRules.BOB_SPEEDPHASETYPE "" VALUE 0x8060B174 DefaultValueRecordLayout_AUTOSAR_Platform_BaseTypes_uint8 6.0 RB_PT_PCT_SWC_DWC_CompuMethods_Enumerations_DWC_SpeedPhaseType 0.0 6. FORMAT "%10.5"
 /begin ANNOTATION ANNOTATION_LABEL "Description (coming from AUTOSAR DESC field)" /begin ANNOTATION_TEXT "Calibrated forced speed phase type\r\n" /end ANNOTATION_TEXT /end ANNOTATION
/end CHARACTERISTIC
/begin CHARACTERISTIC DWC_EFLASHB.DWC_SpeedPhaseControl.DWC_SpeedPhaseRules.DWC_BYPASSOVERINPUTSPEEDOFFGOINGDOWN "" VALUE 0x8060B175 DefaultValueRecordLayout_AUTOSAR_Platform_BaseTypes_boolean 255.0 AUTOSAR_Platform_CompuMethods_boolean 0.0 255. FORMAT "%10.5"
 /begin ANNOTATION ANNOTATION_LABEL "Description (coming from AUTOSAR DESC field)"
  /begin ANNOTATION_TEXT "Flag to force bypass check for engine over opposite shaft speed\r\n" /end ANNOTATION_TEXT
 /end ANNOTATION
/end CHARACTERISTIC
/begin CHARACTERISTIC DWC_EFLASHB.DWC_SpeedPhaseControl.DWC_SpeedPhaseRules.DWC_BYPASSOVERINPUTSPEEDONCOMINGDOWN "" VALUE 0x8060B176 DefaultValueRecordLayout_AUTOSAR_Platform_BaseTypes_boolean 255.0 AUTOSAR_Platform_CompuMethods_boolean 0.0 255. FORMAT "%10.5"
 /begin ANNOTATION ANNOTATION_LABEL "Description (coming from AUTOSAR DESC field)"
  /begin ANNOTATION_TEXT "Flag to force bypass check for input speed over final target setpoint\r\n" /end ANNOTATION_TEXT
 /end ANNOTATION
/end CHARACTERISTIC
/begin CHARACTERISTIC DWC_EFLASHB.DWC_SpeedPhaseControl.DWC_SpeedPhaseRules.DWC_BYPASSSLIPTARGETCHECKOFFGOINGDOWN "" VALUE 0x8060B177 DefaultValueRecordLayout_AUTOSAR_Platform_BaseTypes_boolean 255.0 AUTOSAR_Platform_CompuMethods_boolean 0.0 255. FORMAT "%10.5"
 /begin ANNOTATION ANNOTATION_LABEL "Description (coming from AUTOSAR DESC field)"
  /begin ANNOTATION_TEXT "Flag to force bypass of slip target check on speed phase\r\n" /end ANNOTATION_TEXT
 /end ANNOTATION
/end CHARACTERISTIC
/begin CHARACTERISTIC DWC_EFLASHB.DWC_SpeedPhaseControl.DWC_SpeedPhaseRules.DWC_INERTIAUPTARGET "" VALUE 0x8060B166 DefaultValueRecordLayout_AUTOSAR_Platform_BaseTypes_uint16 20000.0 RB_PT_PCT_SWC_DWC_CompuMethods_ident 0.0 20000. FORMAT "%10.5"
 /begin ANNOTATION ANNOTATION_LABEL "Description (coming from AUTOSAR DESC field)" /begin ANNOTATION_TEXT "Target slip for inertia up shift\r\n" /end ANNOTATION_TEXT /end ANNOTATION
/end CHARACTERISTIC
/begin CHARACTERISTIC DWC_EFLASHB.DWC_SpeedPhaseControl.DWC_SpeedPhaseRules.DWC_OFFGOINGDOWNTARGETMARGIN "" VALUE 0x8060B168 DefaultValueRecordLayout_AUTOSAR_Platform_BaseTypes_uint16 20000.0 RB_PT_PCT_SWC_DWC_CompuMethods_ident 0.0 20000. FORMAT "%10.5"
 /begin ANNOTATION ANNOTATION_LABEL "Description (coming from AUTOSAR DESC field)" /begin ANNOTATION_TEXT "Offgoing down undershoot margin for completion\r\n" /end ANNOTATION_TEXT /end ANNOTATION
/end CHARACTERISTIC
/begin CHARACTERISTIC DWC_EFLASHB.DWC_SpeedPhaseControl.DWC_SpeedPhaseRules.DWC_OFFGOINGDOWNTARGETMARGINOVERINPUT "" VALUE 0x8060B16A DefaultValueRecordLayout_AUTOSAR_Platform_BaseTypes_uint16 20000.0 RB_PT_PCT_SWC_DWC_CompuMethods_ident 0.0 20000. FORMAT "%10.5"
 /begin ANNOTATION ANNOTATION_LABEL "Description (coming from AUTOSAR DESC field)"
  /begin ANNOTATION_TEXT "Offgoing down undershoot margin for completion - over input speed rule\r\n" /end ANNOTATION_TEXT
 /end ANNOTATION
/end CHARACTERISTIC
/begin CHARACTERISTIC DWC_EFLASHB.DWC_SpeedPhaseControl.DWC_SpeedPhaseRules.DWC_OFFGOINGDOWNTARGETWINDOW "" VALUE 0x8060B16C DefaultValueRecordLayout_AUTOSAR_Platform_BaseTypes_uint16 20000.0 RB_PT_PCT_SWC_DWC_CompuMethods_ident 0.0 20000. FORMAT "%10.5"
 /begin ANNOTATION ANNOTATION_LABEL "Description (coming from AUTOSAR DESC field)" /begin ANNOTATION_TEXT "Target speed window for power on down\r\n" /end ANNOTATION_TEXT /end ANNOTATION
/end CHARACTERISTIC
/begin CHARACTERISTIC DWC_EFLASHB.DWC_SpeedPhaseControl.DWC_SpeedPhaseRules.DWC_OFFGOINGDOWNTORQUEDELAY "" VALUE 0x8060B16E DefaultValueRecordLayout_AUTOSAR_Platform_BaseTypes_uint16 10.0 RB_PT_PCT_SWC_DWC_CompuMethods_ratio_0p001__2 0.0 10. FORMAT "%10.5"
 /begin ANNOTATION ANNOTATION_LABEL "Description (coming from AUTOSAR DESC field)" /begin ANNOTATION_TEXT "Time delay of oncoming clutch during power on down\r\n" /end ANNOTATION_TEXT /end ANNOTATION
/end CHARACTERISTIC
/begin CHARACTERISTIC DWC_EFLASHB.DWC_SpeedPhaseControl.DWC_SpeedPhaseRules.DWC_OFFGOINGUPTARGETWINDOW "" VALUE 0x8060B170 DefaultValueRecordLayout_AUTOSAR_Platform_BaseTypes_uint16 20000.0 RB_PT_PCT_SWC_DWC_CompuMethods_ident 0.0 20000. FORMAT "%10.5"
 /begin ANNOTATION ANNOTATION_LABEL "Description (coming from AUTOSAR DESC field)" /begin ANNOTATION_TEXT "Target speed window for power off up (single clutch)\r\n" /end ANNOTATION_TEXT /end ANNOTATION
/end CHARACTERISTIC
/begin CHARACTERISTIC DWC_EFLASHB.DWC_SpeedPhaseControl.DWC_SpeedPhaseRules.DWC_ONCOMINGDOWNTARGET "" VALUE 0x8060B172 DefaultValueRecordLayout_AUTOSAR_Platform_BaseTypes_uint16 20000.0 RB_PT_PCT_SWC_DWC_CompuMethods_ident 0.0 20000. FORMAT "%10.5"
 /begin ANNOTATION ANNOTATION_LABEL "Description (coming from AUTOSAR DESC field)" /begin ANNOTATION_TEXT "Target slip for oncoming down shift\r\n" /end ANNOTATION_TEXT /end ANNOTATION
/end CHARACTERISTIC
/begin CHARACTERISTIC DWC_EFLASHB.DWC_SpeedPhaseControl.DWC_SpeedPhaseRules.DWC_ONCOMINGUPTARGET "" MAP 0x8060B17A RB_PT_PCT_SWC_DWC_RecordLayouts_RL_Map_uint16_36_sint16_6_sint16_6 20000.0 RB_PT_PCT_SWC_DWC_CompuMethods_ident 0.0 20000. FORMAT "%10.5"
 /begin ANNOTATION ANNOTATION_LABEL "Description (coming from AUTOSAR DESC field)" /begin ANNOTATION_TEXT "Slip actual for completion of upshifts (power on)\r\n" /end ANNOTATION_TEXT /end ANNOTATION
 /begin AXIS_DESCR STD_AXIS NO_INPUT_QUANTITY RB_PT_PCT_SWC_DWC_CompuMethods_ident 6 -32000. 32000. FORMAT "%10.5" DEPOSIT ABSOLUTE /end AXIS_DESCR
 /begin AXIS_DESCR STD_AXIS NO_INPUT_QUANTITY RB_PT_PCT_SWC_DWC_CompuMethods_ident 6 0.0 20000. FORMAT "%10.5" DEPOSIT ABSOLUTE /end AXIS_DESCR
/end CHARACTERISTIC
/begin CHARACTERISTIC DWC_EFLASHB.DWC_SpeedPhaseControl.DWC_SpeedPhaseRules.DWC_ONCOMINGUPTARGETTQDN "" CURVE 0x8060B1DE RB_PT_PCT_SWC_DWC_RecordLayouts_RL_Curve_uint16_5_uint16_5 20000.0 RB_PT_PCT_SWC_DWC_CompuMethods_ident 0.0 20000. FORMAT "%10.5"
 /begin ANNOTATION ANNOTATION_LABEL "Description (coming from AUTOSAR DESC field)"
  /begin ANNOTATION_TEXT "Slip actual for completion of oncoming up - torque down completed\r\n" /end ANNOTATION_TEXT
 /end ANNOTATION
 /begin AXIS_DESCR STD_AXIS NO_INPUT_QUANTITY RB_PT_PCT_SWC_DWC_CompuMethods_ident 5 0.0 20000. FORMAT "%10.5" DEPOSIT ABSOLUTE /end AXIS_DESCR
/end CHARACTERISTIC
/begin CHARACTERISTIC DWC_EFLASHB.DWC_SpeedPhaseControl.DWC_SpeedPhaseRules.DWC_USENORMALPOWEROFFUP "" VALUE 0x8060B178 DefaultValueRecordLayout_AUTOSAR_Platform_BaseTypes_boolean 255.0 AUTOSAR_Platform_CompuMethods_boolean 0.0 255. FORMAT "%10.5"
 /begin ANNOTATION ANNOTATION_LABEL "Description (coming from AUTOSAR DESC field)"
  /begin ANNOTATION_TEXT "Flag to use conventional power off up type, as opposed to inertia cancel type\r\n" /end ANNOTATION_TEXT
 /end ANNOTATION
/end CHARACTERISTIC
/begin CHARACTERISTIC DWC_EFLASHB.DWC_SpeedPhaseControl.DWC_SPHCCLUTCHDELAY "" VALUE 0x8060A64F DefaultValueRecordLayout_AUTOSAR_Platform_BaseTypes_uint8 0.1 RB_PT_PCT_SWC_DWC_CompuMethods_ratio_0p001__2 0.0 0.1 FORMAT "%10.5"
 /begin ANNOTATION ANNOTATION_LABEL "Description (coming from AUTOSAR DESC field)" /begin ANNOTATION_TEXT "Reaction delay of clutch\r\n" /end ANNOTATION_TEXT /end ANNOTATION
/end CHARACTERISTIC
/begin CHARACTERISTIC DWC_EFLASHB.DWC_SpeedPhaseControl.DWC_USEFILTEREDINPUTSPEEDS "" VALUE 0x8060A650 DefaultValueRecordLayout_AUTOSAR_Platform_BaseTypes_boolean 255.0 AUTOSAR_Platform_CompuMethods_boolean 0.0 255. FORMAT "%10.5"
 /begin ANNOTATION ANNOTATION_LABEL "Description (coming from AUTOSAR DESC field)"
  /begin ANNOTATION_TEXT "Flag to request using filtered input speeds for targets\r\n" /end ANNOTATION_TEXT
 /end ANNOTATION
/end CHARACTERISTIC
/begin CHARACTERISTIC DWC_EFLASHB.DWC_SpeedPhaseControl.DWC_USEFILTEREDINPUTSPEEDSUPSHIFT "" VALUE 0x8060A651 DefaultValueRecordLayout_AUTOSAR_Platform_BaseTypes_boolean 255.0 AUTOSAR_Platform_CompuMethods_boolean 0.0 255. FORMAT "%10.5"
 /begin ANNOTATION ANNOTATION_LABEL "Description (coming from AUTOSAR DESC field)"
  /begin ANNOTATION_TEXT "Flag to request using filtered input speeds for targets - for upshifts\r\n" /end ANNOTATION_TEXT
 /end ANNOTATION
/end CHARACTERISTIC
/begin CHARACTERISTIC DWC_EFLASHB.DWC_StatusMux.DWC_BOBFORCEFAILURE "" VALUE 0x8060B264 DefaultValueRecordLayout_AUTOSAR_Platform_BaseTypes_uint32 4.294967295E9 RB_PT_PCT_SWC_DWC_CompuMethods_ident 0.0 4.294967295E9 FORMAT "%10.5"
 /begin ANNOTATION ANNOTATION_LABEL "Description (coming from AUTOSAR DESC field)"
  /begin ANNOTATION_TEXT "Bit mask to apply to return value to allow forced failure for testing\r\n" /end ANNOTATION_TEXT
 /end ANNOTATION
/end CHARACTERISTIC
/begin CHARACTERISTIC DWC_EFLASHB.DWC_StatusMux.DWC_BOBMASKFAILURE "" VALUE 0x8060B268 DefaultValueRecordLayout_AUTOSAR_Platform_BaseTypes_uint32 4.294967295E9 RB_PT_PCT_SWC_DWC_CompuMethods_ident 0.0 4.294967295E9 FORMAT "%10.5"
 /begin ANNOTATION ANNOTATION_LABEL "Description (coming from AUTOSAR DESC field)"
  /begin ANNOTATION_TEXT "Bit mask to apply to return value to allow forced failure for testing\r\n" /end ANNOTATION_TEXT
 /end ANNOTATION
/end CHARACTERISTIC
/begin CHARACTERISTIC DWC_EFLASHB.DWC_TEMPWARNTHRESHDECDELTA "" VALUE 0x8060982C DefaultValueRecordLayout_AUTOSAR_Platform_BaseTypes_sint16 250.0 RB_PT_PCT_SWC_DWC_CompuMethods_ratio_0p05 -50. 200. FORMAT "%10.5"
 /begin ANNOTATION ANNOTATION_LABEL "Description (coming from AUTOSAR DESC field)" /begin ANNOTATION_TEXT "Temperature delta increase rate\r\n" /end ANNOTATION_TEXT /end ANNOTATION
/end CHARACTERISTIC
/begin CHARACTERISTIC DWC_EFLASHB.DWC_TEMPWARNTHRESHINCDELTA "" VALUE 0x8060982E DefaultValueRecordLayout_AUTOSAR_Platform_BaseTypes_sint16 250.0 RB_PT_PCT_SWC_DWC_CompuMethods_ratio_0p05 -50. 200. FORMAT "%10.5"
 /begin ANNOTATION ANNOTATION_LABEL "Description (coming from AUTOSAR DESC field)" /begin ANNOTATION_TEXT "Temperature delta increase rate\r\n" /end ANNOTATION_TEXT /end ANNOTATION
/end CHARACTERISTIC
/begin CHARACTERISTIC DWC_EFLASHB.DWC_TorqueControl.DWC_ALLOWFILTEREDSLIPGLOBAL "" VALUE 0x8060B468 DefaultValueRecordLayout_AUTOSAR_Platform_BaseTypes_boolean 255.0 AUTOSAR_Platform_CompuMethods_boolean 0.0 255. FORMAT "%10.5"
 /begin ANNOTATION ANNOTATION_LABEL "Description (coming from AUTOSAR DESC field)"
  /begin ANNOTATION_TEXT "Flag to allow the use of filtered slip on all areas of a shift\r\n" /end ANNOTATION_TEXT
 /end ANNOTATION
/end CHARACTERISTIC
/begin CHARACTERISTIC DWC_EFLASHB.DWC_TorqueControl.DWC_AMTTRANSMISSIONRULES "" VALUE 0x8060B469 DefaultValueRecordLayout_AUTOSAR_Platform_BaseTypes_boolean 255.0 AUTOSAR_Platform_CompuMethods_boolean 0.0 255. FORMAT "%10.5"
 /begin ANNOTATION ANNOTATION_LABEL "Description (coming from AUTOSAR DESC field)"
  /begin ANNOTATION_TEXT "Flag to use new rules for slip target (look out for power on up/power off down)\r\n" /end ANNOTATION_TEXT
 /end ANNOTATION
/end CHARACTERISTIC
/begin CHARACTERISTIC DWC_EFLASHB.DWC_TorqueControl.DWC_ASGDOWNASSISTENGAGERATEMAP "" MAP 0x8060C7FC RB_PT_PCT_SWC_DWC_RecordLayouts_RL_Map_uint16_40_sint16_5_sint16_8 2000.0 RB_PT_PCT_SWC_DWC_CompuMethods_ratio_0p1 0.0 2000. FORMAT "%10.5"
 /begin ANNOTATION ANNOTATION_LABEL "Description (coming from AUTOSAR DESC field)" /begin ANNOTATION_TEXT "Raw ASG down fill torque for clutch assisted shifts\r\n" /end ANNOTATION_TEXT /end ANNOTATION
 /begin AXIS_DESCR STD_AXIS NO_INPUT_QUANTITY RB_PT_PCT_SWC_DWC_CompuMethods_ident 5 -100. 100. FORMAT "%10.5" DEPOSIT ABSOLUTE /end AXIS_DESCR
 /begin AXIS_DESCR STD_AXIS NO_INPUT_QUANTITY RB_PT_PCT_SWC_DWC_CompuMethods_ident 8 0.0 20000. FORMAT "%10.5" DEPOSIT ABSOLUTE /end AXIS_DESCR
/end CHARACTERISTIC
/begin CHARACTERISTIC DWC_EFLASHB.DWC_TorqueControl.DWC_ASGDOWNASSISTFILLTORQUELIMIT "" MAP 0x8060C86A RB_PT_PCT_SWC_DWC_RecordLayouts_RL_Map_sint16_28_sint16_7_sint16_4 4000.0 RB_PT_PCT_SWC_DWC_CompuMethods_ratio_0p1 -2000. 2000. FORMAT "%10.5"
 /begin ANNOTATION ANNOTATION_LABEL "Description (coming from AUTOSAR DESC field)"
  /begin ANNOTATION_TEXT "Limitation of ASG assist fill torque level as function of target gear and bulk oil temperature\r\n" /end ANNOTATION_TEXT
 /end ANNOTATION
 /begin AXIS_DESCR STD_AXIS NO_INPUT_QUANTITY RB_PT_PCT_SWC_DWC_CompuMethods_ident 7 0.0 11. FORMAT "%10.5" DEPOSIT ABSOLUTE /end AXIS_DESCR
 /begin AXIS_DESCR STD_AXIS NO_INPUT_QUANTITY RB_PT_PCT_SWC_DWC_CompuMethods_ident 4 -50. 200. FORMAT "%10.5" DEPOSIT ABSOLUTE /end AXIS_DESCR
/end CHARACTERISTIC
/begin CHARACTERISTIC DWC_EFLASHB.DWC_TorqueControl.DWC_ASGDOWNASSISTFILLTORQUEMAP "" MAP 0x8060C8BC RB_PT_PCT_SWC_DWC_RecordLayouts_RL_Map_sint16_40_sint16_5_sint16_8 4000.0 RB_PT_PCT_SWC_DWC_CompuMethods_ratio_0p1 -2000. 2000. FORMAT "%10.5"
 /begin ANNOTATION ANNOTATION_LABEL "Description (coming from AUTOSAR DESC field)" /begin ANNOTATION_TEXT "Raw ASG down fill torque for clutch assisted shifts\r\n" /end ANNOTATION_TEXT /end ANNOTATION
 /begin AXIS_DESCR STD_AXIS NO_INPUT_QUANTITY RB_PT_PCT_SWC_DWC_CompuMethods_ident 5 -100. 100. FORMAT "%10.5" DEPOSIT ABSOLUTE /end AXIS_DESCR
 /begin AXIS_DESCR STD_AXIS NO_INPUT_QUANTITY RB_PT_PCT_SWC_DWC_CompuMethods_ident 8 0.0 20000. FORMAT "%10.5" DEPOSIT ABSOLUTE /end AXIS_DESCR
/end CHARACTERISTIC
/begin CHARACTERISTIC DWC_EFLASHB.DWC_TorqueControl.DWC_ASSISTCALTP "" VALUE 0x8060B46A DefaultValueRecordLayout_AUTOSAR_Platform_BaseTypes_boolean 255.0 AUTOSAR_Platform_CompuMethods_boolean 0.0 255. FORMAT "%10.5"
 /begin ANNOTATION ANNOTATION_LABEL "Description (coming from AUTOSAR DESC field)"
  /begin ANNOTATION_TEXT "Flag to watch oncoming clutch torque to assist calibration of fill\r\n" /end ANNOTATION_TEXT
 /end ANNOTATION
/end CHARACTERISTIC
/begin CHARACTERISTIC DWC_EFLASHB.DWC_TorqueControl.DWC_ASSISTFACTORGEAR "" CURVE 0x8060C92A RB_PT_PCT_SWC_DWC_RecordLayouts_RL_Curve_uint16_12_uint8_12 10.0 RB_PT_PCT_SWC_DWC_CompuMethods_ratio_0p1 0.0 10. FORMAT "%10.5"
 /begin ANNOTATION ANNOTATION_LABEL "Description (coming from AUTOSAR DESC field)"
  /begin ANNOTATION_TEXT "Factor to apply to raw fill torque during clutch assited ASG shifts as a function of target gear\r\n" /end ANNOTATION_TEXT
 /end ANNOTATION
 /begin AXIS_DESCR STD_AXIS NO_INPUT_QUANTITY RB_PT_PCT_SWC_DWC_CompuMethods_ident 12 0.0 11. FORMAT "%10.5" DEPOSIT ABSOLUTE /end AXIS_DESCR
/end CHARACTERISTIC
/begin CHARACTERISTIC DWC_EFLASHB.DWC_TorqueControl.DWC_ASSISTFACTORMODE "" CURVE 0x8060C950 RB_PT_PCT_SWC_DWC_RecordLayouts_RL_Curve_uint16_8_uint8_8 10.0 RB_PT_PCT_SWC_DWC_CompuMethods_ratio_0p1 0.0 10. FORMAT "%10.5"
 /begin ANNOTATION ANNOTATION_LABEL "Description (coming from AUTOSAR DESC field)"
  /begin ANNOTATION_TEXT "Factor to apply to raw fill torque during clutch assited ASG shifts as a function of mode\r\n" /end ANNOTATION_TEXT
 /end ANNOTATION
 /begin AXIS_DESCR STD_AXIS NO_INPUT_QUANTITY RB_PT_PCT_SWC_DWC_CompuMethods_ident 8 0.0 7. FORMAT "%10.5" DEPOSIT ABSOLUTE /end AXIS_DESCR
/end CHARACTERISTIC
/begin CHARACTERISTIC DWC_EFLASHB.DWC_TorqueControl.DWC_BOBFORCEWSCACTIVE "" VALUE 0x8060B46B DefaultValueRecordLayout_AUTOSAR_Platform_BaseTypes_boolean 255.0 AUTOSAR_Platform_CompuMethods_boolean 0.0 255. FORMAT "%10.5"
 /begin ANNOTATION ANNOTATION_LABEL "Description (coming from AUTOSAR DESC field)" /begin ANNOTATION_TEXT "Flag to force WSC functions to active for testing\r\n" /end ANNOTATION_TEXT /end ANNOTATION
/end CHARACTERISTIC
/begin CHARACTERISTIC DWC_EFLASHB.DWC_TorqueControl.DWC_BYPASSOVERLAPSPEEDCHECK "" VALUE 0x8060B46C DefaultValueRecordLayout_AUTOSAR_Platform_BaseTypes_boolean 255.0 AUTOSAR_Platform_CompuMethods_boolean 0.0 255. FORMAT "%10.5"
 /begin ANNOTATION ANNOTATION_LABEL "Description (coming from AUTOSAR DESC field)"
  /begin ANNOTATION_TEXT "Flag to bypass check on engine speed for overlap torque phase\r\n" /end ANNOTATION_TEXT
 /end ANNOTATION
/end CHARACTERISTIC
/begin CHARACTERISTIC DWC_EFLASHB.DWC_TorqueControl.DWC_CancelInertia.DWC_DOMINANTCANCELRATE "" VALUE 0x8060B4F4 DefaultValueRecordLayout_AUTOSAR_Platform_BaseTypes_uint16 2000.0 RB_PT_PCT_SWC_DWC_CompuMethods_ratio_0p1 0.0 2000. FORMAT "%10.5"
 /begin ANNOTATION ANNOTATION_LABEL "Description (coming from AUTOSAR DESC field)" /begin ANNOTATION_TEXT "Rate of decrease of dominant torque\r\n" /end ANNOTATION_TEXT /end ANNOTATION
/end CHARACTERISTIC
/begin CHARACTERISTIC DWC_EFLASHB.DWC_TorqueControl.DWC_CancelInertia.DWC_PASSIVECANCELRATE "" VALUE 0x8060B4F6 DefaultValueRecordLayout_AUTOSAR_Platform_BaseTypes_uint16 2000.0 RB_PT_PCT_SWC_DWC_CompuMethods_ratio_0p1 0.0 2000. FORMAT "%10.5"
 /begin ANNOTATION ANNOTATION_LABEL "Description (coming from AUTOSAR DESC field)" /begin ANNOTATION_TEXT "Rate of increase of passive torque\r\n" /end ANNOTATION_TEXT /end ANNOTATION
/end CHARACTERISTIC
/begin CHARACTERISTIC DWC_EFLASHB.DWC_TorqueControl.DWC_ClutchHysterisis.DWC_CHSENGINESPEEDABOVEIDLEHYSTENABLE "" VALUE 0x8060B4F8 DefaultValueRecordLayout_AUTOSAR_Platform_BaseTypes_sint16 40000.0 RB_PT_PCT_SWC_DWC_CompuMethods_ident -20000. 20000. FORMAT "%10.5"
 /begin ANNOTATION ANNOTATION_LABEL "Description (coming from AUTOSAR DESC field)"
  /begin ANNOTATION_TEXT "Engine speed above idle speed before hysterisis compensation is enabled\r\n" /end ANNOTATION_TEXT
 /end ANNOTATION
/end CHARACTERISTIC
/begin CHARACTERISTIC DWC_EFLASHB.DWC_TorqueControl.DWC_ClutchHysterisis.DWC_CHSHYSTBANDCROSSINGGAINNEG "" VALUE 0x8060B4FC DefaultValueRecordLayout_AUTOSAR_Platform_BaseTypes_uint8 1.0 RB_PT_PCT_SWC_DWC_CompuMethods_ratio_0p01 0.0 1. FORMAT "%10.5"
 /begin ANNOTATION ANNOTATION_LABEL "Description (coming from AUTOSAR DESC field)"
  /begin ANNOTATION_TEXT "Hysterisis band crossing linear gain - falling torque demands\r\n" /end ANNOTATION_TEXT
 /end ANNOTATION
/end CHARACTERISTIC
/begin CHARACTERISTIC DWC_EFLASHB.DWC_TorqueControl.DWC_ClutchHysterisis.DWC_CHSHYSTBANDCROSSINGGAINPOS "" VALUE 0x8060B4FD DefaultValueRecordLayout_AUTOSAR_Platform_BaseTypes_uint8 1.0 RB_PT_PCT_SWC_DWC_CompuMethods_ratio_0p01 0.0 1. FORMAT "%10.5"
 /begin ANNOTATION ANNOTATION_LABEL "Description (coming from AUTOSAR DESC field)"
  /begin ANNOTATION_TEXT "Hysterisis band crossing linear gain - Rising torque demands\r\n" /end ANNOTATION_TEXT
 /end ANNOTATION
/end CHARACTERISTIC
/begin CHARACTERISTIC DWC_EFLASHB.DWC_TorqueControl.DWC_ClutchHysterisis.DWC_CHSHYSTERESISMAXINFLUENCE "" CURVE 0x8060B500 RB_PT_PCT_SWC_DWC_RecordLayouts_RL_Curve_uint16_5_sint16_5 65.535 RB_PT_PCT_SWC_DWC_CompuMethods_ratio_0p001__2 0.0 65.535 FORMAT "%10.5"
 /begin ANNOTATION ANNOTATION_LABEL "Description (coming from AUTOSAR DESC field)" /begin ANNOTATION_TEXT "Maximum influence of hysterisis for clutch\r\n" /end ANNOTATION_TEXT /end ANNOTATION
 /begin AXIS_DESCR STD_AXIS NO_INPUT_QUANTITY RB_PT_PCT_SWC_DWC_CompuMethods_ratio_0p1 5 -2000. 2000. FORMAT "%10.5" DEPOSIT ABSOLUTE /end AXIS_DESCR
/end CHARACTERISTIC
/begin CHARACTERISTIC DWC_EFLASHB.DWC_TorqueControl.DWC_ClutchHysterisis.DWC_CHSMODELTYPE "" VALUE 0x8060B4FE DefaultValueRecordLayout_AUTOSAR_Platform_BaseTypes_uint8 2.0 RB_PT_PCT_SWC_DWC_CompuMethods_ident 0.0 2. FORMAT "%10.5"
 /begin ANNOTATION ANNOTATION_LABEL "Description (coming from AUTOSAR DESC field)"
  /begin ANNOTATION_TEXT "Type of hysterisis model to use. 0 = None, 1 = True hyst, 2 = low torque only\r\n" /end ANNOTATION_TEXT
 /end ANNOTATION
/end CHARACTERISTIC
/begin CHARACTERISTIC DWC_EFLASHB.DWC_TorqueControl.DWC_ClutchHysterisis.DWC_CHSTORQUEDEMANDCLEARHYST "" VALUE 0x8060B4FA DefaultValueRecordLayout_AUTOSAR_Platform_BaseTypes_sint16 4000.0 RB_PT_PCT_SWC_DWC_CompuMethods_ratio_0p1 -2000. 2000. FORMAT "%10.5"
 /begin ANNOTATION ANNOTATION_LABEL "Description (coming from AUTOSAR DESC field)"
  /begin ANNOTATION_TEXT "Torque demand, less than which hysteresis model is cleared\r\n" /end ANNOTATION_TEXT
 /end ANNOTATION
/end CHARACTERISTIC
/begin CHARACTERISTIC DWC_EFLASHB.DWC_TorqueControl.DWC_CLUTCHLOCKEDBASEDONTORQUESLIPRULES "" VALUE 0x8060B46D DefaultValueRecordLayout_AUTOSAR_Platform_BaseTypes_boolean 255.0 AUTOSAR_Platform_CompuMethods_boolean 0.0 255. FORMAT "%10.5"
 /begin ANNOTATION ANNOTATION_LABEL "Description (coming from AUTOSAR DESC field)"
  /begin ANNOTATION_TEXT "Flag to activate extra conditions for derivation of cluch locked signal\r\n" /end ANNOTATION_TEXT
 /end ANNOTATION
/end CHARACTERISTIC
/begin CHARACTERISTIC DWC_EFLASHB.DWC_TorqueControl.DWC_ControllerTypeSwitch.DWC_ARBCLUTCHSTATEHYST "" VALUE 0x8060B516 DefaultValueRecordLayout_AUTOSAR_Platform_BaseTypes_uint16 2000.0 RB_PT_PCT_SWC_DWC_CompuMethods_ratio_0p1 0.0 2000. FORMAT "%10.5"
 /begin ANNOTATION ANNOTATION_LABEL "Description (coming from AUTOSAR DESC field)" /begin ANNOTATION_TEXT "Clutch status P term hysteresis for type switch\r\n" /end ANNOTATION_TEXT /end ANNOTATION
/end CHARACTERISTIC
/begin CHARACTERISTIC DWC_EFLASHB.DWC_TorqueControl.DWC_ControllerTypeSwitch.DWC_ARBCONTROLLERHYST "" VALUE 0x8060B518 DefaultValueRecordLayout_AUTOSAR_Platform_BaseTypes_uint16 2000.0 RB_PT_PCT_SWC_DWC_CompuMethods_ratio_0p1 0.0 2000. FORMAT "%10.5"
 /begin ANNOTATION ANNOTATION_LABEL "Description (coming from AUTOSAR DESC field)" /begin ANNOTATION_TEXT "Controller P term hysteresis for type switch\r\n" /end ANNOTATION_TEXT /end ANNOTATION
/end CHARACTERISTIC
/begin CHARACTERISTIC DWC_EFLASHB.DWC_TorqueControl.DWC_CONTROLTYPEDEFAULT "" VALUE 0x8060B46E DefaultValueRecordLayout_AUTOSAR_Platform_BaseTypes_uint8 3.0 RB_PT_PCT_SWC_DWC_CompuMethods_Enumerations_DWC_ControllerType_PCCU 0.0 3. FORMAT "%10.5"
 /begin ANNOTATION ANNOTATION_LABEL "Description (coming from AUTOSAR DESC field)" /begin ANNOTATION_TEXT "Type of controller to be used for speed phase\r\n" /end ANNOTATION_TEXT /end ANNOTATION
/end CHARACTERISTIC
/begin CHARACTERISTIC DWC_EFLASHB.DWC_TorqueControl.DWC_CONTROLTYPEINERTIACANCEL "" VALUE 0x8060B46F DefaultValueRecordLayout_AUTOSAR_Platform_BaseTypes_uint8 3.0 RB_PT_PCT_SWC_DWC_CompuMethods_Enumerations_DWC_ControllerType_PCCU 0.0 3. FORMAT "%10.5"
 /begin ANNOTATION ANNOTATION_LABEL "Description (coming from AUTOSAR DESC field)" /begin ANNOTATION_TEXT "Type of controller to be used for speed phase\r\n" /end ANNOTATION_TEXT /end ANNOTATION
/end CHARACTERISTIC
/begin CHARACTERISTIC DWC_EFLASHB.DWC_TorqueControl.DWC_CONTROLTYPEOFFGOINGDOWNHIGH "" VALUE 0x8060B470 DefaultValueRecordLayout_AUTOSAR_Platform_BaseTypes_uint8 3.0 RB_PT_PCT_SWC_DWC_CompuMethods_Enumerations_DWC_ControllerType_PCCU 0.0 3. FORMAT "%10.5"
 /begin ANNOTATION ANNOTATION_LABEL "Description (coming from AUTOSAR DESC field)" /begin ANNOTATION_TEXT "Type of controller to be used for speed phase\r\n" /end ANNOTATION_TEXT /end ANNOTATION
/end CHARACTERISTIC
/begin CHARACTERISTIC DWC_EFLASHB.DWC_TorqueControl.DWC_CONTROLTYPEOFFGOINGDOWNLOW "" VALUE 0x8060B471 DefaultValueRecordLayout_AUTOSAR_Platform_BaseTypes_uint8 3.0 RB_PT_PCT_SWC_DWC_CompuMethods_Enumerations_DWC_ControllerType_PCCU 0.0 3. FORMAT "%10.5"
 /begin ANNOTATION ANNOTATION_LABEL "Description (coming from AUTOSAR DESC field)" /begin ANNOTATION_TEXT "Type of controller to be used for speed phase\r\n" /end ANNOTATION_TEXT /end ANNOTATION
/end CHARACTERISTIC
/begin CHARACTERISTIC DWC_EFLASHB.DWC_TorqueControl.DWC_CONTROLTYPEOFFGOINGUPHIGH "" VALUE 0x8060B472 DefaultValueRecordLayout_AUTOSAR_Platform_BaseTypes_uint8 3.0 RB_PT_PCT_SWC_DWC_CompuMethods_Enumerations_DWC_ControllerType_PCCU 0.0 3. FORMAT "%10.5"
 /begin ANNOTATION ANNOTATION_LABEL "Description (coming from AUTOSAR DESC field)" /begin ANNOTATION_TEXT "Type of controller to be used for speed phase\r\n" /end ANNOTATION_TEXT /end ANNOTATION
/end CHARACTERISTIC
/begin CHARACTERISTIC DWC_EFLASHB.DWC_TorqueControl.DWC_CONTROLTYPEOFFGOINGUPLOW "" VALUE 0x8060B473 DefaultValueRecordLayout_AUTOSAR_Platform_BaseTypes_uint8 3.0 RB_PT_PCT_SWC_DWC_CompuMethods_Enumerations_DWC_ControllerType_PCCU 0.0 3. FORMAT "%10.5"
 /begin ANNOTATION ANNOTATION_LABEL "Description (coming from AUTOSAR DESC field)" /begin ANNOTATION_TEXT "Type of controller to be used for speed phase\r\n" /end ANNOTATION_TEXT /end ANNOTATION
/end CHARACTERISTIC
/begin CHARACTERISTIC DWC_EFLASHB.DWC_TorqueControl.DWC_CONTROLTYPEONCOMINGDOWN "" VALUE 0x8060B474 DefaultValueRecordLayout_AUTOSAR_Platform_BaseTypes_uint8 3.0 RB_PT_PCT_SWC_DWC_CompuMethods_Enumerations_DWC_ControllerType_PCCU 0.0 3. FORMAT "%10.5"
 /begin ANNOTATION ANNOTATION_LABEL "Description (coming from AUTOSAR DESC field)" /begin ANNOTATION_TEXT "Type of controller to be used for speed phase\r\n" /end ANNOTATION_TEXT /end ANNOTATION
/end CHARACTERISTIC
/begin CHARACTERISTIC DWC_EFLASHB.DWC_TorqueControl.DWC_CONTROLTYPEONCOMINGDOWNAS "" VALUE 0x8060B475 DefaultValueRecordLayout_AUTOSAR_Platform_BaseTypes_uint8 3.0 RB_PT_PCT_SWC_DWC_CompuMethods_Enumerations_DWC_ControllerType_PCCU 0.0 3. FORMAT "%10.5"
 /begin ANNOTATION ANNOTATION_LABEL "Description (coming from AUTOSAR DESC field)" /begin ANNOTATION_TEXT "Type of controller to be used for speed phase\r\n" /end ANNOTATION_TEXT /end ANNOTATION
/end CHARACTERISTIC
/begin CHARACTERISTIC DWC_EFLASHB.DWC_TorqueControl.DWC_CONTROLTYPEONCOMINGUP "" VALUE 0x8060B476 DefaultValueRecordLayout_AUTOSAR_Platform_BaseTypes_uint8 3.0 RB_PT_PCT_SWC_DWC_CompuMethods_Enumerations_DWC_ControllerType_PCCU 0.0 3. FORMAT "%10.5"
 /begin ANNOTATION ANNOTATION_LABEL "Description (coming from AUTOSAR DESC field)" /begin ANNOTATION_TEXT "Type of controller to be used for speed phase\r\n" /end ANNOTATION_TEXT /end ANNOTATION
/end CHARACTERISTIC
/begin CHARACTERISTIC DWC_EFLASHB.DWC_TorqueControl.DWC_CreepDisengage.DWC_CREEPDEGRADEVSTARGETSPEED "" CURVE 0x8060B58A RB_PT_PCT_SWC_DWC_RecordLayouts_RL_Curve_uint16_5_uint16_5 2000.0 RB_PT_PCT_SWC_DWC_CompuMethods_ratio_0p1 0.0 2000. FORMAT "%10.5"
 /begin ANNOTATION ANNOTATION_LABEL "Description (coming from AUTOSAR DESC field)"
  /begin ANNOTATION_TEXT "Creep degrade target torque against demand creep speed\r\n" /end ANNOTATION_TEXT
 /end ANNOTATION
 /begin AXIS_DESCR STD_AXIS NO_INPUT_QUANTITY RB_PT_PCT_SWC_DWC_CompuMethods_ratio_0p1 5 0.0 20. FORMAT "%10.5" DEPOSIT ABSOLUTE /end AXIS_DESCR
/end CHARACTERISTIC
/begin CHARACTERISTIC DWC_EFLASHB.DWC_TorqueControl.DWC_CreepDisengage.DWC_CREEPDEGRADEVSTARGETSPEEDECO "" CURVE 0x8060B5A0 RB_PT_PCT_SWC_DWC_RecordLayouts_RL_Curve_uint16_5_uint16_5 2000.0 RB_PT_PCT_SWC_DWC_CompuMethods_ratio_0p1 0.0 2000. FORMAT "%10.5"
 /begin ANNOTATION ANNOTATION_LABEL "Description (coming from AUTOSAR DESC field)"
  /begin ANNOTATION_TEXT "Creep degrade target torque against demand creep speed\r\n" /end ANNOTATION_TEXT
 /end ANNOTATION
 /begin AXIS_DESCR STD_AXIS NO_INPUT_QUANTITY RB_PT_PCT_SWC_DWC_CompuMethods_ratio_0p1 5 0.0 20. FORMAT "%10.5" DEPOSIT ABSOLUTE /end AXIS_DESCR
/end CHARACTERISTIC
/begin CHARACTERISTIC DWC_EFLASHB.DWC_TorqueControl.DWC_CreepDisengage.DWC_CRPBRAKEPRESSCANCELBLOCK "" VALUE 0x8060B564 DefaultValueRecordLayout_AUTOSAR_Platform_BaseTypes_uint16 409.5 RB_PT_PCT_SWC_DWC_CompuMethods_ratio_0p1 0.0 409.5 FORMAT "%10.5"
 /begin ANNOTATION ANNOTATION_LABEL "Description (coming from AUTOSAR DESC field)"
  /begin ANNOTATION_TEXT "Maximum brake pressure, above which the degrade blocking for creep is cleared\r\n" /end ANNOTATION_TEXT
 /end ANNOTATION
/end CHARACTERISTIC
/begin CHARACTERISTIC DWC_EFLASHB.DWC_TorqueControl.DWC_CreepDisengage.DWC_CRPBRAKEPRESSCANCELROLL "" VALUE 0x8060B566 DefaultValueRecordLayout_AUTOSAR_Platform_BaseTypes_uint16 409.5 RB_PT_PCT_SWC_DWC_CompuMethods_ratio_0p1 0.0 409.5 FORMAT "%10.5"
 /begin ANNOTATION ANNOTATION_LABEL "Description (coming from AUTOSAR DESC field)" /begin ANNOTATION_TEXT "Maximum brake pressure for rolling launch\r\n" /end ANNOTATION_TEXT /end ANNOTATION
/end CHARACTERISTIC
/begin CHARACTERISTIC DWC_EFLASHB.DWC_TorqueControl.DWC_CreepDisengage.DWC_CRPDEGRADEDECINCREASE "" VALUE 0x8060B550 DefaultValueRecordLayout_AUTOSAR_Platform_BaseTypes_uint32 2000.0 RB_PT_PCT_SWC_DWC_CompuMethods_ratio_0p0001 0.0 2000. FORMAT "%10.5"
 /begin ANNOTATION ANNOTATION_LABEL "Description (coming from AUTOSAR DESC field)" /begin ANNOTATION_TEXT "Rate of change of creep degrade - increase rate\r\n" /end ANNOTATION_TEXT /end ANNOTATION
/end CHARACTERISTIC
/begin CHARACTERISTIC DWC_EFLASHB.DWC_TorqueControl.DWC_CreepDisengage.DWC_CRPDEGRADEDECINCREASEECO "" VALUE 0x8060B554 DefaultValueRecordLayout_AUTOSAR_Platform_BaseTypes_uint32 2000.0 RB_PT_PCT_SWC_DWC_CompuMethods_ratio_0p0001 0.0 2000. FORMAT "%10.5"
 /begin ANNOTATION ANNOTATION_LABEL "Description (coming from AUTOSAR DESC field)" /begin ANNOTATION_TEXT "Rate of change of creep degrade - increase rate\r\n" /end ANNOTATION_TEXT /end ANNOTATION
/end CHARACTERISTIC
/begin CHARACTERISTIC DWC_EFLASHB.DWC_TorqueControl.DWC_CreepDisengage.DWC_CRPDEGRADEDECINCREASETHROTTLE "" VALUE 0x8060B558 DefaultValueRecordLayout_AUTOSAR_Platform_BaseTypes_uint32 2000.0 RB_PT_PCT_SWC_DWC_CompuMethods_ratio_0p0001 0.0 2000. FORMAT "%10.5"
 /begin ANNOTATION ANNOTATION_LABEL "Description (coming from AUTOSAR DESC field)"
  /begin ANNOTATION_TEXT "Rate of change of creep degrade - increase rate - on throttle\r\n" /end ANNOTATION_TEXT
 /end ANNOTATION
/end CHARACTERISTIC
/begin CHARACTERISTIC DWC_EFLASHB.DWC_TorqueControl.DWC_CreepDisengage.DWC_CRPDEGRADEDECREDUCE "" VALUE 0x8060B568 DefaultValueRecordLayout_AUTOSAR_Platform_BaseTypes_uint16 10.0 RB_PT_PCT_SWC_DWC_CompuMethods_ratio_0p001__2 0.0 10. FORMAT "%10.5"
 /begin ANNOTATION ANNOTATION_LABEL "Description (coming from AUTOSAR DESC field)" /begin ANNOTATION_TEXT "Reduction rate of degrade increase\r\n" /end ANNOTATION_TEXT /end ANNOTATION
/end CHARACTERISTIC
/begin CHARACTERISTIC DWC_EFLASHB.DWC_TorqueControl.DWC_CreepDisengage.DWC_CRPDEGRADEDECREDUCEECO "" VALUE 0x8060B56A DefaultValueRecordLayout_AUTOSAR_Platform_BaseTypes_uint16 10.0 RB_PT_PCT_SWC_DWC_CompuMethods_ratio_0p001__2 0.0 10. FORMAT "%10.5"
 /begin ANNOTATION ANNOTATION_LABEL "Description (coming from AUTOSAR DESC field)" /begin ANNOTATION_TEXT "Reduction rate of degrade increase\r\n" /end ANNOTATION_TEXT /end ANNOTATION
/end CHARACTERISTIC
/begin CHARACTERISTIC DWC_EFLASHB.DWC_TorqueControl.DWC_CreepDisengage.DWC_CRPDEGRADEDECREDUCETHROTTLE "" VALUE 0x8060B56C DefaultValueRecordLayout_AUTOSAR_Platform_BaseTypes_uint16 10.0 RB_PT_PCT_SWC_DWC_CompuMethods_ratio_0p001__2 0.0 10. FORMAT "%10.5"
 /begin ANNOTATION ANNOTATION_LABEL "Description (coming from AUTOSAR DESC field)" /begin ANNOTATION_TEXT "Reduction rate of degrade increase - on throttle\r\n" /end ANNOTATION_TEXT /end ANNOTATION
/end CHARACTERISTIC
/begin CHARACTERISTIC DWC_EFLASHB.DWC_TorqueControl.DWC_CreepDisengage.DWC_CRPDEGRADEHOLD "" VALUE 0x8060B56E DefaultValueRecordLayout_AUTOSAR_Platform_BaseTypes_uint16 2000.0 RB_PT_PCT_SWC_DWC_CompuMethods_ratio_0p1 0.0 2000. FORMAT "%10.5"
 /begin ANNOTATION ANNOTATION_LABEL "Description (coming from AUTOSAR DESC field)"
  /begin ANNOTATION_TEXT "Degrade torque to hold until re-fill request is made (0.0 = don't hold)\r\n" /end ANNOTATION_TEXT
 /end ANNOTATION
/end CHARACTERISTIC
/begin CHARACTERISTIC DWC_EFLASHB.DWC_TorqueControl.DWC_CreepDisengage.DWC_CRPDEGRADEINCINCREASE "" VALUE 0x8060B55C DefaultValueRecordLayout_AUTOSAR_Platform_BaseTypes_uint32 2000.0 RB_PT_PCT_SWC_DWC_CompuMethods_ratio_0p0001 0.0 2000. FORMAT "%10.5"
 /begin ANNOTATION ANNOTATION_LABEL "Description (coming from AUTOSAR DESC field)" /begin ANNOTATION_TEXT "Rate of change of creep degrade - increase rate\r\n" /end ANNOTATION_TEXT /end ANNOTATION
/end CHARACTERISTIC
/begin CHARACTERISTIC DWC_EFLASHB.DWC_TorqueControl.DWC_CreepDisengage.DWC_CRPDEGRADEINCINCREASEECO "" VALUE 0x8060B560 DefaultValueRecordLayout_AUTOSAR_Platform_BaseTypes_uint32 2000.0 RB_PT_PCT_SWC_DWC_CompuMethods_ratio_0p0001 0.0 2000. FORMAT "%10.5"
 /begin ANNOTATION ANNOTATION_LABEL "Description (coming from AUTOSAR DESC field)" /begin ANNOTATION_TEXT "Rate of change of creep degrade - increase rate\r\n" /end ANNOTATION_TEXT /end ANNOTATION
/end CHARACTERISTIC
/begin CHARACTERISTIC DWC_EFLASHB.DWC_TorqueControl.DWC_CreepDisengage.DWC_CRPDEGRADEINCREDUCE "" VALUE 0x8060B570 DefaultValueRecordLayout_AUTOSAR_Platform_BaseTypes_uint16 1.0 RB_PT_PCT_SWC_DWC_CompuMethods_ratio_0p001__2 0.0 1. FORMAT "%10.5"
 /begin ANNOTATION ANNOTATION_LABEL "Description (coming from AUTOSAR DESC field)" /begin ANNOTATION_TEXT "Reduction rate of degrade increase\r\n" /end ANNOTATION_TEXT /end ANNOTATION
/end CHARACTERISTIC
/begin CHARACTERISTIC DWC_EFLASHB.DWC_TorqueControl.DWC_CreepDisengage.DWC_CRPDEGRADEINCREDUCEECO "" VALUE 0x8060B572 DefaultValueRecordLayout_AUTOSAR_Platform_BaseTypes_uint16 1.0 RB_PT_PCT_SWC_DWC_CompuMethods_ratio_0p001__2 0.0 1. FORMAT "%10.5"
 /begin ANNOTATION ANNOTATION_LABEL "Description (coming from AUTOSAR DESC field)" /begin ANNOTATION_TEXT "Reduction rate of degrade increase\r\n" /end ANNOTATION_TEXT /end ANNOTATION
/end CHARACTERISTIC
/begin CHARACTERISTIC DWC_EFLASHB.DWC_TorqueControl.DWC_CreepDisengage.DWC_CRPDEGRADEINPUTDROPOFFTHROTTLE "" VALUE 0x8060B574 DefaultValueRecordLayout_AUTOSAR_Platform_BaseTypes_uint16 20000.0 RB_PT_PCT_SWC_DWC_CompuMethods_ident 0.0 20000. FORMAT "%10.5"
 /begin ANNOTATION ANNOTATION_LABEL "Description (coming from AUTOSAR DESC field)"
  /begin ANNOTATION_TEXT "RPM by which the threshold to exit degrade is moved down when driver is off throttle, and creep speed high is false (allow for early refill off throttle)\r\n" /end ANNOTATION_TEXT
 /end ANNOTATION
/end CHARACTERISTIC
/begin CHARACTERISTIC DWC_EFLASHB.DWC_TorqueControl.DWC_CreepDisengage.DWC_CRPDEGRADEINPUTHYSTDISABLE "" VALUE 0x8060B576 DefaultValueRecordLayout_AUTOSAR_Platform_BaseTypes_uint16 20000.0 RB_PT_PCT_SWC_DWC_CompuMethods_ident 0.0 20000. FORMAT "%10.5"
 /begin ANNOTATION ANNOTATION_LABEL "Description (coming from AUTOSAR DESC field)"
  /begin ANNOTATION_TEXT "RPM by which the threshold to exit degrade is moved up by (from idle offset) when active input decreased below max input speed\r\n" /end ANNOTATION_TEXT
 /end ANNOTATION
/end CHARACTERISTIC
/begin CHARACTERISTIC DWC_EFLASHB.DWC_TorqueControl.DWC_CreepDisengage.DWC_CRPDEGRADEINPUTHYSTENABLE "" VALUE 0x8060B578 DefaultValueRecordLayout_AUTOSAR_Platform_BaseTypes_uint16 20000.0 RB_PT_PCT_SWC_DWC_CompuMethods_ident 0.0 20000. FORMAT "%10.5"
 /begin ANNOTATION ANNOTATION_LABEL "Description (coming from AUTOSAR DESC field)"
  /begin ANNOTATION_TEXT "RPM by which the threshold to enter degrade is moved down by (from idle offset) when active input increases above max input speed\r\n" /end ANNOTATION_TEXT
 /end ANNOTATION
/end CHARACTERISTIC
/begin CHARACTERISTIC DWC_EFLASHB.DWC_TorqueControl.DWC_CreepDisengage.DWC_CRPDEGRADEMAXOUTGEAR "" VAL_BLK 0x8060B51C DefaultValueRecordLayout_AUTOSAR_Platform_BaseTypes_uint16 20000.0 RB_PT_PCT_SWC_DWC_CompuMethods_ident 0.0 20000. FORMAT "%10.5"
 /begin ANNOTATION ANNOTATION_LABEL "Description (coming from AUTOSAR DESC field)"
  /begin ANNOTATION_TEXT "Maximum speed data for degrade with hysteresis against gear (row 0 = falling enable, row 1 = rising disable)\r\n" /end ANNOTATION_TEXT
 /end ANNOTATION
 MATRIX_DIM 13 2 1 /end CHARACTERISTIC
/begin CHARACTERISTIC DWC_EFLASHB.DWC_TorqueControl.DWC_CreepDisengage.DWC_CRPDEGRADEREFILLPULSETIME "" VALUE 0x8060B57A DefaultValueRecordLayout_AUTOSAR_Platform_BaseTypes_uint16 10.0 RB_PT_PCT_SWC_DWC_CompuMethods_ratio_0p001__2 0.0 10. FORMAT "%10.5"
 /begin ANNOTATION ANNOTATION_LABEL "Description (coming from AUTOSAR DESC field)" /begin ANNOTATION_TEXT "Time that re-grade refill pulse is requested for\r\n" /end ANNOTATION_TEXT /end ANNOTATION
/end CHARACTERISTIC
/begin CHARACTERISTIC DWC_EFLASHB.DWC_TorqueControl.DWC_CreepDisengage.DWC_CRPDEGRADEREFILLREQUIRED "" VALUE 0x8060B57C DefaultValueRecordLayout_AUTOSAR_Platform_BaseTypes_uint16 2000.0 RB_PT_PCT_SWC_DWC_CompuMethods_ratio_0p1 0.0 2000. FORMAT "%10.5"
 /begin ANNOTATION ANNOTATION_LABEL "Description (coming from AUTOSAR DESC field)" /begin ANNOTATION_TEXT "Re-fill required torque level for degrade\r\n" /end ANNOTATION_TEXT /end ANNOTATION
/end CHARACTERISTIC
/begin CHARACTERISTIC DWC_EFLASHB.DWC_TorqueControl.DWC_CreepDisengage.DWC_CRPDEGRADEREFILLRUN "" VALUE 0x8060B57E DefaultValueRecordLayout_AUTOSAR_Platform_BaseTypes_uint16 2000.0 RB_PT_PCT_SWC_DWC_CompuMethods_ratio_0p1 0.0 2000. FORMAT "%10.5"
 /begin ANNOTATION ANNOTATION_LABEL "Description (coming from AUTOSAR DESC field)" /begin ANNOTATION_TEXT "Re-fill required torque level for degrade\r\n" /end ANNOTATION_TEXT /end ANNOTATION
/end CHARACTERISTIC
/begin CHARACTERISTIC DWC_EFLASHB.DWC_TorqueControl.DWC_CreepDisengage.DWC_CRPDISABLEDEGRADE "" VALUE 0x8060B582 DefaultValueRecordLayout_AUTOSAR_Platform_BaseTypes_boolean 255.0 AUTOSAR_Platform_CompuMethods_boolean 0.0 255. FORMAT "%10.5"
 /begin ANNOTATION ANNOTATION_LABEL "Description (coming from AUTOSAR DESC field)" /begin ANNOTATION_TEXT "Flag to disable degrade controller\r\n" /end ANNOTATION_TEXT /end ANNOTATION
/end CHARACTERISTIC
/begin CHARACTERISTIC DWC_EFLASHB.DWC_TorqueControl.DWC_CreepDisengage.DWC_CRPDISABLESPEEDHIGHRULE "" VALUE 0x8060B583 DefaultValueRecordLayout_AUTOSAR_Platform_BaseTypes_boolean 255.0 AUTOSAR_Platform_CompuMethods_boolean 0.0 255. FORMAT "%10.5"
 /begin ANNOTATION ANNOTATION_LABEL "Description (coming from AUTOSAR DESC field)"
  /begin ANNOTATION_TEXT "Flag to disable the use of speed high in degrade cancelling rule\r\n" /end ANNOTATION_TEXT
 /end ANNOTATION
/end CHARACTERISTIC
/begin CHARACTERISTIC DWC_EFLASHB.DWC_TorqueControl.DWC_CreepDisengage.DWC_CRPEXTERNALDEGRADERULES "" VALUE 0x8060B584 DefaultValueRecordLayout_AUTOSAR_Platform_BaseTypes_boolean 255.0 AUTOSAR_Platform_CompuMethods_boolean 0.0 255. FORMAT "%10.5"
 /begin ANNOTATION ANNOTATION_LABEL "Description (coming from AUTOSAR DESC field)"
  /begin ANNOTATION_TEXT "Flag to use clutch must open and can close degrade rules\r\n" /end ANNOTATION_TEXT
 /end ANNOTATION
/end CHARACTERISTIC
/begin CHARACTERISTIC DWC_EFLASHB.DWC_TorqueControl.DWC_CreepDisengage.DWC_CRPFORCEROLLINGLAUNCH "" VALUE 0x8060B585 DefaultValueRecordLayout_AUTOSAR_Platform_BaseTypes_boolean 255.0 AUTOSAR_Platform_CompuMethods_boolean 0.0 255. FORMAT "%10.5"
 /begin ANNOTATION ANNOTATION_LABEL "Description (coming from AUTOSAR DESC field)"
  /begin ANNOTATION_TEXT "Flag to use input shaft speed degrade rules rather than output shaft speed\r\n" /end ANNOTATION_TEXT
 /end ANNOTATION
/end CHARACTERISTIC
/begin CHARACTERISTIC DWC_EFLASHB.DWC_TorqueControl.DWC_CreepDisengage.DWC_CRPINPUTDEGRADERULES "" VALUE 0x8060B586 DefaultValueRecordLayout_AUTOSAR_Platform_BaseTypes_boolean 255.0 AUTOSAR_Platform_CompuMethods_boolean 0.0 255. FORMAT "%10.5"
 /begin ANNOTATION ANNOTATION_LABEL "Description (coming from AUTOSAR DESC field)"
  /begin ANNOTATION_TEXT "Flag to use input shaft speed degrade rules rather than output shaft speed\r\n" /end ANNOTATION_TEXT
 /end ANNOTATION
/end CHARACTERISTIC
/begin CHARACTERISTIC DWC_EFLASHB.DWC_TorqueControl.DWC_CreepDisengage.DWC_CRPMAXCONTROLLERTORQUEDEGRADE "" VALUE 0x8060B580 DefaultValueRecordLayout_AUTOSAR_Platform_BaseTypes_uint16 2000.0 RB_PT_PCT_SWC_DWC_CompuMethods_ratio_0p1 0.0 2000. FORMAT "%10.5"
 /begin ANNOTATION ANNOTATION_LABEL "Description (coming from AUTOSAR DESC field)" /begin ANNOTATION_TEXT "Maximum controller torque for degrade\r\n" /end ANNOTATION_TEXT /end ANNOTATION
/end CHARACTERISTIC
/begin CHARACTERISTIC DWC_EFLASHB.DWC_TorqueControl.DWC_CreepDisengage.DWC_CRPRESETDEGRADETOTARGET "" VALUE 0x8060B587 DefaultValueRecordLayout_AUTOSAR_Platform_BaseTypes_boolean 255.0 AUTOSAR_Platform_CompuMethods_boolean 0.0 255. FORMAT "%10.5"
 /begin ANNOTATION ANNOTATION_LABEL "Description (coming from AUTOSAR DESC field)"
  /begin ANNOTATION_TEXT "Flag to force initialisation of degrade at target during reset\r\n" /end ANNOTATION_TEXT
 /end ANNOTATION
/end CHARACTERISTIC
/begin CHARACTERISTIC DWC_EFLASHB.DWC_TorqueControl.DWC_CreepDisengage.DWC_CRPROLLAWAYNOOPENSTEP1 "" VALUE 0x8060B588 DefaultValueRecordLayout_AUTOSAR_Platform_BaseTypes_boolean 255.0 AUTOSAR_Platform_CompuMethods_boolean 0.0 255. FORMAT "%10.5"
 /begin ANNOTATION ANNOTATION_LABEL "Description (coming from AUTOSAR DESC field)"
  /begin ANNOTATION_TEXT "Flag bypassing the need for clutch 'open' for entry to step one (still needs pullaway to be active)\r\n" /end ANNOTATION_TEXT
 /end ANNOTATION
/end CHARACTERISTIC
/begin CHARACTERISTIC DWC_EFLASHB.DWC_TorqueControl.DWC_CreepDisengage.DWC_MAXTHROTTLEPEDALDEGRADE "" VALUE 0x8060B589 DefaultValueRecordLayout_AUTOSAR_Platform_BaseTypes_uint8 102.0 RB_PT_PCT_SWC_DWC_CompuMethods_ratio_0p4 0.0 102. FORMAT "%10.5"
 /begin ANNOTATION ANNOTATION_LABEL "Description (coming from AUTOSAR DESC field)" /begin ANNOTATION_TEXT "Maximum throttle pedal for degrade function demands\r\n" /end ANNOTATION_TEXT /end ANNOTATION
/end CHARACTERISTIC
/begin CHARACTERISTIC DWC_EFLASHB.DWC_TorqueControl.DWC_CreepLimit.DWC_CRPACTUALSPEEDMAXTORQUE "" CURVE 0x8060B5C0 RB_PT_PCT_SWC_DWC_RecordLayouts_RL_Curve_uint16_4_sint16_4 2000.0 RB_PT_PCT_SWC_DWC_CompuMethods_ratio_0p1 0.0 2000. FORMAT "%10.5"
 /begin ANNOTATION ANNOTATION_LABEL "Description (coming from AUTOSAR DESC field)" /begin ANNOTATION_TEXT "Maximum creep torque vs relative vehicle speed\r\n" /end ANNOTATION_TEXT /end ANNOTATION
 /begin AXIS_DESCR STD_AXIS NO_INPUT_QUANTITY RB_PT_PCT_SWC_DWC_CompuMethods_ratio_0p1 4 -20. 20. FORMAT "%10.5" DEPOSIT ABSOLUTE /end AXIS_DESCR
/end CHARACTERISTIC
/begin CHARACTERISTIC DWC_EFLASHB.DWC_TorqueControl.DWC_CreepLimit.DWC_CRPESPEEMAXTORQUE "" CURVE 0x8060B5D2 RB_PT_PCT_SWC_DWC_RecordLayouts_RL_Curve_uint16_3_uint16_3 2000.0 RB_PT_PCT_SWC_DWC_CompuMethods_ratio_0p1 0.0 2000. FORMAT "%10.5"
 /begin ANNOTATION ANNOTATION_LABEL "Description (coming from AUTOSAR DESC field)" /begin ANNOTATION_TEXT "Maximum clutch creep torque vs engine speed\r\n" /end ANNOTATION_TEXT /end ANNOTATION
 /begin AXIS_DESCR STD_AXIS NO_INPUT_QUANTITY RB_PT_PCT_SWC_DWC_CompuMethods_ident 3 0.0 20000. FORMAT "%10.5" DEPOSIT ABSOLUTE /end AXIS_DESCR
/end CHARACTERISTIC
/begin CHARACTERISTIC DWC_EFLASHB.DWC_TorqueControl.DWC_CreepLimit.DWC_CRPHIGHCREEP "" VALUE 0x8060B5B8 DefaultValueRecordLayout_AUTOSAR_Platform_BaseTypes_sint16 400.0 RB_PT_PCT_SWC_DWC_CompuMethods_ratio_0p1 -200. 200. FORMAT "%10.5"
 /begin ANNOTATION ANNOTATION_LABEL "Description (coming from AUTOSAR DESC field)" /begin ANNOTATION_TEXT "Torque level representing high creep torque\r\n" /end ANNOTATION_TEXT /end ANNOTATION
/end CHARACTERISTIC
/begin CHARACTERISTIC DWC_EFLASHB.DWC_TorqueControl.DWC_CreepLimit.DWC_CRPHIGHENGINESPEED "" VALUE 0x8060B5BA DefaultValueRecordLayout_AUTOSAR_Platform_BaseTypes_uint16 20000.0 RB_PT_PCT_SWC_DWC_CompuMethods_ident 0.0 20000. FORMAT "%10.5"
 /begin ANNOTATION ANNOTATION_LABEL "Description (coming from AUTOSAR DESC field)"
  /begin ANNOTATION_TEXT "High engine speed limit for creep control (above which abuse timer counts down)\r\n" /end ANNOTATION_TEXT
 /end ANNOTATION
/end CHARACTERISTIC
/begin CHARACTERISTIC DWC_EFLASHB.DWC_TorqueControl.DWC_CreepLimit.DWC_CRPLOWCREEP "" VALUE 0x8060B5BC DefaultValueRecordLayout_AUTOSAR_Platform_BaseTypes_sint16 400.0 RB_PT_PCT_SWC_DWC_CompuMethods_ratio_0p1 -200. 200. FORMAT "%10.5"
 /begin ANNOTATION ANNOTATION_LABEL "Description (coming from AUTOSAR DESC field)" /begin ANNOTATION_TEXT "Torque level representing low creep torque\r\n" /end ANNOTATION_TEXT /end ANNOTATION
/end CHARACTERISTIC
/begin CHARACTERISTIC DWC_EFLASHB.DWC_TorqueControl.DWC_CreepLimit.DWC_CRPRESETABUSETIMEONRESET "" VALUE 0x8060B5BE DefaultValueRecordLayout_AUTOSAR_Platform_BaseTypes_boolean 255.0 AUTOSAR_Platform_CompuMethods_boolean 0.0 255. FORMAT "%10.5"
 /begin ANNOTATION ANNOTATION_LABEL "Description (coming from AUTOSAR DESC field)" /begin ANNOTATION_TEXT "Flag to cause creep abuse timer reset on reset input\r\n" /end ANNOTATION_TEXT /end ANNOTATION
/end CHARACTERISTIC
/begin CHARACTERISTIC DWC_EFLASHB.DWC_TorqueControl.DWC_CreepLimit.DWC_CRPRUNTIMEMAXTORQUE "" CURVE 0x8060B5E0 RB_PT_PCT_SWC_DWC_RecordLayouts_RL_Curve_uint16_3_uint16_3 2000.0 RB_PT_PCT_SWC_DWC_CompuMethods_ratio_0p1 0.0 2000. FORMAT "%10.5"
 /begin ANNOTATION ANNOTATION_LABEL "Description (coming from AUTOSAR DESC field)" /begin ANNOTATION_TEXT "Maximum creep torque vs. time since engagement\r\n" /end ANNOTATION_TEXT /end ANNOTATION
 /begin AXIS_DESCR STD_AXIS NO_INPUT_QUANTITY RB_PT_PCT_SWC_DWC_CompuMethods_ratio_0p001__2 3 0.0 10. FORMAT "%10.5" DEPOSIT ABSOLUTE /end AXIS_DESCR
/end CHARACTERISTIC
/begin CHARACTERISTIC DWC_EFLASHB.DWC_TorqueControl.DWC_CreepLimit.DWC_CRPTEMPTIMEMAXTORQUE "" MAP 0x8060B5EE RB_PT_PCT_SWC_DWC_RecordLayouts_RL_Map_uint16_25_uint16_5_sint16_5 2000.0 RB_PT_PCT_SWC_DWC_CompuMethods_ratio_0p1 0.0 2000. FORMAT "%10.5"
 /begin ANNOTATION ANNOTATION_LABEL "Description (coming from AUTOSAR DESC field)"
  /begin ANNOTATION_TEXT "Maximum torque for creep based on temperature and time\r\n" /end ANNOTATION_TEXT
 /end ANNOTATION
 /begin AXIS_DESCR STD_AXIS NO_INPUT_QUANTITY RB_PT_PCT_SWC_DWC_CompuMethods_ratio_0p005 5 0.0 50. FORMAT "%10.5" DEPOSIT ABSOLUTE /end AXIS_DESCR
 /begin AXIS_DESCR STD_AXIS NO_INPUT_QUANTITY RB_PT_PCT_SWC_DWC_CompuMethods_ident 5 -50. 200. FORMAT "%10.5" DEPOSIT ABSOLUTE /end AXIS_DESCR
/end CHARACTERISTIC
/begin CHARACTERISTIC DWC_EFLASHB.DWC_TorqueControl.DWC_CRPActualRateLim.DWC_CRPDECREASEIIR "" VALUE 0x8060B4E4 DefaultValueRecordLayout_AUTOSAR_Platform_BaseTypes_uint8 1.0 RB_PT_PCT_SWC_DWC_CompuMethods_ratio_0p01 0.0 1. FORMAT "%10.5"
 /begin ANNOTATION ANNOTATION_LABEL "Description (coming from AUTOSAR DESC field)" /begin ANNOTATION_TEXT "IIR filter co-efficient - decreasing\r\n" /end ANNOTATION_TEXT /end ANNOTATION
/end CHARACTERISTIC
/begin CHARACTERISTIC DWC_EFLASHB.DWC_TorqueControl.DWC_CRPActualRateLim.DWC_CRPDECREASERATE "" VALUE 0x8060B4DC DefaultValueRecordLayout_AUTOSAR_Platform_BaseTypes_sint32 80.0 RB_PT_PCT_SWC_DWC_CompuMethods_ratio_0p0001 -40. 40. FORMAT "%10.5"
 /begin ANNOTATION ANNOTATION_LABEL "Description (coming from AUTOSAR DESC field)" /begin ANNOTATION_TEXT "Decrease rate of speed\r\n" /end ANNOTATION_TEXT /end ANNOTATION
/end CHARACTERISTIC
/begin CHARACTERISTIC DWC_EFLASHB.DWC_TorqueControl.DWC_CRPActualRateLim.DWC_CRPINCREASEIIR "" VALUE 0x8060B4E5 DefaultValueRecordLayout_AUTOSAR_Platform_BaseTypes_uint8 1.0 RB_PT_PCT_SWC_DWC_CompuMethods_ratio_0p01 0.0 1. FORMAT "%10.5"
 /begin ANNOTATION ANNOTATION_LABEL "Description (coming from AUTOSAR DESC field)" /begin ANNOTATION_TEXT "IIR filter co-efficient - increasing\r\n" /end ANNOTATION_TEXT /end ANNOTATION
/end CHARACTERISTIC
/begin CHARACTERISTIC DWC_EFLASHB.DWC_TorqueControl.DWC_CRPActualRateLim.DWC_CRPINCREASERATE "" VALUE 0x8060B4E0 DefaultValueRecordLayout_AUTOSAR_Platform_BaseTypes_sint32 80.0 RB_PT_PCT_SWC_DWC_CompuMethods_ratio_0p0001 -40. 40. FORMAT "%10.5"
 /begin ANNOTATION ANNOTATION_LABEL "Description (coming from AUTOSAR DESC field)" /begin ANNOTATION_TEXT "Maximum increase rate of speed\r\n" /end ANNOTATION_TEXT /end ANNOTATION
/end CHARACTERISTIC
/begin CHARACTERISTIC DWC_EFLASHB.DWC_TorqueControl.DWC_CRPBRKPRESSTARGET "" CURVE 0x8060C96A RB_PT_PCT_SWC_DWC_RecordLayouts_RL_Curve_sint16_5_uint16_5 40.0 RB_PT_PCT_SWC_DWC_CompuMethods_ratio_0p01 -20. 20. FORMAT "%10.5"
 /begin ANNOTATION ANNOTATION_LABEL "Description (coming from AUTOSAR DESC field)" /begin ANNOTATION_TEXT "Target vehicle speed vs brake pressure\r\n" /end ANNOTATION_TEXT /end ANNOTATION
 /begin AXIS_DESCR STD_AXIS NO_INPUT_QUANTITY RB_PT_PCT_SWC_DWC_CompuMethods_ratio_0p1 5 0.0 409.5 FORMAT "%10.5" DEPOSIT ABSOLUTE /end AXIS_DESCR
/end CHARACTERISTIC
/begin CHARACTERISTIC DWC_EFLASHB.DWC_TorqueControl.DWC_CRPDEGRADERESETLIMIT "" VALUE 0x8060B364 DefaultValueRecordLayout_AUTOSAR_Platform_BaseTypes_uint16 2000.0 RB_PT_PCT_SWC_DWC_CompuMethods_ratio_0p1 0.0 2000. FORMAT "%10.5"
 /begin ANNOTATION ANNOTATION_LABEL "Description (coming from AUTOSAR DESC field)"
  /begin ANNOTATION_TEXT "Degrade torque, above which creep limit reset is held true\r\n" /end ANNOTATION_TEXT
 /end ANNOTATION
/end CHARACTERISTIC
/begin CHARACTERISTIC DWC_EFLASHB.DWC_TorqueControl.DWC_CRPDEGRADETORQUELOWIDLEOK "" VALUE 0x8060B366 DefaultValueRecordLayout_AUTOSAR_Platform_BaseTypes_uint16 2000.0 RB_PT_PCT_SWC_DWC_CompuMethods_ratio_0p1 0.0 2000. FORMAT "%10.5"
 /begin ANNOTATION ANNOTATION_LABEL "Description (coming from AUTOSAR DESC field)" /begin ANNOTATION_TEXT "Degrade torque to accept low idle speed\r\n" /end ANNOTATION_TEXT /end ANNOTATION
/end CHARACTERISTIC
/begin CHARACTERISTIC DWC_EFLASHB.DWC_TorqueControl.DWC_CRPIGAIN "" VALUE 0x8060B477 DefaultValueRecordLayout_AUTOSAR_Platform_BaseTypes_uint8 1.0 RB_PT_PCT_SWC_DWC_CompuMethods_ratio_0p01 0.0 1. FORMAT "%10.5"
 /begin ANNOTATION ANNOTATION_LABEL "Description (coming from AUTOSAR DESC field)" /begin ANNOTATION_TEXT "Integral gain of creep controller\r\n" /end ANNOTATION_TEXT /end ANNOTATION
/end CHARACTERISTIC
/begin CHARACTERISTIC DWC_EFLASHB.DWC_TorqueControl.DWC_CRPITERMMINSPEED "" VALUE 0x8060B478 DefaultValueRecordLayout_AUTOSAR_Platform_BaseTypes_uint8 20.0 RB_PT_PCT_SWC_DWC_CompuMethods_ratio_0p1 0.0 20. FORMAT "%10.5"
 /begin ANNOTATION ANNOTATION_LABEL "Description (coming from AUTOSAR DESC field)" /begin ANNOTATION_TEXT "Minimum target speed, below which I term rolled off\r\n" /end ANNOTATION_TEXT /end ANNOTATION
/end CHARACTERISTIC
/begin CHARACTERISTIC DWC_EFLASHB.DWC_TorqueControl.DWC_CRPITERMREDUCTION "" VALUE 0x8060B350 DefaultValueRecordLayout_AUTOSAR_Platform_BaseTypes_uint32 200.0 RB_PT_PCT_SWC_DWC_CompuMethods_Ratio_0p001 0.0 200. FORMAT "%10.5"
 /begin ANNOTATION ANNOTATION_LABEL "Description (coming from AUTOSAR DESC field)" /begin ANNOTATION_TEXT "Reduction rate of I term at low target speed\r\n" /end ANNOTATION_TEXT /end ANNOTATION
/end CHARACTERISTIC
/begin CHARACTERISTIC DWC_EFLASHB.DWC_TorqueControl.DWC_CRPLOWIDLEOKAYMINOUTPUTSPEEDHI "" VALUE 0x8060B368 DefaultValueRecordLayout_AUTOSAR_Platform_BaseTypes_uint16 20000.0 RB_PT_PCT_SWC_DWC_CompuMethods_ident 0.0 20000. FORMAT "%10.5"
 /begin ANNOTATION ANNOTATION_LABEL "Description (coming from AUTOSAR DESC field)" /begin ANNOTATION_TEXT "Minimum output shaft speed for low idle okay always\r\n" /end ANNOTATION_TEXT /end ANNOTATION
/end CHARACTERISTIC
/begin CHARACTERISTIC DWC_EFLASHB.DWC_TorqueControl.DWC_CRPLOWIDLEOKAYMINOUTPUTSPEEDLO "" VALUE 0x8060B36A DefaultValueRecordLayout_AUTOSAR_Platform_BaseTypes_uint16 20000.0 RB_PT_PCT_SWC_DWC_CompuMethods_ident 0.0 20000. FORMAT "%10.5"
 /begin ANNOTATION ANNOTATION_LABEL "Description (coming from AUTOSAR DESC field)" /begin ANNOTATION_TEXT "Minimum output shaft speed for low idle okay always\r\n" /end ANNOTATION_TEXT /end ANNOTATION
/end CHARACTERISTIC
/begin CHARACTERISTIC DWC_EFLASHB.DWC_TorqueControl.DWC_CRPMINTARGETSLIP "" VALUE 0x8060B36C DefaultValueRecordLayout_AUTOSAR_Platform_BaseTypes_uint16 20000.0 RB_PT_PCT_SWC_DWC_CompuMethods_ident 0.0 20000. FORMAT "%10.5"
 /begin ANNOTATION ANNOTATION_LABEL "Description (coming from AUTOSAR DESC field)"
  /begin ANNOTATION_TEXT "Minimum slip speed during creep (for engine speed target)\r\n" /end ANNOTATION_TEXT
 /end ANNOTATION
/end CHARACTERISTIC
/begin CHARACTERISTIC DWC_EFLASHB.DWC_TorqueControl.DWC_CRPOUTPUTSPEEDTOKMH "" VALUE 0x8060B36E DefaultValueRecordLayout_AUTOSAR_Platform_BaseTypes_uint16 0.2 RB_PT_PCT_SWC_DWC_CompuMethods_ratio_0p0001 0.0 0.2 FORMAT "%10.5"
 /begin ANNOTATION ANNOTATION_LABEL "Description (coming from AUTOSAR DESC field)"
  /begin ANNOTATION_TEXT "Conversion factor from output speed (RPM) to vehicle speed (KMH)\r\n" /end ANNOTATION_TEXT
 /end ANNOTATION
/end CHARACTERISTIC
/begin CHARACTERISTIC DWC_EFLASHB.DWC_TorqueControl.DWC_CRPPGAINSCHED "" CURVE 0x8060C980 RB_PT_PCT_SWC_DWC_RecordLayouts_RL_Curve_sint16_5_sint16_5 20.0 RB_PT_PCT_SWC_DWC_CompuMethods_ratio_0p01 0.0 20. FORMAT "%10.5"
 /begin ANNOTATION ANNOTATION_LABEL "Description (coming from AUTOSAR DESC field)" /begin ANNOTATION_TEXT "Scheduled creep gain vs actual speed\r\n" /end ANNOTATION_TEXT /end ANNOTATION
 /begin AXIS_DESCR STD_AXIS NO_INPUT_QUANTITY RB_PT_PCT_SWC_DWC_CompuMethods_ratio_0p01 5 -20. 20. FORMAT "%10.5" DEPOSIT ABSOLUTE /end AXIS_DESCR
/end CHARACTERISTIC
/begin CHARACTERISTIC DWC_EFLASHB.DWC_TorqueControl.DWC_CRPTargetRateLim.DWC_CRPDECREASEIIR "" VALUE 0x8060B4F0 DefaultValueRecordLayout_AUTOSAR_Platform_BaseTypes_uint8 1.0 RB_PT_PCT_SWC_DWC_CompuMethods_ratio_0p01 0.0 1. FORMAT "%10.5"
 /begin ANNOTATION ANNOTATION_LABEL "Description (coming from AUTOSAR DESC field)" /begin ANNOTATION_TEXT "IIR filter co-efficient - decreasing\r\n" /end ANNOTATION_TEXT /end ANNOTATION
/end CHARACTERISTIC
/begin CHARACTERISTIC DWC_EFLASHB.DWC_TorqueControl.DWC_CRPTargetRateLim.DWC_CRPDECREASERATE "" VALUE 0x8060B4E8 DefaultValueRecordLayout_AUTOSAR_Platform_BaseTypes_sint32 80.0 RB_PT_PCT_SWC_DWC_CompuMethods_ratio_0p0001 -40. 40. FORMAT "%10.5"
 /begin ANNOTATION ANNOTATION_LABEL "Description (coming from AUTOSAR DESC field)" /begin ANNOTATION_TEXT "Decrease rate of speed\r\n" /end ANNOTATION_TEXT /end ANNOTATION
/end CHARACTERISTIC
/begin CHARACTERISTIC DWC_EFLASHB.DWC_TorqueControl.DWC_CRPTargetRateLim.DWC_CRPINCREASEIIR "" VALUE 0x8060B4F1 DefaultValueRecordLayout_AUTOSAR_Platform_BaseTypes_uint8 1.0 RB_PT_PCT_SWC_DWC_CompuMethods_ratio_0p01 0.0 1. FORMAT "%10.5"
 /begin ANNOTATION ANNOTATION_LABEL "Description (coming from AUTOSAR DESC field)" /begin ANNOTATION_TEXT "IIR filter co-efficient - increasing\r\n" /end ANNOTATION_TEXT /end ANNOTATION
/end CHARACTERISTIC
/begin CHARACTERISTIC DWC_EFLASHB.DWC_TorqueControl.DWC_CRPTargetRateLim.DWC_CRPINCREASERATE "" VALUE 0x8060B4EC DefaultValueRecordLayout_AUTOSAR_Platform_BaseTypes_sint32 80.0 RB_PT_PCT_SWC_DWC_CompuMethods_ratio_0p0001 -40. 40. FORMAT "%10.5"
 /begin ANNOTATION ANNOTATION_LABEL "Description (coming from AUTOSAR DESC field)" /begin ANNOTATION_TEXT "Maximum increase rate of speed\r\n" /end ANNOTATION_TEXT /end ANNOTATION
/end CHARACTERISTIC
/begin CHARACTERISTIC DWC_EFLASHB.DWC_TorqueControl.DWC_CRPTARGETSPEEDHYST "" VALUE 0x8060B370 DefaultValueRecordLayout_AUTOSAR_Platform_BaseTypes_sint16 40.0 RB_PT_PCT_SWC_DWC_CompuMethods_ratio_0p01 -20. 20. FORMAT "%10.5"
 /begin ANNOTATION ANNOTATION_LABEL "Description (coming from AUTOSAR DESC field)"
  /begin ANNOTATION_TEXT "Offset of actual creep speed below desired creep speed for re-activation of a creep target speed\r\n" /end ANNOTATION_TEXT
 /end ANNOTATION
/end CHARACTERISTIC
/begin CHARACTERISTIC DWC_EFLASHB.DWC_TorqueControl.DWC_CRPTARGETSPEEDOFFSET "" VALUE 0x8060B372 DefaultValueRecordLayout_AUTOSAR_Platform_BaseTypes_sint16 40.0 RB_PT_PCT_SWC_DWC_CompuMethods_ratio_0p01 -20. 20. FORMAT "%10.5"
 /begin ANNOTATION ANNOTATION_LABEL "Description (coming from AUTOSAR DESC field)"
  /begin ANNOTATION_TEXT "Offset above desired creep speed that target creep is set to 0\r\n" /end ANNOTATION_TEXT
 /end ANNOTATION
/end CHARACTERISTIC
/begin CHARACTERISTIC DWC_EFLASHB.DWC_TorqueControl.DWC_CRPTHROTTLETARGET "" CURVE 0x8060C996 RB_PT_PCT_SWC_DWC_RecordLayouts_RL_Curve_sint16_5_uint8_5 40.0 RB_PT_PCT_SWC_DWC_CompuMethods_ratio_0p01 -20. 20. FORMAT "%10.5"
 /begin ANNOTATION ANNOTATION_LABEL "Description (coming from AUTOSAR DESC field)" /begin ANNOTATION_TEXT "Target vehicle speed based on throttle pedal\r\n" /end ANNOTATION_TEXT /end ANNOTATION
 /begin AXIS_DESCR STD_AXIS NO_INPUT_QUANTITY RB_PT_PCT_SWC_DWC_CompuMethods_ratio_0p4 5 0.0 102. FORMAT "%10.5" DEPOSIT ABSOLUTE /end AXIS_DESCR
/end CHARACTERISTIC
/begin CHARACTERISTIC DWC_EFLASHB.DWC_TorqueControl.DWC_DeltaCalc.DWC_DELTACYCLES "" VALUE 0x8060B638 DefaultValueRecordLayout_AUTOSAR_Platform_BaseTypes_uint8 8.0 RB_PT_PCT_SWC_DWC_CompuMethods_ident 1. 9. FORMAT "%10.5"
 /begin ANNOTATION ANNOTATION_LABEL "Description (coming from AUTOSAR DESC field)" /begin ANNOTATION_TEXT "Cycles over which the delta is done\r\n" /end ANNOTATION_TEXT /end ANNOTATION
/end CHARACTERISTIC
/begin CHARACTERISTIC DWC_EFLASHB.DWC_TorqueControl.DWC_DeltaCalc.DWC_DELTAPEDALDECAYRATE "" CURVE 0x8060B63A RB_PT_PCT_SWC_DWC_RecordLayouts_RL_Curve_uint16_5_uint8_5 65.535 RB_PT_PCT_SWC_DWC_CompuMethods_ratio_0p001__2 0.0 65.535 FORMAT "%10.5"
 /begin ANNOTATION ANNOTATION_LABEL "Description (coming from AUTOSAR DESC field)" /begin ANNOTATION_TEXT "Rate of decay of delta pedal\r\n" /end ANNOTATION_TEXT /end ANNOTATION
 /begin AXIS_DESCR STD_AXIS NO_INPUT_QUANTITY RB_PT_PCT_SWC_DWC_CompuMethods_ratio_0p4 5 0.0 102. FORMAT "%10.5" DEPOSIT ABSOLUTE /end AXIS_DESCR
/end CHARACTERISTIC
/begin CHARACTERISTIC DWC_EFLASHB.DWC_TorqueControl.DWC_DeltaDecay.DWC_DDDECAYRATE "" CURVE 0x8060B650 RB_PT_PCT_SWC_DWC_RecordLayouts_RL_Curve_uint16_7_sint16_7 65535.0 RB_PT_PCT_SWC_DWC_CompuMethods_ident 0.0 65535. FORMAT "%10.5"
 /begin ANNOTATION ANNOTATION_LABEL "Description (coming from AUTOSAR DESC field)" /begin ANNOTATION_TEXT "Rate of decay of delta torque\r\n" /end ANNOTATION_TEXT /end ANNOTATION
 /begin AXIS_DESCR STD_AXIS NO_INPUT_QUANTITY RB_PT_PCT_SWC_DWC_CompuMethods_ident 7 -10000. 10000. FORMAT "%10.5" DEPOSIT ABSOLUTE /end AXIS_DESCR
/end CHARACTERISTIC
/begin CHARACTERISTIC DWC_EFLASHB.DWC_TorqueControl.DWC_DeltaDecay.DWC_DDENABLE "" VALUE 0x8060B64C DefaultValueRecordLayout_AUTOSAR_Platform_BaseTypes_boolean 255.0 AUTOSAR_Platform_CompuMethods_boolean 0.0 255. FORMAT "%10.5"
 /begin ANNOTATION ANNOTATION_LABEL "Description (coming from AUTOSAR DESC field)" /begin ANNOTATION_TEXT "Flag to enable class\r\n" /end ANNOTATION_TEXT /end ANNOTATION
/end CHARACTERISTIC
/begin CHARACTERISTIC DWC_EFLASHB.DWC_TorqueControl.DWC_DeltaDecay.DWC_DDNEGATIVEONLY "" VALUE 0x8060B64D DefaultValueRecordLayout_AUTOSAR_Platform_BaseTypes_boolean 255.0 AUTOSAR_Platform_CompuMethods_boolean 0.0 255. FORMAT "%10.5"
 /begin ANNOTATION ANNOTATION_LABEL "Description (coming from AUTOSAR DESC field)" /begin ANNOTATION_TEXT "Flag to request only negative data\r\n" /end ANNOTATION_TEXT /end ANNOTATION
/end CHARACTERISTIC
/begin CHARACTERISTIC DWC_EFLASHB.DWC_TorqueControl.DWC_DeltaDecay.DWC_DDPEAKHOLDTIME "" CURVE 0x8060B66E RB_PT_PCT_SWC_DWC_RecordLayouts_RL_Curve_uint16_7_sint16_7 10.0 RB_PT_PCT_SWC_DWC_CompuMethods_ratio_0p001__2 0.0 10. FORMAT "%10.5"
 /begin ANNOTATION ANNOTATION_LABEL "Description (coming from AUTOSAR DESC field)" /begin ANNOTATION_TEXT "Time to peak hold delta torque based on hold delta\r\n" /end ANNOTATION_TEXT /end ANNOTATION
 /begin AXIS_DESCR STD_AXIS NO_INPUT_QUANTITY RB_PT_PCT_SWC_DWC_CompuMethods_ident 7 -10000. 10000. FORMAT "%10.5" DEPOSIT ABSOLUTE /end AXIS_DESCR
/end CHARACTERISTIC
/begin CHARACTERISTIC DWC_EFLASHB.DWC_TorqueControl.DWC_DeltaDecay.DWC_DDPOSITIVEONLY "" VALUE 0x8060B64E DefaultValueRecordLayout_AUTOSAR_Platform_BaseTypes_boolean 255.0 AUTOSAR_Platform_CompuMethods_boolean 0.0 255. FORMAT "%10.5"
 /begin ANNOTATION ANNOTATION_LABEL "Description (coming from AUTOSAR DESC field)" /begin ANNOTATION_TEXT "Flag to request only positive data\r\n" /end ANNOTATION_TEXT /end ANNOTATION
/end CHARACTERISTIC
/begin CHARACTERISTIC DWC_EFLASHB.DWC_TorqueControl.DWC_dEngineCFilter.DWC_FIRSTORDERLPCOEFF "" VALUE 0x8060C7F6 DefaultValueRecordLayout_AUTOSAR_Platform_BaseTypes_uint8 1.0 RB_PT_PCT_SWC_DWC_CompuMethods_ratio_0p01 0.0 1. FORMAT "%10.5"
 /begin ANNOTATION ANNOTATION_LABEL "Description (coming from AUTOSAR DESC field)" /begin ANNOTATION_TEXT "Coefficient for low pass IIR filter\r\n" /end ANNOTATION_TEXT /end ANNOTATION
/end CHARACTERISTIC
/begin CHARACTERISTIC DWC_EFLASHB.DWC_TorqueControl.DWC_dEngineSpeedFilter.DWC_FIRSTORDERLPCOEFF "" VALUE 0x8060C7F7 DefaultValueRecordLayout_AUTOSAR_Platform_BaseTypes_uint8 1.0 RB_PT_PCT_SWC_DWC_CompuMethods_ratio_0p01 0.0 1. FORMAT "%10.5"
 /begin ANNOTATION ANNOTATION_LABEL "Description (coming from AUTOSAR DESC field)" /begin ANNOTATION_TEXT "Coefficient for low pass IIR filter\r\n" /end ANNOTATION_TEXT /end ANNOTATION
/end CHARACTERISTIC
/begin CHARACTERISTIC DWC_EFLASHB.DWC_TorqueControl.DWC_dInput1Filter.DWC_FIRSTORDERLPCOEFF "" VALUE 0x8060C7F8 DefaultValueRecordLayout_AUTOSAR_Platform_BaseTypes_uint8 1.0 RB_PT_PCT_SWC_DWC_CompuMethods_ratio_0p01 0.0 1. FORMAT "%10.5"
 /begin ANNOTATION ANNOTATION_LABEL "Description (coming from AUTOSAR DESC field)" /begin ANNOTATION_TEXT "Coefficient for low pass IIR filter\r\n" /end ANNOTATION_TEXT /end ANNOTATION
/end CHARACTERISTIC
/begin CHARACTERISTIC DWC_EFLASHB.DWC_TorqueControl.DWC_dInput2Filter.DWC_FIRSTORDERLPCOEFF "" VALUE 0x8060C7F9 DefaultValueRecordLayout_AUTOSAR_Platform_BaseTypes_uint8 1.0 RB_PT_PCT_SWC_DWC_CompuMethods_ratio_0p01 0.0 1. FORMAT "%10.5"
 /begin ANNOTATION ANNOTATION_LABEL "Description (coming from AUTOSAR DESC field)" /begin ANNOTATION_TEXT "Coefficient for low pass IIR filter\r\n" /end ANNOTATION_TEXT /end ANNOTATION
/end CHARACTERISTIC
/begin CHARACTERISTIC DWC_EFLASHB.DWC_TorqueControl.DWC_DINPUTCORRECTMAX "" VALUE 0x8060B374 DefaultValueRecordLayout_AUTOSAR_Platform_BaseTypes_sint16 64000.0 RB_PT_PCT_SWC_DWC_CompuMethods_ident -32000. 32000. FORMAT "%10.5"
 /begin ANNOTATION ANNOTATION_LABEL "Description (coming from AUTOSAR DESC field)" /begin ANNOTATION_TEXT "Correction positive max use\r\n" /end ANNOTATION_TEXT /end ANNOTATION
/end CHARACTERISTIC
/begin CHARACTERISTIC DWC_EFLASHB.DWC_TorqueControl.DWC_DINPUTCORRECTMIN "" VALUE 0x8060B376 DefaultValueRecordLayout_AUTOSAR_Platform_BaseTypes_sint16 64000.0 RB_PT_PCT_SWC_DWC_CompuMethods_ident -32000. 32000. FORMAT "%10.5"
 /begin ANNOTATION ANNOTATION_LABEL "Description (coming from AUTOSAR DESC field)" /begin ANNOTATION_TEXT "Correction negative max use\r\n" /end ANNOTATION_TEXT /end ANNOTATION
/end CHARACTERISTIC
/begin CHARACTERISTIC DWC_EFLASHB.DWC_TorqueControl.DWC_DisengageHold.DWC_DISENGAGEMINTORQUE "" CURVE 0x8060B690 RB_PT_PCT_SWC_DWC_RecordLayouts_RL_Curve_sint16_5_sint16_5 4000.0 RB_PT_PCT_SWC_DWC_CompuMethods_ratio_0p1 -2000. 2000. FORMAT "%10.5"
 /begin ANNOTATION ANNOTATION_LABEL "Description (coming from AUTOSAR DESC field)"
  /begin ANNOTATION_TEXT "Minimum torque in disengage phase with respect to engine torque\r\n" /end ANNOTATION_TEXT
 /end ANNOTATION
 /begin AXIS_DESCR STD_AXIS NO_INPUT_QUANTITY RB_PT_PCT_SWC_DWC_CompuMethods_ratio_0p1 5 -2000. 2000. FORMAT "%10.5" DEPOSIT ABSOLUTE /end AXIS_DESCR
/end CHARACTERISTIC
/begin CHARACTERISTIC DWC_EFLASHB.DWC_TorqueControl.DWC_DisengageHold.DWC_DISENGAGEMINTORQUEPOWEROFFDOWN "" CURVE 0x8060B6A6 RB_PT_PCT_SWC_DWC_RecordLayouts_RL_Curve_sint16_5_sint16_5 4000.0 RB_PT_PCT_SWC_DWC_CompuMethods_ratio_0p1 -2000. 2000. FORMAT "%10.5"
 /begin ANNOTATION ANNOTATION_LABEL "Description (coming from AUTOSAR DESC field)"
  /begin ANNOTATION_TEXT "Minimum torque in disengage phase with respect to engine torque\r\n" /end ANNOTATION_TEXT
 /end ANNOTATION
 /begin AXIS_DESCR STD_AXIS NO_INPUT_QUANTITY RB_PT_PCT_SWC_DWC_CompuMethods_ratio_0p1 5 -2000. 2000. FORMAT "%10.5" DEPOSIT ABSOLUTE /end AXIS_DESCR
/end CHARACTERISTIC
/begin CHARACTERISTIC DWC_EFLASHB.DWC_TorqueControl.DWC_DisengageHold.DWC_DISENGAGERATE "" VALUE 0x8060B68C DefaultValueRecordLayout_AUTOSAR_Platform_BaseTypes_uint16 2000.0 RB_PT_PCT_SWC_DWC_CompuMethods_ratio_0p1 0.0 2000. FORMAT "%10.5"
 /begin ANNOTATION ANNOTATION_LABEL "Description (coming from AUTOSAR DESC field)" /begin ANNOTATION_TEXT "Disengagement rate for clutch\r\n" /end ANNOTATION_TEXT /end ANNOTATION
/end CHARACTERISTIC
/begin CHARACTERISTIC DWC_EFLASHB.DWC_TorqueControl.DWC_DisengageHold.DWC_HYSTERISISOPENTIME "" VALUE 0x8060B68E DefaultValueRecordLayout_AUTOSAR_Platform_BaseTypes_uint16 10.0 RB_PT_PCT_SWC_DWC_CompuMethods_ratio_0p001__2 0.0 10. FORMAT "%10.5"
 /begin ANNOTATION ANNOTATION_LABEL "Description (coming from AUTOSAR DESC field)"
  /begin ANNOTATION_TEXT "Minimum torque level for brief opening to reduce clutch hysterisis effects\r\n" /end ANNOTATION_TEXT
 /end ANNOTATION
/end CHARACTERISTIC
/begin CHARACTERISTIC DWC_EFLASHB.DWC_TorqueControl.DWC_DisengageRollOff.DWC_DISENGAGEMINTORQUEASG "" VALUE 0x8060B6BC DefaultValueRecordLayout_AUTOSAR_Platform_BaseTypes_sint16 4000.0 RB_PT_PCT_SWC_DWC_CompuMethods_ratio_0p1 -2000. 2000. FORMAT "%10.5"
 /begin ANNOTATION ANNOTATION_LABEL "Description (coming from AUTOSAR DESC field)" /begin ANNOTATION_TEXT "Torque to disengage to before drop - ASG mode\r\n" /end ANNOTATION_TEXT /end ANNOTATION
/end CHARACTERISTIC
/begin CHARACTERISTIC DWC_EFLASHB.DWC_TorqueControl.DWC_DisengageRollOff.DWC_DISENGAGEMINTORQUEFAST "" VALUE 0x8060B6BE DefaultValueRecordLayout_AUTOSAR_Platform_BaseTypes_sint16 4000.0 RB_PT_PCT_SWC_DWC_CompuMethods_ratio_0p1 -2000. 2000. FORMAT "%10.5"
 /begin ANNOTATION ANNOTATION_LABEL "Description (coming from AUTOSAR DESC field)" /begin ANNOTATION_TEXT "Torque to disengage to before drop - fast handover\r\n" /end ANNOTATION_TEXT /end ANNOTATION
/end CHARACTERISTIC
/begin CHARACTERISTIC DWC_EFLASHB.DWC_TorqueControl.DWC_DisengageRollOff.DWC_DISENGAGEMINTORQUEHYBRID "" VALUE 0x8060B6C0 DefaultValueRecordLayout_AUTOSAR_Platform_BaseTypes_sint16 4000.0 RB_PT_PCT_SWC_DWC_CompuMethods_ratio_0p1 -2000. 2000. FORMAT "%10.5"
 /begin ANNOTATION ANNOTATION_LABEL "Description (coming from AUTOSAR DESC field)"
  /begin ANNOTATION_TEXT "Torque to disengage to before drop - ASG HYBRID shift\r\n" /end ANNOTATION_TEXT
 /end ANNOTATION
/end CHARACTERISTIC
/begin CHARACTERISTIC DWC_EFLASHB.DWC_TorqueControl.DWC_DisengageRollOff.DWC_DISENGAGEMINTORQUESLOW "" VALUE 0x8060B6C2 DefaultValueRecordLayout_AUTOSAR_Platform_BaseTypes_sint16 4000.0 RB_PT_PCT_SWC_DWC_CompuMethods_ratio_0p1 -2000. 2000. FORMAT "%10.5"
 /begin ANNOTATION ANNOTATION_LABEL "Description (coming from AUTOSAR DESC field)" /begin ANNOTATION_TEXT "Torque to disengage to before drop - slow handover\r\n" /end ANNOTATION_TEXT /end ANNOTATION
/end CHARACTERISTIC
/begin CHARACTERISTIC DWC_EFLASHB.DWC_TorqueControl.DWC_DisengageRollOff.DWC_DISENGAGERATEVSTORQUEDEMAND "" CURVE 0x8060B6C4 RB_PT_PCT_SWC_DWC_RecordLayouts_RL_Curve_uint16_5_sint16_5 40000.0 RB_PT_PCT_SWC_DWC_CompuMethods_ident 0.0 40000. FORMAT "%10.5"
 /begin ANNOTATION ANNOTATION_LABEL "Description (coming from AUTOSAR DESC field)"
  /begin ANNOTATION_TEXT "Roll off rate of torque as a function of torque demand\r\n" /end ANNOTATION_TEXT
 /end ANNOTATION
 /begin AXIS_DESCR STD_AXIS NO_INPUT_QUANTITY RB_PT_PCT_SWC_DWC_CompuMethods_ratio_0p1 5 -2000. 2000. FORMAT "%10.5" DEPOSIT ABSOLUTE /end AXIS_DESCR
/end CHARACTERISTIC
/begin CHARACTERISTIC DWC_EFLASHB.DWC_TorqueControl.DWC_DisengageRollOff.DWC_DISENGAGERATEVSTORQUEDEMANDASG "" CURVE 0x8060B6DA RB_PT_PCT_SWC_DWC_RecordLayouts_RL_Curve_uint16_5_sint16_5 40000.0 RB_PT_PCT_SWC_DWC_CompuMethods_ident 0.0 40000. FORMAT "%10.5"
 /begin ANNOTATION ANNOTATION_LABEL "Description (coming from AUTOSAR DESC field)"
  /begin ANNOTATION_TEXT "Roll off rate of torque as a function of torque demand - ASG shifts only\r\n" /end ANNOTATION_TEXT
 /end ANNOTATION
 /begin AXIS_DESCR STD_AXIS NO_INPUT_QUANTITY RB_PT_PCT_SWC_DWC_CompuMethods_ratio_0p1 5 -2000. 2000. FORMAT "%10.5" DEPOSIT ABSOLUTE /end AXIS_DESCR
/end CHARACTERISTIC
/begin CHARACTERISTIC DWC_EFLASHB.DWC_TorqueControl.DWC_DisengageRollOff.DWC_DISENGAGERATEVSTORQUEDEMANDFIRST "" CURVE 0x8060B6F0 RB_PT_PCT_SWC_DWC_RecordLayouts_RL_Curve_uint16_5_sint16_5 40000.0 RB_PT_PCT_SWC_DWC_CompuMethods_ident 0.0 40000. FORMAT "%10.5"
 /begin ANNOTATION ANNOTATION_LABEL "Description (coming from AUTOSAR DESC field)"
  /begin ANNOTATION_TEXT "Roll off rate of torque as a function of torque demand - selection of first\r\n" /end ANNOTATION_TEXT
 /end ANNOTATION
 /begin AXIS_DESCR STD_AXIS NO_INPUT_QUANTITY RB_PT_PCT_SWC_DWC_CompuMethods_ratio_0p1 5 -2000. 2000. FORMAT "%10.5" DEPOSIT ABSOLUTE /end AXIS_DESCR
/end CHARACTERISTIC
/begin CHARACTERISTIC DWC_EFLASHB.DWC_TorqueControl.DWC_DisengageRollOff.DWC_DISENGAGERATEVSTORQUEDEMANDHYBRID "" CURVE 0x8060B706 RB_PT_PCT_SWC_DWC_RecordLayouts_RL_Curve_uint16_5_sint16_5 40000.0 RB_PT_PCT_SWC_DWC_CompuMethods_ident 0.0 40000. FORMAT "%10.5"
 /begin ANNOTATION ANNOTATION_LABEL "Description (coming from AUTOSAR DESC field)"
  /begin ANNOTATION_TEXT "Roll off rate of torque as a function of torque demand - ASG HYBRID shifts only\r\n" /end ANNOTATION_TEXT
 /end ANNOTATION
 /begin AXIS_DESCR STD_AXIS NO_INPUT_QUANTITY RB_PT_PCT_SWC_DWC_CompuMethods_ratio_0p1 5 -2000. 2000. FORMAT "%10.5" DEPOSIT ABSOLUTE /end AXIS_DESCR
/end CHARACTERISTIC
/begin CHARACTERISTIC DWC_EFLASHB.DWC_TorqueControl.DWC_DisengageRollOff.DWC_DISENGAGERATEVSTORQUEDEMANDNEUT "" CURVE 0x8060B71C RB_PT_PCT_SWC_DWC_RecordLayouts_RL_Curve_uint16_5_sint16_5 40000.0 RB_PT_PCT_SWC_DWC_CompuMethods_ident 0.0 40000. FORMAT "%10.5"
 /begin ANNOTATION ANNOTATION_LABEL "Description (coming from AUTOSAR DESC field)"
  /begin ANNOTATION_TEXT "Roll off rate of torque as a function of torque demand - Neutral selection\r\n" /end ANNOTATION_TEXT
 /end ANNOTATION
 /begin AXIS_DESCR STD_AXIS NO_INPUT_QUANTITY RB_PT_PCT_SWC_DWC_CompuMethods_ratio_0p1 5 -2000. 2000. FORMAT "%10.5" DEPOSIT ABSOLUTE /end AXIS_DESCR
/end CHARACTERISTIC
/begin CHARACTERISTIC DWC_EFLASHB.DWC_TorqueControl.DWC_dOutput.DWC_ROCCYCLES "" VALUE 0x8060C7FA DefaultValueRecordLayout_AUTOSAR_Platform_BaseTypes_uint8 8.0 RB_PT_PCT_SWC_DWC_CompuMethods_ident 1. 9. FORMAT "%10.5"
 /begin ANNOTATION ANNOTATION_LABEL "Description (coming from AUTOSAR DESC field)" /begin ANNOTATION_TEXT "Cycles over which the ROC is done\r\n" /end ANNOTATION_TEXT /end ANNOTATION
/end CHARACTERISTIC
/begin CHARACTERISTIC DWC_EFLASHB.DWC_TorqueControl.DWC_dOutput.DWC_ROCIIRCOEFF "" VALUE 0x8060C7FB DefaultValueRecordLayout_AUTOSAR_Platform_BaseTypes_uint8 1.0 RB_PT_PCT_SWC_DWC_CompuMethods_ratio_0p01 0.0 1. FORMAT "%10.5"
 /begin ANNOTATION ANNOTATION_LABEL "Description (coming from AUTOSAR DESC field)" /begin ANNOTATION_TEXT "Coefficient for low pass IIR filter\r\n" /end ANNOTATION_TEXT /end ANNOTATION
/end CHARACTERISTIC
/begin CHARACTERISTIC DWC_EFLASHB.DWC_TorqueControl.DWC_DRVTORQUEPHASEENDDELAY "" MAP 0x8060C9A8 RB_PT_PCT_SWC_DWC_RecordLayouts_RL_Map_uint16_55_sint16_5_uint8_11 10.0 RB_PT_PCT_SWC_DWC_CompuMethods_ratio_0p001__2 0.0 10. FORMAT "%10.5"
 /begin ANNOTATION ANNOTATION_LABEL "Description (coming from AUTOSAR DESC field)" /begin ANNOTATION_TEXT "Delay at end of torque phase for offgoing to open\r\n" /end ANNOTATION_TEXT /end ANNOTATION
 /begin AXIS_DESCR STD_AXIS NO_INPUT_QUANTITY RB_PT_PCT_SWC_DWC_CompuMethods_ratio_0p1 5 -2000. 2000. FORMAT "%10.5" DEPOSIT ABSOLUTE /end AXIS_DESCR
 /begin AXIS_DESCR STD_AXIS NO_INPUT_QUANTITY RB_PT_PCT_SWC_DWC_CompuMethods_ident 11 0.0 13. FORMAT "%10.5" DEPOSIT ABSOLUTE /end AXIS_DESCR
/end CHARACTERISTIC
/begin CHARACTERISTIC DWC_EFLASHB.DWC_TorqueControl.DWC_DSPEEDCOMPOFFGOINGDOWN "" VALUE 0x8060B479 DefaultValueRecordLayout_AUTOSAR_Platform_BaseTypes_boolean 255.0 AUTOSAR_Platform_CompuMethods_boolean 0.0 255. FORMAT "%10.5"
 /begin ANNOTATION ANNOTATION_LABEL "Description (coming from AUTOSAR DESC field)"
  /begin ANNOTATION_TEXT "Flag to enable compensation of dEngineSpeed for dInputSpeed\r\n" /end ANNOTATION_TEXT
 /end ANNOTATION
/end CHARACTERISTIC
/begin CHARACTERISTIC DWC_EFLASHB.DWC_TorqueControl.DWC_DSPEEDCOMPOFFGOINGUP "" VALUE 0x8060B47A DefaultValueRecordLayout_AUTOSAR_Platform_BaseTypes_boolean 255.0 AUTOSAR_Platform_CompuMethods_boolean 0.0 255. FORMAT "%10.5"
 /begin ANNOTATION ANNOTATION_LABEL "Description (coming from AUTOSAR DESC field)"
  /begin ANNOTATION_TEXT "Flag to enable compensation of dEngineSpeed for dInputSpeed\r\n" /end ANNOTATION_TEXT
 /end ANNOTATION
/end CHARACTERISTIC
/begin CHARACTERISTIC DWC_EFLASHB.DWC_TorqueControl.DWC_DSPEEDCOMPONCOMINGDOWN "" VALUE 0x8060B47B DefaultValueRecordLayout_AUTOSAR_Platform_BaseTypes_boolean 255.0 AUTOSAR_Platform_CompuMethods_boolean 0.0 255. FORMAT "%10.5"
 /begin ANNOTATION ANNOTATION_LABEL "Description (coming from AUTOSAR DESC field)"
  /begin ANNOTATION_TEXT "Flag to enable compensation of dEngineSpeed for dInputSpeed\r\n" /end ANNOTATION_TEXT
 /end ANNOTATION
/end CHARACTERISTIC
/begin CHARACTERISTIC DWC_EFLASHB.DWC_TorqueControl.DWC_DSPEEDCOMPONCOMINGUP "" VALUE 0x8060B47C DefaultValueRecordLayout_AUTOSAR_Platform_BaseTypes_boolean 255.0 AUTOSAR_Platform_CompuMethods_boolean 0.0 255. FORMAT "%10.5"
 /begin ANNOTATION ANNOTATION_LABEL "Description (coming from AUTOSAR DESC field)"
  /begin ANNOTATION_TEXT "Flag to enable compensation of dEngineSpeed for dInputSpeed\r\n" /end ANNOTATION_TEXT
 /end ANNOTATION
/end CHARACTERISTIC
/begin CHARACTERISTIC DWC_EFLASHB.DWC_TorqueControl.DWC_DynamicFF.DWC_DYNREDUCTIONTIME "" VALUE 0x8060B732 DefaultValueRecordLayout_AUTOSAR_Platform_BaseTypes_uint16 9.99 RB_PT_PCT_SWC_DWC_CompuMethods_ratio_0p001__2 0.01 10. FORMAT "%10.5"
 /begin ANNOTATION ANNOTATION_LABEL "Description (coming from AUTOSAR DESC field)" /begin ANNOTATION_TEXT "Time to reduce from dynamic feedforward to static\r\n" /end ANNOTATION_TEXT /end ANNOTATION
/end CHARACTERISTIC
/begin CHARACTERISTIC DWC_EFLASHB.DWC_TorqueControl.DWC_ENABLEALLMODELEADTORQUE "" VALUE 0x8060B47D DefaultValueRecordLayout_AUTOSAR_Platform_BaseTypes_boolean 255.0 AUTOSAR_Platform_CompuMethods_boolean 0.0 255. FORMAT "%10.5"
 /begin ANNOTATION ANNOTATION_LABEL "Description (coming from AUTOSAR DESC field)" /begin ANNOTATION_TEXT "Flag to enable lead torque with all controller types\r\n" /end ANNOTATION_TEXT /end ANNOTATION
/end CHARACTERISTIC
/begin CHARACTERISTIC DWC_EFLASHB.DWC_TorqueControl.DWC_ENABLEALWAYSUPDATEFASTFILL "" VALUE 0x8060B47E DefaultValueRecordLayout_AUTOSAR_Platform_BaseTypes_boolean 255.0 AUTOSAR_Platform_CompuMethods_boolean 0.0 255. FORMAT "%10.5"
 /begin ANNOTATION ANNOTATION_LABEL "Description (coming from AUTOSAR DESC field)" /begin ANNOTATION_TEXT "Flag to force constant update of fast fill\r\n" /end ANNOTATION_TEXT /end ANNOTATION
/end CHARACTERISTIC
/begin CHARACTERISTIC DWC_EFLASHB.DWC_TorqueControl.DWC_ENABLEASGBYPASSPULSE "" VALUE 0x8060B47F DefaultValueRecordLayout_AUTOSAR_Platform_BaseTypes_boolean 255.0 AUTOSAR_Platform_CompuMethods_boolean 0.0 255. FORMAT "%10.5"
 /begin ANNOTATION ANNOTATION_LABEL "Description (coming from AUTOSAR DESC field)" /begin ANNOTATION_TEXT "Flag to enable fast fill in manual mode\r\n" /end ANNOTATION_TEXT /end ANNOTATION
/end CHARACTERISTIC
/begin CHARACTERISTIC DWC_EFLASHB.DWC_TorqueControl.DWC_ENABLEBUMPLESSOFFGOINGDOWN "" VALUE 0x8060B480 DefaultValueRecordLayout_AUTOSAR_Platform_BaseTypes_boolean 255.0 AUTOSAR_Platform_CompuMethods_boolean 0.0 255. FORMAT "%10.5"
 /begin ANNOTATION ANNOTATION_LABEL "Description (coming from AUTOSAR DESC field)"
  /begin ANNOTATION_TEXT "Flag to enable bumpless transfer for offgoing downshift\r\n" /end ANNOTATION_TEXT
 /end ANNOTATION
/end CHARACTERISTIC
/begin CHARACTERISTIC DWC_EFLASHB.DWC_TorqueControl.DWC_ENABLEBUMPLESSSLIPTHRESH "" VALUE 0x8060B378 DefaultValueRecordLayout_AUTOSAR_Platform_BaseTypes_sint16 40000.0 RB_PT_PCT_SWC_DWC_CompuMethods_ident -20000. 20000. FORMAT "%10.5"
 /begin ANNOTATION ANNOTATION_LABEL "Description (coming from AUTOSAR DESC field)"
  /begin ANNOTATION_TEXT "Slip threshold to bypass logic to prevent bumpless transfer for offgoing down shift, slip to gradient control.\r\n" /end ANNOTATION_TEXT
 /end ANNOTATION
/end CHARACTERISTIC
/begin CHARACTERISTIC DWC_EFLASHB.DWC_TorqueControl.DWC_ENABLEBYPASSPREPAREHIGHESTIMATE "" VALUE 0x8060B481 DefaultValueRecordLayout_AUTOSAR_Platform_BaseTypes_boolean 255.0 AUTOSAR_Platform_CompuMethods_boolean 0.0 255. FORMAT "%10.5"
 /begin ANNOTATION ANNOTATION_LABEL "Description (coming from AUTOSAR DESC field)"
  /begin ANNOTATION_TEXT "Flag to enable high torque estimate for power on up shifts\r\n" /end ANNOTATION_TEXT
 /end ANNOTATION
/end CHARACTERISTIC
/begin CHARACTERISTIC DWC_EFLASHB.DWC_TorqueControl.DWC_ENABLEBYPASSPREPAREMINI "" VALUE 0x8060B482 DefaultValueRecordLayout_AUTOSAR_Platform_BaseTypes_boolean 255.0 AUTOSAR_Platform_CompuMethods_boolean 0.0 255. FORMAT "%10.5"
 /begin ANNOTATION ANNOTATION_LABEL "Description (coming from AUTOSAR DESC field)"
  /begin ANNOTATION_TEXT "Flag to force a minimum integrator limit when bypass prepare is active\r\n" /end ANNOTATION_TEXT
 /end ANNOTATION
/end CHARACTERISTIC
/begin CHARACTERISTIC DWC_EFLASHB.DWC_TorqueControl.DWC_ENABLEBYPASSTORQUEDOWNLIMIT "" VALUE 0x8060B483 DefaultValueRecordLayout_AUTOSAR_Platform_BaseTypes_boolean 255.0 AUTOSAR_Platform_CompuMethods_boolean 0.0 255. FORMAT "%10.5"
 /begin ANNOTATION ANNOTATION_LABEL "Description (coming from AUTOSAR DESC field)" /begin ANNOTATION_TEXT "Flag to bypass torque down limit from engine\r\n" /end ANNOTATION_TEXT /end ANNOTATION
/end CHARACTERISTIC
/begin CHARACTERISTIC DWC_EFLASHB.DWC_TorqueControl.DWC_ENABLECRPRESETREFILL "" VALUE 0x8060B484 DefaultValueRecordLayout_AUTOSAR_Platform_BaseTypes_boolean 255.0 AUTOSAR_Platform_CompuMethods_boolean 0.0 255. FORMAT "%10.5"
 /begin ANNOTATION ANNOTATION_LABEL "Description (coming from AUTOSAR DESC field)"
  /begin ANNOTATION_TEXT "Flag to request creep reset if a re-fill is triggered\r\n" /end ANNOTATION_TEXT
 /end ANNOTATION
/end CHARACTERISTIC
/begin CHARACTERISTIC DWC_EFLASHB.DWC_TorqueControl.DWC_ENABLECURRTRQINPTGEARUNFILT "" VALUE 0x8060B485 DefaultValueRecordLayout_AUTOSAR_Platform_BaseTypes_boolean 255.0 AUTOSAR_Platform_CompuMethods_boolean 0.0 255. FORMAT "%10.5"
 /begin ANNOTATION ANNOTATION_LABEL "Description (coming from AUTOSAR DESC field)"
  /begin ANNOTATION_TEXT "Flag to enable unfiltered current torque input gear when NOT in pullaway\r\n" /end ANNOTATION_TEXT
 /end ANNOTATION
/end CHARACTERISTIC
/begin CHARACTERISTIC DWC_EFLASHB.DWC_TorqueControl.DWC_ENABLEDRIVERSTEADY "" VALUE 0x8060B486 DefaultValueRecordLayout_AUTOSAR_Platform_BaseTypes_boolean 255.0 AUTOSAR_Platform_CompuMethods_boolean 0.0 255. FORMAT "%10.5"
 /begin ANNOTATION ANNOTATION_LABEL "Description (coming from AUTOSAR DESC field)" /begin ANNOTATION_TEXT "Flag to enable driver steady condition assessment\r\n" /end ANNOTATION_TEXT /end ANNOTATION
/end CHARACTERISTIC
/begin CHARACTERISTIC DWC_EFLASHB.DWC_TorqueControl.DWC_ENABLEESPEEDPEDALMAXTORQUEFUNC "" VALUE 0x8060B487 DefaultValueRecordLayout_AUTOSAR_Platform_BaseTypes_boolean 255.0 AUTOSAR_Platform_CompuMethods_boolean 0.0 255. FORMAT "%10.5"
 /begin ANNOTATION ANNOTATION_LABEL "Description (coming from AUTOSAR DESC field)" /begin ANNOTATION_TEXT "Flag to enable engine speed max torque function\r\n" /end ANNOTATION_TEXT /end ANNOTATION
/end CHARACTERISTIC
/begin CHARACTERISTIC DWC_EFLASHB.DWC_TorqueControl.DWC_ENABLEETQMAXINERTIA "" VALUE 0x8060B488 DefaultValueRecordLayout_AUTOSAR_Platform_BaseTypes_boolean 255.0 AUTOSAR_Platform_CompuMethods_boolean 0.0 255. FORMAT "%10.5"
 /begin ANNOTATION ANNOTATION_LABEL "Description (coming from AUTOSAR DESC field)"
  /begin ANNOTATION_TEXT "Flag to enable maximum engine torque of the two inputs for inertia shifts - error condition from engine\r\n" /end ANNOTATION_TEXT
 /end ANNOTATION
/end CHARACTERISTIC
/begin CHARACTERISTIC DWC_EFLASHB.DWC_TorqueControl.DWC_ENABLEFASTFILLPOWERONDOWNGLOBAL "" VALUE 0x8060B489 DefaultValueRecordLayout_AUTOSAR_Platform_BaseTypes_boolean 255.0 AUTOSAR_Platform_CompuMethods_boolean 0.0 255. FORMAT "%10.5"
 /begin ANNOTATION ANNOTATION_LABEL "Description (coming from AUTOSAR DESC field)"
  /begin ANNOTATION_TEXT "Flag to enable prepare bypass on all power on down shift types\r\n" /end ANNOTATION_TEXT
 /end ANNOTATION
/end CHARACTERISTIC
/begin CHARACTERISTIC DWC_EFLASHB.DWC_TorqueControl.DWC_ENABLEFRICCOMPPOWEROFFDOWN "" VALUE 0x8060B48A DefaultValueRecordLayout_AUTOSAR_Platform_BaseTypes_boolean 255.0 AUTOSAR_Platform_CompuMethods_boolean 0.0 255. FORMAT "%10.5"
 /begin ANNOTATION ANNOTATION_LABEL "Description (coming from AUTOSAR DESC field)"
  /begin ANNOTATION_TEXT "Flag to enable friction compensation for power off down\r\n" /end ANNOTATION_TEXT
 /end ANNOTATION
/end CHARACTERISTIC
/begin CHARACTERISTIC DWC_EFLASHB.DWC_TorqueControl.DWC_ENABLEFRICCOMPPOWEROFFUP "" VALUE 0x8060B48B DefaultValueRecordLayout_AUTOSAR_Platform_BaseTypes_boolean 255.0 AUTOSAR_Platform_CompuMethods_boolean 0.0 255. FORMAT "%10.5"
 /begin ANNOTATION ANNOTATION_LABEL "Description (coming from AUTOSAR DESC field)"
  /begin ANNOTATION_TEXT "Flag to enable friction compensation for power off up\r\n" /end ANNOTATION_TEXT
 /end ANNOTATION
/end CHARACTERISTIC
/begin CHARACTERISTIC DWC_EFLASHB.DWC_TorqueControl.DWC_ENABLEFRICCOMPPOWERONDOWN "" VALUE 0x8060B48C DefaultValueRecordLayout_AUTOSAR_Platform_BaseTypes_boolean 255.0 AUTOSAR_Platform_CompuMethods_boolean 0.0 255. FORMAT "%10.5"
 /begin ANNOTATION ANNOTATION_LABEL "Description (coming from AUTOSAR DESC field)"
  /begin ANNOTATION_TEXT "Flag to enable friction compensation for power on down\r\n" /end ANNOTATION_TEXT
 /end ANNOTATION
/end CHARACTERISTIC
/begin CHARACTERISTIC DWC_EFLASHB.DWC_TorqueControl.DWC_ENABLEFRICCOMPPOWERONUP "" VALUE 0x8060B48D DefaultValueRecordLayout_AUTOSAR_Platform_BaseTypes_boolean 255.0 AUTOSAR_Platform_CompuMethods_boolean 0.0 255. FORMAT "%10.5"
 /begin ANNOTATION ANNOTATION_LABEL "Description (coming from AUTOSAR DESC field)" /begin ANNOTATION_TEXT "Flag to enable friction compensation for power on up\r\n" /end ANNOTATION_TEXT /end ANNOTATION
/end CHARACTERISTIC
/begin CHARACTERISTIC DWC_EFLASHB.DWC_TorqueControl.DWC_ENABLEIDLEADAPTCREEP "" VALUE 0x8060B48E DefaultValueRecordLayout_AUTOSAR_Platform_BaseTypes_boolean 255.0 AUTOSAR_Platform_CompuMethods_boolean 0.0 255. FORMAT "%10.5"
 /begin ANNOTATION ANNOTATION_LABEL "Description (coming from AUTOSAR DESC field)" /begin ANNOTATION_TEXT "Flag to enable engine torque adapt in creep\r\n" /end ANNOTATION_TEXT /end ANNOTATION
/end CHARACTERISTIC
/begin CHARACTERISTIC DWC_EFLASHB.DWC_TorqueControl.DWC_ENABLEIDLEADAPTNEUTRAL "" VALUE 0x8060B48F DefaultValueRecordLayout_AUTOSAR_Platform_BaseTypes_boolean 255.0 AUTOSAR_Platform_CompuMethods_boolean 0.0 255. FORMAT "%10.5"
 /begin ANNOTATION ANNOTATION_LABEL "Description (coming from AUTOSAR DESC field)" /begin ANNOTATION_TEXT "Flag to enable engine torque adapt in neutral\r\n" /end ANNOTATION_TEXT /end ANNOTATION
/end CHARACTERISTIC
/begin CHARACTERISTIC DWC_EFLASHB.DWC_TorqueControl.DWC_ENABLEITERMLOWLIMITCALC "" VALUE 0x8060B490 DefaultValueRecordLayout_AUTOSAR_Platform_BaseTypes_boolean 255.0 AUTOSAR_Platform_CompuMethods_boolean 0.0 255. FORMAT "%10.5"
 /begin ANNOTATION ANNOTATION_LABEL "Description (coming from AUTOSAR DESC field)" /begin ANNOTATION_TEXT "Flag to enable calculate I term lower limit\r\n" /end ANNOTATION_TEXT /end ANNOTATION
/end CHARACTERISTIC
/begin CHARACTERISTIC DWC_EFLASHB.DWC_TorqueControl.DWC_ENABLEITERMMAXINPUTENGINERULE "" VALUE 0x8060B491 DefaultValueRecordLayout_AUTOSAR_Platform_BaseTypes_boolean 255.0 AUTOSAR_Platform_CompuMethods_boolean 0.0 255. FORMAT "%10.5"
 /begin ANNOTATION ANNOTATION_LABEL "Description (coming from AUTOSAR DESC field)"
  /begin ANNOTATION_TEXT "Flag to enable maximum of dominant input speed and engine speed as input to I term max map\r\n" /end ANNOTATION_TEXT
 /end ANNOTATION
/end CHARACTERISTIC
/begin CHARACTERISTIC DWC_EFLASHB.DWC_TorqueControl.DWC_ENABLEITERMUNWINDSTOPLOCKUP "" VALUE 0x8060B492 DefaultValueRecordLayout_AUTOSAR_Platform_BaseTypes_boolean 255.0 AUTOSAR_Platform_CompuMethods_boolean 0.0 255. FORMAT "%10.5"
 /begin ANNOTATION ANNOTATION_LABEL "Description (coming from AUTOSAR DESC field)"
  /begin ANNOTATION_TEXT "Flag to enable unwind lock on I term during lockup overclamp when I term is <= 0.0\r\n" /end ANNOTATION_TEXT
 /end ANNOTATION
/end CHARACTERISTIC
/begin CHARACTERISTIC DWC_EFLASHB.DWC_TorqueControl.DWC_ENABLEMINITERMLIMITONCOMINGUP "" VALUE 0x8060B493 DefaultValueRecordLayout_AUTOSAR_Platform_BaseTypes_boolean 255.0 AUTOSAR_Platform_CompuMethods_boolean 0.0 255. FORMAT "%10.5"
 /begin ANNOTATION ANNOTATION_LABEL "Description (coming from AUTOSAR DESC field)"
  /begin ANNOTATION_TEXT "Flag to enable minimum I term limit on oncoming upshift\r\n" /end ANNOTATION_TEXT
 /end ANNOTATION
/end CHARACTERISTIC
/begin CHARACTERISTIC DWC_EFLASHB.DWC_TorqueControl.DWC_ENABLEMUVCOMPPULLAWAY "" VALUE 0x8060B494 DefaultValueRecordLayout_AUTOSAR_Platform_BaseTypes_boolean 255.0 AUTOSAR_Platform_CompuMethods_boolean 0.0 255. FORMAT "%10.5"
 /begin ANNOTATION ANNOTATION_LABEL "Description (coming from AUTOSAR DESC field)" /begin ANNOTATION_TEXT "Flag to allow mu/v comp during pullaway\r\n" /end ANNOTATION_TEXT /end ANNOTATION
/end CHARACTERISTIC
/begin CHARACTERISTIC DWC_EFLASHB.DWC_TorqueControl.DWC_ENABLEONCOMINGUPCTRLBLANK "" VALUE 0x8060B495 DefaultValueRecordLayout_AUTOSAR_Platform_BaseTypes_boolean 255.0 AUTOSAR_Platform_CompuMethods_boolean 0.0 255. FORMAT "%10.5"
 /begin ANNOTATION ANNOTATION_LABEL "Description (coming from AUTOSAR DESC field)"
  /begin ANNOTATION_TEXT "Flag to enable a controller blank for oncoming upshifts when gradient target is >=zero\r\n" /end ANNOTATION_TEXT
 /end ANNOTATION
/end CHARACTERISTIC
/begin CHARACTERISTIC DWC_EFLASHB.DWC_TorqueControl.DWC_ENABLEOVERHEATTORQUEOSCILLATION "" VALUE 0x8060B496 DefaultValueRecordLayout_AUTOSAR_Platform_BaseTypes_boolean 255.0 AUTOSAR_Platform_CompuMethods_boolean 0.0 255. FORMAT "%10.5"
 /begin ANNOTATION ANNOTATION_LABEL "Description (coming from AUTOSAR DESC field)" /begin ANNOTATION_TEXT "Flag to enable oscillation request on overheat\r\n" /end ANNOTATION_TEXT /end ANNOTATION
/end CHARACTERISTIC
/begin CHARACTERISTIC DWC_EFLASHB.DWC_TorqueControl.DWC_ENABLEOVERLAPTORQUEPHASEFASTFILL "" VALUE 0x8060B497 DefaultValueRecordLayout_AUTOSAR_Platform_BaseTypes_boolean 255.0 AUTOSAR_Platform_CompuMethods_boolean 0.0 255. FORMAT "%10.5"
 /begin ANNOTATION ANNOTATION_LABEL "Description (coming from AUTOSAR DESC field)" /begin ANNOTATION_TEXT "Flag to enable overlap torque phase fast fill\r\n" /end ANNOTATION_TEXT /end ANNOTATION
/end CHARACTERISTIC
/begin CHARACTERISTIC DWC_EFLASHB.DWC_TorqueControl.DWC_ENABLEOVERLAPTORQUEPHASEMIDSUPPORT "" VALUE 0x8060B498 DefaultValueRecordLayout_AUTOSAR_Platform_BaseTypes_boolean 255.0 AUTOSAR_Platform_CompuMethods_boolean 0.0 255. FORMAT "%10.5"
 /begin ANNOTATION ANNOTATION_LABEL "Description (coming from AUTOSAR DESC field)"
  /begin ANNOTATION_TEXT "Flag to enable prepare bypass on overlap torque phase mid supported shift\r\n" /end ANNOTATION_TEXT
 /end ANNOTATION
/end CHARACTERISTIC
/begin CHARACTERISTIC DWC_EFLASHB.DWC_TorqueControl.DWC_ENABLEOVERRUNTQVSPULLAWAYFUNC "" VALUE 0x8060B499 DefaultValueRecordLayout_AUTOSAR_Platform_BaseTypes_boolean 255.0 AUTOSAR_Platform_CompuMethods_boolean 0.0 255. FORMAT "%10.5"
 /begin ANNOTATION ANNOTATION_LABEL "Description (coming from AUTOSAR DESC field)" /begin ANNOTATION_TEXT "Flag to enable overrun torque vs pullaway function\r\n" /end ANNOTATION_TEXT /end ANNOTATION
/end CHARACTERISTIC
/begin CHARACTERISTIC DWC_EFLASHB.DWC_TorqueControl.DWC_ENABLEPOWEROFFDOWNMAXITERMSWITCH "" VALUE 0x8060B49A DefaultValueRecordLayout_AUTOSAR_Platform_BaseTypes_boolean 255.0 AUTOSAR_Platform_CompuMethods_boolean 0.0 255. FORMAT "%10.5"
 /begin ANNOTATION ANNOTATION_LABEL "Description (coming from AUTOSAR DESC field)"
  /begin ANNOTATION_TEXT "Flag to enable power off down switch on I term max block\r\n" /end ANNOTATION_TEXT
 /end ANNOTATION
/end CHARACTERISTIC
/begin CHARACTERISTIC DWC_EFLASHB.DWC_TorqueControl.DWC_ENABLEPOWEROFFUPRULE "" VALUE 0x8060B49B DefaultValueRecordLayout_AUTOSAR_Platform_BaseTypes_boolean 255.0 AUTOSAR_Platform_CompuMethods_boolean 0.0 255. FORMAT "%10.5"
 /begin ANNOTATION ANNOTATION_LABEL "Description (coming from AUTOSAR DESC field)" /begin ANNOTATION_TEXT "Flag to enable power off up new rule\r\n" /end ANNOTATION_TEXT /end ANNOTATION
/end CHARACTERISTIC
/begin CHARACTERISTIC DWC_EFLASHB.DWC_TorqueControl.DWC_ENABLEPREPAREBYPASS "" VALUE 0x8060B49C DefaultValueRecordLayout_AUTOSAR_Platform_BaseTypes_boolean 255.0 AUTOSAR_Platform_CompuMethods_boolean 0.0 255. FORMAT "%10.5"
 /begin ANNOTATION ANNOTATION_LABEL "Description (coming from AUTOSAR DESC field)"
  /begin ANNOTATION_TEXT "Flag to enable prepare bypass output from DWC (use bypass pulse, not normal fill pulse)\r\n" /end ANNOTATION_TEXT
 /end ANNOTATION
/end CHARACTERISTIC
/begin CHARACTERISTIC DWC_EFLASHB.DWC_TorqueControl.DWC_ENABLEPWROFFDNPWRONDNTQPHASECANCEL "" VALUE 0x8060B49D DefaultValueRecordLayout_AUTOSAR_Platform_BaseTypes_boolean 255.0 AUTOSAR_Platform_CompuMethods_boolean 0.0 255. FORMAT "%10.5"
 /begin ANNOTATION ANNOTATION_LABEL "Description (coming from AUTOSAR DESC field)"
  /begin ANNOTATION_TEXT "Flag to allow power off down to power on down torque phase early abort\r\n" /end ANNOTATION_TEXT
 /end ANNOTATION
/end CHARACTERISTIC
/begin CHARACTERISTIC DWC_EFLASHB.DWC_TorqueControl.DWC_ENABLEPWRONUPPWROFFUPTQPHASECANCEL "" VALUE 0x8060B49E DefaultValueRecordLayout_AUTOSAR_Platform_BaseTypes_boolean 255.0 AUTOSAR_Platform_CompuMethods_boolean 0.0 255. FORMAT "%10.5"
 /begin ANNOTATION ANNOTATION_LABEL "Description (coming from AUTOSAR DESC field)"
  /begin ANNOTATION_TEXT "Flag to allow power on up to power off up torque phase early abort\r\n" /end ANNOTATION_TEXT
 /end ANNOTATION
/end CHARACTERISTIC
/begin CHARACTERISTIC DWC_EFLASHB.DWC_TorqueControl.DWC_ENABLESCHEDULEDSLCGAINSPA "" VALUE 0x8060B49F DefaultValueRecordLayout_AUTOSAR_Platform_BaseTypes_boolean 255.0 AUTOSAR_Platform_CompuMethods_boolean 0.0 255. FORMAT "%10.5"
 /begin ANNOTATION ANNOTATION_LABEL "Description (coming from AUTOSAR DESC field)" /begin ANNOTATION_TEXT "Flag to request slip P gains based on pullaway gears\r\n" /end ANNOTATION_TEXT /end ANNOTATION
/end CHARACTERISTIC
/begin CHARACTERISTIC DWC_EFLASHB.DWC_TorqueControl.DWC_ENABLESLIPINCLUTCHSTATE "" VALUE 0x8060B4A0 DefaultValueRecordLayout_AUTOSAR_Platform_BaseTypes_boolean 255.0 AUTOSAR_Platform_CompuMethods_boolean 0.0 255. FORMAT "%10.5"
 /begin ANNOTATION ANNOTATION_LABEL "Description (coming from AUTOSAR DESC field)"
  /begin ANNOTATION_TEXT "Flag to enable slip monitoring one shot in clutch state\r\n" /end ANNOTATION_TEXT
 /end ANNOTATION
/end CHARACTERISTIC
/begin CHARACTERISTIC DWC_EFLASHB.DWC_TorqueControl.DWC_ENABLESOFTFILL "" VALUE 0x8060B4A1 DefaultValueRecordLayout_AUTOSAR_Platform_BaseTypes_boolean 255.0 AUTOSAR_Platform_CompuMethods_boolean 0.0 255. FORMAT "%10.5"
 /begin ANNOTATION ANNOTATION_LABEL "Description (coming from AUTOSAR DESC field)" /begin ANNOTATION_TEXT "Flag to enable soft fill requests\r\n" /end ANNOTATION_TEXT /end ANNOTATION
/end CHARACTERISTIC
/begin CHARACTERISTIC DWC_EFLASHB.DWC_TorqueControl.DWC_ENABLESPEEDCONTROLPOWERONRULEDOWN "" VALUE 0x8060B4A2 DefaultValueRecordLayout_AUTOSAR_Platform_BaseTypes_boolean 255.0 AUTOSAR_Platform_CompuMethods_boolean 0.0 255. FORMAT "%10.5"
 /begin ANNOTATION ANNOTATION_LABEL "Description (coming from AUTOSAR DESC field)" /begin ANNOTATION_TEXT "Flag to enable power on rule in pullaway\r\n" /end ANNOTATION_TEXT /end ANNOTATION
/end CHARACTERISTIC
/begin CHARACTERISTIC DWC_EFLASHB.DWC_TorqueControl.DWC_ENABLETORQUEESTALWAYS "" VALUE 0x8060B4A3 DefaultValueRecordLayout_AUTOSAR_Platform_BaseTypes_boolean 255.0 AUTOSAR_Platform_CompuMethods_boolean 0.0 255. FORMAT "%10.5"
 /begin ANNOTATION ANNOTATION_LABEL "Description (coming from AUTOSAR DESC field)" /begin ANNOTATION_TEXT "Flag to enable torque estimate always\r\n" /end ANNOTATION_TEXT /end ANNOTATION
/end CHARACTERISTIC
/begin CHARACTERISTIC DWC_EFLASHB.DWC_TorqueControl.DWC_ENABLETORQUEESTPOWERONDOWN "" VALUE 0x8060B4A4 DefaultValueRecordLayout_AUTOSAR_Platform_BaseTypes_boolean 255.0 AUTOSAR_Platform_CompuMethods_boolean 0.0 255. FORMAT "%10.5"
 /begin ANNOTATION ANNOTATION_LABEL "Description (coming from AUTOSAR DESC field)" /begin ANNOTATION_TEXT "Flag to enable overlap torque phase fast fill\r\n" /end ANNOTATION_TEXT /end ANNOTATION
/end CHARACTERISTIC
/begin CHARACTERISTIC DWC_EFLASHB.DWC_TorqueControl.DWC_ENABLETORQUESWITCHASG "" VALUE 0x8060B4A5 DefaultValueRecordLayout_AUTOSAR_Platform_BaseTypes_boolean 255.0 AUTOSAR_Platform_CompuMethods_boolean 0.0 255. FORMAT "%10.5"
 /begin ANNOTATION ANNOTATION_LABEL "Description (coming from AUTOSAR DESC field)"
  /begin ANNOTATION_TEXT "Flag to switch torque signals when ASG shifts are active\r\n" /end ANNOTATION_TEXT
 /end ANNOTATION
/end CHARACTERISTIC
/begin CHARACTERISTIC DWC_EFLASHB.DWC_TorqueControl.DWC_ENABLETORQUESWITCHPTSYNC "" VALUE 0x8060B4A6 DefaultValueRecordLayout_AUTOSAR_Platform_BaseTypes_boolean 255.0 AUTOSAR_Platform_CompuMethods_boolean 0.0 255. FORMAT "%10.5"
 /begin ANNOTATION ANNOTATION_LABEL "Description (coming from AUTOSAR DESC field)" /begin ANNOTATION_TEXT "Flag to switch torque signals when PTSync is active\r\n" /end ANNOTATION_TEXT /end ANNOTATION
/end CHARACTERISTIC
/begin CHARACTERISTIC DWC_EFLASHB.DWC_TorqueControl.DWC_ENABLETRUETORQUEPHASETIMEOUTPUT "" VALUE 0x8060B4A7 DefaultValueRecordLayout_AUTOSAR_Platform_BaseTypes_boolean 255.0 AUTOSAR_Platform_CompuMethods_boolean 0.0 255. FORMAT "%10.5"
 /begin ANNOTATION ANNOTATION_LABEL "Description (coming from AUTOSAR DESC field)"
  /begin ANNOTATION_TEXT "Flag to enable output of true torque phase time as opposed to auto mode\r\n" /end ANNOTATION_TEXT
 /end ANNOTATION
/end CHARACTERISTIC
/begin CHARACTERISTIC DWC_EFLASHB.DWC_TorqueControl.DWC_ENGINEINERTIAOFFDNVSTYPE "" VAL_BLK 0x8060B354 DefaultValueRecordLayout_AUTOSAR_Platform_BaseTypes_uint8 0.95 RB_PT_PCT_SWC_DWC_CompuMethods_ratio_0p01 0.05 1. FORMAT "%10.5"
 /begin ANNOTATION ANNOTATION_LABEL "Description (coming from AUTOSAR DESC field)"
  /begin ANNOTATION_TEXT "Inertia of transmission input (offgoing down) - against inertia type (0 = Normal)\r\n" /end ANNOTATION_TEXT
 /end ANNOTATION
 MATRIX_DIM 2 1 1 /end CHARACTERISTIC
/begin CHARACTERISTIC DWC_EFLASHB.DWC_TorqueControl.DWC_ENGINEINERTIATQCOMPVSTYPE "" VAL_BLK 0x8060B356 DefaultValueRecordLayout_AUTOSAR_Platform_BaseTypes_uint8 1.0 RB_PT_PCT_SWC_DWC_CompuMethods_ratio_0p01 0.0 1. FORMAT "%10.5"
 /begin ANNOTATION ANNOTATION_LABEL "Description (coming from AUTOSAR DESC field)"
  /begin ANNOTATION_TEXT "Inertia of transmission input for torque compensation - against inertia type (0 = Normal)\r\n" /end ANNOTATION_TEXT
 /end ANNOTATION
 MATRIX_DIM 2 1 1 /end CHARACTERISTIC
/begin CHARACTERISTIC DWC_EFLASHB.DWC_TorqueControl.DWC_ENGINEINERTIATQDNVSTYPE "" VAL_BLK 0x8060B358 DefaultValueRecordLayout_AUTOSAR_Platform_BaseTypes_uint8 0.95 RB_PT_PCT_SWC_DWC_CompuMethods_ratio_0p01 0.05 1. FORMAT "%10.5"
 /begin ANNOTATION ANNOTATION_LABEL "Description (coming from AUTOSAR DESC field)"
  /begin ANNOTATION_TEXT "Inertia of transmission input (torque down) - against inertia type (0 = Normal)\r\n" /end ANNOTATION_TEXT
 /end ANNOTATION
 MATRIX_DIM 2 1 1 /end CHARACTERISTIC
/begin CHARACTERISTIC DWC_EFLASHB.DWC_TorqueControl.DWC_ENGINEINERTIAVSTYPE "" VAL_BLK 0x8060B35A DefaultValueRecordLayout_AUTOSAR_Platform_BaseTypes_uint8 0.95 RB_PT_PCT_SWC_DWC_CompuMethods_ratio_0p01 0.05 1. FORMAT "%10.5"
 /begin ANNOTATION ANNOTATION_LABEL "Description (coming from AUTOSAR DESC field)"
  /begin ANNOTATION_TEXT "Inertia of transmission input - against inertia type (0 = Normal)\r\n" /end ANNOTATION_TEXT
 /end ANNOTATION
 MATRIX_DIM 2 1 1 /end CHARACTERISTIC
/begin CHARACTERISTIC DWC_EFLASHB.DWC_TorqueControl.DWC_ENGINESPEEDITERMMAX "" CURVE 0x8060CA30 RB_PT_PCT_SWC_DWC_RecordLayouts_RL_Curve_uint16_5_sint16_5 2000.0 RB_PT_PCT_SWC_DWC_CompuMethods_ratio_0p1 0.0 2000. FORMAT "%10.5"
 /begin ANNOTATION ANNOTATION_LABEL "Description (coming from AUTOSAR DESC field)" /begin ANNOTATION_TEXT "Maximum Integral term vs engine speed above idle\r\n" /end ANNOTATION_TEXT /end ANNOTATION
 /begin AXIS_DESCR STD_AXIS NO_INPUT_QUANTITY RB_PT_PCT_SWC_DWC_CompuMethods_ident 5 -20000. 20000. FORMAT "%10.5" DEPOSIT ABSOLUTE /end AXIS_DESCR
/end CHARACTERISTIC
/begin CHARACTERISTIC DWC_EFLASHB.DWC_TorqueControl.DWC_ENGINETORQUEDOWNREMAP "" MAP 0x8060CA46 RB_PT_PCT_SWC_DWC_RecordLayouts_RL_Map_uint16_35_uint16_5_uint16_7 2000.0 RB_PT_PCT_SWC_DWC_CompuMethods_ratio_0p1 0.0 2000. FORMAT "%10.5"
 /begin ANNOTATION ANNOTATION_LABEL "Description (coming from AUTOSAR DESC field)"
  /begin ANNOTATION_TEXT "Torque down request re-mapped to avoid errors in engine calculations\r\n" /end ANNOTATION_TEXT
 /end ANNOTATION
 /begin AXIS_DESCR STD_AXIS NO_INPUT_QUANTITY RB_PT_PCT_SWC_DWC_CompuMethods_ident 5 0.0 20000. FORMAT "%10.5" DEPOSIT ABSOLUTE /end AXIS_DESCR
 /begin AXIS_DESCR STD_AXIS NO_INPUT_QUANTITY RB_PT_PCT_SWC_DWC_CompuMethods_ratio_0p1 7 0.0 2000. FORMAT "%10.5" DEPOSIT ABSOLUTE /end AXIS_DESCR
/end CHARACTERISTIC
/begin CHARACTERISTIC DWC_EFLASHB.DWC_TorqueControl.DWC_FFCASGMAXFEEDFORWARD "" CURVE 0x8060CAA8 RB_PT_PCT_SWC_DWC_RecordLayouts_RL_Curve_sint16_5_uint16_5 2000.0 RB_PT_PCT_SWC_DWC_CompuMethods_ratio_0p1 0.0 2000. FORMAT "%10.5"
 /begin ANNOTATION ANNOTATION_LABEL "Description (coming from AUTOSAR DESC field)" /begin ANNOTATION_TEXT "Maximum feedforward based on pulse time (ASG)\r\n" /end ANNOTATION_TEXT /end ANNOTATION
 /begin AXIS_DESCR STD_AXIS NO_INPUT_QUANTITY RB_PT_PCT_SWC_DWC_CompuMethods_ratio_0p001__2 5 0.0 10. FORMAT "%10.5" DEPOSIT ABSOLUTE /end AXIS_DESCR
/end CHARACTERISTIC
/begin CHARACTERISTIC DWC_EFLASHB.DWC_TorqueControl.DWC_FillTorque.DWC_FILLTORQUETARGETPOWEROFFDOWN "" CURVE 0x8060B734 RB_PT_PCT_SWC_DWC_RecordLayouts_RL_Curve_sint16_5_uint16_5 4000.0 RB_PT_PCT_SWC_DWC_CompuMethods_ratio_0p1 -2000. 2000. FORMAT "%10.5"
 /begin ANNOTATION ANNOTATION_LABEL "Description (coming from AUTOSAR DESC field)"
  /begin ANNOTATION_TEXT "Target torque for end of fill in progress - power off down shift\r\n" /end ANNOTATION_TEXT
 /end ANNOTATION
 /begin AXIS_DESCR STD_AXIS NO_INPUT_QUANTITY RB_PT_PCT_SWC_DWC_CompuMethods_ratio_0p1 5 0.0 2000. FORMAT "%10.5" DEPOSIT ABSOLUTE /end AXIS_DESCR
/end CHARACTERISTIC
/begin CHARACTERISTIC DWC_EFLASHB.DWC_TorqueControl.DWC_FillTorque.DWC_FILLTORQUETARGETPOWEROFFUP "" CURVE 0x8060B74A RB_PT_PCT_SWC_DWC_RecordLayouts_RL_Curve_sint16_5_uint16_5 4000.0 RB_PT_PCT_SWC_DWC_CompuMethods_ratio_0p1 -2000. 2000. FORMAT "%10.5"
 /begin ANNOTATION ANNOTATION_LABEL "Description (coming from AUTOSAR DESC field)"
  /begin ANNOTATION_TEXT "Target torque for end of fill in progress - inertia or power off up shift\r\n" /end ANNOTATION_TEXT
 /end ANNOTATION
 /begin AXIS_DESCR STD_AXIS NO_INPUT_QUANTITY RB_PT_PCT_SWC_DWC_CompuMethods_ratio_0p1 5 0.0 2000. FORMAT "%10.5" DEPOSIT ABSOLUTE /end AXIS_DESCR
/end CHARACTERISTIC
/begin CHARACTERISTIC DWC_EFLASHB.DWC_TorqueControl.DWC_FillTorque.DWC_FILLTORQUETARGETPOWERONDOWN "" MAP 0x8060B760 RB_PT_PCT_SWC_DWC_RecordLayouts_RL_Map_sint16_25_sint16_5_sint16_5 4000.0 RB_PT_PCT_SWC_DWC_CompuMethods_ratio_0p1 -2000. 2000. FORMAT "%10.5"
 /begin ANNOTATION ANNOTATION_LABEL "Description (coming from AUTOSAR DESC field)"
  /begin ANNOTATION_TEXT "Target torque for end of fill in progress - power on down last torque phase\r\n" /end ANNOTATION_TEXT
 /end ANNOTATION
 /begin AXIS_DESCR STD_AXIS NO_INPUT_QUANTITY RB_PT_PCT_SWC_DWC_CompuMethods_ratio_0p1 5 -2000. 2000. FORMAT "%10.5" DEPOSIT ABSOLUTE /end AXIS_DESCR
 /begin AXIS_DESCR STD_AXIS NO_INPUT_QUANTITY RB_PT_PCT_SWC_DWC_CompuMethods_ident 5 -20000. 20000. FORMAT "%10.5" DEPOSIT ABSOLUTE /end AXIS_DESCR
/end CHARACTERISTIC
/begin CHARACTERISTIC DWC_EFLASHB.DWC_TorqueControl.DWC_FillTorque.DWC_FILLTORQUETARGETPOWERONDOWNPULLAWAY "" MAP 0x8060B7AA RB_PT_PCT_SWC_DWC_RecordLayouts_RL_Map_sint16_25_sint16_5_sint16_5 4000.0 RB_PT_PCT_SWC_DWC_CompuMethods_ratio_0p1 -2000. 2000. FORMAT "%10.5"
 /begin ANNOTATION ANNOTATION_LABEL "Description (coming from AUTOSAR DESC field)"
  /begin ANNOTATION_TEXT "Target torque for end of fill in progress - power on down into pullaway\r\n" /end ANNOTATION_TEXT
 /end ANNOTATION
 /begin AXIS_DESCR STD_AXIS NO_INPUT_QUANTITY RB_PT_PCT_SWC_DWC_CompuMethods_ratio_0p1 5 -2000. 2000. FORMAT "%10.5" DEPOSIT ABSOLUTE /end AXIS_DESCR
 /begin AXIS_DESCR STD_AXIS NO_INPUT_QUANTITY RB_PT_PCT_SWC_DWC_CompuMethods_ident 5 -20000. 20000. FORMAT "%10.5" DEPOSIT ABSOLUTE /end AXIS_DESCR
/end CHARACTERISTIC
/begin CHARACTERISTIC DWC_EFLASHB.DWC_TorqueControl.DWC_FillTorque.DWC_FILLTORQUETARGETPOWERONUP "" MAP 0x8060B7F4 RB_PT_PCT_SWC_DWC_RecordLayouts_RL_Map_sint16_60_uint16_5_uint8_12 4000.0 RB_PT_PCT_SWC_DWC_CompuMethods_ratio_0p1 -2000. 2000. FORMAT "%10.5"
 /begin ANNOTATION ANNOTATION_LABEL "Description (coming from AUTOSAR DESC field)"
  /begin ANNOTATION_TEXT "Target torque for end of fill in progress - power on up shift\r\n" /end ANNOTATION_TEXT
 /end ANNOTATION
 /begin AXIS_DESCR STD_AXIS NO_INPUT_QUANTITY RB_PT_PCT_SWC_DWC_CompuMethods_ratio_0p1 5 0.0 2000. FORMAT "%10.5" DEPOSIT ABSOLUTE /end AXIS_DESCR
 /begin AXIS_DESCR STD_AXIS NO_INPUT_QUANTITY RB_PT_PCT_SWC_DWC_CompuMethods_ident 12 0.0 13. FORMAT "%10.5" DEPOSIT ABSOLUTE /end AXIS_DESCR
/end CHARACTERISTIC
/begin CHARACTERISTIC DWC_EFLASHB.DWC_TorqueControl.DWC_FillTorque.DWC_FILLTORQUETARGETSUPPORT "" MAP 0x8060B886 RB_PT_PCT_SWC_DWC_RecordLayouts_RL_Map_sint16_25_sint16_5_sint16_5 4000.0 RB_PT_PCT_SWC_DWC_CompuMethods_ratio_0p1 -2000. 2000. FORMAT "%10.5"
 /begin ANNOTATION ANNOTATION_LABEL "Description (coming from AUTOSAR DESC field)"
  /begin ANNOTATION_TEXT "Target torque for end of fill in progress - supported power on down first torque phase\r\n" /end ANNOTATION_TEXT
 /end ANNOTATION
 /begin AXIS_DESCR STD_AXIS NO_INPUT_QUANTITY RB_PT_PCT_SWC_DWC_CompuMethods_ratio_0p1 5 -2000. 2000. FORMAT "%10.5" DEPOSIT ABSOLUTE /end AXIS_DESCR
 /begin AXIS_DESCR STD_AXIS NO_INPUT_QUANTITY RB_PT_PCT_SWC_DWC_CompuMethods_ident 5 -20000. 20000. FORMAT "%10.5" DEPOSIT ABSOLUTE /end AXIS_DESCR
/end CHARACTERISTIC
/begin CHARACTERISTIC DWC_EFLASHB.DWC_TorqueControl.DWC_FORCEIDLESPEED "" VALUE 0x8060B37A DefaultValueRecordLayout_AUTOSAR_Platform_BaseTypes_uint16 20000.0 RB_PT_PCT_SWC_DWC_CompuMethods_ident 0.0 20000. FORMAT "%10.5"
 /begin ANNOTATION ANNOTATION_LABEL "Description (coming from AUTOSAR DESC field)" /begin ANNOTATION_TEXT "Forced engine idle speed data\r\n" /end ANNOTATION_TEXT /end ANNOTATION
/end CHARACTERISTIC
/begin CHARACTERISTIC DWC_EFLASHB.DWC_TorqueControl.DWC_FORCETHROTTLEPOWERONDOWN "" VALUE 0x8060B4A8 DefaultValueRecordLayout_AUTOSAR_Platform_BaseTypes_uint8 102.0 RB_PT_PCT_SWC_DWC_CompuMethods_ratio_0p4 0.0 102. FORMAT "%10.5"
 /begin ANNOTATION ANNOTATION_LABEL "Description (coming from AUTOSAR DESC field)" /begin ANNOTATION_TEXT "Throttle angle for force power on down shift\r\n" /end ANNOTATION_TEXT /end ANNOTATION
/end CHARACTERISTIC
/begin CHARACTERISTIC DWC_EFLASHB.DWC_TorqueControl.DWC_FREEZETARGETCREEPSPEEDINHYST "" VALUE 0x8060B4A9 DefaultValueRecordLayout_AUTOSAR_Platform_BaseTypes_boolean 255.0 AUTOSAR_Platform_CompuMethods_boolean 0.0 255. FORMAT "%10.5"
 /begin ANNOTATION ANNOTATION_LABEL "Description (coming from AUTOSAR DESC field)"
  /begin ANNOTATION_TEXT "Flag to freeze the target creep speed during the hysteresis window (1 =freeze,  0 = set to 0)\r\n" /end ANNOTATION_TEXT
 /end ANNOTATION
/end CHARACTERISTIC
/begin CHARACTERISTIC DWC_EFLASHB.DWC_TorqueControl.DWC_GRDINTEGRALGAIN "" CURVE 0x8060CABE RB_PT_PCT_SWC_DWC_RecordLayouts_RL_Curve_uint16_5_uint16_5 0.1 RB_PT_PCT_SWC_DWC_CompuMethods_ratio_0p0001 0.0 0.1 FORMAT "%10.5"
 /begin ANNOTATION ANNOTATION_LABEL "Description (coming from AUTOSAR DESC field)" /begin ANNOTATION_TEXT "Scheduled integral gain for gradient controller\r\n" /end ANNOTATION_TEXT /end ANNOTATION
 /begin AXIS_DESCR STD_AXIS NO_INPUT_QUANTITY RB_PT_PCT_SWC_DWC_CompuMethods_ratio_0p1 5 0.0 2000. FORMAT "%10.5" DEPOSIT ABSOLUTE /end AXIS_DESCR
/end CHARACTERISTIC
/begin CHARACTERISTIC DWC_EFLASHB.DWC_TorqueControl.DWC_GRDINTEGRALGAININERTIA "" VALUE 0x8060B37C DefaultValueRecordLayout_AUTOSAR_Platform_BaseTypes_uint16 0.1 RB_PT_PCT_SWC_DWC_CompuMethods_ratio_0p0001 0.0 0.1 FORMAT "%10.5"
 /begin ANNOTATION ANNOTATION_LABEL "Description (coming from AUTOSAR DESC field)" /begin ANNOTATION_TEXT "Integral gain of gradient controller\r\n" /end ANNOTATION_TEXT /end ANNOTATION
/end CHARACTERISTIC
/begin CHARACTERISTIC DWC_EFLASHB.DWC_TorqueControl.DWC_GRDINTEGRALGAINNORM "" VALUE 0x8060B37E DefaultValueRecordLayout_AUTOSAR_Platform_BaseTypes_uint16 0.3 RB_PT_PCT_SWC_DWC_CompuMethods_ratio_0p0001 0.0 0.3 FORMAT "%10.5"
 /begin ANNOTATION ANNOTATION_LABEL "Description (coming from AUTOSAR DESC field)" /begin ANNOTATION_TEXT "Integral gain of gradient controller\r\n" /end ANNOTATION_TEXT /end ANNOTATION
/end CHARACTERISTIC
/begin CHARACTERISTIC DWC_EFLASHB.DWC_TorqueControl.DWC_GRDPROPORTIONALGAININERTIA "" VALUE 0x8060B380 DefaultValueRecordLayout_AUTOSAR_Platform_BaseTypes_uint16 1.0 RB_PT_PCT_SWC_DWC_CompuMethods_ratio_0p001__2 0.0 1. FORMAT "%10.5"
 /begin ANNOTATION ANNOTATION_LABEL "Description (coming from AUTOSAR DESC field)" /begin ANNOTATION_TEXT "Proportional gain of gradient controller\r\n" /end ANNOTATION_TEXT /end ANNOTATION
/end CHARACTERISTIC
/begin CHARACTERISTIC DWC_EFLASHB.DWC_TorqueControl.DWC_GRDPROPORTIONALGAINNORM "" VALUE 0x8060B382 DefaultValueRecordLayout_AUTOSAR_Platform_BaseTypes_uint16 1.0 RB_PT_PCT_SWC_DWC_CompuMethods_ratio_0p001__2 0.0 1. FORMAT "%10.5"
 /begin ANNOTATION ANNOTATION_LABEL "Description (coming from AUTOSAR DESC field)" /begin ANNOTATION_TEXT "Proportional gain of gradient controller\r\n" /end ANNOTATION_TEXT /end ANNOTATION
/end CHARACTERISTIC
/end MODULE
/end PROJECT
