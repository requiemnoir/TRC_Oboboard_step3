ASAP2_VERSION 1 60
/begin PROJECT LB74x_TCU "5201C535"
/begin HEADER "" VERSION "5201C535" PROJECT_NO LB74x_TCU /end HEADER
/begin MODULE DIM ""
/begin MOD_COMMON "" BYTE_ORDER MSB_LAST ALIGNMENT_BYTE 1 ALIGNMENT_WORD 2 ALIGNMENT_LONG 4 ALIGNMENT_INT64 4 ALIGNMENT_FLOAT32_IEEE 4 ALIGNMENT_FLOAT64_IEEE 4 DATA_SIZE 32 /end MOD_COMMON
/begin CHARACTERISTIC DWC_EFLASHB.DWC_TorqueControl.DWC_GRDPROPORTIONALGAINOFFDOWN "" VALUE 0x8060B384 DefaultValueRecordLayout_AUTOSAR_Platform_BaseTypes_uint16 1.0 RB_PT_PCT_SWC_DWC_CompuMethods_ratio_0p001__2 0.0 1. FORMAT "%10.5"
 /begin ANNOTATION ANNOTATION_LABEL "Description (coming from AUTOSAR DESC field)" /begin ANNOTATION_TEXT "Proportional gain of gradient controller\r\n" /end ANNOTATION_TEXT /end ANNOTATION
/end CHARACTERISTIC
/begin CHARACTERISTIC DWC_EFLASHB.DWC_TorqueControl.DWC_HardReaquire.DWC_ABORTAQUIREMINTORQUE "" VALUE 0x8060B8DC DefaultValueRecordLayout_AUTOSAR_Platform_BaseTypes_boolean 255.0 AUTOSAR_Platform_CompuMethods_boolean 0.0 255. FORMAT "%10.5"
 /begin ANNOTATION ANNOTATION_LABEL "Description (coming from AUTOSAR DESC field)"
  /begin ANNOTATION_TEXT "Flag to allow aquire pulse to be aborted if controller torque demand falls below minimum clutch torque (abort without copy to I)\r\n" /end ANNOTATION_TEXT
 /end ANNOTATION
/end CHARACTERISTIC
/begin CHARACTERISTIC DWC_EFLASHB.DWC_TorqueControl.DWC_HardReaquire.DWC_AQUIREABORTSLIP "" VALUE 0x8060B8D0 DefaultValueRecordLayout_AUTOSAR_Platform_BaseTypes_uint16 20000.0 RB_PT_PCT_SWC_DWC_CompuMethods_ident 0.0 20000. FORMAT "%10.5"
 /begin ANNOTATION ANNOTATION_LABEL "Description (coming from AUTOSAR DESC field)"
  /begin ANNOTATION_TEXT "Slip, above which hard aquire is disallowed and held off\r\n" /end ANNOTATION_TEXT
 /end ANNOTATION
/end CHARACTERISTIC
/begin CHARACTERISTIC DWC_EFLASHB.DWC_TorqueControl.DWC_HardReaquire.DWC_CLUTCHLOCKSLIP "" VALUE 0x8060B8D2 DefaultValueRecordLayout_AUTOSAR_Platform_BaseTypes_uint16 20000.0 RB_PT_PCT_SWC_DWC_CompuMethods_ident 0.0 20000. FORMAT "%10.5"
 /begin ANNOTATION ANNOTATION_LABEL "Description (coming from AUTOSAR DESC field)" /begin ANNOTATION_TEXT "Slip, below which clutch lock is assumed\r\n" /end ANNOTATION_TEXT /end ANNOTATION
/end CHARACTERISTIC
/begin CHARACTERISTIC DWC_EFLASHB.DWC_TorqueControl.DWC_HardReaquire.DWC_CLUTCHUNLOCKSLIP "" VALUE 0x8060B8D4 DefaultValueRecordLayout_AUTOSAR_Platform_BaseTypes_uint16 20000.0 RB_PT_PCT_SWC_DWC_CompuMethods_ident 0.0 20000. FORMAT "%10.5"
 /begin ANNOTATION ANNOTATION_LABEL "Description (coming from AUTOSAR DESC field)" /begin ANNOTATION_TEXT "Slip, above which clutch is assumed to be slipping\r\n" /end ANNOTATION_TEXT /end ANNOTATION
/end CHARACTERISTIC
/begin CHARACTERISTIC DWC_EFLASHB.DWC_TorqueControl.DWC_HardReaquire.DWC_ENGAGEDECAYCOEFF "" VALUE 0x8060B8DD DefaultValueRecordLayout_AUTOSAR_Platform_BaseTypes_uint8 1.0 RB_PT_PCT_SWC_DWC_CompuMethods_ratio_0p01 0.0 1. FORMAT "%10.5"
 /begin ANNOTATION ANNOTATION_LABEL "Description (coming from AUTOSAR DESC field)" /begin ANNOTATION_TEXT "Coefficient of decay (first order) for engage pulse\r\n" /end ANNOTATION_TEXT /end ANNOTATION
/end CHARACTERISTIC
/begin CHARACTERISTIC DWC_EFLASHB.DWC_TorqueControl.DWC_HardReaquire.DWC_ENGAGEDECAYRATE "" VALUE 0x8060B8D6 DefaultValueRecordLayout_AUTOSAR_Platform_BaseTypes_uint16 2000.0 RB_PT_PCT_SWC_DWC_CompuMethods_ratio_0p1 0.0 2000. FORMAT "%10.5"
 /begin ANNOTATION ANNOTATION_LABEL "Description (coming from AUTOSAR DESC field)"
  /begin ANNOTATION_TEXT "Decay rate minimum (linear) for engage torque (IIR correction)\r\n" /end ANNOTATION_TEXT
 /end ANNOTATION
/end CHARACTERISTIC
/begin CHARACTERISTIC DWC_EFLASHB.DWC_TorqueControl.DWC_HardReaquire.DWC_ENGAGEPHASETIME "" VALUE 0x8060B8D8 DefaultValueRecordLayout_AUTOSAR_Platform_BaseTypes_uint16 10.0 RB_PT_PCT_SWC_DWC_CompuMethods_ratio_0p001__2 0.0 10. FORMAT "%10.5"
 /begin ANNOTATION ANNOTATION_LABEL "Description (coming from AUTOSAR DESC field)" /begin ANNOTATION_TEXT "Time for which pulse tries engagement\r\n" /end ANNOTATION_TEXT /end ANNOTATION
/end CHARACTERISTIC
/begin CHARACTERISTIC DWC_EFLASHB.DWC_TorqueControl.DWC_HardReaquire.DWC_ENGAGETORQUEINCVSSLIP "" MAP 0x8060B8DE RB_PT_PCT_SWC_DWC_RecordLayouts_RL_Map_sint16_55_sint16_5_uint8_11 2000.0 RB_PT_PCT_SWC_DWC_CompuMethods_ratio_0p1 0.0 2000. FORMAT "%10.5"
 /begin ANNOTATION ANNOTATION_LABEL "Description (coming from AUTOSAR DESC field)" /begin ANNOTATION_TEXT "Engagement torque increase vs slip\r\n" /end ANNOTATION_TEXT /end ANNOTATION
 /begin AXIS_DESCR STD_AXIS NO_INPUT_QUANTITY RB_PT_PCT_SWC_DWC_CompuMethods_ident 5 -20000. 20000. FORMAT "%10.5" DEPOSIT ABSOLUTE /end AXIS_DESCR
 /begin AXIS_DESCR STD_AXIS NO_INPUT_QUANTITY RB_PT_PCT_SWC_DWC_CompuMethods_ident 11 0.0 13. FORMAT "%10.5" DEPOSIT ABSOLUTE /end AXIS_DESCR
/end CHARACTERISTIC
/begin CHARACTERISTIC DWC_EFLASHB.DWC_TorqueControl.DWC_HardReaquire.DWC_ENGAGETORQUEINCVSSLIPES "" MAP 0x8060B966 RB_PT_PCT_SWC_DWC_RecordLayouts_RL_Map_sint16_55_sint16_5_uint8_11 2000.0 RB_PT_PCT_SWC_DWC_CompuMethods_ratio_0p1 0.0 2000. FORMAT "%10.5"
 /begin ANNOTATION ANNOTATION_LABEL "Description (coming from AUTOSAR DESC field)"
  /begin ANNOTATION_TEXT "Engagement torque increase vs slip - Engine start condition\r\n" /end ANNOTATION_TEXT
 /end ANNOTATION
 /begin AXIS_DESCR STD_AXIS NO_INPUT_QUANTITY RB_PT_PCT_SWC_DWC_CompuMethods_ident 5 -20000. 20000. FORMAT "%10.5" DEPOSIT ABSOLUTE /end AXIS_DESCR
 /begin AXIS_DESCR STD_AXIS NO_INPUT_QUANTITY RB_PT_PCT_SWC_DWC_CompuMethods_ident 11 0.0 13. FORMAT "%10.5" DEPOSIT ABSOLUTE /end AXIS_DESCR
/end CHARACTERISTIC
/begin CHARACTERISTIC DWC_EFLASHB.DWC_TorqueControl.DWC_HardReaquire.DWC_ENGAGETORQUEMAX "" MAP 0x8060B9EE RB_PT_PCT_SWC_DWC_RecordLayouts_RL_Map_uint16_55_sint16_5_uint8_11 2000.0 RB_PT_PCT_SWC_DWC_CompuMethods_ratio_0p1 0.0 2000. FORMAT "%10.5"
 /begin ANNOTATION ANNOTATION_LABEL "Description (coming from AUTOSAR DESC field)"
  /begin ANNOTATION_TEXT "Maximum engagement torque vs engine speed above pullaway setpoint\r\n" /end ANNOTATION_TEXT
 /end ANNOTATION
 /begin AXIS_DESCR STD_AXIS NO_INPUT_QUANTITY RB_PT_PCT_SWC_DWC_CompuMethods_ident 5 -20000. 20000. FORMAT "%10.5" DEPOSIT ABSOLUTE /end AXIS_DESCR
 /begin AXIS_DESCR STD_AXIS NO_INPUT_QUANTITY RB_PT_PCT_SWC_DWC_CompuMethods_ident 11 0.0 13. FORMAT "%10.5" DEPOSIT ABSOLUTE /end AXIS_DESCR
/end CHARACTERISTIC
/begin CHARACTERISTIC DWC_EFLASHB.DWC_TorqueControl.DWC_HardReaquire.DWC_ENGAGETORQUEMAXES "" MAP 0x8060BA76 RB_PT_PCT_SWC_DWC_RecordLayouts_RL_Map_uint16_55_sint16_5_uint8_11 2000.0 RB_PT_PCT_SWC_DWC_CompuMethods_ratio_0p1 0.0 2000. FORMAT "%10.5"
 /begin ANNOTATION ANNOTATION_LABEL "Description (coming from AUTOSAR DESC field)"
  /begin ANNOTATION_TEXT "Maximum engagement torque vs engine speed above pullaway setpoint - engine start case\r\n" /end ANNOTATION_TEXT
 /end ANNOTATION
 /begin AXIS_DESCR STD_AXIS NO_INPUT_QUANTITY RB_PT_PCT_SWC_DWC_CompuMethods_ident 5 -20000. 20000. FORMAT "%10.5" DEPOSIT ABSOLUTE /end AXIS_DESCR
 /begin AXIS_DESCR STD_AXIS NO_INPUT_QUANTITY RB_PT_PCT_SWC_DWC_CompuMethods_ident 11 0.0 13. FORMAT "%10.5" DEPOSIT ABSOLUTE /end AXIS_DESCR
/end CHARACTERISTIC
/begin CHARACTERISTIC DWC_EFLASHB.DWC_TorqueControl.DWC_HardReaquire.DWC_MAXENGAGETORQUEUNLOCK "" VALUE 0x8060B8DA DefaultValueRecordLayout_AUTOSAR_Platform_BaseTypes_sint16 4000.0 RB_PT_PCT_SWC_DWC_CompuMethods_ratio_0p1 -2000. 2000. FORMAT "%10.5"
 /begin ANNOTATION ANNOTATION_LABEL "Description (coming from AUTOSAR DESC field)" /begin ANNOTATION_TEXT "Maximum engage torque allowed for I term copy\r\n" /end ANNOTATION_TEXT /end ANNOTATION
/end CHARACTERISTIC
/begin CHARACTERISTIC DWC_EFLASHB.DWC_TorqueControl.DWC_IDLESPEEDMAXINCRATE "" VALUE 0x8060B386 DefaultValueRecordLayout_AUTOSAR_Platform_BaseTypes_uint16 20000.0 RB_PT_PCT_SWC_DWC_CompuMethods_ident 0.0 20000. FORMAT "%10.5"
 /begin ANNOTATION ANNOTATION_LABEL "Description (coming from AUTOSAR DESC field)"
  /begin ANNOTATION_TEXT "Maximum increase rate of idle speed setpoint used in calculation of PA clutch must open speed\r\n" /end ANNOTATION_TEXT
 /end ANNOTATION
/end CHARACTERISTIC
/begin CHARACTERISTIC DWC_EFLASHB.DWC_TorqueControl.DWC_InertiaFeedforward.DWC_TORQUEHANDOVERRATE "" VALUE 0x8060BAFE DefaultValueRecordLayout_AUTOSAR_Platform_BaseTypes_uint16 2000.0 RB_PT_PCT_SWC_DWC_CompuMethods_ratio_0p1 0.0 2000. FORMAT "%10.5"
 /begin ANNOTATION ANNOTATION_LABEL "Description (coming from AUTOSAR DESC field)" /begin ANNOTATION_TEXT "Torque handover rate for on throttle\r\n" /end ANNOTATION_TEXT /end ANNOTATION
/end CHARACTERISTIC
/begin CHARACTERISTIC DWC_EFLASHB.DWC_TorqueControl.DWC_KPMINCONTROLLERTQ "" VALUE 0x8060B388 DefaultValueRecordLayout_AUTOSAR_Platform_BaseTypes_uint16 2000.0 RB_PT_PCT_SWC_DWC_CompuMethods_ratio_0p1 0.0 2000. FORMAT "%10.5"
 /begin ANNOTATION ANNOTATION_LABEL "Description (coming from AUTOSAR DESC field)"
  /begin ANNOTATION_TEXT "Minimum allowed controller torque for kisspoint adaption\r\n" /end ANNOTATION_TEXT
 /end ANNOTATION
/end CHARACTERISTIC
/begin CHARACTERISTIC DWC_EFLASHB.DWC_TorqueControl.DWC_LEADABOVEINERTIATORQUEFORLOCK "" VALUE 0x8060B38A DefaultValueRecordLayout_AUTOSAR_Platform_BaseTypes_sint16 4000.0 RB_PT_PCT_SWC_DWC_CompuMethods_ratio_0p1 -2000. 2000. FORMAT "%10.5"
 /begin ANNOTATION ANNOTATION_LABEL "Description (coming from AUTOSAR DESC field)"
  /begin ANNOTATION_TEXT "Torque offset above DWC_TEEngineTorqueInertia for lock-up condition\r\n" /end ANNOTATION_TEXT
 /end ANNOTATION
/end CHARACTERISTIC
/begin CHARACTERISTIC DWC_EFLASHB.DWC_TorqueControl.DWC_LEADLESSTHANMINFORLOCK "" VALUE 0x8060B38C DefaultValueRecordLayout_AUTOSAR_Platform_BaseTypes_sint16 4000.0 RB_PT_PCT_SWC_DWC_CompuMethods_ratio_0p1 -2000. 2000. FORMAT "%10.5"
 /begin ANNOTATION ANNOTATION_LABEL "Description (coming from AUTOSAR DESC field)"
  /begin ANNOTATION_TEXT "Torque offset above DWC_TEEngineTorqueDriverdTqLeadRaw for lock -up signal\r\n" /end ANNOTATION_TEXT
 /end ANNOTATION
/end CHARACTERISTIC
/begin CHARACTERISTIC DWC_EFLASHB.DWC_TorqueControl.DWC_MANTORQUEPHASEENDDELAY "" MAP 0x8060CAD4 RB_PT_PCT_SWC_DWC_RecordLayouts_RL_Map_uint16_55_sint16_5_uint8_11 10.0 RB_PT_PCT_SWC_DWC_CompuMethods_ratio_0p001__2 0.0 10. FORMAT "%10.5"
 /begin ANNOTATION ANNOTATION_LABEL "Description (coming from AUTOSAR DESC field)" /begin ANNOTATION_TEXT "Delay at end of torque phase for offgoing to open\r\n" /end ANNOTATION_TEXT /end ANNOTATION
 /begin AXIS_DESCR STD_AXIS NO_INPUT_QUANTITY RB_PT_PCT_SWC_DWC_CompuMethods_ratio_0p1 5 -2000. 2000. FORMAT "%10.5" DEPOSIT ABSOLUTE /end AXIS_DESCR
 /begin AXIS_DESCR STD_AXIS NO_INPUT_QUANTITY RB_PT_PCT_SWC_DWC_CompuMethods_ident 11 0.0 13. FORMAT "%10.5" DEPOSIT ABSOLUTE /end AXIS_DESCR
/end CHARACTERISTIC
/begin CHARACTERISTIC DWC_EFLASHB.DWC_TorqueControl.DWC_MAXCREEPTARGETTORQUEDEVIATIONIDLEADAPT "" VALUE 0x8060B38E DefaultValueRecordLayout_AUTOSAR_Platform_BaseTypes_uint16 2000.0 RB_PT_PCT_SWC_DWC_CompuMethods_ratio_0p1 0.0 2000. FORMAT "%10.5"
 /begin ANNOTATION ANNOTATION_LABEL "Description (coming from AUTOSAR DESC field)"
  /begin ANNOTATION_TEXT "Maximum rate of change of target creep torque for idle adaption enable\r\n" /end ANNOTATION_TEXT
 /end ANNOTATION
/end CHARACTERISTIC
/begin CHARACTERISTIC DWC_EFLASHB.DWC_TorqueControl.DWC_MAXETORQUEPOWEROFFDOWN "" VALUE 0x8060B390 DefaultValueRecordLayout_AUTOSAR_Platform_BaseTypes_sint16 4000.0 RB_PT_PCT_SWC_DWC_CompuMethods_ratio_0p1 -2000. 2000. FORMAT "%10.5"
 /begin ANNOTATION ANNOTATION_LABEL "Description (coming from AUTOSAR DESC field)"
  /begin ANNOTATION_TEXT "Maximum controller torque for a power off down when on throttle shift\r\n" /end ANNOTATION_TEXT
 /end ANNOTATION
/end CHARACTERISTIC
/begin CHARACTERISTIC DWC_EFLASHB.DWC_TorqueControl.DWC_MAXETORQUEPOWEROFFDOWNEVSTRT "" VALUE 0x8060B392 DefaultValueRecordLayout_AUTOSAR_Platform_BaseTypes_sint16 4000.0 RB_PT_PCT_SWC_DWC_CompuMethods_ratio_0p1 -2000. 2000. FORMAT "%10.5"
 /begin ANNOTATION ANNOTATION_LABEL "Description (coming from AUTOSAR DESC field)"
  /begin ANNOTATION_TEXT "Maximum controller torque for a power off down when on throttle shift\r\n" /end ANNOTATION_TEXT
 /end ANNOTATION
/end CHARACTERISTIC
/begin CHARACTERISTIC DWC_EFLASHB.DWC_TorqueControl.DWC_MAXFILLTORQUEPOWERONDOWN "" VALUE 0x8060B394 DefaultValueRecordLayout_AUTOSAR_Platform_BaseTypes_uint16 2000.0 RB_PT_PCT_SWC_DWC_CompuMethods_ratio_0p1 0.0 2000. FORMAT "%10.5"
 /begin ANNOTATION ANNOTATION_LABEL "Description (coming from AUTOSAR DESC field)"
  /begin ANNOTATION_TEXT "Maximum allowed fill torque request for a power on down shift\r\n" /end ANNOTATION_TEXT
 /end ANNOTATION
/end CHARACTERISTIC
/begin CHARACTERISTIC DWC_EFLASHB.DWC_TorqueControl.DWC_MAXIMUMTORQUEDEMAND "" VALUE 0x8060B396 DefaultValueRecordLayout_AUTOSAR_Platform_BaseTypes_uint16 2000.0 RB_PT_PCT_SWC_DWC_CompuMethods_ratio_0p1 0.0 2000. FORMAT "%10.5"
 /begin ANNOTATION ANNOTATION_LABEL "Description (coming from AUTOSAR DESC field)" /begin ANNOTATION_TEXT "Maximum torque request for the clutches\r\n" /end ANNOTATION_TEXT /end ANNOTATION
/end CHARACTERISTIC
/begin CHARACTERISTIC DWC_EFLASHB.DWC_TorqueControl.DWC_MAXOUTPUTSPEEDIDLEADAPT "" VALUE 0x8060B398 DefaultValueRecordLayout_AUTOSAR_Platform_BaseTypes_uint16 20000.0 RB_PT_PCT_SWC_DWC_CompuMethods_ident 0.0 20000. FORMAT "%10.5"
 /begin ANNOTATION ANNOTATION_LABEL "Description (coming from AUTOSAR DESC field)" /begin ANNOTATION_TEXT "Maximum output shaft speed for engine idle adaption\r\n" /end ANNOTATION_TEXT /end ANNOTATION
/end CHARACTERISTIC
/begin CHARACTERISTIC DWC_EFLASHB.DWC_TorqueControl.DWC_MAXSHIFTTYPEINDEXGLAT "" CURVE 0x8060CB5C RB_PT_PCT_SWC_DWC_RecordLayouts_RL_Curve_sint8_5_sint8_5 1.0 RB_PT_PCT_SWC_DWC_CompuMethods_ratio_0p01 0.0 1. FORMAT "%10.5"
 /begin ANNOTATION ANNOTATION_LABEL "Description (coming from AUTOSAR DESC field)"
  /begin ANNOTATION_TEXT "Maximum shift type index based on lateral acceleration\r\n" /end ANNOTATION_TEXT
 /end ANNOTATION
 /begin AXIS_DESCR STD_AXIS NO_INPUT_QUANTITY RB_PT_PCT_SWC_DWC_CompuMethods_ratio_0p01 5 -1.27 1.27 FORMAT "%10.5" DEPOSIT ABSOLUTE /end AXIS_DESCR
/end CHARACTERISTIC
/begin CHARACTERISTIC DWC_EFLASHB.DWC_TorqueControl.DWC_MAXSHIFTTYPEINDEXTEMP "" CURVE 0x8060CB68 RB_PT_PCT_SWC_DWC_RecordLayouts_RL_Curve_sint8_6_sint16_6 1.0 RB_PT_PCT_SWC_DWC_CompuMethods_ratio_0p01 0.0 1. FORMAT "%10.5"
 /begin ANNOTATION ANNOTATION_LABEL "Description (coming from AUTOSAR DESC field)"
  /begin ANNOTATION_TEXT "Maximum shift type index based on transmission temperature\r\n" /end ANNOTATION_TEXT
 /end ANNOTATION
 /begin AXIS_DESCR STD_AXIS NO_INPUT_QUANTITY RB_PT_PCT_SWC_DWC_CompuMethods_ident 6 -50. 200. FORMAT "%10.5" DEPOSIT ABSOLUTE /end AXIS_DESCR
/end CHARACTERISTIC
/begin CHARACTERISTIC DWC_EFLASHB.DWC_TorqueControl.DWC_MAXTHROT4POWEROFFUP "" VALUE 0x8060B4AA DefaultValueRecordLayout_AUTOSAR_Platform_BaseTypes_uint8 102.0 RB_PT_PCT_SWC_DWC_CompuMethods_ratio_0p4 0.0 102. FORMAT "%10.5"
 /begin ANNOTATION ANNOTATION_LABEL "Description (coming from AUTOSAR DESC field)"
  /begin ANNOTATION_TEXT "Maximum controller torque for a power on down when on throttle shift\r\n" /end ANNOTATION_TEXT
 /end ANNOTATION
/end CHARACTERISTIC
/begin CHARACTERISTIC DWC_EFLASHB.DWC_TorqueControl.DWC_MAXTORQUEPOWEROFFDOWN "" VALUE 0x8060B39A DefaultValueRecordLayout_AUTOSAR_Platform_BaseTypes_sint16 4000.0 RB_PT_PCT_SWC_DWC_CompuMethods_ratio_0p1 -2000. 2000. FORMAT "%10.5"
 /begin ANNOTATION ANNOTATION_LABEL "Description (coming from AUTOSAR DESC field)"
  /begin ANNOTATION_TEXT "Maximum controller torque for a power off down when on throttle shift\r\n" /end ANNOTATION_TEXT
 /end ANNOTATION
/end CHARACTERISTIC
/begin CHARACTERISTIC DWC_EFLASHB.DWC_TorqueControl.DWC_MAXTORQUEPOWEROFFUP "" VALUE 0x8060B39C DefaultValueRecordLayout_AUTOSAR_Platform_BaseTypes_sint16 4000.0 RB_PT_PCT_SWC_DWC_CompuMethods_ratio_0p1 -2000. 2000. FORMAT "%10.5"
 /begin ANNOTATION ANNOTATION_LABEL "Description (coming from AUTOSAR DESC field)"
  /begin ANNOTATION_TEXT "Maximum controller torque for a power on down when on throttle shift\r\n" /end ANNOTATION_TEXT
 /end ANNOTATION
/end CHARACTERISTIC
/begin CHARACTERISTIC DWC_EFLASHB.DWC_TorqueControl.DWC_MICROSLIPMAXSPEED "" VALUE 0x8060B39E DefaultValueRecordLayout_AUTOSAR_Platform_BaseTypes_uint16 20000.0 RB_PT_PCT_SWC_DWC_CompuMethods_ident 0.0 20000. FORMAT "%10.5"
 /begin ANNOTATION ANNOTATION_LABEL "Description (coming from AUTOSAR DESC field)" /begin ANNOTATION_TEXT "Maximum speed considered to be micro slip\r\n" /end ANNOTATION_TEXT /end ANNOTATION
/end CHARACTERISTIC
/begin CHARACTERISTIC DWC_EFLASHB.DWC_TorqueControl.DWC_MICROSLIPMINSPEED "" VALUE 0x8060B3A0 DefaultValueRecordLayout_AUTOSAR_Platform_BaseTypes_uint16 20000.0 RB_PT_PCT_SWC_DWC_CompuMethods_ident 0.0 20000. FORMAT "%10.5"
 /begin ANNOTATION ANNOTATION_LABEL "Description (coming from AUTOSAR DESC field)" /begin ANNOTATION_TEXT "Minimum speed considered to be micro slip\r\n" /end ANNOTATION_TEXT /end ANNOTATION
/end CHARACTERISTIC
/begin CHARACTERISTIC DWC_EFLASHB.DWC_TorqueControl.DWC_MicroSlipMonitor.DWC_SLCDENGINETORQUELOCKUP "" VALUE 0x8060BB00 DefaultValueRecordLayout_AUTOSAR_Platform_BaseTypes_uint16 10000.0 RB_PT_PCT_SWC_DWC_CompuMethods_ident 0.0 10000. FORMAT "%10.5"
 /begin ANNOTATION ANNOTATION_LABEL "Description (coming from AUTOSAR DESC field)" /begin ANNOTATION_TEXT "Rate of change of engine torque for lockup\r\n" /end ANNOTATION_TEXT /end ANNOTATION
/end CHARACTERISTIC
/begin CHARACTERISTIC DWC_EFLASHB.DWC_TorqueControl.DWC_MicroSlipMonitor.DWC_SLCDENGINETORQUEUNLOCK "" VALUE 0x8060BB02 DefaultValueRecordLayout_AUTOSAR_Platform_BaseTypes_uint16 10000.0 RB_PT_PCT_SWC_DWC_CompuMethods_ident 0.0 10000. FORMAT "%10.5"
 /begin ANNOTATION ANNOTATION_LABEL "Description (coming from AUTOSAR DESC field)"
  /begin ANNOTATION_TEXT "Rate of change of engine torque for lockup to be cancelled\r\n" /end ANNOTATION_TEXT
 /end ANNOTATION
/end CHARACTERISTIC
/begin CHARACTERISTIC DWC_EFLASHB.DWC_TorqueControl.DWC_MicroSlipMonitor.DWC_SLCENABLESCHEDULEIGAINADAPT "" VALUE 0x8060BB2A DefaultValueRecordLayout_AUTOSAR_Platform_BaseTypes_boolean 255.0 AUTOSAR_Platform_CompuMethods_boolean 0.0 255. FORMAT "%10.5"
 /begin ANNOTATION ANNOTATION_LABEL "Description (coming from AUTOSAR DESC field)"
  /begin ANNOTATION_TEXT "Flag to enable scheduled I gain for possible adaption\r\n" /end ANNOTATION_TEXT
 /end ANNOTATION
/end CHARACTERISTIC
/begin CHARACTERISTIC DWC_EFLASHB.DWC_TorqueControl.DWC_MicroSlipMonitor.DWC_SLCENABLETARGETRAMP "" VALUE 0x8060BB2B DefaultValueRecordLayout_AUTOSAR_Platform_BaseTypes_boolean 255.0 AUTOSAR_Platform_CompuMethods_boolean 0.0 255. FORMAT "%10.5"
 /begin ANNOTATION ANNOTATION_LABEL "Description (coming from AUTOSAR DESC field)"
  /begin ANNOTATION_TEXT "Flag to enable slip target ramp - calibration assistant\r\n" /end ANNOTATION_TEXT
 /end ANNOTATION
/end CHARACTERISTIC
/begin CHARACTERISTIC DWC_EFLASHB.DWC_TorqueControl.DWC_MicroSlipMonitor.DWC_SLCENABLEVARIABLEMICROSLIP "" VALUE 0x8060BB2C DefaultValueRecordLayout_AUTOSAR_Platform_BaseTypes_boolean 255.0 AUTOSAR_Platform_CompuMethods_boolean 0.0 255. FORMAT "%10.5"
 /begin ANNOTATION ANNOTATION_LABEL "Description (coming from AUTOSAR DESC field)"
  /begin ANNOTATION_TEXT "Flag to enable microslip scheduled against speed and torque\r\n" /end ANNOTATION_TEXT
 /end ANNOTATION
/end CHARACTERISTIC
/begin CHARACTERISTIC DWC_EFLASHB.DWC_TorqueControl.DWC_MicroSlipMonitor.DWC_SLCENGINETORQUEDRIVE "" VALUE 0x8060BB04 DefaultValueRecordLayout_AUTOSAR_Platform_BaseTypes_sint16 4000.0 RB_PT_PCT_SWC_DWC_CompuMethods_ratio_0p1 -2000. 2000. FORMAT "%10.5"
 /begin ANNOTATION ANNOTATION_LABEL "Description (coming from AUTOSAR DESC field)" /begin ANNOTATION_TEXT "Engine torque level considered to be drive\r\n" /end ANNOTATION_TEXT /end ANNOTATION
/end CHARACTERISTIC
/begin CHARACTERISTIC DWC_EFLASHB.DWC_TorqueControl.DWC_MicroSlipMonitor.DWC_SLCENGINETORQUEOVERRUN "" VALUE 0x8060BB06 DefaultValueRecordLayout_AUTOSAR_Platform_BaseTypes_sint16 4000.0 RB_PT_PCT_SWC_DWC_CompuMethods_ratio_0p1 -2000. 2000. FORMAT "%10.5"
 /begin ANNOTATION ANNOTATION_LABEL "Description (coming from AUTOSAR DESC field)" /begin ANNOTATION_TEXT "Engine torque level considered to be overrun\r\n" /end ANNOTATION_TEXT /end ANNOTATION
/end CHARACTERISTIC
/begin CHARACTERISTIC DWC_EFLASHB.DWC_TorqueControl.DWC_MicroSlipMonitor.DWC_SLCFirstOrderLPSlip.DWC_FIRSTORDERLPCOEFF "" VALUE 0x8060BB2E DefaultValueRecordLayout_AUTOSAR_Platform_BaseTypes_uint8 1.0 RB_PT_PCT_SWC_DWC_CompuMethods_ratio_0p01 0.0 1. FORMAT "%10.5"
 /begin ANNOTATION ANNOTATION_LABEL "Description (coming from AUTOSAR DESC field)" /begin ANNOTATION_TEXT "Coefficient for low pass IIR filter\r\n" /end ANNOTATION_TEXT /end ANNOTATION
/end CHARACTERISTIC
/begin CHARACTERISTIC DWC_EFLASHB.DWC_TorqueControl.DWC_MicroSlipMonitor.DWC_SLCJACKHIINTEGRATORRPM "" VALUE 0x8060BB08 DefaultValueRecordLayout_AUTOSAR_Platform_BaseTypes_uint16 20000.0 RB_PT_PCT_SWC_DWC_CompuMethods_ident 0.0 20000. FORMAT "%10.5"
 /begin ANNOTATION ANNOTATION_LABEL "Description (coming from AUTOSAR DESC field)"
  /begin ANNOTATION_TEXT "Jack RPM, at/above which a request for higher I term gains is used\r\n" /end ANNOTATION_TEXT
 /end ANNOTATION
/end CHARACTERISTIC
/begin CHARACTERISTIC DWC_EFLASHB.DWC_TorqueControl.DWC_MicroSlipMonitor.DWC_SLCMICROSLIPDRIVERPM "" VALUE 0x8060BB0A DefaultValueRecordLayout_AUTOSAR_Platform_BaseTypes_uint16 20000.0 RB_PT_PCT_SWC_DWC_CompuMethods_ident 0.0 20000. FORMAT "%10.5"
 /begin ANNOTATION ANNOTATION_LABEL "Description (coming from AUTOSAR DESC field)" /begin ANNOTATION_TEXT "Microslip target for drive condition\r\n" /end ANNOTATION_TEXT /end ANNOTATION
/end CHARACTERISTIC
/begin CHARACTERISTIC DWC_EFLASHB.DWC_TorqueControl.DWC_MicroSlipMonitor.DWC_SLCMICROSLIPHIGHADAPT "" VALUE 0x8060BB0C DefaultValueRecordLayout_AUTOSAR_Platform_BaseTypes_uint16 20000.0 RB_PT_PCT_SWC_DWC_CompuMethods_ident 0.0 20000. FORMAT "%10.5"
 /begin ANNOTATION ANNOTATION_LABEL "Description (coming from AUTOSAR DESC field)" /begin ANNOTATION_TEXT "Microslip speed for adaption\r\n" /end ANNOTATION_TEXT /end ANNOTATION
/end CHARACTERISTIC
/begin CHARACTERISTIC DWC_EFLASHB.DWC_TorqueControl.DWC_MicroSlipMonitor.DWC_SLCMICROSLIPHIGHADAPTPOWERON "" VALUE 0x8060BB0E DefaultValueRecordLayout_AUTOSAR_Platform_BaseTypes_uint16 20000.0 RB_PT_PCT_SWC_DWC_CompuMethods_ident 0.0 20000. FORMAT "%10.5"
 /begin ANNOTATION ANNOTATION_LABEL "Description (coming from AUTOSAR DESC field)" /begin ANNOTATION_TEXT "Microslip speed for adaption - power on\r\n" /end ANNOTATION_TEXT /end ANNOTATION
/end CHARACTERISTIC
/begin CHARACTERISTIC DWC_EFLASHB.DWC_TorqueControl.DWC_MicroSlipMonitor.DWC_SLCMICROSLIPJACKDEC "" VALUE 0x8060BB10 DefaultValueRecordLayout_AUTOSAR_Platform_BaseTypes_uint16 2000.0 RB_PT_PCT_SWC_DWC_CompuMethods_ratio_0p1 0.0 2000. FORMAT "%10.5"
 /begin ANNOTATION ANNOTATION_LABEL "Description (coming from AUTOSAR DESC field)" /begin ANNOTATION_TEXT "Rise rate of target slip for jacking\r\n" /end ANNOTATION_TEXT /end ANNOTATION
/end CHARACTERISTIC
/begin CHARACTERISTIC DWC_EFLASHB.DWC_TorqueControl.DWC_MicroSlipMonitor.DWC_SLCMICROSLIPJACKRPM "" VALUE 0x8060BB12 DefaultValueRecordLayout_AUTOSAR_Platform_BaseTypes_uint16 20000.0 RB_PT_PCT_SWC_DWC_CompuMethods_ident 0.0 20000. FORMAT "%10.5"
 /begin ANNOTATION ANNOTATION_LABEL "Description (coming from AUTOSAR DESC field)" /begin ANNOTATION_TEXT "Microslip speed for adaption - power on\r\n" /end ANNOTATION_TEXT /end ANNOTATION
/end CHARACTERISTIC
/begin CHARACTERISTIC DWC_EFLASHB.DWC_TorqueControl.DWC_MicroSlipMonitor.DWC_SLCMICROSLIPLOCKED "" VALUE 0x8060BB14 DefaultValueRecordLayout_AUTOSAR_Platform_BaseTypes_uint16 20000.0 RB_PT_PCT_SWC_DWC_CompuMethods_ident 0.0 20000. FORMAT "%10.5"
 /begin ANNOTATION ANNOTATION_LABEL "Description (coming from AUTOSAR DESC field)" /begin ANNOTATION_TEXT "Microslip speed, less than which lockup is possible\r\n" /end ANNOTATION_TEXT /end ANNOTATION
/end CHARACTERISTIC
/begin CHARACTERISTIC DWC_EFLASHB.DWC_TorqueControl.DWC_MicroSlipMonitor.DWC_SLCMICROSLIPLOSSJACKTIME "" VALUE 0x8060BB16 DefaultValueRecordLayout_AUTOSAR_Platform_BaseTypes_uint16 10.0 RB_PT_PCT_SWC_DWC_CompuMethods_ratio_0p001__2 0.0 10. FORMAT "%10.5"
 /begin ANNOTATION ANNOTATION_LABEL "Description (coming from AUTOSAR DESC field)"
  /begin ANNOTATION_TEXT "Time that microslip loss can be tolerated for before jacking reaction starts\r\n" /end ANNOTATION_TEXT
 /end ANNOTATION
/end CHARACTERISTIC
/begin CHARACTERISTIC DWC_EFLASHB.DWC_TorqueControl.DWC_MicroSlipMonitor.DWC_SLCMICROSLIPMAXFASTTP "" VALUE 0x8060BB18 DefaultValueRecordLayout_AUTOSAR_Platform_BaseTypes_uint16 20000.0 RB_PT_PCT_SWC_DWC_CompuMethods_ident 0.0 20000. FORMAT "%10.5"
 /begin ANNOTATION ANNOTATION_LABEL "Description (coming from AUTOSAR DESC field)" /begin ANNOTATION_TEXT "Microslip speed maximum for fast torque phase\r\n" /end ANNOTATION_TEXT /end ANNOTATION
/end CHARACTERISTIC
/begin CHARACTERISTIC DWC_EFLASHB.DWC_TorqueControl.DWC_MicroSlipMonitor.DWC_SLCMICROSLIPMAXIMUM "" VALUE 0x8060BB1A DefaultValueRecordLayout_AUTOSAR_Platform_BaseTypes_uint16 20000.0 RB_PT_PCT_SWC_DWC_CompuMethods_ident 0.0 20000. FORMAT "%10.5"
 /begin ANNOTATION ANNOTATION_LABEL "Description (coming from AUTOSAR DESC field)" /begin ANNOTATION_TEXT "Microslip maximum target speed\r\n" /end ANNOTATION_TEXT /end ANNOTATION
/end CHARACTERISTIC
/begin CHARACTERISTIC DWC_EFLASHB.DWC_TorqueControl.DWC_MicroSlipMonitor.DWC_SLCMICROSLIPOVERRUNRPM "" VALUE 0x8060BB1C DefaultValueRecordLayout_AUTOSAR_Platform_BaseTypes_uint16 20000.0 RB_PT_PCT_SWC_DWC_CompuMethods_ident 0.0 20000. FORMAT "%10.5"
 /begin ANNOTATION ANNOTATION_LABEL "Description (coming from AUTOSAR DESC field)" /begin ANNOTATION_TEXT "Microslip target for overrun condition\r\n" /end ANNOTATION_TEXT /end ANNOTATION
/end CHARACTERISTIC
/begin CHARACTERISTIC DWC_EFLASHB.DWC_TorqueControl.DWC_MicroSlipMonitor.DWC_SLCMICROSLIPRUNNING "" VALUE 0x8060BB1E DefaultValueRecordLayout_AUTOSAR_Platform_BaseTypes_uint16 20000.0 RB_PT_PCT_SWC_DWC_CompuMethods_ident 0.0 20000. FORMAT "%10.5"
 /begin ANNOTATION ANNOTATION_LABEL "Description (coming from AUTOSAR DESC field)"
  /begin ANNOTATION_TEXT "Microslip speed, more than which microslip is running\r\n" /end ANNOTATION_TEXT
 /end ANNOTATION
/end CHARACTERISTIC
/begin CHARACTERISTIC DWC_EFLASHB.DWC_TorqueControl.DWC_MicroSlipMonitor.DWC_SLCMICROSLIPTARGETTORQUESPEED "" MAP 0x8060BB30 RB_PT_PCT_SWC_DWC_RecordLayouts_RL_Map_uint16_49_uint16_7_sint16_7 20000.0 RB_PT_PCT_SWC_DWC_CompuMethods_ident 0.0 20000. FORMAT "%10.5"
 /begin ANNOTATION ANNOTATION_LABEL "Description (coming from AUTOSAR DESC field)" /begin ANNOTATION_TEXT "Microslip target based on torque and speed\r\n" /end ANNOTATION_TEXT /end ANNOTATION
 /begin AXIS_DESCR STD_AXIS NO_INPUT_QUANTITY RB_PT_PCT_SWC_DWC_CompuMethods_ident 7 0.0 20000. FORMAT "%10.5" DEPOSIT ABSOLUTE /end AXIS_DESCR
 /begin AXIS_DESCR STD_AXIS NO_INPUT_QUANTITY RB_PT_PCT_SWC_DWC_CompuMethods_ratio_0p1 7 -2000. 2000. FORMAT "%10.5" DEPOSIT ABSOLUTE /end AXIS_DESCR
/end CHARACTERISTIC
/begin CHARACTERISTIC DWC_EFLASHB.DWC_TorqueControl.DWC_MicroSlipMonitor.DWC_SLCMICROSLIPTORQUEDEC "" VALUE 0x8060BB20 DefaultValueRecordLayout_AUTOSAR_Platform_BaseTypes_uint16 2000.0 RB_PT_PCT_SWC_DWC_CompuMethods_ratio_0p1 0.0 2000. FORMAT "%10.5"
 /begin ANNOTATION ANNOTATION_LABEL "Description (coming from AUTOSAR DESC field)" /begin ANNOTATION_TEXT "Rise rate of target slip for torque direction\r\n" /end ANNOTATION_TEXT /end ANNOTATION
/end CHARACTERISTIC
/begin CHARACTERISTIC DWC_EFLASHB.DWC_TorqueControl.DWC_MicroSlipMonitor.DWC_SLCMICROSLIPTORQUEINC "" VALUE 0x8060BB22 DefaultValueRecordLayout_AUTOSAR_Platform_BaseTypes_uint16 2000.0 RB_PT_PCT_SWC_DWC_CompuMethods_ratio_0p1 0.0 2000. FORMAT "%10.5"
 /begin ANNOTATION ANNOTATION_LABEL "Description (coming from AUTOSAR DESC field)" /begin ANNOTATION_TEXT "Rise rate of target slip for torque\r\n" /end ANNOTATION_TEXT /end ANNOTATION
/end CHARACTERISTIC
/begin CHARACTERISTIC DWC_EFLASHB.DWC_TorqueControl.DWC_MicroSlipMonitor.DWC_SLCMINTORQUEHYST "" VALUE 0x8060BB24 DefaultValueRecordLayout_AUTOSAR_Platform_BaseTypes_uint16 2000.0 RB_PT_PCT_SWC_DWC_CompuMethods_ratio_0p1 0.0 2000. FORMAT "%10.5"
 /begin ANNOTATION ANNOTATION_LABEL "Description (coming from AUTOSAR DESC field)"
  /begin ANNOTATION_TEXT "Hysteresis on minimum clutch torque request for lockup decision\r\n" /end ANNOTATION_TEXT
 /end ANNOTATION
/end CHARACTERISTIC
/begin CHARACTERISTIC DWC_EFLASHB.DWC_TorqueControl.DWC_MicroSlipMonitor.DWC_SLCMINTORQUELOCKUP "" VALUE 0x8060BB2D DefaultValueRecordLayout_AUTOSAR_Platform_BaseTypes_boolean 255.0 AUTOSAR_Platform_CompuMethods_boolean 0.0 255. FORMAT "%10.5"
 /begin ANNOTATION ANNOTATION_LABEL "Description (coming from AUTOSAR DESC field)"
  /begin ANNOTATION_TEXT "Flag requesting lockup on engine torque < min controller torque\r\n" /end ANNOTATION_TEXT
 /end ANNOTATION
/end CHARACTERISTIC
/begin CHARACTERISTIC DWC_EFLASHB.DWC_TorqueControl.DWC_MicroSlipMonitor.DWC_SLCOPPOSITETORQUELOCKTIME "" VALUE 0x8060BB26 DefaultValueRecordLayout_AUTOSAR_Platform_BaseTypes_uint16 10.0 RB_PT_PCT_SWC_DWC_CompuMethods_ratio_0p001__2 0.0 10. FORMAT "%10.5"
 /begin ANNOTATION ANNOTATION_LABEL "Description (coming from AUTOSAR DESC field)"
  /begin ANNOTATION_TEXT "Time for which clutch is locked in opposite torque case\r\n" /end ANNOTATION_TEXT
 /end ANNOTATION
/end CHARACTERISTIC
/begin CHARACTERISTIC DWC_EFLASHB.DWC_TorqueControl.DWC_MicroSlipMonitor.DWC_SLCTARGETRAMPMIN "" VALUE 0x8060BB28 DefaultValueRecordLayout_AUTOSAR_Platform_BaseTypes_uint16 20000.0 RB_PT_PCT_SWC_DWC_CompuMethods_ident 0.0 20000. FORMAT "%10.5"
 /begin ANNOTATION ANNOTATION_LABEL "Description (coming from AUTOSAR DESC field)" /begin ANNOTATION_TEXT "Microslip target ramp minimum target\r\n" /end ANNOTATION_TEXT /end ANNOTATION
/end CHARACTERISTIC
/begin CHARACTERISTIC DWC_EFLASHB.DWC_TorqueControl.DWC_MINCNTRLTORQUEPOWERONDOWN "" VALUE 0x8060B3A2 DefaultValueRecordLayout_AUTOSAR_Platform_BaseTypes_sint16 4000.0 RB_PT_PCT_SWC_DWC_CompuMethods_ratio_0p1 -2000. 2000. FORMAT "%10.5"
 /begin ANNOTATION ANNOTATION_LABEL "Description (coming from AUTOSAR DESC field)" /begin ANNOTATION_TEXT "Minimum controller torque for a power on down\r\n" /end ANNOTATION_TEXT /end ANNOTATION
/end CHARACTERISTIC
/begin CHARACTERISTIC DWC_EFLASHB.DWC_TorqueControl.DWC_MINDEMANDFORLOCK "" VALUE 0x8060B3A4 DefaultValueRecordLayout_AUTOSAR_Platform_BaseTypes_uint16 2000.0 RB_PT_PCT_SWC_DWC_CompuMethods_ratio_0p1 0.0 2000. FORMAT "%10.5"
 /begin ANNOTATION ANNOTATION_LABEL "Description (coming from AUTOSAR DESC field)"
  /begin ANNOTATION_TEXT "Minimum torque demand above which lock-up signal is sent\r\n" /end ANNOTATION_TEXT
 /end ANNOTATION
/end CHARACTERISTIC
/begin CHARACTERISTIC DWC_EFLASHB.DWC_TorqueControl.DWC_MINDESPEEDPOWERONDOWN "" VALUE 0x8060B3A6 DefaultValueRecordLayout_AUTOSAR_Platform_BaseTypes_sint16 64000.0 RB_PT_PCT_SWC_DWC_CompuMethods_ident -32000. 32000. FORMAT "%10.5"
 /begin ANNOTATION ANNOTATION_LABEL "Description (coming from AUTOSAR DESC field)"
  /begin ANNOTATION_TEXT "Minimum rate of change of engine speed for power on down shift\r\n" /end ANNOTATION_TEXT
 /end ANNOTATION
/end CHARACTERISTIC
/begin CHARACTERISTIC DWC_EFLASHB.DWC_TorqueControl.DWC_MININPUTSPEEDPOWEROFFUPVSGEAR "" VAL_BLK 0x8060B2A0 DefaultValueRecordLayout_AUTOSAR_Platform_BaseTypes_uint16 20000.0 RB_PT_PCT_SWC_DWC_CompuMethods_ident 0.0 20000. FORMAT "%10.5"
 /begin ANNOTATION ANNOTATION_LABEL "Description (coming from AUTOSAR DESC field)"
  /begin ANNOTATION_TEXT "Minimum allowed input shaft speed before a power off up shift is allowed, vs gear\r\n" /end ANNOTATION_TEXT
 /end ANNOTATION
 MATRIX_DIM 12 1 1 /end CHARACTERISTIC
/begin CHARACTERISTIC DWC_EFLASHB.DWC_TorqueControl.DWC_MINPEDALPOWERONDOWN "" VALUE 0x8060B4AB DefaultValueRecordLayout_AUTOSAR_Platform_BaseTypes_uint8 102.0 RB_PT_PCT_SWC_DWC_CompuMethods_ratio_0p4 0.0 102. FORMAT "%10.5"
 /begin ANNOTATION ANNOTATION_LABEL "Description (coming from AUTOSAR DESC field)" /begin ANNOTATION_TEXT "Min pedal for power on down in speed control\r\n" /end ANNOTATION_TEXT /end ANNOTATION
/end CHARACTERISTIC
/begin CHARACTERISTIC DWC_EFLASHB.DWC_TorqueControl.DWC_MINSTABLETIMEENGINEADAPTOK "" VALUE 0x8060B3A8 DefaultValueRecordLayout_AUTOSAR_Platform_BaseTypes_uint16 10.0 RB_PT_PCT_SWC_DWC_CompuMethods_ratio_0p001__2 0.0 10. FORMAT "%10.5"
 /begin ANNOTATION ANNOTATION_LABEL "Description (coming from AUTOSAR DESC field)"
  /begin ANNOTATION_TEXT "Minimum time for stable adaption conditions before engine idle adapt flag is set true\r\n" /end ANNOTATION_TEXT
 /end ANNOTATION
/end CHARACTERISTIC
/begin CHARACTERISTIC DWC_EFLASHB.DWC_TorqueControl.DWC_MINTHROTTLEPOWERONDOWN "" VALUE 0x8060B4AC DefaultValueRecordLayout_AUTOSAR_Platform_BaseTypes_uint8 102.0 RB_PT_PCT_SWC_DWC_CompuMethods_ratio_0p4 0.0 102. FORMAT "%10.5"
 /begin ANNOTATION ANNOTATION_LABEL "Description (coming from AUTOSAR DESC field)" /begin ANNOTATION_TEXT "Minimum throttle angle for power on down shift\r\n" /end ANNOTATION_TEXT /end ANNOTATION
/end CHARACTERISTIC
/begin CHARACTERISTIC DWC_EFLASHB.DWC_TorqueControl.DWC_MINTORQUEPOWERONDOWN "" VALUE 0x8060B3AA DefaultValueRecordLayout_AUTOSAR_Platform_BaseTypes_sint16 4000.0 RB_PT_PCT_SWC_DWC_CompuMethods_ratio_0p1 -2000. 2000. FORMAT "%10.5"
 /begin ANNOTATION ANNOTATION_LABEL "Description (coming from AUTOSAR DESC field)" /begin ANNOTATION_TEXT "Minimum controller torque for a power on down shift\r\n" /end ANNOTATION_TEXT /end ANNOTATION
/end CHARACTERISTIC
/begin CHARACTERISTIC DWC_EFLASHB.DWC_TorqueControl.DWC_MINTORQUEPOWERONUP "" VALUE 0x8060B3AC DefaultValueRecordLayout_AUTOSAR_Platform_BaseTypes_sint16 4000.0 RB_PT_PCT_SWC_DWC_CompuMethods_ratio_0p1 -2000. 2000. FORMAT "%10.5"
 /begin ANNOTATION ANNOTATION_LABEL "Description (coming from AUTOSAR DESC field)" /begin ANNOTATION_TEXT "Minimum controller torque for a power on up shift\r\n" /end ANNOTATION_TEXT /end ANNOTATION
/end CHARACTERISTIC
/begin CHARACTERISTIC DWC_EFLASHB.DWC_TorqueControl.DWC_MINTRQPOWERONDOWNENGINE "" CURVE 0x8060CB7C RB_PT_PCT_SWC_DWC_RecordLayouts_RL_Curve_uint16_5_uint16_5 2000.0 RB_PT_PCT_SWC_DWC_CompuMethods_ratio_0p1 0.0 2000. FORMAT "%10.5"
 /begin ANNOTATION ANNOTATION_LABEL "Description (coming from AUTOSAR DESC field)"
  /begin ANNOTATION_TEXT "Minimum controller torque for power on down - vs engine speed\r\n" /end ANNOTATION_TEXT
 /end ANNOTATION
 /begin AXIS_DESCR STD_AXIS NO_INPUT_QUANTITY RB_PT_PCT_SWC_DWC_CompuMethods_ident 5 0.0 20000. FORMAT "%10.5" DEPOSIT ABSOLUTE /end AXIS_DESCR
/end CHARACTERISTIC
/begin CHARACTERISTIC DWC_EFLASHB.DWC_TorqueControl.DWC_MINTRQPOWERONDOWNENGINEEVSTRT "" CURVE 0x8060CB92 RB_PT_PCT_SWC_DWC_RecordLayouts_RL_Curve_uint16_5_uint16_5 2000.0 RB_PT_PCT_SWC_DWC_CompuMethods_ratio_0p1 0.0 2000. FORMAT "%10.5"
 /begin ANNOTATION ANNOTATION_LABEL "Description (coming from AUTOSAR DESC field)"
  /begin ANNOTATION_TEXT "Minimum controller torque for power on down - vs engine speed\r\n" /end ANNOTATION_TEXT
 /end ANNOTATION
 /begin AXIS_DESCR STD_AXIS NO_INPUT_QUANTITY RB_PT_PCT_SWC_DWC_CompuMethods_ident 5 0.0 20000. FORMAT "%10.5" DEPOSIT ABSOLUTE /end AXIS_DESCR
/end CHARACTERISTIC
/begin CHARACTERISTIC DWC_EFLASHB.DWC_TorqueControl.DWC_MINTRQPOWERONDOWNENGINETIP "" CURVE 0x8060CBA8 RB_PT_PCT_SWC_DWC_RecordLayouts_RL_Curve_uint16_5_uint16_5 2000.0 RB_PT_PCT_SWC_DWC_CompuMethods_ratio_0p1 0.0 2000. FORMAT "%10.5"
 /begin ANNOTATION ANNOTATION_LABEL "Description (coming from AUTOSAR DESC field)"
  /begin ANNOTATION_TEXT "Minimum controller torque for power on down vs engine speed - TIP mode\r\n" /end ANNOTATION_TEXT
 /end ANNOTATION
 /begin AXIS_DESCR STD_AXIS NO_INPUT_QUANTITY RB_PT_PCT_SWC_DWC_CompuMethods_ident 5 0.0 20000. FORMAT "%10.5" DEPOSIT ABSOLUTE /end AXIS_DESCR
/end CHARACTERISTIC
/begin CHARACTERISTIC DWC_EFLASHB.DWC_TorqueControl.DWC_OFFGOINGDOWNGRADIENTSWITCH "" VALUE 0x8060B3AE DefaultValueRecordLayout_AUTOSAR_Platform_BaseTypes_sint16 64000.0 RB_PT_PCT_SWC_DWC_CompuMethods_ident -32000. 32000. FORMAT "%10.5"
 /begin ANNOTATION ANNOTATION_LABEL "Description (coming from AUTOSAR DESC field)"
  /begin ANNOTATION_TEXT "Switch to change controller type based on gradient demand\r\n" /end ANNOTATION_TEXT
 /end ANNOTATION
/end CHARACTERISTIC
/begin CHARACTERISTIC DWC_EFLASHB.DWC_TorqueControl.DWC_OFFGOINGUPGRADIENTSWITCH "" VALUE 0x8060B3B0 DefaultValueRecordLayout_AUTOSAR_Platform_BaseTypes_sint16 64000.0 RB_PT_PCT_SWC_DWC_CompuMethods_ident -32000. 32000. FORMAT "%10.5"
 /begin ANNOTATION ANNOTATION_LABEL "Description (coming from AUTOSAR DESC field)"
  /begin ANNOTATION_TEXT "Switch to change controller type based on gradient demand\r\n" /end ANNOTATION_TEXT
 /end ANNOTATION
/end CHARACTERISTIC
/begin CHARACTERISTIC DWC_EFLASHB.DWC_TorqueControl.DWC_ONCOMINGCHECKTIME "" VALUE 0x8060B3B2 DefaultValueRecordLayout_AUTOSAR_Platform_BaseTypes_uint16 10.0 RB_PT_PCT_SWC_DWC_CompuMethods_ratio_0p001__2 0.0 10. FORMAT "%10.5"
 /begin ANNOTATION ANNOTATION_LABEL "Description (coming from AUTOSAR DESC field)" /begin ANNOTATION_TEXT "Time after oncoming for check of integrator\r\n" /end ANNOTATION_TEXT /end ANNOTATION
/end CHARACTERISTIC
/begin CHARACTERISTIC DWC_EFLASHB.DWC_TorqueControl.DWC_OverheatOscillation.DWC_OOMAXOSCILLATIONAMP "" VALUE 0x8060BBB2 DefaultValueRecordLayout_AUTOSAR_Platform_BaseTypes_uint16 2000.0 RB_PT_PCT_SWC_DWC_CompuMethods_ratio_0p1 0.0 2000. FORMAT "%10.5"
 /begin ANNOTATION ANNOTATION_LABEL "Description (coming from AUTOSAR DESC field)"
  /begin ANNOTATION_TEXT "Maximum amplitude of clutch oscillation (symetrical clipping is applied also)\r\n" /end ANNOTATION_TEXT
 /end ANNOTATION
/end CHARACTERISTIC
/begin CHARACTERISTIC DWC_EFLASHB.DWC_TorqueControl.DWC_OverheatOscillation.DWC_OOMAXOSCILLATIONMINREQUEST "" VALUE 0x8060BBB4 DefaultValueRecordLayout_AUTOSAR_Platform_BaseTypes_uint16 2000.0 RB_PT_PCT_SWC_DWC_CompuMethods_ratio_0p1 0.0 2000. FORMAT "%10.5"
 /begin ANNOTATION ANNOTATION_LABEL "Description (coming from AUTOSAR DESC field)"
  /begin ANNOTATION_TEXT "Minimum torque obtained by overheat oscillation (minimum demand)\r\n" /end ANNOTATION_TEXT
 /end ANNOTATION
/end CHARACTERISTIC
/begin CHARACTERISTIC DWC_EFLASHB.DWC_TorqueControl.DWC_OverheatOscillation.DWC_OOTIMERPERIOD "" VALUE 0x8060BBB6 DefaultValueRecordLayout_AUTOSAR_Platform_BaseTypes_uint16 10.0 RB_PT_PCT_SWC_DWC_CompuMethods_ratio_0p001__2 0.0 10. FORMAT "%10.5"
 /begin ANNOTATION ANNOTATION_LABEL "Description (coming from AUTOSAR DESC field)"
  /begin ANNOTATION_TEXT "Timer period for clutch overheat oscillation - NOTE: MUST be a multiple of 2 x dT\r\n" /end ANNOTATION_TEXT
 /end ANNOTATION
/end CHARACTERISTIC
/begin CHARACTERISTIC DWC_EFLASHB.DWC_TorqueControl.DWC_PAACBYPASSDEADPEDAL "" VALUE 0x8060B4AD DefaultValueRecordLayout_AUTOSAR_Platform_BaseTypes_boolean 255.0 AUTOSAR_Platform_CompuMethods_boolean 0.0 255. FORMAT "%10.5"
 /begin ANNOTATION ANNOTATION_LABEL "Description (coming from AUTOSAR DESC field)" /begin ANNOTATION_TEXT "Flag to bypass dead pedal rule\r\n" /end ANNOTATION_TEXT /end ANNOTATION
/end CHARACTERISTIC
/begin CHARACTERISTIC DWC_EFLASHB.DWC_TorqueControl.DWC_PAACDGAIN "" CURVE 0x8060CBBE RB_PT_PCT_SWC_DWC_RecordLayouts_RL_Curve_uint16_5_sint16_5 5.0 RB_PT_PCT_SWC_DWC_CompuMethods_ratio_0p001__2 0.0 5. FORMAT "%10.5"
 /begin ANNOTATION ANNOTATION_LABEL "Description (coming from AUTOSAR DESC field)" /begin ANNOTATION_TEXT "Gain of auto close controller\r\n" /end ANNOTATION_TEXT /end ANNOTATION
 /begin AXIS_DESCR STD_AXIS NO_INPUT_QUANTITY RB_PT_PCT_SWC_DWC_CompuMethods_ident 5 -20000. 20000. FORMAT "%10.5" DEPOSIT ABSOLUTE /end AXIS_DESCR
/end CHARACTERISTIC
/begin CHARACTERISTIC DWC_EFLASHB.DWC_TorqueControl.DWC_PAACIGAIN "" CURVE 0x8060CBD4 RB_PT_PCT_SWC_DWC_RecordLayouts_RL_Curve_uint16_5_sint16_5 0.15 RB_PT_PCT_SWC_DWC_CompuMethods_ratio_0p00001 0.0 0.15 FORMAT "%10.5"
 /begin ANNOTATION ANNOTATION_LABEL "Description (coming from AUTOSAR DESC field)" /begin ANNOTATION_TEXT "Gain of auto close controller\r\n" /end ANNOTATION_TEXT /end ANNOTATION
 /begin AXIS_DESCR STD_AXIS NO_INPUT_QUANTITY RB_PT_PCT_SWC_DWC_CompuMethods_ident 5 -20000. 20000. FORMAT "%10.5" DEPOSIT ABSOLUTE /end AXIS_DESCR
/end CHARACTERISTIC
/begin CHARACTERISTIC DWC_EFLASHB.DWC_TorqueControl.DWC_PAACPGAIN "" CURVE 0x8060CBEA RB_PT_PCT_SWC_DWC_RecordLayouts_RL_Curve_uint16_5_sint16_5 5.0 RB_PT_PCT_SWC_DWC_CompuMethods_ratio_0p001__2 0.0 5. FORMAT "%10.5"
 /begin ANNOTATION ANNOTATION_LABEL "Description (coming from AUTOSAR DESC field)" /begin ANNOTATION_TEXT "Gain of auto close controller\r\n" /end ANNOTATION_TEXT /end ANNOTATION
 /begin AXIS_DESCR STD_AXIS NO_INPUT_QUANTITY RB_PT_PCT_SWC_DWC_CompuMethods_ident 5 -20000. 20000. FORMAT "%10.5" DEPOSIT ABSOLUTE /end AXIS_DESCR
/end CHARACTERISTIC
/begin CHARACTERISTIC DWC_EFLASHB.DWC_TorqueControl.DWC_PAACREVERSESLIPDISABLE "" VALUE 0x8060B3B4 DefaultValueRecordLayout_AUTOSAR_Platform_BaseTypes_sint16 40000.0 RB_PT_PCT_SWC_DWC_CompuMethods_ident -20000. 20000. FORMAT "%10.5"
 /begin ANNOTATION ANNOTATION_LABEL "Description (coming from AUTOSAR DESC field)"
  /begin ANNOTATION_TEXT "Reverse slip threshold, above which AC is allowed to deactivate\r\n" /end ANNOTATION_TEXT
 /end ANNOTATION
/end CHARACTERISTIC
/begin CHARACTERISTIC DWC_EFLASHB.DWC_TorqueControl.DWC_PAACREVERSESLIPENABLE "" VALUE 0x8060B3B6 DefaultValueRecordLayout_AUTOSAR_Platform_BaseTypes_sint16 40000.0 RB_PT_PCT_SWC_DWC_CompuMethods_ident -20000. 20000. FORMAT "%10.5"
 /begin ANNOTATION ANNOTATION_LABEL "Description (coming from AUTOSAR DESC field)"
  /begin ANNOTATION_TEXT "Reverse slip threshold, above which AC is allowed to activate\r\n" /end ANNOTATION_TEXT
 /end ANNOTATION
/end CHARACTERISTIC
/begin CHARACTERISTIC DWC_EFLASHB.DWC_TorqueControl.DWC_PAACTARGETSLIP "" CURVE 0x8060CC00 RB_PT_PCT_SWC_DWC_RecordLayouts_RL_Curve_uint16_5_uint16_5 20000.0 RB_PT_PCT_SWC_DWC_CompuMethods_ident 0.0 20000. FORMAT "%10.5"
 /begin ANNOTATION ANNOTATION_LABEL "Description (coming from AUTOSAR DESC field)" /begin ANNOTATION_TEXT "Slip target for clutch auto closure\r\n" /end ANNOTATION_TEXT /end ANNOTATION
 /begin AXIS_DESCR STD_AXIS NO_INPUT_QUANTITY RB_PT_PCT_SWC_DWC_CompuMethods_ident 5 0.0 20000. FORMAT "%10.5" DEPOSIT ABSOLUTE /end AXIS_DESCR
/end CHARACTERISTIC
/begin CHARACTERISTIC DWC_EFLASHB.DWC_TorqueControl.DWC_PAARBONLYINPTSYNC "" VALUE 0x8060B3B8 DefaultValueRecordLayout_AUTOSAR_Platform_BaseTypes_uint16 2000.0 RB_PT_PCT_SWC_DWC_CompuMethods_ratio_0p1 0.0 2000. FORMAT "%10.5"
 /begin ANNOTATION ANNOTATION_LABEL "Description (coming from AUTOSAR DESC field)"
  /begin ANNOTATION_TEXT "A value greater than 0.0 puts -2000.0Nm on the SPC Arbitrator\r\n" /end ANNOTATION_TEXT
 /end ANNOTATION
/end CHARACTERISTIC
/begin CHARACTERISTIC DWC_EFLASHB.DWC_TorqueControl.DWC_PAASDGAIN "" MAP 0x8060CC16 RB_PT_PCT_SWC_DWC_RecordLayouts_RL_Map_uint16_25_sint16_5_sint16_5 5.0 RB_PT_PCT_SWC_DWC_CompuMethods_ratio_0p001__2 0.0 5. FORMAT "%10.5"
 /begin ANNOTATION ANNOTATION_LABEL "Description (coming from AUTOSAR DESC field)" /begin ANNOTATION_TEXT "Derivative gain of the anti-stall controller\r\n" /end ANNOTATION_TEXT /end ANNOTATION
 /begin AXIS_DESCR STD_AXIS NO_INPUT_QUANTITY RB_PT_PCT_SWC_DWC_CompuMethods_ratio_0p1 5 -2000. 2000. FORMAT "%10.5" DEPOSIT ABSOLUTE /end AXIS_DESCR
 /begin AXIS_DESCR STD_AXIS NO_INPUT_QUANTITY RB_PT_PCT_SWC_DWC_CompuMethods_ident 5 -32000. 32000. FORMAT "%10.5" DEPOSIT ABSOLUTE /end AXIS_DESCR
/end CHARACTERISTIC
/begin CHARACTERISTIC DWC_EFLASHB.DWC_TorqueControl.DWC_PAASDGAINLC "" MAP 0x8060CC60 RB_PT_PCT_SWC_DWC_RecordLayouts_RL_Map_uint16_25_sint16_5_sint16_5 5.0 RB_PT_PCT_SWC_DWC_CompuMethods_ratio_0p001__2 0.0 5. FORMAT "%10.5"
 /begin ANNOTATION ANNOTATION_LABEL "Description (coming from AUTOSAR DESC field)" /begin ANNOTATION_TEXT "Derivative gain of the anti-stall controller for LC\r\n" /end ANNOTATION_TEXT /end ANNOTATION
 /begin AXIS_DESCR STD_AXIS NO_INPUT_QUANTITY RB_PT_PCT_SWC_DWC_CompuMethods_ratio_0p1 5 -2000. 2000. FORMAT "%10.5" DEPOSIT ABSOLUTE /end AXIS_DESCR
 /begin AXIS_DESCR STD_AXIS NO_INPUT_QUANTITY RB_PT_PCT_SWC_DWC_CompuMethods_ident 5 -32000. 32000. FORMAT "%10.5" DEPOSIT ABSOLUTE /end AXIS_DESCR
/end CHARACTERISTIC
/begin CHARACTERISTIC DWC_EFLASHB.DWC_TorqueControl.DWC_PAASERRORENABLE "" VALUE 0x8060B3BA DefaultValueRecordLayout_AUTOSAR_Platform_BaseTypes_sint16 40000.0 RB_PT_PCT_SWC_DWC_CompuMethods_ident -20000. 20000. FORMAT "%10.5"
 /begin ANNOTATION ANNOTATION_LABEL "Description (coming from AUTOSAR DESC field)"
  /begin ANNOTATION_TEXT "Error of antistall controller limit for controller activation\r\n" /end ANNOTATION_TEXT
 /end ANNOTATION
/end CHARACTERISTIC
/begin CHARACTERISTIC DWC_EFLASHB.DWC_TorqueControl.DWC_PAASERRORENABLELC "" VALUE 0x8060B3BC DefaultValueRecordLayout_AUTOSAR_Platform_BaseTypes_sint16 40000.0 RB_PT_PCT_SWC_DWC_CompuMethods_ident -20000. 20000. FORMAT "%10.5"
 /begin ANNOTATION ANNOTATION_LABEL "Description (coming from AUTOSAR DESC field)"
  /begin ANNOTATION_TEXT "Error of antistall controller limit for controller activation for LC\r\n" /end ANNOTATION_TEXT
 /end ANNOTATION
/end CHARACTERISTIC
/begin CHARACTERISTIC DWC_EFLASHB.DWC_TorqueControl.DWC_PAASFORCEENABLE "" VALUE 0x8060B4AE DefaultValueRecordLayout_AUTOSAR_Platform_BaseTypes_boolean 255.0 AUTOSAR_Platform_CompuMethods_boolean 0.0 255. FORMAT "%10.5"
 /begin ANNOTATION ANNOTATION_LABEL "Description (coming from AUTOSAR DESC field)"
  /begin ANNOTATION_TEXT "Flag to force the Anti Stall controller to be always enabled\r\n" /end ANNOTATION_TEXT
 /end ANNOTATION
/end CHARACTERISTIC
/begin CHARACTERISTIC DWC_EFLASHB.DWC_TorqueControl.DWC_PAASGRADIENTOFFSETENABLE "" VALUE 0x8060B3BE DefaultValueRecordLayout_AUTOSAR_Platform_BaseTypes_sint16 64000.0 RB_PT_PCT_SWC_DWC_CompuMethods_ident -32000. 32000. FORMAT "%10.5"
 /begin ANNOTATION ANNOTATION_LABEL "Description (coming from AUTOSAR DESC field)" /begin ANNOTATION_TEXT "Gradient offset for anti-stall controller activation\r\n" /end ANNOTATION_TEXT /end ANNOTATION
/end CHARACTERISTIC
/begin CHARACTERISTIC DWC_EFLASHB.DWC_TorqueControl.DWC_PAASGRADIENTOFFSETENABLELC "" VALUE 0x8060B3C0 DefaultValueRecordLayout_AUTOSAR_Platform_BaseTypes_sint16 64000.0 RB_PT_PCT_SWC_DWC_CompuMethods_ident -32000. 32000. FORMAT "%10.5"
 /begin ANNOTATION ANNOTATION_LABEL "Description (coming from AUTOSAR DESC field)"
  /begin ANNOTATION_TEXT "Gradient offset for anti-stall controller activation for LC\r\n" /end ANNOTATION_TEXT
 /end ANNOTATION
/end CHARACTERISTIC
/begin CHARACTERISTIC DWC_EFLASHB.DWC_TorqueControl.DWC_PAASIGAIN "" MAP 0x8060CCAA RB_PT_PCT_SWC_DWC_RecordLayouts_RL_Map_uint16_16_sint16_4_sint16_4 0.15 RB_PT_PCT_SWC_DWC_CompuMethods_ratio_0p00001 0.0 0.15 FORMAT "%10.5"
 /begin ANNOTATION ANNOTATION_LABEL "Description (coming from AUTOSAR DESC field)"
  /begin ANNOTATION_TEXT "Gain of the integral part of the anti-stall controller\r\n" /end ANNOTATION_TEXT
 /end ANNOTATION
 /begin AXIS_DESCR STD_AXIS NO_INPUT_QUANTITY RB_PT_PCT_SWC_DWC_CompuMethods_ratio_0p1 4 -2000. 2000. FORMAT "%10.5" DEPOSIT ABSOLUTE /end AXIS_DESCR
 /begin AXIS_DESCR STD_AXIS NO_INPUT_QUANTITY RB_PT_PCT_SWC_DWC_CompuMethods_ident 4 -20000. 20000. FORMAT "%10.5" DEPOSIT ABSOLUTE /end AXIS_DESCR
/end CHARACTERISTIC
/begin CHARACTERISTIC DWC_EFLASHB.DWC_TorqueControl.DWC_PAASIGAINLC "" MAP 0x8060CCDE RB_PT_PCT_SWC_DWC_RecordLayouts_RL_Map_uint16_16_sint16_4_sint16_4 0.15 RB_PT_PCT_SWC_DWC_CompuMethods_ratio_0p00001 0.0 0.15 FORMAT "%10.5"
 /begin ANNOTATION ANNOTATION_LABEL "Description (coming from AUTOSAR DESC field)"
  /begin ANNOTATION_TEXT "Gain of the integral part of the anti-stall controller for LC\r\n" /end ANNOTATION_TEXT
 /end ANNOTATION
 /begin AXIS_DESCR STD_AXIS NO_INPUT_QUANTITY RB_PT_PCT_SWC_DWC_CompuMethods_ratio_0p1 4 -2000. 2000. FORMAT "%10.5" DEPOSIT ABSOLUTE /end AXIS_DESCR
 /begin AXIS_DESCR STD_AXIS NO_INPUT_QUANTITY RB_PT_PCT_SWC_DWC_CompuMethods_ident 4 -20000. 20000. FORMAT "%10.5" DEPOSIT ABSOLUTE /end AXIS_DESCR
/end CHARACTERISTIC
/begin CHARACTERISTIC DWC_EFLASHB.DWC_TorqueControl.DWC_PAASLAUNCHOFFSETTARGET "" VALUE 0x8060B3C2 DefaultValueRecordLayout_AUTOSAR_Platform_BaseTypes_uint16 20000.0 RB_PT_PCT_SWC_DWC_CompuMethods_ident 0.0 20000. FORMAT "%10.5"
 /begin ANNOTATION ANNOTATION_LABEL "Description (coming from AUTOSAR DESC field)"
  /begin ANNOTATION_TEXT "Offset to target speed for anti-stall target - launch mode\r\n" /end ANNOTATION_TEXT
 /end ANNOTATION
/end CHARACTERISTIC
/begin CHARACTERISTIC DWC_EFLASHB.DWC_TorqueControl.DWC_PAASMINITERMOFFSET "" VALUE 0x8060B3C4 DefaultValueRecordLayout_AUTOSAR_Platform_BaseTypes_sint16 4000.0 RB_PT_PCT_SWC_DWC_CompuMethods_ratio_0p1 -2000. 2000. FORMAT "%10.5"
 /begin ANNOTATION ANNOTATION_LABEL "Description (coming from AUTOSAR DESC field)" /begin ANNOTATION_TEXT "Minimum I term from anti-stall in RPM pullaway\r\n" /end ANNOTATION_TEXT /end ANNOTATION
/end CHARACTERISTIC
/begin CHARACTERISTIC DWC_EFLASHB.DWC_TorqueControl.DWC_PAASOFFSETTARGET "" VALUE 0x8060B3C6 DefaultValueRecordLayout_AUTOSAR_Platform_BaseTypes_uint16 20000.0 RB_PT_PCT_SWC_DWC_CompuMethods_ident 0.0 20000. FORMAT "%10.5"
 /begin ANNOTATION ANNOTATION_LABEL "Description (coming from AUTOSAR DESC field)" /begin ANNOTATION_TEXT "Offset to target speed for anti-stall target\r\n" /end ANNOTATION_TEXT /end ANNOTATION
/end CHARACTERISTIC
/begin CHARACTERISTIC DWC_EFLASHB.DWC_TorqueControl.DWC_PAASPGAIN "" MAP 0x8060CD12 RB_PT_PCT_SWC_DWC_RecordLayouts_RL_Map_uint16_25_sint16_5_sint16_5 5.0 RB_PT_PCT_SWC_DWC_CompuMethods_ratio_0p001__2 0.0 5. FORMAT "%10.5"
 /begin ANNOTATION ANNOTATION_LABEL "Description (coming from AUTOSAR DESC field)" /begin ANNOTATION_TEXT "Proportional gain of the anti-stall controller\r\n" /end ANNOTATION_TEXT /end ANNOTATION
 /begin AXIS_DESCR STD_AXIS NO_INPUT_QUANTITY RB_PT_PCT_SWC_DWC_CompuMethods_ratio_0p1 5 -2000. 2000. FORMAT "%10.5" DEPOSIT ABSOLUTE /end AXIS_DESCR
 /begin AXIS_DESCR STD_AXIS NO_INPUT_QUANTITY RB_PT_PCT_SWC_DWC_CompuMethods_ratio_0p01 5 0.0 5. FORMAT "%10.5" DEPOSIT ABSOLUTE /end AXIS_DESCR
/end CHARACTERISTIC
/begin CHARACTERISTIC DWC_EFLASHB.DWC_TorqueControl.DWC_PAASPGAINLC "" MAP 0x8060CD5C RB_PT_PCT_SWC_DWC_RecordLayouts_RL_Map_uint16_25_sint16_5_sint16_5 5.0 RB_PT_PCT_SWC_DWC_CompuMethods_ratio_0p001__2 0.0 5. FORMAT "%10.5"
 /begin ANNOTATION ANNOTATION_LABEL "Description (coming from AUTOSAR DESC field)"
  /begin ANNOTATION_TEXT "Proportional gain of the anti-stall controller for LC\r\n" /end ANNOTATION_TEXT
 /end ANNOTATION
 /begin AXIS_DESCR STD_AXIS NO_INPUT_QUANTITY RB_PT_PCT_SWC_DWC_CompuMethods_ratio_0p1 5 -2000. 2000. FORMAT "%10.5" DEPOSIT ABSOLUTE /end AXIS_DESCR
 /begin AXIS_DESCR STD_AXIS NO_INPUT_QUANTITY RB_PT_PCT_SWC_DWC_CompuMethods_ratio_0p01 5 0.0 5. FORMAT "%10.5" DEPOSIT ABSOLUTE /end AXIS_DESCR
/end CHARACTERISTIC
/begin CHARACTERISTIC DWC_EFLASHB.DWC_TorqueControl.DWC_PAASTIMEBEFORESTART "" VALUE 0x8060B3C8 DefaultValueRecordLayout_AUTOSAR_Platform_BaseTypes_uint16 10.0 RB_PT_PCT_SWC_DWC_CompuMethods_ratio_0p001__2 0.0 10. FORMAT "%10.5"
 /begin ANNOTATION ANNOTATION_LABEL "Description (coming from AUTOSAR DESC field)"
  /begin ANNOTATION_TEXT "Time before anti-stall controller is activated in sync and running phases\r\n" /end ANNOTATION_TEXT
 /end ANNOTATION
/end CHARACTERISTIC
/begin CHARACTERISTIC DWC_EFLASHB.DWC_TorqueControl.DWC_PAASTIMEBEFORESTARTLC "" VALUE 0x8060B3CA DefaultValueRecordLayout_AUTOSAR_Platform_BaseTypes_uint16 10.0 RB_PT_PCT_SWC_DWC_CompuMethods_ratio_0p001__2 0.0 10. FORMAT "%10.5"
 /begin ANNOTATION ANNOTATION_LABEL "Description (coming from AUTOSAR DESC field)"
  /begin ANNOTATION_TEXT "Time before anti-stall controller is activated in sync and running phases for LC\r\n" /end ANNOTATION_TEXT
 /end ANNOTATION
/end CHARACTERISTIC
/begin CHARACTERISTIC DWC_EFLASHB.DWC_TorqueControl.DWC_PABRAKEREDUCTIONRPM "" CURVE 0x8060CDA6 RB_PT_PCT_SWC_DWC_RecordLayouts_RL_Curve_uint8_4_uint16_4 1.0 RB_PT_PCT_SWC_DWC_CompuMethods_ratio_0p01 0.0 1. FORMAT "%10.5"
 /begin ANNOTATION ANNOTATION_LABEL "Description (coming from AUTOSAR DESC field)" /begin ANNOTATION_TEXT "Gain on pullaway RPM for brake pressure\r\n" /end ANNOTATION_TEXT /end ANNOTATION
 /begin AXIS_DESCR STD_AXIS NO_INPUT_QUANTITY RB_PT_PCT_SWC_DWC_CompuMethods_ratio_0p1 4 0.0 409.5 FORMAT "%10.5" DEPOSIT ABSOLUTE /end AXIS_DESCR
/end CHARACTERISTIC
/begin CHARACTERISTIC DWC_EFLASHB.DWC_TorqueControl.DWC_PABRAKEREDUCTIONTQ "" CURVE 0x8060CDB4 RB_PT_PCT_SWC_DWC_RecordLayouts_RL_Curve_sint8_4_uint16_4 1.0 RB_PT_PCT_SWC_DWC_CompuMethods_ratio_0p01 0.0 1. FORMAT "%10.5"
 /begin ANNOTATION ANNOTATION_LABEL "Description (coming from AUTOSAR DESC field)" /begin ANNOTATION_TEXT "Gain on pullaway torque for brake pressure\r\n" /end ANNOTATION_TEXT /end ANNOTATION
 /begin AXIS_DESCR STD_AXIS NO_INPUT_QUANTITY RB_PT_PCT_SWC_DWC_CompuMethods_ratio_0p1 4 0.0 409.5 FORMAT "%10.5" DEPOSIT ABSOLUTE /end AXIS_DESCR
/end CHARACTERISTIC
/begin CHARACTERISTIC DWC_EFLASHB.DWC_TorqueControl.DWC_PACANCLOSEOFFSET "" VALUE 0x8060B3CC DefaultValueRecordLayout_AUTOSAR_Platform_BaseTypes_uint16 20000.0 RB_PT_PCT_SWC_DWC_CompuMethods_ident 0.0 20000. FORMAT "%10.5"
 /begin ANNOTATION ANNOTATION_LABEL "Description (coming from AUTOSAR DESC field)" /begin ANNOTATION_TEXT "Clutch must open to clutch can close offset\r\n" /end ANNOTATION_TEXT /end ANNOTATION
/end CHARACTERISTIC
/begin CHARACTERISTIC DWC_EFLASHB.DWC_TorqueControl.DWC_PACLUTCHCANCLOSEOFFSET "" CURVE 0x8060CDC2 RB_PT_PCT_SWC_DWC_RecordLayouts_RL_CurveGrouped_uint16_5_uint8_5 20000.0 RB_PT_PCT_SWC_DWC_CompuMethods_ident 0.0 20000. FORMAT "%10.5"
 /begin ANNOTATION ANNOTATION_LABEL "Description (coming from AUTOSAR DESC field)" /begin ANNOTATION_TEXT "Offset from clutch can close for statemachine input\r\n" /end ANNOTATION_TEXT /end ANNOTATION
 /begin AXIS_DESCR COM_AXIS NO_INPUT_QUANTITY RB_PT_PCT_SWC_DWC_CompuMethods_ratio_0p4 5 0.0 102. FORMAT "%10.5" AXIS_PTS_REF DWC_EFLASHB.DWC_TorqueControl.DWC_PATPS5 DEPOSIT ABSOLUTE /end AXIS_DESCR
/end CHARACTERISTIC
/begin CHARACTERISTIC DWC_EFLASHB.DWC_TorqueControl.DWC_PACLUTCHCANCLOSEOFFSET_ALT "" CURVE 0x8060CDCC RB_PT_PCT_SWC_DWC_RecordLayouts_RL_CurveGrouped_uint16_5_uint8_5 20000.0 RB_PT_PCT_SWC_DWC_CompuMethods_ident 0.0 20000. FORMAT "%10.5"
 /begin ANNOTATION ANNOTATION_LABEL "Description (coming from AUTOSAR DESC field)" /begin ANNOTATION_TEXT "Offset from clutch can close for statemachine input\r\n" /end ANNOTATION_TEXT /end ANNOTATION
 /begin AXIS_DESCR COM_AXIS NO_INPUT_QUANTITY RB_PT_PCT_SWC_DWC_CompuMethods_ratio_0p4 5 0.0 102. FORMAT "%10.5" AXIS_PTS_REF DWC_EFLASHB.DWC_TorqueControl.DWC_PATPS5 DEPOSIT ABSOLUTE /end AXIS_DESCR
/end CHARACTERISTIC
/begin CHARACTERISTIC DWC_EFLASHB.DWC_TorqueControl.DWC_PACLUTCHCANCLOSEOFFSET_ZERO "" CURVE 0x8060CDD6 RB_PT_PCT_SWC_DWC_RecordLayouts_RL_CurveGrouped_uint16_5_uint8_5 20000.0 RB_PT_PCT_SWC_DWC_CompuMethods_ident 0.0 20000. FORMAT "%10.5"
 /begin ANNOTATION ANNOTATION_LABEL "Description (coming from AUTOSAR DESC field)" /begin ANNOTATION_TEXT "Offset from clutch can close for statemachine input\r\n" /end ANNOTATION_TEXT /end ANNOTATION
 /begin AXIS_DESCR COM_AXIS NO_INPUT_QUANTITY RB_PT_PCT_SWC_DWC_CompuMethods_ratio_0p4 5 0.0 102. FORMAT "%10.5" AXIS_PTS_REF DWC_EFLASHB.DWC_TorqueControl.DWC_PATPS5 DEPOSIT ABSOLUTE /end AXIS_DESCR
/end CHARACTERISTIC
/begin CHARACTERISTIC DWC_EFLASHB.DWC_TorqueControl.DWC_PACONTROLLERTORQUEFILTERSWITCH "" VALUE 0x8060B3CE DefaultValueRecordLayout_AUTOSAR_Platform_BaseTypes_uint16 2000.0 RB_PT_PCT_SWC_DWC_CompuMethods_ratio_0p1 0.0 2000. FORMAT "%10.5"
 /begin ANNOTATION ANNOTATION_LABEL "Description (coming from AUTOSAR DESC field)"
  /begin ANNOTATION_TEXT "Controller torque for switch of falling speed filters\r\n" /end ANNOTATION_TEXT
 /end ANNOTATION
/end CHARACTERISTIC
/begin CHARACTERISTIC DWC_EFLASHB.DWC_TorqueControl.DWC_PAENABLEHOLDRESETNOTPA "" VALUE 0x8060B4AF DefaultValueRecordLayout_AUTOSAR_Platform_BaseTypes_boolean 255.0 AUTOSAR_Platform_CompuMethods_boolean 0.0 255. FORMAT "%10.5"
 /begin ANNOTATION ANNOTATION_LABEL "Description (coming from AUTOSAR DESC field)"
  /begin ANNOTATION_TEXT "Flag to hold target speed in reset during !PA conditions\r\n" /end ANNOTATION_TEXT
 /end ANNOTATION
/end CHARACTERISTIC
/begin CHARACTERISTIC DWC_EFLASHB.DWC_TorqueControl.DWC_PAENABLENMAXTQINPREPARE "" VALUE 0x8060B4B0 DefaultValueRecordLayout_AUTOSAR_Platform_BaseTypes_boolean 255.0 AUTOSAR_Platform_CompuMethods_boolean 0.0 255. FORMAT "%10.5"
 /begin ANNOTATION ANNOTATION_LABEL "Description (coming from AUTOSAR DESC field)"
  /begin ANNOTATION_TEXT "Flag to enable torque maximum in prepare phase (DWC_PAMinTorque)\r\n" /end ANNOTATION_TEXT
 /end ANNOTATION
/end CHARACTERISTIC
/begin CHARACTERISTIC DWC_EFLASHB.DWC_TorqueControl.DWC_PAENABLEOFFGOINGDOWNGRADIENT "" VALUE 0x8060B4B1 DefaultValueRecordLayout_AUTOSAR_Platform_BaseTypes_boolean 255.0 AUTOSAR_Platform_CompuMethods_boolean 0.0 255. FORMAT "%10.5"
 /begin ANNOTATION ANNOTATION_LABEL "Description (coming from AUTOSAR DESC field)"
  /begin ANNOTATION_TEXT "Flag to enable offgoing down gradient max with pullaway gradient\r\n" /end ANNOTATION_TEXT
 /end ANNOTATION
/end CHARACTERISTIC
/begin CHARACTERISTIC DWC_EFLASHB.DWC_TorqueControl.DWC_PAENABLETARGETSLOPEMAX "" VALUE 0x8060B4B2 DefaultValueRecordLayout_AUTOSAR_Platform_BaseTypes_boolean 255.0 AUTOSAR_Platform_CompuMethods_boolean 0.0 255. FORMAT "%10.5"
 /begin ANNOTATION ANNOTATION_LABEL "Description (coming from AUTOSAR DESC field)"
  /begin ANNOTATION_TEXT "Flag to enable target slope max calculation on target speed calculation\r\n" /end ANNOTATION_TEXT
 /end ANNOTATION
/end CHARACTERISTIC
/begin CHARACTERISTIC DWC_EFLASHB.DWC_TorqueControl.DWC_PAENABLETARGETSLOPEMAXOFFGOINGDOWN "" VALUE 0x8060B4B3 DefaultValueRecordLayout_AUTOSAR_Platform_BaseTypes_boolean 255.0 AUTOSAR_Platform_CompuMethods_boolean 0.0 255. FORMAT "%10.5"
 /begin ANNOTATION ANNOTATION_LABEL "Description (coming from AUTOSAR DESC field)"
  /begin ANNOTATION_TEXT "Flag to enable target slope max calculation on target speed calculation - during power on down shift (offgoing down)\r\n" /end ANNOTATION_TEXT
 /end ANNOTATION
/end CHARACTERISTIC
/begin CHARACTERISTIC DWC_EFLASHB.DWC_TorqueControl.DWC_PAFEEDFORWARDHOLDTIME "" VALUE 0x8060B3D0 DefaultValueRecordLayout_AUTOSAR_Platform_BaseTypes_uint16 10.0 RB_PT_PCT_SWC_DWC_CompuMethods_ratio_0p001__2 0.0 10. FORMAT "%10.5"
 /begin ANNOTATION ANNOTATION_LABEL "Description (coming from AUTOSAR DESC field)"
  /begin ANNOTATION_TEXT "Time to hold feedforward at pullaway before changing to slip control\r\n" /end ANNOTATION_TEXT
 /end ANNOTATION
/end CHARACTERISTIC
/begin CHARACTERISTIC DWC_EFLASHB.DWC_TorqueControl.DWC_PAFILLFINISH "" VALUE 0x8060B4B4 DefaultValueRecordLayout_AUTOSAR_Platform_BaseTypes_boolean 255.0 AUTOSAR_Platform_CompuMethods_boolean 0.0 255. FORMAT "%10.5"
 /begin ANNOTATION ANNOTATION_LABEL "Description (coming from AUTOSAR DESC field)"
  /begin ANNOTATION_TEXT "Flag to set flag condition for fill finished variable\r\n" /end ANNOTATION_TEXT
 /end ANNOTATION
/end CHARACTERISTIC
/begin CHARACTERISTIC DWC_EFLASHB.DWC_TorqueControl.DWC_PAFILTEREDSLIPSTATEMACHINE "" VALUE 0x8060B4B5 DefaultValueRecordLayout_AUTOSAR_Platform_BaseTypes_boolean 255.0 AUTOSAR_Platform_CompuMethods_boolean 0.0 255. FORMAT "%10.5"
 /begin ANNOTATION ANNOTATION_LABEL "Description (coming from AUTOSAR DESC field)"
  /begin ANNOTATION_TEXT "Flag to use filtered slip for the pullaway state machine\r\n" /end ANNOTATION_TEXT
 /end ANNOTATION
/end CHARACTERISTIC
/begin CHARACTERISTIC DWC_EFLASHB.DWC_TorqueControl.DWC_PAFINALOFFSET "" CURVE 0x8060CDE0 RB_PT_PCT_SWC_DWC_RecordLayouts_RL_CurveGrouped_uint16_5_uint8_5 20000.0 RB_PT_PCT_SWC_DWC_CompuMethods_ident 0.0 20000. FORMAT "%10.5"
 /begin ANNOTATION ANNOTATION_LABEL "Description (coming from AUTOSAR DESC field)" /begin ANNOTATION_TEXT "Offset from PATargetSpeedRaw to PAFinalTargetSpeed\r\n" /end ANNOTATION_TEXT /end ANNOTATION
 /begin AXIS_DESCR COM_AXIS NO_INPUT_QUANTITY RB_PT_PCT_SWC_DWC_CompuMethods_ratio_0p4 5 0.0 102. FORMAT "%10.5" AXIS_PTS_REF DWC_EFLASHB.DWC_TorqueControl.DWC_PATPS5 DEPOSIT ABSOLUTE /end AXIS_DESCR
/end CHARACTERISTIC
/begin CHARACTERISTIC DWC_EFLASHB.DWC_TorqueControl.DWC_PAFINALOFFSET_ALT "" CURVE 0x8060CDEA RB_PT_PCT_SWC_DWC_RecordLayouts_RL_CurveGrouped_uint16_5_uint8_5 20000.0 RB_PT_PCT_SWC_DWC_CompuMethods_ident 0.0 20000. FORMAT "%10.5"
 /begin ANNOTATION ANNOTATION_LABEL "Description (coming from AUTOSAR DESC field)" /begin ANNOTATION_TEXT "Offset from PATargetSpeedRaw to PAFinalTargetSpeed\r\n" /end ANNOTATION_TEXT /end ANNOTATION
 /begin AXIS_DESCR COM_AXIS NO_INPUT_QUANTITY RB_PT_PCT_SWC_DWC_CompuMethods_ratio_0p4 5 0.0 102. FORMAT "%10.5" AXIS_PTS_REF DWC_EFLASHB.DWC_TorqueControl.DWC_PATPS5 DEPOSIT ABSOLUTE /end AXIS_DESCR
/end CHARACTERISTIC
/begin CHARACTERISTIC DWC_EFLASHB.DWC_TorqueControl.DWC_PAFINALOFFSET_ZERO "" CURVE 0x8060CDF4 RB_PT_PCT_SWC_DWC_RecordLayouts_RL_CurveGrouped_uint16_5_uint8_5 20000.0 RB_PT_PCT_SWC_DWC_CompuMethods_ident 0.0 20000. FORMAT "%10.5"
 /begin ANNOTATION ANNOTATION_LABEL "Description (coming from AUTOSAR DESC field)" /begin ANNOTATION_TEXT "Offset from PATargetSpeedRaw to PAFinalTargetSpeed\r\n" /end ANNOTATION_TEXT /end ANNOTATION
 /begin AXIS_DESCR COM_AXIS NO_INPUT_QUANTITY RB_PT_PCT_SWC_DWC_CompuMethods_ratio_0p4 5 0.0 102. FORMAT "%10.5" AXIS_PTS_REF DWC_EFLASHB.DWC_TorqueControl.DWC_PATPS5 DEPOSIT ABSOLUTE /end AXIS_DESCR
/end CHARACTERISTIC
/begin CHARACTERISTIC DWC_EFLASHB.DWC_TorqueControl.DWC_PAFINALTARGETCANCLOSEOFFSET "" VALUE 0x8060B3D2 DefaultValueRecordLayout_AUTOSAR_Platform_BaseTypes_uint16 20000.0 RB_PT_PCT_SWC_DWC_CompuMethods_ident 0.0 20000. FORMAT "%10.5"
 /begin ANNOTATION ANNOTATION_LABEL "Description (coming from AUTOSAR DESC field)"
  /begin ANNOTATION_TEXT "Offset from clutch can close offset which becomes the minimum value of PAFinalTargetSpeedLimited\r\n" /end ANNOTATION_TEXT
 /end ANNOTATION
/end CHARACTERISTIC
/begin CHARACTERISTIC DWC_EFLASHB.DWC_TorqueControl.DWC_PAFINALTARGETSPD "" MAP 0x8060CDFE RB_PT_PCT_SWC_DWC_RecordLayouts_RL_Map_uint16_33_uint8_11_uint8_3 20000.0 RB_PT_PCT_SWC_DWC_CompuMethods_ident 0.0 20000. FORMAT "%10.5"
 /begin ANNOTATION ANNOTATION_LABEL "Description (coming from AUTOSAR DESC field)" /begin ANNOTATION_TEXT "Final target speed for pullaway\r\n" /end ANNOTATION_TEXT /end ANNOTATION
 /begin AXIS_DESCR STD_AXIS NO_INPUT_QUANTITY RB_PT_PCT_SWC_DWC_CompuMethods_ratio_0p4 11 0.0 102. FORMAT "%10.5" DEPOSIT ABSOLUTE /end AXIS_DESCR
 /begin AXIS_DESCR STD_AXIS NO_INPUT_QUANTITY RB_PT_PCT_SWC_DWC_CompuMethods_ident 3 0.0 13. FORMAT "%10.5" DEPOSIT ABSOLUTE /end AXIS_DESCR
/end CHARACTERISTIC
/begin CHARACTERISTIC DWC_EFLASHB.DWC_TorqueControl.DWC_PAFINALTARGETSPD_ALT "" MAP 0x8060CEAC RB_PT_PCT_SWC_DWC_RecordLayouts_RL_Map_uint16_33_uint8_11_uint8_3 20000.0 RB_PT_PCT_SWC_DWC_CompuMethods_ident 0.0 20000. FORMAT "%10.5"
 /begin ANNOTATION ANNOTATION_LABEL "Description (coming from AUTOSAR DESC field)" /begin ANNOTATION_TEXT "Final target speed for pullaway\r\n" /end ANNOTATION_TEXT /end ANNOTATION
 /begin AXIS_DESCR STD_AXIS NO_INPUT_QUANTITY RB_PT_PCT_SWC_DWC_CompuMethods_ratio_0p4 11 0.0 102. FORMAT "%10.5" DEPOSIT ABSOLUTE /end AXIS_DESCR
 /begin AXIS_DESCR STD_AXIS NO_INPUT_QUANTITY RB_PT_PCT_SWC_DWC_CompuMethods_ident 3 0.0 13. FORMAT "%10.5" DEPOSIT ABSOLUTE /end AXIS_DESCR
/end CHARACTERISTIC
/begin CHARACTERISTIC DWC_EFLASHB.DWC_TorqueControl.DWC_PAFINALTARGETSPD_ZERO "" MAP 0x8060CF00 RB_PT_PCT_SWC_DWC_RecordLayouts_RL_Map_uint16_33_uint8_11_uint8_3 20000.0 RB_PT_PCT_SWC_DWC_CompuMethods_ident 0.0 20000. FORMAT "%10.5"
 /begin ANNOTATION ANNOTATION_LABEL "Description (coming from AUTOSAR DESC field)" /begin ANNOTATION_TEXT "Final target speed for pullaway\r\n" /end ANNOTATION_TEXT /end ANNOTATION
 /begin AXIS_DESCR STD_AXIS NO_INPUT_QUANTITY RB_PT_PCT_SWC_DWC_CompuMethods_ratio_0p4 11 0.0 102. FORMAT "%10.5" DEPOSIT ABSOLUTE /end AXIS_DESCR
 /begin AXIS_DESCR STD_AXIS NO_INPUT_QUANTITY RB_PT_PCT_SWC_DWC_CompuMethods_ident 3 0.0 13. FORMAT "%10.5" DEPOSIT ABSOLUTE /end AXIS_DESCR
/end CHARACTERISTIC
/begin CHARACTERISTIC DWC_EFLASHB.DWC_TorqueControl.DWC_PAFINALTARGETSPDESPFAULT "" VALUE 0x8060B3D4 DefaultValueRecordLayout_AUTOSAR_Platform_BaseTypes_uint16 20000.0 RB_PT_PCT_SWC_DWC_CompuMethods_ident 0.0 20000. FORMAT "%10.5"
 /begin ANNOTATION ANNOTATION_LABEL "Description (coming from AUTOSAR DESC field)"
  /begin ANNOTATION_TEXT "Final target pullaway speed when the ESP system is in a fault condition\r\n" /end ANNOTATION_TEXT
 /end ANNOTATION
/end CHARACTERISTIC
/begin CHARACTERISTIC DWC_EFLASHB.DWC_TorqueControl.DWC_PAFINALTARGETSPDESPLIMIT "" CURVE 0x8060CE52 RB_PT_PCT_SWC_DWC_RecordLayouts_RL_Curve_uint16_7_sint16_7 20000.0 RB_PT_PCT_SWC_DWC_CompuMethods_ident 0.0 20000. FORMAT "%10.5"
 /begin ANNOTATION ANNOTATION_LABEL "Description (coming from AUTOSAR DESC field)" /begin ANNOTATION_TEXT "Final target speed based on ESP limitation\r\n" /end ANNOTATION_TEXT /end ANNOTATION
 /begin AXIS_DESCR STD_AXIS NO_INPUT_QUANTITY RB_PT_PCT_SWC_DWC_CompuMethods_ratio_0p1 7 -2000. 2000. FORMAT "%10.5" DEPOSIT ABSOLUTE /end AXIS_DESCR
/end CHARACTERISTIC
/begin CHARACTERISTIC DWC_EFLASHB.DWC_TorqueControl.DWC_PAFINALTARGETSPDTCOOLANTLIMIT "" CURVE 0x8060CE70 RB_PT_PCT_SWC_DWC_RecordLayouts_RL_Curve_uint16_7_sint16_7 20000.0 RB_PT_PCT_SWC_DWC_CompuMethods_ident 0.0 20000. FORMAT "%10.5"
 /begin ANNOTATION ANNOTATION_LABEL "Description (coming from AUTOSAR DESC field)" /begin ANNOTATION_TEXT "Final target speed based on ESP limitation\r\n" /end ANNOTATION_TEXT /end ANNOTATION
 /begin AXIS_DESCR STD_AXIS NO_INPUT_QUANTITY RB_PT_PCT_SWC_DWC_CompuMethods_ident 7 -60. 195. FORMAT "%10.5" DEPOSIT ABSOLUTE /end AXIS_DESCR
/end CHARACTERISTIC
/begin CHARACTERISTIC DWC_EFLASHB.DWC_TorqueControl.DWC_PAFINALTARGETSPDTQLIMIT "" CURVE 0x8060CE8E RB_PT_PCT_SWC_DWC_RecordLayouts_RL_Curve_uint16_7_sint16_7 20000.0 RB_PT_PCT_SWC_DWC_CompuMethods_ident 0.0 20000. FORMAT "%10.5"
 /begin ANNOTATION ANNOTATION_LABEL "Description (coming from AUTOSAR DESC field)" /begin ANNOTATION_TEXT "Final target speed based on torque limitation\r\n" /end ANNOTATION_TEXT /end ANNOTATION
 /begin AXIS_DESCR STD_AXIS NO_INPUT_QUANTITY RB_PT_PCT_SWC_DWC_CompuMethods_ratio_0p1 7 -2000. 2000. FORMAT "%10.5" DEPOSIT ABSOLUTE /end AXIS_DESCR
/end CHARACTERISTIC
/begin CHARACTERISTIC DWC_EFLASHB.DWC_TorqueControl.DWC_PAINERTIAFACTOR "" VAL_BLK 0x8060B26C DefaultValueRecordLayout_AUTOSAR_Platform_BaseTypes_uint16 1.0 RB_PT_PCT_SWC_DWC_CompuMethods_ratio_0p001__2 0.0 1. FORMAT "%10.5"
 /begin ANNOTATION ANNOTATION_LABEL "Description (coming from AUTOSAR DESC field)"
  /begin ANNOTATION_TEXT "Factor of engine torque for inertia torque compensation\r\n" /end ANNOTATION_TEXT
 /end ANNOTATION
 MATRIX_DIM 13 1 1 /end CHARACTERISTIC
/begin CHARACTERISTIC DWC_EFLASHB.DWC_TorqueControl.DWC_PAITERMUNWINDRATE "" VALUE 0x8060B35C DefaultValueRecordLayout_AUTOSAR_Platform_BaseTypes_sint32 4000.0 RB_PT_PCT_SWC_DWC_CompuMethods_ratio_0p0001 -2000. 2000. FORMAT "%10.5"
 /begin ANNOTATION ANNOTATION_LABEL "Description (coming from AUTOSAR DESC field)"
  /begin ANNOTATION_TEXT "Iterm unwind term for pullaway controller. Active when tipped out in pullaway.\r\n" /end ANNOTATION_TEXT
 /end ANNOTATION
/end CHARACTERISTIC
/begin CHARACTERISTIC DWC_EFLASHB.DWC_TorqueControl.DWC_PALAUNCHABORTFINALTARGETSPEED "" VALUE 0x8060B3D6 DefaultValueRecordLayout_AUTOSAR_Platform_BaseTypes_uint16 20000.0 RB_PT_PCT_SWC_DWC_CompuMethods_ident 0.0 20000. FORMAT "%10.5"
 /begin ANNOTATION ANNOTATION_LABEL "Description (coming from AUTOSAR DESC field)" /begin ANNOTATION_TEXT "Final target speed for launch abort\r\n" /end ANNOTATION_TEXT /end ANNOTATION
/end CHARACTERISTIC
/begin CHARACTERISTIC DWC_EFLASHB.DWC_TorqueControl.DWC_PALAUNCHDISABLEASCONTROLLER "" VALUE 0x8060B4B6 DefaultValueRecordLayout_AUTOSAR_Platform_BaseTypes_boolean 255.0 AUTOSAR_Platform_CompuMethods_boolean 0.0 255. FORMAT "%10.5"
 /begin ANNOTATION ANNOTATION_LABEL "Description (coming from AUTOSAR DESC field)" /begin ANNOTATION_TEXT "Flag to disable As controller in launch mode\r\n" /end ANNOTATION_TEXT /end ANNOTATION
/end CHARACTERISTIC
/begin CHARACTERISTIC DWC_EFLASHB.DWC_TorqueControl.DWC_PALAUNCHDISABLECLOSEDLOOP "" VALUE 0x8060B4B7 DefaultValueRecordLayout_AUTOSAR_Platform_BaseTypes_boolean 255.0 AUTOSAR_Platform_CompuMethods_boolean 0.0 255. FORMAT "%10.5"
 /begin ANNOTATION ANNOTATION_LABEL "Description (coming from AUTOSAR DESC field)"
  /begin ANNOTATION_TEXT "Flag to disable closed loop control in launch mode (disables Ac,Se and Tc controllers)\r\n" /end ANNOTATION_TEXT
 /end ANNOTATION
/end CHARACTERISTIC
/begin CHARACTERISTIC DWC_EFLASHB.DWC_TorqueControl.DWC_PALAUNCHENABLEWSCENGFFTERM "" VALUE 0x8060B4B8 DefaultValueRecordLayout_AUTOSAR_Platform_BaseTypes_boolean 255.0 AUTOSAR_Platform_CompuMethods_boolean 0.0 255. FORMAT "%10.5"
 /begin ANNOTATION ANNOTATION_LABEL "Description (coming from AUTOSAR DESC field)"
  /begin ANNOTATION_TEXT "Flag to add WSC controller terms to the engine torque feedforward in launch\r\n" /end ANNOTATION_TEXT
 /end ANNOTATION
/end CHARACTERISTIC
/begin CHARACTERISTIC DWC_EFLASHB.DWC_TorqueControl.DWC_PALAUNCHFINALOFFSET "" VALUE 0x8060B3D8 DefaultValueRecordLayout_AUTOSAR_Platform_BaseTypes_uint16 20000.0 RB_PT_PCT_SWC_DWC_CompuMethods_ident 0.0 20000. FORMAT "%10.5"
 /begin ANNOTATION ANNOTATION_LABEL "Description (coming from AUTOSAR DESC field)" /begin ANNOTATION_TEXT "Offset for pullaway speed for launch mode\r\n" /end ANNOTATION_TEXT /end ANNOTATION
/end CHARACTERISTIC
/begin CHARACTERISTIC DWC_EFLASHB.DWC_TorqueControl.DWC_PALAUNCHFINALTARGETSPD "" CURVE 0x8060CF54 RB_PT_PCT_SWC_DWC_RecordLayouts_RL_CurveGrouped_uint16_5_uint8_5 20000.0 RB_PT_PCT_SWC_DWC_CompuMethods_ident 0.0 20000. FORMAT "%10.5"
 /begin ANNOTATION ANNOTATION_LABEL "Description (coming from AUTOSAR DESC field)" /begin ANNOTATION_TEXT "Final target speed for launch mode\r\n" /end ANNOTATION_TEXT /end ANNOTATION
 /begin AXIS_DESCR COM_AXIS NO_INPUT_QUANTITY RB_PT_PCT_SWC_DWC_CompuMethods_ratio_0p4 5 0.0 102. FORMAT "%10.5" AXIS_PTS_REF DWC_EFLASHB.DWC_TorqueControl.DWC_PATPS5 DEPOSIT ABSOLUTE /end AXIS_DESCR
/end CHARACTERISTIC
/begin CHARACTERISTIC DWC_EFLASHB.DWC_TorqueControl.DWC_PALAUNCHMINTORQUEPEDAL "" CURVE 0x8060CF5E RB_PT_PCT_SWC_DWC_RecordLayouts_RL_CurveGrouped_uint16_4_uint8_4 2000.0 RB_PT_PCT_SWC_DWC_CompuMethods_ratio_0p1 0.0 2000. FORMAT "%10.5"
 /begin ANNOTATION ANNOTATION_LABEL "Description (coming from AUTOSAR DESC field)"
  /begin ANNOTATION_TEXT "Minimum clutch torque for pullaway based on throttle pedal - launch mode\r\n" /end ANNOTATION_TEXT
 /end ANNOTATION
 /begin AXIS_DESCR COM_AXIS NO_INPUT_QUANTITY RB_PT_PCT_SWC_DWC_CompuMethods_ratio_0p4 4 0.0 102. FORMAT "%10.5" AXIS_PTS_REF DWC_EFLASHB.DWC_TorqueControl.DWC_PATPS4 DEPOSIT ABSOLUTE /end AXIS_DESCR
/end CHARACTERISTIC
/begin CHARACTERISTIC DWC_EFLASHB.DWC_TorqueControl.DWC_PALAUNCHSLOPE "" VALUE 0x8060B3DA DefaultValueRecordLayout_AUTOSAR_Platform_BaseTypes_sint16 64000.0 RB_PT_PCT_SWC_DWC_CompuMethods_ident -32000. 32000. FORMAT "%10.5"
 /begin ANNOTATION ANNOTATION_LABEL "Description (coming from AUTOSAR DESC field)" /begin ANNOTATION_TEXT "RPM slope for launch mode\r\n" /end ANNOTATION_TEXT /end ANNOTATION
/end CHARACTERISTIC
/begin CHARACTERISTIC DWC_EFLASHB.DWC_TorqueControl.DWC_PALAUNCHSLOPEPREPARE "" VALUE 0x8060B3DC DefaultValueRecordLayout_AUTOSAR_Platform_BaseTypes_sint16 64000.0 RB_PT_PCT_SWC_DWC_CompuMethods_ident -32000. 32000. FORMAT "%10.5"
 /begin ANNOTATION ANNOTATION_LABEL "Description (coming from AUTOSAR DESC field)" /begin ANNOTATION_TEXT "RPM slope for launch mode - prepare phase\r\n" /end ANNOTATION_TEXT /end ANNOTATION
/end CHARACTERISTIC
/begin CHARACTERISTIC DWC_EFLASHB.DWC_TorqueControl.DWC_PALAUNCHTQINIT "" VALUE 0x8060B3DE DefaultValueRecordLayout_AUTOSAR_Platform_BaseTypes_uint16 2000.0 RB_PT_PCT_SWC_DWC_CompuMethods_ratio_0p1 0.0 2000. FORMAT "%10.5"
 /begin ANNOTATION ANNOTATION_LABEL "Description (coming from AUTOSAR DESC field)" /begin ANNOTATION_TEXT "Launch initialisation torque\r\n" /end ANNOTATION_TEXT /end ANNOTATION
/end CHARACTERISTIC
/begin CHARACTERISTIC DWC_EFLASHB.DWC_TorqueControl.DWC_PALAUNCHTQSLOPE1 "" VALUE 0x8060B3E0 DefaultValueRecordLayout_AUTOSAR_Platform_BaseTypes_sint16 64000.0 RB_PT_PCT_SWC_DWC_CompuMethods_ident -32000. 32000. FORMAT "%10.5"
 /begin ANNOTATION ANNOTATION_LABEL "Description (coming from AUTOSAR DESC field)" /begin ANNOTATION_TEXT "Slope of clutch torque for launch control mode\r\n" /end ANNOTATION_TEXT /end ANNOTATION
/end CHARACTERISTIC
/begin CHARACTERISTIC DWC_EFLASHB.DWC_TorqueControl.DWC_PALAUNCHTQSLOPE2 "" VALUE 0x8060B3E2 DefaultValueRecordLayout_AUTOSAR_Platform_BaseTypes_sint16 64000.0 RB_PT_PCT_SWC_DWC_CompuMethods_ident -32000. 32000. FORMAT "%10.5"
 /begin ANNOTATION ANNOTATION_LABEL "Description (coming from AUTOSAR DESC field)" /begin ANNOTATION_TEXT "Slope of clutch torque for launch control mode\r\n" /end ANNOTATION_TEXT /end ANNOTATION
/end CHARACTERISTIC
/begin CHARACTERISTIC DWC_EFLASHB.DWC_TorqueControl.DWC_PALAUNCHTQSLOPE3 "" VALUE 0x8060B3E4 DefaultValueRecordLayout_AUTOSAR_Platform_BaseTypes_sint16 64000.0 RB_PT_PCT_SWC_DWC_CompuMethods_ident -32000. 32000. FORMAT "%10.5"
 /begin ANNOTATION ANNOTATION_LABEL "Description (coming from AUTOSAR DESC field)" /begin ANNOTATION_TEXT "Slope of clutch torque for launch control mode\r\n" /end ANNOTATION_TEXT /end ANNOTATION
/end CHARACTERISTIC
/begin CHARACTERISTIC DWC_EFLASHB.DWC_TorqueControl.DWC_PALAUNCHTQSLOPESWITCHPOINT "" VALUE 0x8060B4B9 DefaultValueRecordLayout_AUTOSAR_Platform_BaseTypes_uint8 1.0 RB_PT_PCT_SWC_DWC_CompuMethods_ratio_0p01 0.0 1. FORMAT "%10.5"
 /begin ANNOTATION ANNOTATION_LABEL "Description (coming from AUTOSAR DESC field)" /begin ANNOTATION_TEXT "Launch slope switch point factor\r\n" /end ANNOTATION_TEXT /end ANNOTATION
/end CHARACTERISTIC
/begin CHARACTERISTIC DWC_EFLASHB.DWC_TorqueControl.DWC_PALIMITITERMPULLAWAY "" VALUE 0x8060B4BA DefaultValueRecordLayout_AUTOSAR_Platform_BaseTypes_boolean 255.0 AUTOSAR_Platform_CompuMethods_boolean 0.0 255. FORMAT "%10.5"
 /begin ANNOTATION ANNOTATION_LABEL "Description (coming from AUTOSAR DESC field)" /begin ANNOTATION_TEXT "Flag to limit the I term during pullaway\r\n" /end ANNOTATION_TEXT /end ANNOTATION
/end CHARACTERISTIC
/begin CHARACTERISTIC DWC_EFLASHB.DWC_TorqueControl.DWC_PAMAXINSTOFFSET "" VALUE 0x8060B3E6 DefaultValueRecordLayout_AUTOSAR_Platform_BaseTypes_uint16 2000.0 RB_PT_PCT_SWC_DWC_CompuMethods_ratio_0p1 0.0 2000. FORMAT "%10.5"
 /begin ANNOTATION ANNOTATION_LABEL "Description (coming from AUTOSAR DESC field)" /begin ANNOTATION_TEXT "Instant torque offset\r\n" /end ANNOTATION_TEXT /end ANNOTATION
/end CHARACTERISTIC
/begin CHARACTERISTIC DWC_EFLASHB.DWC_TorqueControl.DWC_PAMAXINSTPEDOFFSET "" CURVE 0x8060CF66 RB_PT_PCT_SWC_DWC_RecordLayouts_RL_CurveGrouped_uint16_4_uint8_4 2000.0 RB_PT_PCT_SWC_DWC_CompuMethods_ratio_0p1 0.0 2000. FORMAT "%10.5"
 /begin ANNOTATION ANNOTATION_LABEL "Description (coming from AUTOSAR DESC field)" /begin ANNOTATION_TEXT "Offset from powertrain max fast for torque limit\r\n" /end ANNOTATION_TEXT /end ANNOTATION
 /begin AXIS_DESCR COM_AXIS NO_INPUT_QUANTITY RB_PT_PCT_SWC_DWC_CompuMethods_ratio_0p4 4 0.0 102. FORMAT "%10.5" AXIS_PTS_REF DWC_EFLASHB.DWC_TorqueControl.DWC_PATPS4 DEPOSIT ABSOLUTE /end AXIS_DESCR
/end CHARACTERISTIC
/begin CHARACTERISTIC DWC_EFLASHB.DWC_TorqueControl.DWC_PAMAXINSTRATEDOWN "" VALUE 0x8060B3E8 DefaultValueRecordLayout_AUTOSAR_Platform_BaseTypes_sint16 64000.0 RB_PT_PCT_SWC_DWC_CompuMethods_ident -32000. 32000. FORMAT "%10.5"
 /begin ANNOTATION ANNOTATION_LABEL "Description (coming from AUTOSAR DESC field)" /begin ANNOTATION_TEXT "Maximum rate of change of torque limit - falling\r\n" /end ANNOTATION_TEXT /end ANNOTATION
/end CHARACTERISTIC
/begin CHARACTERISTIC DWC_EFLASHB.DWC_TorqueControl.DWC_PAMAXINSTRATEUP "" VALUE 0x8060B3EA DefaultValueRecordLayout_AUTOSAR_Platform_BaseTypes_sint16 64000.0 RB_PT_PCT_SWC_DWC_CompuMethods_ident -32000. 32000. FORMAT "%10.5"
 /begin ANNOTATION ANNOTATION_LABEL "Description (coming from AUTOSAR DESC field)" /begin ANNOTATION_TEXT "Maximum rate of change of torque limit - rising\r\n" /end ANNOTATION_TEXT /end ANNOTATION
/end CHARACTERISTIC
/begin CHARACTERISTIC DWC_EFLASHB.DWC_TorqueControl.DWC_PAMINTORQUEINVERTEDPA "" CURVE 0x8060CF6E RB_PT_PCT_SWC_DWC_RecordLayouts_RL_CurveGrouped_uint16_4_uint8_4 2000.0 RB_PT_PCT_SWC_DWC_CompuMethods_ratio_0p1 0.0 2000. FORMAT "%10.5"
 /begin ANNOTATION ANNOTATION_LABEL "Description (coming from AUTOSAR DESC field)"
  /begin ANNOTATION_TEXT "Minimum clutch torque for inverted pullaway based on throttle pedal\r\n" /end ANNOTATION_TEXT
 /end ANNOTATION
 /begin AXIS_DESCR COM_AXIS NO_INPUT_QUANTITY RB_PT_PCT_SWC_DWC_CompuMethods_ratio_0p4 4 0.0 102. FORMAT "%10.5" AXIS_PTS_REF DWC_EFLASHB.DWC_TorqueControl.DWC_PATPS4 DEPOSIT ABSOLUTE /end AXIS_DESCR
/end CHARACTERISTIC
/begin CHARACTERISTIC DWC_EFLASHB.DWC_TorqueControl.DWC_PAMINTORQUEINVERTEDPA_ALT "" CURVE 0x8060CF76 RB_PT_PCT_SWC_DWC_RecordLayouts_RL_CurveGrouped_uint16_4_uint8_4 2000.0 RB_PT_PCT_SWC_DWC_CompuMethods_ratio_0p1 0.0 2000. FORMAT "%10.5"
 /begin ANNOTATION ANNOTATION_LABEL "Description (coming from AUTOSAR DESC field)"
  /begin ANNOTATION_TEXT "Minimum clutch torque for inverted pullaway based on throttle pedal\r\n" /end ANNOTATION_TEXT
 /end ANNOTATION
 /begin AXIS_DESCR COM_AXIS NO_INPUT_QUANTITY RB_PT_PCT_SWC_DWC_CompuMethods_ratio_0p4 4 0.0 102. FORMAT "%10.5" AXIS_PTS_REF DWC_EFLASHB.DWC_TorqueControl.DWC_PATPS4 DEPOSIT ABSOLUTE /end AXIS_DESCR
/end CHARACTERISTIC
/begin CHARACTERISTIC DWC_EFLASHB.DWC_TorqueControl.DWC_PAMINTORQUEINVERTEDPA_ZERO "" CURVE 0x8060CF7E RB_PT_PCT_SWC_DWC_RecordLayouts_RL_CurveGrouped_uint16_4_uint8_4 2000.0 RB_PT_PCT_SWC_DWC_CompuMethods_ratio_0p1 0.0 2000. FORMAT "%10.5"
 /begin ANNOTATION ANNOTATION_LABEL "Description (coming from AUTOSAR DESC field)"
  /begin ANNOTATION_TEXT "Minimum clutch torque for inverted pullaway based on throttle pedal\r\n" /end ANNOTATION_TEXT
 /end ANNOTATION
 /begin AXIS_DESCR COM_AXIS NO_INPUT_QUANTITY RB_PT_PCT_SWC_DWC_CompuMethods_ratio_0p4 4 0.0 102. FORMAT "%10.5" AXIS_PTS_REF DWC_EFLASHB.DWC_TorqueControl.DWC_PATPS4 DEPOSIT ABSOLUTE /end AXIS_DESCR
/end CHARACTERISTIC
/begin CHARACTERISTIC DWC_EFLASHB.DWC_TorqueControl.DWC_PAMINTORQUEPEDAL "" CURVE 0x8060CF86 RB_PT_PCT_SWC_DWC_RecordLayouts_RL_CurveGrouped_uint16_4_uint8_4 2000.0 RB_PT_PCT_SWC_DWC_CompuMethods_ratio_0p1 0.0 2000. FORMAT "%10.5"
 /begin ANNOTATION ANNOTATION_LABEL "Description (coming from AUTOSAR DESC field)"
  /begin ANNOTATION_TEXT "Minimum clutch torque for pullaway based on throttle pedal\r\n" /end ANNOTATION_TEXT
 /end ANNOTATION
 /begin AXIS_DESCR COM_AXIS NO_INPUT_QUANTITY RB_PT_PCT_SWC_DWC_CompuMethods_ratio_0p4 4 0.0 102. FORMAT "%10.5" AXIS_PTS_REF DWC_EFLASHB.DWC_TorqueControl.DWC_PATPS4 DEPOSIT ABSOLUTE /end AXIS_DESCR
/end CHARACTERISTIC
/begin CHARACTERISTIC DWC_EFLASHB.DWC_TorqueControl.DWC_PAMINTORQUEPEDAL_ALT "" CURVE 0x8060CF8E RB_PT_PCT_SWC_DWC_RecordLayouts_RL_CurveGrouped_uint16_4_uint8_4 2000.0 RB_PT_PCT_SWC_DWC_CompuMethods_ratio_0p1 0.0 2000. FORMAT "%10.5"
 /begin ANNOTATION ANNOTATION_LABEL "Description (coming from AUTOSAR DESC field)"
  /begin ANNOTATION_TEXT "Minimum clutch torque for pullaway based on throttle pedal\r\n" /end ANNOTATION_TEXT
 /end ANNOTATION
 /begin AXIS_DESCR COM_AXIS NO_INPUT_QUANTITY RB_PT_PCT_SWC_DWC_CompuMethods_ratio_0p4 4 0.0 102. FORMAT "%10.5" AXIS_PTS_REF DWC_EFLASHB.DWC_TorqueControl.DWC_PATPS4 DEPOSIT ABSOLUTE /end AXIS_DESCR
/end CHARACTERISTIC
/begin CHARACTERISTIC DWC_EFLASHB.DWC_TorqueControl.DWC_PAMINTORQUEPEDAL_ZERO "" CURVE 0x8060CF96 RB_PT_PCT_SWC_DWC_RecordLayouts_RL_CurveGrouped_uint16_4_uint8_4 2000.0 RB_PT_PCT_SWC_DWC_CompuMethods_ratio_0p1 0.0 2000. FORMAT "%10.5"
 /begin ANNOTATION ANNOTATION_LABEL "Description (coming from AUTOSAR DESC field)"
  /begin ANNOTATION_TEXT "Minimum clutch torque for pullaway based on throttle pedal\r\n" /end ANNOTATION_TEXT
 /end ANNOTATION
 /begin AXIS_DESCR COM_AXIS NO_INPUT_QUANTITY RB_PT_PCT_SWC_DWC_CompuMethods_ratio_0p4 4 0.0 102. FORMAT "%10.5" AXIS_PTS_REF DWC_EFLASHB.DWC_TorqueControl.DWC_PATPS4 DEPOSIT ABSOLUTE /end AXIS_DESCR
/end CHARACTERISTIC
/begin CHARACTERISTIC DWC_EFLASHB.DWC_TorqueControl.DWC_PAMUSTOPENDECELOFFSET "" CURVE 0x8060CF9E RB_PT_PCT_SWC_DWC_RecordLayouts_RL_Curve_uint16_5_sint16_5 20000.0 RB_PT_PCT_SWC_DWC_CompuMethods_ident 0.0 20000. FORMAT "%10.5"
 /begin ANNOTATION ANNOTATION_LABEL "Description (coming from AUTOSAR DESC field)"
  /begin ANNOTATION_TEXT "Offset for must open based on gradient of engine speed\r\n" /end ANNOTATION_TEXT
 /end ANNOTATION
 /begin AXIS_DESCR STD_AXIS NO_INPUT_QUANTITY RB_PT_PCT_SWC_DWC_CompuMethods_ident 5 -32000. 32000. FORMAT "%10.5" DEPOSIT ABSOLUTE /end AXIS_DESCR
/end CHARACTERISTIC
/begin CHARACTERISTIC DWC_EFLASHB.DWC_TorqueControl.DWC_PAMUSTOPENOFFSET "" VAL_BLK 0x8060B2B8 DefaultValueRecordLayout_AUTOSAR_Platform_BaseTypes_uint16 20000.0 RB_PT_PCT_SWC_DWC_CompuMethods_ident 0.0 20000. FORMAT "%10.5"
 /begin ANNOTATION ANNOTATION_LABEL "Description (coming from AUTOSAR DESC field)" /begin ANNOTATION_TEXT "Offset to idle speed for clutch must open\r\n" /end ANNOTATION_TEXT /end ANNOTATION
 MATRIX_DIM 12 1 1 /end CHARACTERISTIC
/begin CHARACTERISTIC DWC_EFLASHB.DWC_TorqueControl.DWC_PAMUSTOPENOFFSETECO "" VAL_BLK 0x8060B2D0 DefaultValueRecordLayout_AUTOSAR_Platform_BaseTypes_uint16 20000.0 RB_PT_PCT_SWC_DWC_CompuMethods_ident 0.0 20000. FORMAT "%10.5"
 /begin ANNOTATION ANNOTATION_LABEL "Description (coming from AUTOSAR DESC field)" /begin ANNOTATION_TEXT "Offset to idle speed for clutch must open - eco mode\r\n" /end ANNOTATION_TEXT /end ANNOTATION
 MATRIX_DIM 12 1 1 /end CHARACTERISTIC
/begin CHARACTERISTIC DWC_EFLASHB.DWC_TorqueControl.DWC_PAPOWERTRAINRESYNCGRADIENTOFFSET "" CURVE 0x8060CFB4 RB_PT_PCT_SWC_DWC_RecordLayouts_RL_CurveGrouped_sint16_5_uint8_5 64000.0 RB_PT_PCT_SWC_DWC_CompuMethods_ident -32000. 32000. FORMAT "%10.5"
 /begin ANNOTATION ANNOTATION_LABEL "Description (coming from AUTOSAR DESC field)"
  /begin ANNOTATION_TEXT "Gradient compensation on powertrain gradient for pullaway\r\n" /end ANNOTATION_TEXT
 /end ANNOTATION
 /begin AXIS_DESCR COM_AXIS NO_INPUT_QUANTITY RB_PT_PCT_SWC_DWC_CompuMethods_ratio_0p4 5 0.0 102. FORMAT "%10.5" AXIS_PTS_REF DWC_EFLASHB.DWC_TorqueControl.DWC_PATPS5 DEPOSIT ABSOLUTE /end AXIS_DESCR
/end CHARACTERISTIC
/begin CHARACTERISTIC DWC_EFLASHB.DWC_TorqueControl.DWC_PAPOWERTRAINRESYNCGRADIENTOFFSET_ALT "" CURVE 0x8060CFBE RB_PT_PCT_SWC_DWC_RecordLayouts_RL_CurveGrouped_sint16_5_uint8_5 64000.0 RB_PT_PCT_SWC_DWC_CompuMethods_ident -32000. 32000. FORMAT "%10.5"
 /begin ANNOTATION ANNOTATION_LABEL "Description (coming from AUTOSAR DESC field)"
  /begin ANNOTATION_TEXT "Gradient compensation on powertrain gradient for pullaway\r\n" /end ANNOTATION_TEXT
 /end ANNOTATION
 /begin AXIS_DESCR COM_AXIS NO_INPUT_QUANTITY RB_PT_PCT_SWC_DWC_CompuMethods_ratio_0p4 5 0.0 102. FORMAT "%10.5" AXIS_PTS_REF DWC_EFLASHB.DWC_TorqueControl.DWC_PATPS5 DEPOSIT ABSOLUTE /end AXIS_DESCR
/end CHARACTERISTIC
/begin CHARACTERISTIC DWC_EFLASHB.DWC_TorqueControl.DWC_PAPOWERTRAINRESYNCGRADIENTOFFSET_ZERO "" CURVE 0x8060CFC8 RB_PT_PCT_SWC_DWC_RecordLayouts_RL_CurveGrouped_sint16_5_uint8_5 64000.0 RB_PT_PCT_SWC_DWC_CompuMethods_ident -32000. 32000. FORMAT "%10.5"
 /begin ANNOTATION ANNOTATION_LABEL "Description (coming from AUTOSAR DESC field)"
  /begin ANNOTATION_TEXT "Gradient compensation on powertrain gradient for pullaway\r\n" /end ANNOTATION_TEXT
 /end ANNOTATION
 /begin AXIS_DESCR COM_AXIS NO_INPUT_QUANTITY RB_PT_PCT_SWC_DWC_CompuMethods_ratio_0p4 5 0.0 102. FORMAT "%10.5" AXIS_PTS_REF DWC_EFLASHB.DWC_TorqueControl.DWC_PATPS5 DEPOSIT ABSOLUTE /end AXIS_DESCR
/end CHARACTERISTIC
/begin CHARACTERISTIC DWC_EFLASHB.DWC_TorqueControl.DWC_PAPOWERTRAINRESYNCTORQUERATE "" CURVE 0x8060CFD2 RB_PT_PCT_SWC_DWC_RecordLayouts_RL_CurveGrouped_sint16_5_uint8_5 20000.0 RB_PT_PCT_SWC_DWC_CompuMethods_ident -10000. 10000. FORMAT "%10.5"
 /begin ANNOTATION ANNOTATION_LABEL "Description (coming from AUTOSAR DESC field)"
  /begin ANNOTATION_TEXT "Gradient of torque for reconnection during powertrain sync\r\n" /end ANNOTATION_TEXT
 /end ANNOTATION
 /begin AXIS_DESCR COM_AXIS NO_INPUT_QUANTITY RB_PT_PCT_SWC_DWC_CompuMethods_ratio_0p4 5 0.0 102. FORMAT "%10.5" AXIS_PTS_REF DWC_EFLASHB.DWC_TorqueControl.DWC_PATPS5 DEPOSIT ABSOLUTE /end AXIS_DESCR
/end CHARACTERISTIC
/begin CHARACTERISTIC DWC_EFLASHB.DWC_TorqueControl.DWC_PAPOWERTRAINRESYNCTORQUERATE_ALT "" CURVE 0x8060CFDC RB_PT_PCT_SWC_DWC_RecordLayouts_RL_CurveGrouped_sint16_5_uint8_5 20000.0 RB_PT_PCT_SWC_DWC_CompuMethods_ident -10000. 10000. FORMAT "%10.5"
 /begin ANNOTATION ANNOTATION_LABEL "Description (coming from AUTOSAR DESC field)"
  /begin ANNOTATION_TEXT "Gradient of torque for reconnection during powertrain sync\r\n" /end ANNOTATION_TEXT
 /end ANNOTATION
 /begin AXIS_DESCR COM_AXIS NO_INPUT_QUANTITY RB_PT_PCT_SWC_DWC_CompuMethods_ratio_0p4 5 0.0 102. FORMAT "%10.5" AXIS_PTS_REF DWC_EFLASHB.DWC_TorqueControl.DWC_PATPS5 DEPOSIT ABSOLUTE /end AXIS_DESCR
/end CHARACTERISTIC
/begin CHARACTERISTIC DWC_EFLASHB.DWC_TorqueControl.DWC_PAPOWERTRAINRESYNCTORQUERATE_ZERO "" CURVE 0x8060CFE6 RB_PT_PCT_SWC_DWC_RecordLayouts_RL_CurveGrouped_sint16_5_uint8_5 20000.0 RB_PT_PCT_SWC_DWC_CompuMethods_ident -10000. 10000. FORMAT "%10.5"
 /begin ANNOTATION ANNOTATION_LABEL "Description (coming from AUTOSAR DESC field)"
  /begin ANNOTATION_TEXT "Gradient of torque for reconnection during powertrain sync\r\n" /end ANNOTATION_TEXT
 /end ANNOTATION
 /begin AXIS_DESCR COM_AXIS NO_INPUT_QUANTITY RB_PT_PCT_SWC_DWC_CompuMethods_ratio_0p4 5 0.0 102. FORMAT "%10.5" AXIS_PTS_REF DWC_EFLASHB.DWC_TorqueControl.DWC_PATPS5 DEPOSIT ABSOLUTE /end AXIS_DESCR
/end CHARACTERISTIC
/begin CHARACTERISTIC DWC_EFLASHB.DWC_TorqueControl.DWC_PAPREPARECLUTCHSPEEDOFFSET "" VALUE 0x8060B3EC DefaultValueRecordLayout_AUTOSAR_Platform_BaseTypes_uint16 20000.0 RB_PT_PCT_SWC_DWC_CompuMethods_ident 0.0 20000. FORMAT "%10.5"
 /begin ANNOTATION ANNOTATION_LABEL "Description (coming from AUTOSAR DESC field)"
  /begin ANNOTATION_TEXT "Offset from clutch speed for prepare part of pullaway\r\n" /end ANNOTATION_TEXT
 /end ANNOTATION
/end CHARACTERISTIC
/begin CHARACTERISTIC DWC_EFLASHB.DWC_TorqueControl.DWC_PAPTSYNCOFFSET "" CURVE 0x8060CFF0 RB_PT_PCT_SWC_DWC_RecordLayouts_RL_CurveGrouped_uint16_5_uint8_5 20000.0 RB_PT_PCT_SWC_DWC_CompuMethods_ident 0.0 20000. FORMAT "%10.5"
 /begin ANNOTATION ANNOTATION_LABEL "Description (coming from AUTOSAR DESC field)"
  /begin ANNOTATION_TEXT "Offset from PAFinalTargetSpeed to target speed for powertrain sync (increase)\r\n" /end ANNOTATION_TEXT
 /end ANNOTATION
 /begin AXIS_DESCR COM_AXIS NO_INPUT_QUANTITY RB_PT_PCT_SWC_DWC_CompuMethods_ratio_0p4 5 0.0 102. FORMAT "%10.5" AXIS_PTS_REF DWC_EFLASHB.DWC_TorqueControl.DWC_PATPS5 DEPOSIT ABSOLUTE /end AXIS_DESCR
/end CHARACTERISTIC
/begin CHARACTERISTIC DWC_EFLASHB.DWC_TorqueControl.DWC_PAPTSYNCOFFSET_ALT "" CURVE 0x8060CFFA RB_PT_PCT_SWC_DWC_RecordLayouts_RL_CurveGrouped_uint16_5_uint8_5 20000.0 RB_PT_PCT_SWC_DWC_CompuMethods_ident 0.0 20000. FORMAT "%10.5"
 /begin ANNOTATION ANNOTATION_LABEL "Description (coming from AUTOSAR DESC field)"
  /begin ANNOTATION_TEXT "Offset from PAFinalTargetSpeed to target speed for powertrain sync (increase)\r\n" /end ANNOTATION_TEXT
 /end ANNOTATION
 /begin AXIS_DESCR COM_AXIS NO_INPUT_QUANTITY RB_PT_PCT_SWC_DWC_CompuMethods_ratio_0p4 5 0.0 102. FORMAT "%10.5" AXIS_PTS_REF DWC_EFLASHB.DWC_TorqueControl.DWC_PATPS5 DEPOSIT ABSOLUTE /end AXIS_DESCR
/end CHARACTERISTIC
/begin CHARACTERISTIC DWC_EFLASHB.DWC_TorqueControl.DWC_PAPTSYNCOFFSET_ZERO "" CURVE 0x8060D004 RB_PT_PCT_SWC_DWC_RecordLayouts_RL_CurveGrouped_uint16_5_uint8_5 20000.0 RB_PT_PCT_SWC_DWC_CompuMethods_ident 0.0 20000. FORMAT "%10.5"
 /begin ANNOTATION ANNOTATION_LABEL "Description (coming from AUTOSAR DESC field)"
  /begin ANNOTATION_TEXT "Offset from PAFinalTargetSpeed to target speed for powertrain sync (increase)\r\n" /end ANNOTATION_TEXT
 /end ANNOTATION
 /begin AXIS_DESCR COM_AXIS NO_INPUT_QUANTITY RB_PT_PCT_SWC_DWC_CompuMethods_ratio_0p4 5 0.0 102. FORMAT "%10.5" AXIS_PTS_REF DWC_EFLASHB.DWC_TorqueControl.DWC_PATPS5 DEPOSIT ABSOLUTE /end AXIS_DESCR
/end CHARACTERISTIC
/begin CHARACTERISTIC DWC_EFLASHB.DWC_TorqueControl.DWC_PAPullawaySequencer.DWC_PAACTUALINPUTSLIPSTATEMACHINE "" VALUE 0x8060BC06 DefaultValueRecordLayout_AUTOSAR_Platform_BaseTypes_boolean 255.0 AUTOSAR_Platform_CompuMethods_boolean 0.0 255. FORMAT "%10.5"
 /begin ANNOTATION ANNOTATION_LABEL "Description (coming from AUTOSAR DESC field)"
  /begin ANNOTATION_TEXT "Flag to use actual input slip for the pullaway state machine\r\n" /end ANNOTATION_TEXT
 /end ANNOTATION
/end CHARACTERISTIC
/begin CHARACTERISTIC DWC_EFLASHB.DWC_TorqueControl.DWC_PAPullawaySequencer.DWC_PABYPASSDRVTQABVCRP "" VALUE 0x8060BC07 DefaultValueRecordLayout_AUTOSAR_Platform_BaseTypes_boolean 255.0 AUTOSAR_Platform_CompuMethods_boolean 0.0 255. FORMAT "%10.5"
 /begin ANNOTATION ANNOTATION_LABEL "Description (coming from AUTOSAR DESC field)"
  /begin ANNOTATION_TEXT "Flag to bypass driver torque above creep torque transition rule\r\n" /end ANNOTATION_TEXT
 /end ANNOTATION
/end CHARACTERISTIC
/begin CHARACTERISTIC DWC_EFLASHB.DWC_TorqueControl.DWC_PAPullawaySequencer.DWC_PABYPASSTORQUESYNC "" VALUE 0x8060BC08 DefaultValueRecordLayout_AUTOSAR_Platform_BaseTypes_boolean 255.0 AUTOSAR_Platform_CompuMethods_boolean 0.0 255. FORMAT "%10.5"
 /begin ANNOTATION ANNOTATION_LABEL "Description (coming from AUTOSAR DESC field)" /begin ANNOTATION_TEXT "Flag to bypass torque sync request\r\n" /end ANNOTATION_TEXT /end ANNOTATION
/end CHARACTERISTIC
/begin CHARACTERISTIC DWC_EFLASHB.DWC_TorqueControl.DWC_PAPullawaySequencer.DWC_PACLOSEDLOOPTOPOWERTRAINSYNC "" VALUE 0x8060BBB8 DefaultValueRecordLayout_AUTOSAR_Platform_BaseTypes_sint16 4000.0 RB_PT_PCT_SWC_DWC_CompuMethods_ratio_0p1 -2000. 2000. FORMAT "%10.5"
 /begin ANNOTATION ANNOTATION_LABEL "Description (coming from AUTOSAR DESC field)" /begin ANNOTATION_TEXT "Close loop controller term for powertrain sync entry\r\n" /end ANNOTATION_TEXT /end ANNOTATION
/end CHARACTERISTIC
/begin CHARACTERISTIC DWC_EFLASHB.DWC_TorqueControl.DWC_PAPullawaySequencer.DWC_PACLUTCHCANCLOSEOFFSETHYST "" VALUE 0x8060BBBA DefaultValueRecordLayout_AUTOSAR_Platform_BaseTypes_uint16 20000.0 RB_PT_PCT_SWC_DWC_CompuMethods_ident 0.0 20000. FORMAT "%10.5"
 /begin ANNOTATION ANNOTATION_LABEL "Description (coming from AUTOSAR DESC field)"
  /begin ANNOTATION_TEXT "Hysteresis on clutch can close threshold for return to pullaway running from pullaway sync\r\n" /end ANNOTATION_TEXT
 /end ANNOTATION
/end CHARACTERISTIC
/begin CHARACTERISTIC DWC_EFLASHB.DWC_TorqueControl.DWC_PAPullawaySequencer.DWC_PACLUTCHSLIPTOPOWERTRAINSYNC "" CURVE 0x8060BC0E RB_PT_PCT_SWC_DWC_RecordLayouts_RL_CurveGrouped_sint16_5_uint8_5 40000.0 RB_PT_PCT_SWC_DWC_CompuMethods_ident -20000. 20000. FORMAT "%10.5"
 /begin ANNOTATION ANNOTATION_LABEL "Description (coming from AUTOSAR DESC field)" /begin ANNOTATION_TEXT "Slip before powertrain sync timer is incremented\r\n" /end ANNOTATION_TEXT /end ANNOTATION
 /begin AXIS_DESCR COM_AXIS NO_INPUT_QUANTITY RB_PT_PCT_SWC_DWC_CompuMethods_ratio_0p4 5 0.0 102. FORMAT "%10.5" AXIS_PTS_REF DWC_EFLASHB.DWC_TorqueControl.DWC_PAPullawaySequencer.DWC_PATPS5 DEPOSIT ABSOLUTE /end AXIS_DESCR
/end CHARACTERISTIC
/begin CHARACTERISTIC DWC_EFLASHB.DWC_TorqueControl.DWC_PAPullawaySequencer.DWC_PACLUTCHSLIPTOPOWERTRAINSYNCTIME "" VALUE 0x8060BBBC DefaultValueRecordLayout_AUTOSAR_Platform_BaseTypes_uint16 10.0 RB_PT_PCT_SWC_DWC_CompuMethods_ratio_0p001__2 0.0 10. FORMAT "%10.5"
 /begin ANNOTATION ANNOTATION_LABEL "Description (coming from AUTOSAR DESC field)"
  /begin ANNOTATION_TEXT "Time value for entering the powertrain sync based on slip\r\n" /end ANNOTATION_TEXT
 /end ANNOTATION
/end CHARACTERISTIC
/begin CHARACTERISTIC DWC_EFLASHB.DWC_TorqueControl.DWC_PAPullawaySequencer.DWC_PACLUTCHSLIPTOPULLAWAYSYNC "" VALUE 0x8060BBBE DefaultValueRecordLayout_AUTOSAR_Platform_BaseTypes_sint16 40000.0 RB_PT_PCT_SWC_DWC_CompuMethods_ident -20000. 20000. FORMAT "%10.5"
 /begin ANNOTATION ANNOTATION_LABEL "Description (coming from AUTOSAR DESC field)"
  /begin ANNOTATION_TEXT "Clutch slip above which the PA will transition back to Pullaway Sync from Sync Powertrain\r\n" /end ANNOTATION_TEXT
 /end ANNOTATION
/end CHARACTERISTIC
/begin CHARACTERISTIC DWC_EFLASHB.DWC_TorqueControl.DWC_PAPullawaySequencer.DWC_PACLUTCHTORQUETOPOWERTRAINSYNC "" VALUE 0x8060BBC0 DefaultValueRecordLayout_AUTOSAR_Platform_BaseTypes_uint16 2000.0 RB_PT_PCT_SWC_DWC_CompuMethods_ratio_0p1 0.0 2000. FORMAT "%10.5"
 /begin ANNOTATION ANNOTATION_LABEL "Description (coming from AUTOSAR DESC field)" /begin ANNOTATION_TEXT "Clutch torque required to step to powertrain sync\r\n" /end ANNOTATION_TEXT /end ANNOTATION
/end CHARACTERISTIC
/begin CHARACTERISTIC DWC_EFLASHB.DWC_TorqueControl.DWC_PAPullawaySequencer.DWC_PACREEPDELTASPEED "" VALUE 0x8060BBC2 DefaultValueRecordLayout_AUTOSAR_Platform_BaseTypes_sint16 40000.0 RB_PT_PCT_SWC_DWC_CompuMethods_ident -20000. 20000. FORMAT "%10.5"
 /begin ANNOTATION ANNOTATION_LABEL "Description (coming from AUTOSAR DESC field)"
  /begin ANNOTATION_TEXT "Engine speed to idle speed delta for dead pedal condition\r\n" /end ANNOTATION_TEXT
 /end ANNOTATION
/end CHARACTERISTIC
/begin CHARACTERISTIC DWC_EFLASHB.DWC_TorqueControl.DWC_PAPullawaySequencer.DWC_PACREEPDELTASPEEDTIME "" VALUE 0x8060BBC4 DefaultValueRecordLayout_AUTOSAR_Platform_BaseTypes_uint16 10.0 RB_PT_PCT_SWC_DWC_CompuMethods_ratio_0p001__2 0.0 10. FORMAT "%10.5"
 /begin ANNOTATION ANNOTATION_LABEL "Description (coming from AUTOSAR DESC field)" /begin ANNOTATION_TEXT "Engine speed to creep target speed timer\r\n" /end ANNOTATION_TEXT /end ANNOTATION
/end CHARACTERISTIC
/begin CHARACTERISTIC DWC_EFLASHB.DWC_TorqueControl.DWC_PAPullawaySequencer.DWC_PACREEPTARGETEXITCREEP "" VALUE 0x8060BBC6 DefaultValueRecordLayout_AUTOSAR_Platform_BaseTypes_sint16 40.0 RB_PT_PCT_SWC_DWC_CompuMethods_ratio_0p01 -20. 20. FORMAT "%10.5"
 /begin ANNOTATION ANNOTATION_LABEL "Description (coming from AUTOSAR DESC field)"
  /begin ANNOTATION_TEXT "Creep target speed, below which controller can exit creep state\r\n" /end ANNOTATION_TEXT
 /end ANNOTATION
/end CHARACTERISTIC
/begin CHARACTERISTIC DWC_EFLASHB.DWC_TorqueControl.DWC_PAPullawaySequencer.DWC_PADEADPEDALDELTAABOVEIDLE "" VALUE 0x8060BBC8 DefaultValueRecordLayout_AUTOSAR_Platform_BaseTypes_sint16 40000.0 RB_PT_PCT_SWC_DWC_CompuMethods_ident -20000. 20000. FORMAT "%10.5"
 /begin ANNOTATION ANNOTATION_LABEL "Description (coming from AUTOSAR DESC field)"
  /begin ANNOTATION_TEXT "Target engine speed above idle speed threshold for dead pedal to prepare\r\n" /end ANNOTATION_TEXT
 /end ANNOTATION
/end CHARACTERISTIC
/begin CHARACTERISTIC DWC_EFLASHB.DWC_TorqueControl.DWC_PAPullawaySequencer.DWC_PADEADPEDALDELTASPEED "" VALUE 0x8060BBCA DefaultValueRecordLayout_AUTOSAR_Platform_BaseTypes_sint16 40000.0 RB_PT_PCT_SWC_DWC_CompuMethods_ident -20000. 20000. FORMAT "%10.5"
 /begin ANNOTATION ANNOTATION_LABEL "Description (coming from AUTOSAR DESC field)"
  /begin ANNOTATION_TEXT "Engine speed to idle speed delta for dead pedal condition\r\n" /end ANNOTATION_TEXT
 /end ANNOTATION
/end CHARACTERISTIC
/begin CHARACTERISTIC DWC_EFLASHB.DWC_TorqueControl.DWC_PAPullawaySequencer.DWC_PADEADPEDALDELTASPEEDTIME "" VALUE 0x8060BBCC DefaultValueRecordLayout_AUTOSAR_Platform_BaseTypes_uint16 10.0 RB_PT_PCT_SWC_DWC_CompuMethods_ratio_0p001__2 0.0 10. FORMAT "%10.5"
 /begin ANNOTATION ANNOTATION_LABEL "Description (coming from AUTOSAR DESC field)"
  /begin ANNOTATION_TEXT "Engine speed to idle speed for dead pedal condition time\r\n" /end ANNOTATION_TEXT
 /end ANNOTATION
/end CHARACTERISTIC
/begin CHARACTERISTIC DWC_EFLASHB.DWC_TorqueControl.DWC_PAPullawaySequencer.DWC_PADELTACLUIDLESPEED "" VALUE 0x8060BBCE DefaultValueRecordLayout_AUTOSAR_Platform_BaseTypes_sint16 40000.0 RB_PT_PCT_SWC_DWC_CompuMethods_ident -20000. 20000. FORMAT "%10.5"
 /begin ANNOTATION ANNOTATION_LABEL "Description (coming from AUTOSAR DESC field)" /begin ANNOTATION_TEXT "Clutch speed to idle speed delta for condition\r\n" /end ANNOTATION_TEXT /end ANNOTATION
/end CHARACTERISTIC
/begin CHARACTERISTIC DWC_EFLASHB.DWC_TorqueControl.DWC_PAPullawaySequencer.DWC_PADELTACLUIDLESPEEDTIME "" VALUE 0x8060BBD0 DefaultValueRecordLayout_AUTOSAR_Platform_BaseTypes_uint16 10.0 RB_PT_PCT_SWC_DWC_CompuMethods_ratio_0p001__2 0.0 10. FORMAT "%10.5"
 /begin ANNOTATION ANNOTATION_LABEL "Description (coming from AUTOSAR DESC field)" /begin ANNOTATION_TEXT "Clutch speed to idle speed condition time\r\n" /end ANNOTATION_TEXT /end ANNOTATION
/end CHARACTERISTIC
/begin CHARACTERISTIC DWC_EFLASHB.DWC_TorqueControl.DWC_PAPullawaySequencer.DWC_PADELTAENGBELOWCLUHOLDPREPTIME "" VALUE 0x8060BBD2 DefaultValueRecordLayout_AUTOSAR_Platform_BaseTypes_sint16 40000.0 RB_PT_PCT_SWC_DWC_CompuMethods_ident -20000. 20000. FORMAT "%10.5"
 /begin ANNOTATION ANNOTATION_LABEL "Description (coming from AUTOSAR DESC field)"
  /begin ANNOTATION_TEXT "Engine speed below clutch speed to hold prepare timer\r\n" /end ANNOTATION_TEXT
 /end ANNOTATION
/end CHARACTERISTIC
/begin CHARACTERISTIC DWC_EFLASHB.DWC_TorqueControl.DWC_PAPullawaySequencer.DWC_PADELTAENGIDLESPEED "" VALUE 0x8060BBD4 DefaultValueRecordLayout_AUTOSAR_Platform_BaseTypes_sint16 40000.0 RB_PT_PCT_SWC_DWC_CompuMethods_ident -20000. 20000. FORMAT "%10.5"
 /begin ANNOTATION ANNOTATION_LABEL "Description (coming from AUTOSAR DESC field)" /begin ANNOTATION_TEXT "Engine speed to idle speed delta for condition\r\n" /end ANNOTATION_TEXT /end ANNOTATION
/end CHARACTERISTIC
/begin CHARACTERISTIC DWC_EFLASHB.DWC_TorqueControl.DWC_PAPullawaySequencer.DWC_PADELTAENGIDLESPEEDTIME "" VALUE 0x8060BBD6 DefaultValueRecordLayout_AUTOSAR_Platform_BaseTypes_uint16 10.0 RB_PT_PCT_SWC_DWC_CompuMethods_ratio_0p001__2 0.0 10. FORMAT "%10.5"
 /begin ANNOTATION ANNOTATION_LABEL "Description (coming from AUTOSAR DESC field)" /begin ANNOTATION_TEXT "Engine speed to idle speed condition time\r\n" /end ANNOTATION_TEXT /end ANNOTATION
/end CHARACTERISTIC
/begin CHARACTERISTIC DWC_EFLASHB.DWC_TorqueControl.DWC_PAPullawaySequencer.DWC_PAENABLEPTSYNCGRADFREEZE "" VALUE 0x8060BC09 DefaultValueRecordLayout_AUTOSAR_Platform_BaseTypes_boolean 255.0 AUTOSAR_Platform_CompuMethods_boolean 0.0 255. FORMAT "%10.5"
 /begin ANNOTATION ANNOTATION_LABEL "Description (coming from AUTOSAR DESC field)" /begin ANNOTATION_TEXT "Flag to enable PT sync gradient signal freeze\r\n" /end ANNOTATION_TEXT /end ANNOTATION
/end CHARACTERISTIC
/begin CHARACTERISTIC DWC_EFLASHB.DWC_TorqueControl.DWC_PAPullawaySequencer.DWC_PAENFORCEGEARCOMPFORPOWERTRAINSYNC "" VALUE 0x8060BC0A DefaultValueRecordLayout_AUTOSAR_Platform_BaseTypes_boolean 255.0 AUTOSAR_Platform_CompuMethods_boolean 0.0 255. FORMAT "%10.5"
 /begin ANNOTATION ANNOTATION_LABEL "Description (coming from AUTOSAR DESC field)"
  /begin ANNOTATION_TEXT "Flag to enforce comparision of demand and current torque gears before entry to powertrain sync\r\n" /end ANNOTATION_TEXT
 /end ANNOTATION
/end CHARACTERISTIC
/begin CHARACTERISTIC DWC_EFLASHB.DWC_TorqueControl.DWC_PAPullawaySequencer.DWC_PAFILTEREDSLIPSTATEMACHINE "" VALUE 0x8060BC0B DefaultValueRecordLayout_AUTOSAR_Platform_BaseTypes_boolean 255.0 AUTOSAR_Platform_CompuMethods_boolean 0.0 255. FORMAT "%10.5"
 /begin ANNOTATION ANNOTATION_LABEL "Description (coming from AUTOSAR DESC field)"
  /begin ANNOTATION_TEXT "Flag to use filtered slip for the pullaway state machine\r\n" /end ANNOTATION_TEXT
 /end ANNOTATION
/end CHARACTERISTIC
/begin CHARACTERISTIC DWC_EFLASHB.DWC_TorqueControl.DWC_PAPullawaySequencer.DWC_PALAUNCHPOWERTRAINSYNCEXITSLIP "" VALUE 0x8060BBD8 DefaultValueRecordLayout_AUTOSAR_Platform_BaseTypes_uint16 20000.0 RB_PT_PCT_SWC_DWC_CompuMethods_ident 0.0 20000. FORMAT "%10.5"
 /begin ANNOTATION ANNOTATION_LABEL "Description (coming from AUTOSAR DESC field)"
  /begin ANNOTATION_TEXT "Slip actual to allow early powertrain sync exit  (Launch mode active)\r\n" /end ANNOTATION_TEXT
 /end ANNOTATION
/end CHARACTERISTIC
/begin CHARACTERISTIC DWC_EFLASHB.DWC_TorqueControl.DWC_PAPullawaySequencer.DWC_PALAUNCHPOWERTRAINSYNCEXITTIME "" VALUE 0x8060BBDA DefaultValueRecordLayout_AUTOSAR_Platform_BaseTypes_uint16 10.0 RB_PT_PCT_SWC_DWC_CompuMethods_ratio_0p001__2 0.0 10. FORMAT "%10.5"
 /begin ANNOTATION ANNOTATION_LABEL "Description (coming from AUTOSAR DESC field)"
  /begin ANNOTATION_TEXT "Time in powertrain sync before exit is requested (Launch mode active)\r\n" /end ANNOTATION_TEXT
 /end ANNOTATION
/end CHARACTERISTIC
/begin CHARACTERISTIC DWC_EFLASHB.DWC_TorqueControl.DWC_PAPullawaySequencer.DWC_PALAUNCHPOWERTRAINSYNCEXITTIMEMIN "" VALUE 0x8060BBDC DefaultValueRecordLayout_AUTOSAR_Platform_BaseTypes_uint16 10.0 RB_PT_PCT_SWC_DWC_CompuMethods_ratio_0p001__2 0.0 10. FORMAT "%10.5"
 /begin ANNOTATION ANNOTATION_LABEL "Description (coming from AUTOSAR DESC field)"
  /begin ANNOTATION_TEXT "Time in powertrain sync before exit is requested - minimum allowed based on slip  (Launch mode active)\r\n" /end ANNOTATION_TEXT
 /end ANNOTATION
/end CHARACTERISTIC
/begin CHARACTERISTIC DWC_EFLASHB.DWC_TorqueControl.DWC_PAPullawaySequencer.DWC_PALAUNCHSLIPTOPOWERTRAINSYNC "" VALUE 0x8060BBDE DefaultValueRecordLayout_AUTOSAR_Platform_BaseTypes_sint16 40000.0 RB_PT_PCT_SWC_DWC_CompuMethods_ident -20000. 20000. FORMAT "%10.5"
 /begin ANNOTATION ANNOTATION_LABEL "Description (coming from AUTOSAR DESC field)"
  /begin ANNOTATION_TEXT "Slip before powertrain sync timer is incremented (Launch Mode Active)\r\n" /end ANNOTATION_TEXT
 /end ANNOTATION
/end CHARACTERISTIC
/begin CHARACTERISTIC DWC_EFLASHB.DWC_TorqueControl.DWC_PAPullawaySequencer.DWC_PAPOWERTRAINSYNCEXITSLIP "" VALUE 0x8060BBE0 DefaultValueRecordLayout_AUTOSAR_Platform_BaseTypes_uint16 20000.0 RB_PT_PCT_SWC_DWC_CompuMethods_ident 0.0 20000. FORMAT "%10.5"
 /begin ANNOTATION ANNOTATION_LABEL "Description (coming from AUTOSAR DESC field)" /begin ANNOTATION_TEXT "Slip actual to allow early powertrain sync exit\r\n" /end ANNOTATION_TEXT /end ANNOTATION
/end CHARACTERISTIC
/begin CHARACTERISTIC DWC_EFLASHB.DWC_TorqueControl.DWC_PAPullawaySequencer.DWC_PAPOWERTRAINSYNCEXITTIME "" VALUE 0x8060BBE2 DefaultValueRecordLayout_AUTOSAR_Platform_BaseTypes_uint16 10.0 RB_PT_PCT_SWC_DWC_CompuMethods_ratio_0p001__2 0.0 10. FORMAT "%10.5"
 /begin ANNOTATION ANNOTATION_LABEL "Description (coming from AUTOSAR DESC field)" /begin ANNOTATION_TEXT "Time in powertrain sync before exit is requested\r\n" /end ANNOTATION_TEXT /end ANNOTATION
/end CHARACTERISTIC
/begin CHARACTERISTIC DWC_EFLASHB.DWC_TorqueControl.DWC_PAPullawaySequencer.DWC_PAPOWERTRAINSYNCEXITTIMEMIN "" VALUE 0x8060BBE4 DefaultValueRecordLayout_AUTOSAR_Platform_BaseTypes_uint16 10.0 RB_PT_PCT_SWC_DWC_CompuMethods_ratio_0p001__2 0.0 10. FORMAT "%10.5"
 /begin ANNOTATION ANNOTATION_LABEL "Description (coming from AUTOSAR DESC field)"
  /begin ANNOTATION_TEXT "Time in powertrain sync before exit is requested - minimum allowed based on slip\r\n" /end ANNOTATION_TEXT
 /end ANNOTATION
/end CHARACTERISTIC
/begin CHARACTERISTIC DWC_EFLASHB.DWC_TorqueControl.DWC_PAPullawaySequencer.DWC_PAPOWERTRAINSYNCTIMEOUT "" VALUE 0x8060BBE6 DefaultValueRecordLayout_AUTOSAR_Platform_BaseTypes_uint16 10.0 RB_PT_PCT_SWC_DWC_CompuMethods_ratio_0p001__2 0.0 10. FORMAT "%10.5"
 /begin ANNOTATION ANNOTATION_LABEL "Description (coming from AUTOSAR DESC field)" /begin ANNOTATION_TEXT "Timeout for powertrain sync phase\r\n" /end ANNOTATION_TEXT /end ANNOTATION
/end CHARACTERISTIC
/begin CHARACTERISTIC DWC_EFLASHB.DWC_TorqueControl.DWC_PAPullawaySequencer.DWC_PAPREPAREDELTASPEEDABOVEIDLE "" VALUE 0x8060BBE8 DefaultValueRecordLayout_AUTOSAR_Platform_BaseTypes_sint16 40000.0 RB_PT_PCT_SWC_DWC_CompuMethods_ident -20000. 20000. FORMAT "%10.5"
 /begin ANNOTATION ANNOTATION_LABEL "Description (coming from AUTOSAR DESC field)"
  /begin ANNOTATION_TEXT "Target engine speed offset above idle, below which dead pedal is entered from prepare\r\n" /end ANNOTATION_TEXT
 /end ANNOTATION
/end CHARACTERISTIC
/begin CHARACTERISTIC DWC_EFLASHB.DWC_TorqueControl.DWC_PAPullawaySequencer.DWC_PAPREPAREENGINESPEEDOFFSET "" VALUE 0x8060BBEA DefaultValueRecordLayout_AUTOSAR_Platform_BaseTypes_sint16 40000.0 RB_PT_PCT_SWC_DWC_CompuMethods_ident -20000. 20000. FORMAT "%10.5"
 /begin ANNOTATION ANNOTATION_LABEL "Description (coming from AUTOSAR DESC field)"
  /begin ANNOTATION_TEXT "Engine speed offset above engine speed at start of prepare for transition to next stage\r\n" /end ANNOTATION_TEXT
 /end ANNOTATION
/end CHARACTERISTIC
/begin CHARACTERISTIC DWC_EFLASHB.DWC_TorqueControl.DWC_PAPullawaySequencer.DWC_PAPREPAREFILLTIME "" CURVE 0x8060BC18 RB_PT_PCT_SWC_DWC_RecordLayouts_RL_Curve_uint16_5_sint16_5 10.0 RB_PT_PCT_SWC_DWC_CompuMethods_ratio_0p001__2 0.0 10. FORMAT "%10.5"
 /begin ANNOTATION ANNOTATION_LABEL "Description (coming from AUTOSAR DESC field)" /begin ANNOTATION_TEXT "Fill time against temperature (worst case)\r\n" /end ANNOTATION_TEXT /end ANNOTATION
 /begin AXIS_DESCR STD_AXIS NO_INPUT_QUANTITY RB_PT_PCT_SWC_DWC_CompuMethods_ident 5 -50. 200. FORMAT "%10.5" DEPOSIT ABSOLUTE /end AXIS_DESCR
/end CHARACTERISTIC
/begin CHARACTERISTIC DWC_EFLASHB.DWC_TorqueControl.DWC_PAPullawaySequencer.DWC_PAPREPAREHIGHTORQUETIME "" VALUE 0x8060BBEC DefaultValueRecordLayout_AUTOSAR_Platform_BaseTypes_uint16 10.0 RB_PT_PCT_SWC_DWC_CompuMethods_ratio_0p001__2 0.0 10. FORMAT "%10.5"
 /begin ANNOTATION ANNOTATION_LABEL "Description (coming from AUTOSAR DESC field)"
  /begin ANNOTATION_TEXT "Time to set prepare phase timer to in case of high torque on entry\r\n" /end ANNOTATION_TEXT
 /end ANNOTATION
/end CHARACTERISTIC
/begin CHARACTERISTIC DWC_EFLASHB.DWC_TorqueControl.DWC_PAPullawaySequencer.DWC_PAPREPAREMAXBRAKE "" VALUE 0x8060BBEE DefaultValueRecordLayout_AUTOSAR_Platform_BaseTypes_uint16 409.5 RB_PT_PCT_SWC_DWC_CompuMethods_ratio_0p1 0.0 409.5 FORMAT "%10.5"
 /begin ANNOTATION ANNOTATION_LABEL "Description (coming from AUTOSAR DESC field)" /begin ANNOTATION_TEXT "Brake pressure,below which prepare can exit\r\n" /end ANNOTATION_TEXT /end ANNOTATION
/end CHARACTERISTIC
/begin CHARACTERISTIC DWC_EFLASHB.DWC_TorqueControl.DWC_PAPullawaySequencer.DWC_PAPREPARETIMEOUT "" VALUE 0x8060BBF0 DefaultValueRecordLayout_AUTOSAR_Platform_BaseTypes_uint16 10.0 RB_PT_PCT_SWC_DWC_CompuMethods_ratio_0p001__2 0.0 10. FORMAT "%10.5"
 /begin ANNOTATION ANNOTATION_LABEL "Description (coming from AUTOSAR DESC field)" /begin ANNOTATION_TEXT "Timeout for prepare phase\r\n" /end ANNOTATION_TEXT /end ANNOTATION
/end CHARACTERISTIC
/begin CHARACTERISTIC DWC_EFLASHB.DWC_TorqueControl.DWC_PAPullawaySequencer.DWC_PAPREPARETORQUEDEMANDNOFILL "" VALUE 0x8060BBF2 DefaultValueRecordLayout_AUTOSAR_Platform_BaseTypes_uint16 2000.0 RB_PT_PCT_SWC_DWC_CompuMethods_ratio_0p1 0.0 2000. FORMAT "%10.5"
 /begin ANNOTATION ANNOTATION_LABEL "Description (coming from AUTOSAR DESC field)"
  /begin ANNOTATION_TEXT "Existing torque demand on controller, above which clutch is assumed to be filled already\r\n" /end ANNOTATION_TEXT
 /end ANNOTATION
/end CHARACTERISTIC
/begin CHARACTERISTIC DWC_EFLASHB.DWC_TorqueControl.DWC_PAPullawaySequencer.DWC_PASLIPRESYNCCALCSTOP "" VALUE 0x8060BBF4 DefaultValueRecordLayout_AUTOSAR_Platform_BaseTypes_sint16 40000.0 RB_PT_PCT_SWC_DWC_CompuMethods_ident -20000. 20000. FORMAT "%10.5"
 /begin ANNOTATION ANNOTATION_LABEL "Description (coming from AUTOSAR DESC field)" /begin ANNOTATION_TEXT "Slip offset to stop calculation of resync gradients\r\n" /end ANNOTATION_TEXT /end ANNOTATION
/end CHARACTERISTIC
/begin CHARACTERISTIC DWC_EFLASHB.DWC_TorqueControl.DWC_PAPullawaySequencer.DWC_PASPEEDERRORTOPOWERTRAINSYNC "" VALUE 0x8060BBF6 DefaultValueRecordLayout_AUTOSAR_Platform_BaseTypes_sint16 40000.0 RB_PT_PCT_SWC_DWC_CompuMethods_ident -20000. 20000. FORMAT "%10.5"
 /begin ANNOTATION ANNOTATION_LABEL "Description (coming from AUTOSAR DESC field)"
  /begin ANNOTATION_TEXT "Target speed to engine speed difference before transition to powertrain sync\r\n" /end ANNOTATION_TEXT
 /end ANNOTATION
/end CHARACTERISTIC
/begin CHARACTERISTIC DWC_EFLASHB.DWC_TorqueControl.DWC_PAPullawaySequencer.DWC_PASWPREPAREENGINESPEED "" VALUE 0x8060BBF8 DefaultValueRecordLayout_AUTOSAR_Platform_BaseTypes_uint16 20000.0 RB_PT_PCT_SWC_DWC_CompuMethods_ident 0.0 20000. FORMAT "%10.5"
 /begin ANNOTATION ANNOTATION_LABEL "Description (coming from AUTOSAR DESC field)"
  /begin ANNOTATION_TEXT "Engine speed at start of prepare for transition to next stage - slipping wheels launch\r\n" /end ANNOTATION_TEXT
 /end ANNOTATION
/end CHARACTERISTIC
/begin CHARACTERISTIC DWC_EFLASHB.DWC_TorqueControl.DWC_PAPullawaySequencer.DWC_PASWPREPAREMAXFAST "" VALUE 0x8060BBFA DefaultValueRecordLayout_AUTOSAR_Platform_BaseTypes_sint16 4000.0 RB_PT_PCT_SWC_DWC_CompuMethods_ratio_0p1 -2000. 2000. FORMAT "%10.5"
 /begin ANNOTATION ANNOTATION_LABEL "Description (coming from AUTOSAR DESC field)"
  /begin ANNOTATION_TEXT "Offset for powertrain max fast from start of prepare phase, before prepare can be exited - launch mode\r\n" /end ANNOTATION_TEXT
 /end ANNOTATION
/end CHARACTERISTIC
/begin CHARACTERISTIC DWC_EFLASHB.DWC_TorqueControl.DWC_PAPullawaySequencer.DWC_PASWPREPARETIMEOUT "" VALUE 0x8060BBFC DefaultValueRecordLayout_AUTOSAR_Platform_BaseTypes_uint16 10.0 RB_PT_PCT_SWC_DWC_CompuMethods_ratio_0p001__2 0.0 10. FORMAT "%10.5"
 /begin ANNOTATION ANNOTATION_LABEL "Description (coming from AUTOSAR DESC field)" /begin ANNOTATION_TEXT "Timeout for prepare phase - slipping wheels mode\r\n" /end ANNOTATION_TEXT /end ANNOTATION
/end CHARACTERISTIC
/begin CHARACTERISTIC DWC_EFLASHB.DWC_TorqueControl.DWC_PAPullawaySequencer.DWC_PASYNCEXITPEDALBYPASS "" VALUE 0x8060BC0C DefaultValueRecordLayout_AUTOSAR_Platform_BaseTypes_boolean 255.0 AUTOSAR_Platform_CompuMethods_boolean 0.0 255. FORMAT "%10.5"
 /begin ANNOTATION ANNOTATION_LABEL "Description (coming from AUTOSAR DESC field)"
  /begin ANNOTATION_TEXT "Flag to bypass pedal rule on exit of PA sync to PA running\r\n" /end ANNOTATION_TEXT
 /end ANNOTATION
/end CHARACTERISTIC
/begin CHARACTERISTIC DWC_EFLASHB.DWC_TorqueControl.DWC_PAPullawaySequencer.DWC_PASYNCPEDALBYPASS "" VALUE 0x8060BC0D DefaultValueRecordLayout_AUTOSAR_Platform_BaseTypes_boolean 255.0 AUTOSAR_Platform_CompuMethods_boolean 0.0 255. FORMAT "%10.5"
 /begin ANNOTATION ANNOTATION_LABEL "Description (coming from AUTOSAR DESC field)" /begin ANNOTATION_TEXT "Flag to bypass pedal rule on entry to PA sync\r\n" /end ANNOTATION_TEXT /end ANNOTATION
/end CHARACTERISTIC
/begin CHARACTERISTIC DWC_EFLASHB.DWC_TorqueControl.DWC_PAPullawaySequencer.DWC_PASYNCSLIPTOENTER "" CURVE 0x8060BC2E RB_PT_PCT_SWC_DWC_RecordLayouts_RL_CurveGrouped_sint16_5_uint8_5 40000.0 RB_PT_PCT_SWC_DWC_CompuMethods_ident -20000. 20000. FORMAT "%10.5"
 /begin ANNOTATION ANNOTATION_LABEL "Description (coming from AUTOSAR DESC field)" /begin ANNOTATION_TEXT "Slip before sync timer is incremented\r\n" /end ANNOTATION_TEXT /end ANNOTATION
 /begin AXIS_DESCR COM_AXIS NO_INPUT_QUANTITY RB_PT_PCT_SWC_DWC_CompuMethods_ratio_0p4 5 0.0 102. FORMAT "%10.5" AXIS_PTS_REF DWC_EFLASHB.DWC_TorqueControl.DWC_PAPullawaySequencer.DWC_PATPS5 DEPOSIT ABSOLUTE /end AXIS_DESCR
/end CHARACTERISTIC
/begin CHARACTERISTIC DWC_EFLASHB.DWC_TorqueControl.DWC_PAPullawaySequencer.DWC_PASYNCSLIPTOENTERHYST "" CURVE 0x8060BC38 RB_PT_PCT_SWC_DWC_RecordLayouts_RL_CurveGrouped_uint16_5_uint8_5 20000.0 RB_PT_PCT_SWC_DWC_CompuMethods_ident 0.0 20000. FORMAT "%10.5"
 /begin ANNOTATION ANNOTATION_LABEL "Description (coming from AUTOSAR DESC field)" /begin ANNOTATION_TEXT "Slip before sync timer is incremented - hysteresis\r\n" /end ANNOTATION_TEXT /end ANNOTATION
 /begin AXIS_DESCR COM_AXIS NO_INPUT_QUANTITY RB_PT_PCT_SWC_DWC_CompuMethods_ratio_0p4 5 0.0 102. FORMAT "%10.5" AXIS_PTS_REF DWC_EFLASHB.DWC_TorqueControl.DWC_PAPullawaySequencer.DWC_PATPS5 DEPOSIT ABSOLUTE /end AXIS_DESCR
/end CHARACTERISTIC
/begin CHARACTERISTIC DWC_EFLASHB.DWC_TorqueControl.DWC_PAPullawaySequencer.DWC_PASYNCSLIPTOENTERTIME "" VALUE 0x8060BBFE DefaultValueRecordLayout_AUTOSAR_Platform_BaseTypes_uint16 10.0 RB_PT_PCT_SWC_DWC_CompuMethods_ratio_0p001__2 0.0 10. FORMAT "%10.5"
 /begin ANNOTATION ANNOTATION_LABEL "Description (coming from AUTOSAR DESC field)"
  /begin ANNOTATION_TEXT "Time value for entering the sync slip phase of the pullaway\r\n" /end ANNOTATION_TEXT
 /end ANNOTATION
/end CHARACTERISTIC
/begin CHARACTERISTIC DWC_EFLASHB.DWC_TorqueControl.DWC_PAPullawaySequencer.DWC_PATARGETRAWFILTERHYST "" VALUE 0x8060BC00 DefaultValueRecordLayout_AUTOSAR_Platform_BaseTypes_uint16 20000.0 RB_PT_PCT_SWC_DWC_CompuMethods_ident 0.0 20000. FORMAT "%10.5"
 /begin ANNOTATION ANNOTATION_LABEL "Description (coming from AUTOSAR DESC field)"
  /begin ANNOTATION_TEXT "Hysteresis on sync target flag rule to prevent toggle\r\n" /end ANNOTATION_TEXT
 /end ANNOTATION
/end CHARACTERISTIC
/begin CHARACTERISTIC DWC_EFLASHB.DWC_TorqueControl.DWC_PAPullawaySequencer.DWC_PATARGETRAWFILTERMAX "" VALUE 0x8060BC02 DefaultValueRecordLayout_AUTOSAR_Platform_BaseTypes_sint16 40000.0 RB_PT_PCT_SWC_DWC_CompuMethods_ident -20000. 20000. FORMAT "%10.5"
 /begin ANNOTATION ANNOTATION_LABEL "Description (coming from AUTOSAR DESC field)"
  /begin ANNOTATION_TEXT "Error between raw and filtered target speed considered okay for entry to powertrain sync\r\n" /end ANNOTATION_TEXT
 /end ANNOTATION
/end CHARACTERISTIC
/begin CHARACTERISTIC DWC_EFLASHB.DWC_TorqueControl.DWC_PAPullawaySequencer.DWC_PATARGETRAWFILTERMIN "" VALUE 0x8060BC04 DefaultValueRecordLayout_AUTOSAR_Platform_BaseTypes_sint16 40000.0 RB_PT_PCT_SWC_DWC_CompuMethods_ident -20000. 20000. FORMAT "%10.5"
 /begin ANNOTATION ANNOTATION_LABEL "Description (coming from AUTOSAR DESC field)"
  /begin ANNOTATION_TEXT "Error between raw and filtered target speed considered okay for entry to powertrain sync\r\n" /end ANNOTATION_TEXT
 /end ANNOTATION
/end CHARACTERISTIC
/begin CHARACTERISTIC DWC_EFLASHB.DWC_TorqueControl.DWC_PARESYNCMAXLIMIT "" VALUE 0x8060B3EE DefaultValueRecordLayout_AUTOSAR_Platform_BaseTypes_sint16 64000.0 RB_PT_PCT_SWC_DWC_CompuMethods_ident -32000. 32000. FORMAT "%10.5"
 /begin ANNOTATION ANNOTATION_LABEL "Description (coming from AUTOSAR DESC field)" /begin ANNOTATION_TEXT "Gradient limit for output to engine\r\n" /end ANNOTATION_TEXT /end ANNOTATION
/end CHARACTERISTIC
/begin CHARACTERISTIC DWC_EFLASHB.DWC_TorqueControl.DWC_PARESYNCMINLIMIT "" VALUE 0x8060B3F0 DefaultValueRecordLayout_AUTOSAR_Platform_BaseTypes_sint16 64000.0 RB_PT_PCT_SWC_DWC_CompuMethods_ident -32000. 32000. FORMAT "%10.5"
 /begin ANNOTATION ANNOTATION_LABEL "Description (coming from AUTOSAR DESC field)" /begin ANNOTATION_TEXT "Gradient limit for output to engine\r\n" /end ANNOTATION_TEXT /end ANNOTATION
/end CHARACTERISTIC
/begin CHARACTERISTIC DWC_EFLASHB.DWC_TorqueControl.DWC_PASECLUTCHSPDOFFSET "" VALUE 0x8060B3F2 DefaultValueRecordLayout_AUTOSAR_Platform_BaseTypes_sint16 40000.0 RB_PT_PCT_SWC_DWC_CompuMethods_ident -20000. 20000. FORMAT "%10.5"
 /begin ANNOTATION ANNOTATION_LABEL "Description (coming from AUTOSAR DESC field)"
  /begin ANNOTATION_TEXT "Speed offset to active input used as MAX for target speed\r\n" /end ANNOTATION_TEXT
 /end ANNOTATION
/end CHARACTERISTIC
/begin CHARACTERISTIC DWC_EFLASHB.DWC_TorqueControl.DWC_PASEENABLE "" VALUE 0x8060B4BB DefaultValueRecordLayout_AUTOSAR_Platform_BaseTypes_boolean 255.0 AUTOSAR_Platform_CompuMethods_boolean 0.0 255. FORMAT "%10.5"
 /begin ANNOTATION ANNOTATION_LABEL "Description (coming from AUTOSAR DESC field)" /begin ANNOTATION_TEXT "Flag to enable sync engine controller\r\n" /end ANNOTATION_TEXT /end ANNOTATION
/end CHARACTERISTIC
/begin CHARACTERISTIC DWC_EFLASHB.DWC_TorqueControl.DWC_PASEINTEGRALGAINGEARERROR "" MAP 0x8060D00E RB_PT_PCT_SWC_DWC_RecordLayouts_RL_Map_uint16_25_sint16_5_sint16_5 0.15 RB_PT_PCT_SWC_DWC_CompuMethods_ratio_0p00001 0.0 0.15 FORMAT "%10.5"
 /begin ANNOTATION ANNOTATION_LABEL "Description (coming from AUTOSAR DESC field)" /begin ANNOTATION_TEXT "Integral gain of sync engine controller\r\n" /end ANNOTATION_TEXT /end ANNOTATION
 /begin AXIS_DESCR STD_AXIS NO_INPUT_QUANTITY RB_PT_PCT_SWC_DWC_CompuMethods_ident 5 0.0 11. FORMAT "%10.5" DEPOSIT ABSOLUTE /end AXIS_DESCR
 /begin AXIS_DESCR STD_AXIS NO_INPUT_QUANTITY RB_PT_PCT_SWC_DWC_CompuMethods_ident 5 -20000. 20000. FORMAT "%10.5" DEPOSIT ABSOLUTE /end AXIS_DESCR
/end CHARACTERISTIC
/begin CHARACTERISTIC DWC_EFLASHB.DWC_TorqueControl.DWC_PASEPROPGAINGEARERROR "" MAP 0x8060D058 RB_PT_PCT_SWC_DWC_RecordLayouts_RL_Map_uint16_25_sint16_5_sint16_5 5.0 RB_PT_PCT_SWC_DWC_CompuMethods_ratio_0p001__2 0.0 5. FORMAT "%10.5"
 /begin ANNOTATION ANNOTATION_LABEL "Description (coming from AUTOSAR DESC field)" /begin ANNOTATION_TEXT "Proportional gain of sync engine controller\r\n" /end ANNOTATION_TEXT /end ANNOTATION
 /begin AXIS_DESCR STD_AXIS NO_INPUT_QUANTITY RB_PT_PCT_SWC_DWC_CompuMethods_ident 5 0.0 11. FORMAT "%10.5" DEPOSIT ABSOLUTE /end AXIS_DESCR
 /begin AXIS_DESCR STD_AXIS NO_INPUT_QUANTITY RB_PT_PCT_SWC_DWC_CompuMethods_ident 5 -20000. 20000. FORMAT "%10.5" DEPOSIT ABSOLUTE /end AXIS_DESCR
/end CHARACTERISTIC
/begin CHARACTERISTIC DWC_EFLASHB.DWC_TorqueControl.DWC_PASEPROPGAINSLIPTEMP "" MAP 0x8060D0A2 RB_PT_PCT_SWC_DWC_RecordLayouts_RL_Map_uint16_25_uint16_5_sint16_5 1.0 RB_PT_PCT_SWC_DWC_CompuMethods_ratio_0p001__2 0.0 1. FORMAT "%10.5"
 /begin ANNOTATION ANNOTATION_LABEL "Description (coming from AUTOSAR DESC field)" /begin ANNOTATION_TEXT "Factor of prop gain based on |slip| and temperature\r\n" /end ANNOTATION_TEXT /end ANNOTATION
 /begin AXIS_DESCR STD_AXIS NO_INPUT_QUANTITY RB_PT_PCT_SWC_DWC_CompuMethods_ident 5 0.0 20000. FORMAT "%10.5" DEPOSIT ABSOLUTE /end AXIS_DESCR
 /begin AXIS_DESCR STD_AXIS NO_INPUT_QUANTITY RB_PT_PCT_SWC_DWC_CompuMethods_ident 5 -50. 200. FORMAT "%10.5" DEPOSIT ABSOLUTE /end AXIS_DESCR
/end CHARACTERISTIC
/begin CHARACTERISTIC DWC_EFLASHB.DWC_TorqueControl.DWC_PASLOPE1 "" CURVE 0x8060D0EC RB_PT_PCT_SWC_DWC_RecordLayouts_RL_CurveGrouped_sint16_11_uint8_11 64000.0 RB_PT_PCT_SWC_DWC_CompuMethods_ident -32000. 32000. FORMAT "%10.5"
 /begin ANNOTATION ANNOTATION_LABEL "Description (coming from AUTOSAR DESC field)" /begin ANNOTATION_TEXT "Gradient of target speed slope\r\n" /end ANNOTATION_TEXT /end ANNOTATION
 /begin AXIS_DESCR COM_AXIS NO_INPUT_QUANTITY RB_PT_PCT_SWC_DWC_CompuMethods_ratio_0p4 11 0.0 102. FORMAT "%10.5" AXIS_PTS_REF DWC_EFLASHB.DWC_TorqueControl.DWC_PATPS11 DEPOSIT ABSOLUTE /end AXIS_DESCR
/end CHARACTERISTIC
/begin CHARACTERISTIC DWC_EFLASHB.DWC_TorqueControl.DWC_PASLOPE1_ALT "" CURVE 0x8060D102 RB_PT_PCT_SWC_DWC_RecordLayouts_RL_CurveGrouped_sint16_11_uint8_11 64000.0 RB_PT_PCT_SWC_DWC_CompuMethods_ident -32000. 32000. FORMAT "%10.5"
 /begin ANNOTATION ANNOTATION_LABEL "Description (coming from AUTOSAR DESC field)" /begin ANNOTATION_TEXT "Gradient of target speed slope\r\n" /end ANNOTATION_TEXT /end ANNOTATION
 /begin AXIS_DESCR COM_AXIS NO_INPUT_QUANTITY RB_PT_PCT_SWC_DWC_CompuMethods_ratio_0p4 11 0.0 102. FORMAT "%10.5" AXIS_PTS_REF DWC_EFLASHB.DWC_TorqueControl.DWC_PATPS11 DEPOSIT ABSOLUTE /end AXIS_DESCR
/end CHARACTERISTIC
/begin CHARACTERISTIC DWC_EFLASHB.DWC_TorqueControl.DWC_PASLOPE1_ZERO "" CURVE 0x8060D118 RB_PT_PCT_SWC_DWC_RecordLayouts_RL_CurveGrouped_sint16_11_uint8_11 64000.0 RB_PT_PCT_SWC_DWC_CompuMethods_ident -32000. 32000. FORMAT "%10.5"
 /begin ANNOTATION ANNOTATION_LABEL "Description (coming from AUTOSAR DESC field)" /begin ANNOTATION_TEXT "Gradient of target speed slope\r\n" /end ANNOTATION_TEXT /end ANNOTATION
 /begin AXIS_DESCR COM_AXIS NO_INPUT_QUANTITY RB_PT_PCT_SWC_DWC_CompuMethods_ratio_0p4 11 0.0 102. FORMAT "%10.5" AXIS_PTS_REF DWC_EFLASHB.DWC_TorqueControl.DWC_PATPS11 DEPOSIT ABSOLUTE /end AXIS_DESCR
/end CHARACTERISTIC
/begin CHARACTERISTIC DWC_EFLASHB.DWC_TorqueControl.DWC_PASLOPE2 "" CURVE 0x8060D12E RB_PT_PCT_SWC_DWC_RecordLayouts_RL_CurveGrouped_sint16_11_uint8_11 64000.0 RB_PT_PCT_SWC_DWC_CompuMethods_ident -32000. 32000. FORMAT "%10.5"
 /begin ANNOTATION ANNOTATION_LABEL "Description (coming from AUTOSAR DESC field)" /begin ANNOTATION_TEXT "Gradient of target speed slope\r\n" /end ANNOTATION_TEXT /end ANNOTATION
 /begin AXIS_DESCR COM_AXIS NO_INPUT_QUANTITY RB_PT_PCT_SWC_DWC_CompuMethods_ratio_0p4 11 0.0 102. FORMAT "%10.5" AXIS_PTS_REF DWC_EFLASHB.DWC_TorqueControl.DWC_PATPS11 DEPOSIT ABSOLUTE /end AXIS_DESCR
/end CHARACTERISTIC
/begin CHARACTERISTIC DWC_EFLASHB.DWC_TorqueControl.DWC_PASLOPE2_ALT "" CURVE 0x8060D144 RB_PT_PCT_SWC_DWC_RecordLayouts_RL_CurveGrouped_sint16_11_uint8_11 64000.0 RB_PT_PCT_SWC_DWC_CompuMethods_ident -32000. 32000. FORMAT "%10.5"
 /begin ANNOTATION ANNOTATION_LABEL "Description (coming from AUTOSAR DESC field)" /begin ANNOTATION_TEXT "Gradient of target speed slope\r\n" /end ANNOTATION_TEXT /end ANNOTATION
 /begin AXIS_DESCR COM_AXIS NO_INPUT_QUANTITY RB_PT_PCT_SWC_DWC_CompuMethods_ratio_0p4 11 0.0 102. FORMAT "%10.5" AXIS_PTS_REF DWC_EFLASHB.DWC_TorqueControl.DWC_PATPS11 DEPOSIT ABSOLUTE /end AXIS_DESCR
/end CHARACTERISTIC
/begin CHARACTERISTIC DWC_EFLASHB.DWC_TorqueControl.DWC_PASLOPE2_ZERO "" CURVE 0x8060D15A RB_PT_PCT_SWC_DWC_RecordLayouts_RL_CurveGrouped_sint16_11_uint8_11 64000.0 RB_PT_PCT_SWC_DWC_CompuMethods_ident -32000. 32000. FORMAT "%10.5"
 /begin ANNOTATION ANNOTATION_LABEL "Description (coming from AUTOSAR DESC field)" /begin ANNOTATION_TEXT "Gradient of target speed slope\r\n" /end ANNOTATION_TEXT /end ANNOTATION
 /begin AXIS_DESCR COM_AXIS NO_INPUT_QUANTITY RB_PT_PCT_SWC_DWC_CompuMethods_ratio_0p4 11 0.0 102. FORMAT "%10.5" AXIS_PTS_REF DWC_EFLASHB.DWC_TorqueControl.DWC_PATPS11 DEPOSIT ABSOLUTE /end AXIS_DESCR
/end CHARACTERISTIC
/begin CHARACTERISTIC DWC_EFLASHB.DWC_TorqueControl.DWC_PASLOPECLUTCHPERC "" CURVE 0x8060D170 RB_PT_PCT_SWC_DWC_RecordLayouts_RL_CurveGrouped_uint8_4_uint8_4 1.0 RB_PT_PCT_SWC_DWC_CompuMethods_ratio_0p01 0.0 1. FORMAT "%10.5"
 /begin ANNOTATION ANNOTATION_LABEL "Description (coming from AUTOSAR DESC field)" /begin ANNOTATION_TEXT "Gain to use during slope 3\r\n" /end ANNOTATION_TEXT /end ANNOTATION
 /begin AXIS_DESCR COM_AXIS NO_INPUT_QUANTITY RB_PT_PCT_SWC_DWC_CompuMethods_ratio_0p4 4 0.0 102. FORMAT "%10.5" AXIS_PTS_REF DWC_EFLASHB.DWC_TorqueControl.DWC_PATPS4 DEPOSIT ABSOLUTE /end AXIS_DESCR
/end CHARACTERISTIC
/begin CHARACTERISTIC DWC_EFLASHB.DWC_TorqueControl.DWC_PASLOPECLUTCHPERC_ALT "" CURVE 0x8060D174 RB_PT_PCT_SWC_DWC_RecordLayouts_RL_CurveGrouped_uint8_4_uint8_4 1.0 RB_PT_PCT_SWC_DWC_CompuMethods_ratio_0p01 0.0 1. FORMAT "%10.5"
 /begin ANNOTATION ANNOTATION_LABEL "Description (coming from AUTOSAR DESC field)" /begin ANNOTATION_TEXT "Gain to use during slope 3\r\n" /end ANNOTATION_TEXT /end ANNOTATION
 /begin AXIS_DESCR COM_AXIS NO_INPUT_QUANTITY RB_PT_PCT_SWC_DWC_CompuMethods_ratio_0p4 4 0.0 102. FORMAT "%10.5" AXIS_PTS_REF DWC_EFLASHB.DWC_TorqueControl.DWC_PATPS4 DEPOSIT ABSOLUTE /end AXIS_DESCR
/end CHARACTERISTIC
/begin CHARACTERISTIC DWC_EFLASHB.DWC_TorqueControl.DWC_PASLOPECLUTCHPERC_ZERO "" CURVE 0x8060D178 RB_PT_PCT_SWC_DWC_RecordLayouts_RL_CurveGrouped_uint8_4_uint8_4 1.0 RB_PT_PCT_SWC_DWC_CompuMethods_ratio_0p01 0.0 1. FORMAT "%10.5"
 /begin ANNOTATION ANNOTATION_LABEL "Description (coming from AUTOSAR DESC field)" /begin ANNOTATION_TEXT "Gain to use during slope 3\r\n" /end ANNOTATION_TEXT /end ANNOTATION
 /begin AXIS_DESCR COM_AXIS NO_INPUT_QUANTITY RB_PT_PCT_SWC_DWC_CompuMethods_ratio_0p4 4 0.0 102. FORMAT "%10.5" AXIS_PTS_REF DWC_EFLASHB.DWC_TorqueControl.DWC_PATPS4 DEPOSIT ABSOLUTE /end AXIS_DESCR
/end CHARACTERISTIC
/begin CHARACTERISTIC DWC_EFLASHB.DWC_TorqueControl.DWC_PASLOPEPREPARE "" CURVE 0x8060D17C RB_PT_PCT_SWC_DWC_RecordLayouts_RL_CurveGrouped_sint16_4_uint8_4 64000.0 RB_PT_PCT_SWC_DWC_CompuMethods_ident -32000. 32000. FORMAT "%10.5"
 /begin ANNOTATION ANNOTATION_LABEL "Description (coming from AUTOSAR DESC field)" /begin ANNOTATION_TEXT "Gradient of target speed slope - prepare phase MAX\r\n" /end ANNOTATION_TEXT /end ANNOTATION
 /begin AXIS_DESCR COM_AXIS NO_INPUT_QUANTITY RB_PT_PCT_SWC_DWC_CompuMethods_ratio_0p4 4 0.0 102. FORMAT "%10.5" AXIS_PTS_REF DWC_EFLASHB.DWC_TorqueControl.DWC_PATPS4 DEPOSIT ABSOLUTE /end AXIS_DESCR
/end CHARACTERISTIC
/begin CHARACTERISTIC DWC_EFLASHB.DWC_TorqueControl.DWC_PASLOPEPREPARE_ALT "" CURVE 0x8060D184 RB_PT_PCT_SWC_DWC_RecordLayouts_RL_CurveGrouped_sint16_4_uint8_4 64000.0 RB_PT_PCT_SWC_DWC_CompuMethods_ident -32000. 32000. FORMAT "%10.5"
 /begin ANNOTATION ANNOTATION_LABEL "Description (coming from AUTOSAR DESC field)" /begin ANNOTATION_TEXT "Gradient of target speed slope - prepare phase MAX\r\n" /end ANNOTATION_TEXT /end ANNOTATION
 /begin AXIS_DESCR COM_AXIS NO_INPUT_QUANTITY RB_PT_PCT_SWC_DWC_CompuMethods_ratio_0p4 4 0.0 102. FORMAT "%10.5" AXIS_PTS_REF DWC_EFLASHB.DWC_TorqueControl.DWC_PATPS4 DEPOSIT ABSOLUTE /end AXIS_DESCR
/end CHARACTERISTIC
/begin CHARACTERISTIC DWC_EFLASHB.DWC_TorqueControl.DWC_PASLOPEPREPARE_ZERO "" CURVE 0x8060D18C RB_PT_PCT_SWC_DWC_RecordLayouts_RL_CurveGrouped_sint16_4_uint8_4 64000.0 RB_PT_PCT_SWC_DWC_CompuMethods_ident -32000. 32000. FORMAT "%10.5"
 /begin ANNOTATION ANNOTATION_LABEL "Description (coming from AUTOSAR DESC field)" /begin ANNOTATION_TEXT "Gradient of target speed slope - prepare phase MAX\r\n" /end ANNOTATION_TEXT /end ANNOTATION
 /begin AXIS_DESCR COM_AXIS NO_INPUT_QUANTITY RB_PT_PCT_SWC_DWC_CompuMethods_ratio_0p4 4 0.0 102. FORMAT "%10.5" AXIS_PTS_REF DWC_EFLASHB.DWC_TorqueControl.DWC_PATPS4 DEPOSIT ABSOLUTE /end AXIS_DESCR
/end CHARACTERISTIC
/begin CHARACTERISTIC DWC_EFLASHB.DWC_TorqueControl.DWC_PASLOPESLIP "" CURVE 0x8060D194 RB_PT_PCT_SWC_DWC_RecordLayouts_RL_Curve_sint16_11_sint16_11 64000.0 RB_PT_PCT_SWC_DWC_CompuMethods_ident -32000. 32000. FORMAT "%10.5"
 /begin ANNOTATION ANNOTATION_LABEL "Description (coming from AUTOSAR DESC field)"
  /begin ANNOTATION_TEXT "Gradient of target speed slope - based on filtered clutch slip\r\n" /end ANNOTATION_TEXT
 /end ANNOTATION
 /begin AXIS_DESCR STD_AXIS NO_INPUT_QUANTITY RB_PT_PCT_SWC_DWC_CompuMethods_ident 11 -20000. 20000. FORMAT "%10.5" DEPOSIT ABSOLUTE /end AXIS_DESCR
/end CHARACTERISTIC
/begin CHARACTERISTIC DWC_EFLASHB.DWC_TorqueControl.DWC_PASLOPESWITCHPOINT "" CURVE 0x8060D1C2 RB_PT_PCT_SWC_DWC_RecordLayouts_RL_CurveGrouped_uint8_5_uint8_5 1.0 RB_PT_PCT_SWC_DWC_CompuMethods_ratio_0p01 0.0 1. FORMAT "%10.5"
 /begin ANNOTATION ANNOTATION_LABEL "Description (coming from AUTOSAR DESC field)" /begin ANNOTATION_TEXT "Factor of PATargetSpeedRaw for slope switch point\r\n" /end ANNOTATION_TEXT /end ANNOTATION
 /begin AXIS_DESCR COM_AXIS NO_INPUT_QUANTITY RB_PT_PCT_SWC_DWC_CompuMethods_ratio_0p4 5 0.0 102. FORMAT "%10.5" AXIS_PTS_REF DWC_EFLASHB.DWC_TorqueControl.DWC_PATPS5 DEPOSIT ABSOLUTE /end AXIS_DESCR
/end CHARACTERISTIC
/begin CHARACTERISTIC DWC_EFLASHB.DWC_TorqueControl.DWC_PASLOPESWITCHPOINT_ALT "" CURVE 0x8060D1C8 RB_PT_PCT_SWC_DWC_RecordLayouts_RL_CurveGrouped_uint8_5_uint8_5 1.0 RB_PT_PCT_SWC_DWC_CompuMethods_ratio_0p01 0.0 1. FORMAT "%10.5"
 /begin ANNOTATION ANNOTATION_LABEL "Description (coming from AUTOSAR DESC field)" /begin ANNOTATION_TEXT "Factor of PATargetSpeedRaw for slope switch point\r\n" /end ANNOTATION_TEXT /end ANNOTATION
 /begin AXIS_DESCR COM_AXIS NO_INPUT_QUANTITY RB_PT_PCT_SWC_DWC_CompuMethods_ratio_0p4 5 0.0 102. FORMAT "%10.5" AXIS_PTS_REF DWC_EFLASHB.DWC_TorqueControl.DWC_PATPS5 DEPOSIT ABSOLUTE /end AXIS_DESCR
/end CHARACTERISTIC
/begin CHARACTERISTIC DWC_EFLASHB.DWC_TorqueControl.DWC_PASLOPESWITCHPOINT_ZERO "" CURVE 0x8060D1CE RB_PT_PCT_SWC_DWC_RecordLayouts_RL_CurveGrouped_uint8_5_uint8_5 1.0 RB_PT_PCT_SWC_DWC_CompuMethods_ratio_0p01 0.0 1. FORMAT "%10.5"
 /begin ANNOTATION ANNOTATION_LABEL "Description (coming from AUTOSAR DESC field)" /begin ANNOTATION_TEXT "Factor of PATargetSpeedRaw for slope switch point\r\n" /end ANNOTATION_TEXT /end ANNOTATION
 /begin AXIS_DESCR COM_AXIS NO_INPUT_QUANTITY RB_PT_PCT_SWC_DWC_CompuMethods_ratio_0p4 5 0.0 102. FORMAT "%10.5" AXIS_PTS_REF DWC_EFLASHB.DWC_TorqueControl.DWC_PATPS5 DEPOSIT ABSOLUTE /end AXIS_DESCR
/end CHARACTERISTIC
/begin CHARACTERISTIC DWC_EFLASHB.DWC_TorqueControl.DWC_PASpeedProfiler.DWC_PADSPEEDFIRLEN "" VALUE 0x8060BC4C DefaultValueRecordLayout_AUTOSAR_Platform_BaseTypes_uint8 9.0 RB_PT_PCT_SWC_DWC_CompuMethods_ident 1. 10. FORMAT "%10.5"
 /begin ANNOTATION ANNOTATION_LABEL "Description (coming from AUTOSAR DESC field)" /begin ANNOTATION_TEXT "Length of FIR filter\r\n" /end ANNOTATION_TEXT /end ANNOTATION
/end CHARACTERISTIC
/begin CHARACTERISTIC DWC_EFLASHB.DWC_TorqueControl.DWC_PASpeedProfiler.DWC_PADSPEEDIIRCOEFF "" VALUE 0x8060BC4A DefaultValueRecordLayout_AUTOSAR_Platform_BaseTypes_uint16 1.0 RB_PT_PCT_SWC_DWC_CompuMethods_ratio_0p001__2 0.0 1. FORMAT "%10.5"
 /begin ANNOTATION ANNOTATION_LABEL "Description (coming from AUTOSAR DESC field)" /begin ANNOTATION_TEXT "Coefficient for IIR filter\r\n" /end ANNOTATION_TEXT /end ANNOTATION
/end CHARACTERISTIC
/begin CHARACTERISTIC DWC_EFLASHB.DWC_TorqueControl.DWC_PASWFINALTGTSPD "" VALUE 0x8060B3F4 DefaultValueRecordLayout_AUTOSAR_Platform_BaseTypes_uint16 20000.0 RB_PT_PCT_SWC_DWC_CompuMethods_ident 0.0 20000. FORMAT "%10.5"
 /begin ANNOTATION ANNOTATION_LABEL "Description (coming from AUTOSAR DESC field)"
  /begin ANNOTATION_TEXT "Final target speed for launch in slipping wheels case\r\n" /end ANNOTATION_TEXT
 /end ANNOTATION
/end CHARACTERISTIC
/begin CHARACTERISTIC DWC_EFLASHB.DWC_TorqueControl.DWC_PASWMINTQ "" VALUE 0x8060B3F6 DefaultValueRecordLayout_AUTOSAR_Platform_BaseTypes_uint16 2000.0 RB_PT_PCT_SWC_DWC_CompuMethods_ratio_0p1 0.0 2000. FORMAT "%10.5"
 /begin ANNOTATION ANNOTATION_LABEL "Description (coming from AUTOSAR DESC field)" /begin ANNOTATION_TEXT "Min torque for slipping wheels mode\r\n" /end ANNOTATION_TEXT /end ANNOTATION
/end CHARACTERISTIC
/begin CHARACTERISTIC DWC_EFLASHB.DWC_TorqueControl.DWC_PASWTGTSLOPE "" VALUE 0x8060B3F8 DefaultValueRecordLayout_AUTOSAR_Platform_BaseTypes_sint16 64000.0 RB_PT_PCT_SWC_DWC_CompuMethods_ident -32000. 32000. FORMAT "%10.5"
 /begin ANNOTATION ANNOTATION_LABEL "Description (coming from AUTOSAR DESC field)" /begin ANNOTATION_TEXT "RPM slope for launch mode - slipping wheels type\r\n" /end ANNOTATION_TEXT /end ANNOTATION
/end CHARACTERISTIC
/begin CHARACTERISTIC DWC_EFLASHB.DWC_TorqueControl.DWC_PASWTQSLOPE "" VALUE 0x8060B3FA DefaultValueRecordLayout_AUTOSAR_Platform_BaseTypes_sint16 64000.0 RB_PT_PCT_SWC_DWC_CompuMethods_ident -32000. 32000. FORMAT "%10.5"
 /begin ANNOTATION ANNOTATION_LABEL "Description (coming from AUTOSAR DESC field)" /begin ANNOTATION_TEXT "Clutch torque gradient slope - slipping wheels mode\r\n" /end ANNOTATION_TEXT /end ANNOTATION
/end CHARACTERISTIC
/begin CHARACTERISTIC DWC_EFLASHB.DWC_TorqueControl.DWC_PASWTQSLOPEPREPARE "" VALUE 0x8060B3FC DefaultValueRecordLayout_AUTOSAR_Platform_BaseTypes_sint16 64000.0 RB_PT_PCT_SWC_DWC_CompuMethods_ident -32000. 32000. FORMAT "%10.5"
 /begin ANNOTATION ANNOTATION_LABEL "Description (coming from AUTOSAR DESC field)"
  /begin ANNOTATION_TEXT "Slope of clutch torque for prepare phase of slipping wheels pullaway\r\n" /end ANNOTATION_TEXT
 /end ANNOTATION
/end CHARACTERISTIC
/begin CHARACTERISTIC DWC_EFLASHB.DWC_TorqueControl.DWC_PATARGETFILTER1 "" CURVE 0x8060D1D4 RB_PT_PCT_SWC_DWC_RecordLayouts_RL_Curve_uint16_11_sint16_11 1.0 RB_PT_PCT_SWC_DWC_CompuMethods_ratio_0p001__2 0.0 1. FORMAT "%10.5"
 /begin ANNOTATION ANNOTATION_LABEL "Description (coming from AUTOSAR DESC field)"
  /begin ANNOTATION_TEXT "Target engine speed filter for falling speed when clutch torque is high\r\n" /end ANNOTATION_TEXT
 /end ANNOTATION
 /begin AXIS_DESCR STD_AXIS NO_INPUT_QUANTITY RB_PT_PCT_SWC_DWC_CompuMethods_ident 11 -20000. 20000. FORMAT "%10.5" DEPOSIT ABSOLUTE /end AXIS_DESCR
/end CHARACTERISTIC
/begin CHARACTERISTIC DWC_EFLASHB.DWC_TorqueControl.DWC_PATARGETFILTER2 "" CURVE 0x8060D202 RB_PT_PCT_SWC_DWC_RecordLayouts_RL_Curve_uint16_11_sint16_11 1.0 RB_PT_PCT_SWC_DWC_CompuMethods_ratio_0p001__2 0.0 1. FORMAT "%10.5"
 /begin ANNOTATION ANNOTATION_LABEL "Description (coming from AUTOSAR DESC field)"
  /begin ANNOTATION_TEXT "Target engine speed filter for falling speed when clutch torque is low\r\n" /end ANNOTATION_TEXT
 /end ANNOTATION
 /begin AXIS_DESCR STD_AXIS NO_INPUT_QUANTITY RB_PT_PCT_SWC_DWC_CompuMethods_ident 11 -20000. 20000. FORMAT "%10.5" DEPOSIT ABSOLUTE /end AXIS_DESCR
/end CHARACTERISTIC
/begin CHARACTERISTIC DWC_EFLASHB.DWC_TorqueControl.DWC_PATcActivation.DWC_PATCASERRORENABLEHYST "" VALUE 0x8060BC4E DefaultValueRecordLayout_AUTOSAR_Platform_BaseTypes_sint16 4000.0 RB_PT_PCT_SWC_DWC_CompuMethods_ratio_0p1 -2000. 2000. FORMAT "%10.5"
 /begin ANNOTATION ANNOTATION_LABEL "Description (coming from AUTOSAR DESC field)" /begin ANNOTATION_TEXT "Anti stall error value for tc enable - hysteresis\r\n" /end ANNOTATION_TEXT /end ANNOTATION
/end CHARACTERISTIC
/begin CHARACTERISTIC DWC_EFLASHB.DWC_TorqueControl.DWC_PATcActivation.DWC_PATCASPTERMENABLE "" VALUE 0x8060BC50 DefaultValueRecordLayout_AUTOSAR_Platform_BaseTypes_sint16 4000.0 RB_PT_PCT_SWC_DWC_CompuMethods_ratio_0p1 -2000. 2000. FORMAT "%10.5"
 /begin ANNOTATION ANNOTATION_LABEL "Description (coming from AUTOSAR DESC field)" /begin ANNOTATION_TEXT "Anti stall proportional term value for tc enable\r\n" /end ANNOTATION_TEXT /end ANNOTATION
/end CHARACTERISTIC
/begin CHARACTERISTIC DWC_EFLASHB.DWC_TorqueControl.DWC_PATcActivation.DWC_PATCASPTERMENABLEHYSTEVB "" VALUE 0x8060BC52 DefaultValueRecordLayout_AUTOSAR_Platform_BaseTypes_sint16 4000.0 RB_PT_PCT_SWC_DWC_CompuMethods_ratio_0p1 -2000. 2000. FORMAT "%10.5"
 /begin ANNOTATION ANNOTATION_LABEL "Description (coming from AUTOSAR DESC field)"
  /begin ANNOTATION_TEXT "Anti stall proportional term value for tc enable - Hysteresis for event B\r\n" /end ANNOTATION_TEXT
 /end ANNOTATION
/end CHARACTERISTIC
/begin CHARACTERISTIC DWC_EFLASHB.DWC_TorqueControl.DWC_PATcActivation.DWC_PATCDELAYTIME "" VALUE 0x8060BC54 DefaultValueRecordLayout_AUTOSAR_Platform_BaseTypes_uint16 10.0 RB_PT_PCT_SWC_DWC_CompuMethods_ratio_0p001__2 0.0 10. FORMAT "%10.5"
 /begin ANNOTATION ANNOTATION_LABEL "Description (coming from AUTOSAR DESC field)" /begin ANNOTATION_TEXT "Delay time for event A\r\n" /end ANNOTATION_TEXT /end ANNOTATION
/end CHARACTERISTIC
/begin CHARACTERISTIC DWC_EFLASHB.DWC_TorqueControl.DWC_PATcActivation.DWC_PATCDELAYTIMEHYST "" VALUE 0x8060BC56 DefaultValueRecordLayout_AUTOSAR_Platform_BaseTypes_uint16 10.0 RB_PT_PCT_SWC_DWC_CompuMethods_ratio_0p001__2 0.0 10. FORMAT "%10.5"
 /begin ANNOTATION ANNOTATION_LABEL "Description (coming from AUTOSAR DESC field)" /begin ANNOTATION_TEXT "Delay time for event A - hysteresis for event B\r\n" /end ANNOTATION_TEXT /end ANNOTATION
/end CHARACTERISTIC
/begin CHARACTERISTIC DWC_EFLASHB.DWC_TorqueControl.DWC_PATcActivation.DWC_PATCENGGRADIENTDISABLE "" VALUE 0x8060BC58 DefaultValueRecordLayout_AUTOSAR_Platform_BaseTypes_sint16 64000.0 RB_PT_PCT_SWC_DWC_CompuMethods_ident -32000. 32000. FORMAT "%10.5"
 /begin ANNOTATION ANNOTATION_LABEL "Description (coming from AUTOSAR DESC field)" /begin ANNOTATION_TEXT "Gradient target maximum for disabling TC controller\r\n" /end ANNOTATION_TEXT /end ANNOTATION
/end CHARACTERISTIC
/begin CHARACTERISTIC DWC_EFLASHB.DWC_TorqueControl.DWC_PATcActivation.DWC_PATCENGGRADIENTENABLE "" VALUE 0x8060BC5A DefaultValueRecordLayout_AUTOSAR_Platform_BaseTypes_sint16 64000.0 RB_PT_PCT_SWC_DWC_CompuMethods_ident -32000. 32000. FORMAT "%10.5"
 /begin ANNOTATION ANNOTATION_LABEL "Description (coming from AUTOSAR DESC field)" /begin ANNOTATION_TEXT "Gradient target maximum for enabling TC controller\r\n" /end ANNOTATION_TEXT /end ANNOTATION
/end CHARACTERISTIC
/begin CHARACTERISTIC DWC_EFLASHB.DWC_TorqueControl.DWC_PATcActivation.DWC_PATCENGGRADIENTENABLEHYST "" VALUE 0x8060BC5C DefaultValueRecordLayout_AUTOSAR_Platform_BaseTypes_sint16 64000.0 RB_PT_PCT_SWC_DWC_CompuMethods_ident -32000. 32000. FORMAT "%10.5"
 /begin ANNOTATION ANNOTATION_LABEL "Description (coming from AUTOSAR DESC field)"
  /begin ANNOTATION_TEXT "Gradient target maximum for enabling TC controller - hysteresis\r\n" /end ANNOTATION_TEXT
 /end ANNOTATION
/end CHARACTERISTIC
/begin CHARACTERISTIC DWC_EFLASHB.DWC_TorqueControl.DWC_PATcActivation.DWC_PATCERRORENABLE "" VALUE 0x8060BC5E DefaultValueRecordLayout_AUTOSAR_Platform_BaseTypes_sint16 4000.0 RB_PT_PCT_SWC_DWC_CompuMethods_ratio_0p1 -2000. 2000. FORMAT "%10.5"
 /begin ANNOTATION ANNOTATION_LABEL "Description (coming from AUTOSAR DESC field)" /begin ANNOTATION_TEXT "TC error to enable controller\r\n" /end ANNOTATION_TEXT /end ANNOTATION
/end CHARACTERISTIC
/begin CHARACTERISTIC DWC_EFLASHB.DWC_TorqueControl.DWC_PATcActivation.DWC_PATCERRORENABLEHYST "" VALUE 0x8060BC60 DefaultValueRecordLayout_AUTOSAR_Platform_BaseTypes_sint16 4000.0 RB_PT_PCT_SWC_DWC_CompuMethods_ratio_0p1 -2000. 2000. FORMAT "%10.5"
 /begin ANNOTATION ANNOTATION_LABEL "Description (coming from AUTOSAR DESC field)" /begin ANNOTATION_TEXT "TC error to enable controller - hysteresis\r\n" /end ANNOTATION_TEXT /end ANNOTATION
/end CHARACTERISTIC
/begin CHARACTERISTIC DWC_EFLASHB.DWC_TorqueControl.DWC_PATcActivation.DWC_PATCERRORENABLEHYSTEVB "" VALUE 0x8060BC62 DefaultValueRecordLayout_AUTOSAR_Platform_BaseTypes_sint16 4000.0 RB_PT_PCT_SWC_DWC_CompuMethods_ratio_0p1 -2000. 2000. FORMAT "%10.5"
 /begin ANNOTATION ANNOTATION_LABEL "Description (coming from AUTOSAR DESC field)"
  /begin ANNOTATION_TEXT "TC error to enable controller - hysteresis for event B\r\n" /end ANNOTATION_TEXT
 /end ANNOTATION
/end CHARACTERISTIC
/begin CHARACTERISTIC DWC_EFLASHB.DWC_TorqueControl.DWC_PATcActivation.DWC_PATCSLIPDISABLE "" VALUE 0x8060BC64 DefaultValueRecordLayout_AUTOSAR_Platform_BaseTypes_sint16 40000.0 RB_PT_PCT_SWC_DWC_CompuMethods_ident -20000. 20000. FORMAT "%10.5"
 /begin ANNOTATION ANNOTATION_LABEL "Description (coming from AUTOSAR DESC field)" /begin ANNOTATION_TEXT "Slip RPM for disabling\r\n" /end ANNOTATION_TEXT /end ANNOTATION
/end CHARACTERISTIC
/begin CHARACTERISTIC DWC_EFLASHB.DWC_TorqueControl.DWC_PATCIGAIN "" MAP 0x8060D230 RB_PT_PCT_SWC_DWC_RecordLayouts_RL_Map_uint16_16_sint16_4_sint16_4 0.15 RB_PT_PCT_SWC_DWC_CompuMethods_ratio_0p00001 0.0 0.15 FORMAT "%10.5"
 /begin ANNOTATION ANNOTATION_LABEL "Description (coming from AUTOSAR DESC field)" /begin ANNOTATION_TEXT "Integral gain of the torque controller\r\n" /end ANNOTATION_TEXT /end ANNOTATION
 /begin AXIS_DESCR STD_AXIS NO_INPUT_QUANTITY RB_PT_PCT_SWC_DWC_CompuMethods_ratio_0p1 4 -2000. 2000. FORMAT "%10.5" DEPOSIT ABSOLUTE /end AXIS_DESCR
 /begin AXIS_DESCR STD_AXIS NO_INPUT_QUANTITY RB_PT_PCT_SWC_DWC_CompuMethods_ratio_0p1 4 -2000. 2000. FORMAT "%10.5" DEPOSIT ABSOLUTE /end AXIS_DESCR
/end CHARACTERISTIC
/begin CHARACTERISTIC DWC_EFLASHB.DWC_TorqueControl.DWC_PATCLIMITDOWN "" CURVE 0x8060D264 RB_PT_PCT_SWC_DWC_RecordLayouts_RL_CurveGrouped_sint16_4_uint8_4 64000.0 RB_PT_PCT_SWC_DWC_CompuMethods_ident -32000. 32000. FORMAT "%10.5"
 /begin ANNOTATION ANNOTATION_LABEL "Description (coming from AUTOSAR DESC field)" /begin ANNOTATION_TEXT "Gradient of integrator limits - down\r\n" /end ANNOTATION_TEXT /end ANNOTATION
 /begin AXIS_DESCR COM_AXIS NO_INPUT_QUANTITY RB_PT_PCT_SWC_DWC_CompuMethods_ratio_0p4 4 0.0 102. FORMAT "%10.5" AXIS_PTS_REF DWC_EFLASHB.DWC_TorqueControl.DWC_PATPS4 DEPOSIT ABSOLUTE /end AXIS_DESCR
/end CHARACTERISTIC
/begin CHARACTERISTIC DWC_EFLASHB.DWC_TorqueControl.DWC_PATCLIMITDOWN_ALT "" CURVE 0x8060D26C RB_PT_PCT_SWC_DWC_RecordLayouts_RL_CurveGrouped_sint16_4_uint8_4 64000.0 RB_PT_PCT_SWC_DWC_CompuMethods_ident -32000. 32000. FORMAT "%10.5"
 /begin ANNOTATION ANNOTATION_LABEL "Description (coming from AUTOSAR DESC field)" /begin ANNOTATION_TEXT "Gradient of integrator limits - down\r\n" /end ANNOTATION_TEXT /end ANNOTATION
 /begin AXIS_DESCR COM_AXIS NO_INPUT_QUANTITY RB_PT_PCT_SWC_DWC_CompuMethods_ratio_0p4 4 0.0 102. FORMAT "%10.5" AXIS_PTS_REF DWC_EFLASHB.DWC_TorqueControl.DWC_PATPS4 DEPOSIT ABSOLUTE /end AXIS_DESCR
/end CHARACTERISTIC
/begin CHARACTERISTIC DWC_EFLASHB.DWC_TorqueControl.DWC_PATCLIMITDOWN_ZERO "" CURVE 0x8060D274 RB_PT_PCT_SWC_DWC_RecordLayouts_RL_CurveGrouped_sint16_4_uint8_4 64000.0 RB_PT_PCT_SWC_DWC_CompuMethods_ident -32000. 32000. FORMAT "%10.5"
 /begin ANNOTATION ANNOTATION_LABEL "Description (coming from AUTOSAR DESC field)" /begin ANNOTATION_TEXT "Gradient of integrator limits - down\r\n" /end ANNOTATION_TEXT /end ANNOTATION
 /begin AXIS_DESCR COM_AXIS NO_INPUT_QUANTITY RB_PT_PCT_SWC_DWC_CompuMethods_ratio_0p4 4 0.0 102. FORMAT "%10.5" AXIS_PTS_REF DWC_EFLASHB.DWC_TorqueControl.DWC_PATPS4 DEPOSIT ABSOLUTE /end AXIS_DESCR
/end CHARACTERISTIC
/begin CHARACTERISTIC DWC_EFLASHB.DWC_TorqueControl.DWC_PATCLIMITUP "" CURVE 0x8060D27C RB_PT_PCT_SWC_DWC_RecordLayouts_RL_CurveGrouped_sint16_4_uint8_4 64000.0 RB_PT_PCT_SWC_DWC_CompuMethods_ident -32000. 32000. FORMAT "%10.5"
 /begin ANNOTATION ANNOTATION_LABEL "Description (coming from AUTOSAR DESC field)" /begin ANNOTATION_TEXT "Gradient of integrator limits - up\r\n" /end ANNOTATION_TEXT /end ANNOTATION
 /begin AXIS_DESCR COM_AXIS NO_INPUT_QUANTITY RB_PT_PCT_SWC_DWC_CompuMethods_ratio_0p4 4 0.0 102. FORMAT "%10.5" AXIS_PTS_REF DWC_EFLASHB.DWC_TorqueControl.DWC_PATPS4 DEPOSIT ABSOLUTE /end AXIS_DESCR
/end CHARACTERISTIC
/begin CHARACTERISTIC DWC_EFLASHB.DWC_TorqueControl.DWC_PATCLIMITUP_ALT "" CURVE 0x8060D284 RB_PT_PCT_SWC_DWC_RecordLayouts_RL_CurveGrouped_sint16_4_uint8_4 64000.0 RB_PT_PCT_SWC_DWC_CompuMethods_ident -32000. 32000. FORMAT "%10.5"
 /begin ANNOTATION ANNOTATION_LABEL "Description (coming from AUTOSAR DESC field)" /begin ANNOTATION_TEXT "Gradient of integrator limits - up\r\n" /end ANNOTATION_TEXT /end ANNOTATION
 /begin AXIS_DESCR COM_AXIS NO_INPUT_QUANTITY RB_PT_PCT_SWC_DWC_CompuMethods_ratio_0p4 4 0.0 102. FORMAT "%10.5" AXIS_PTS_REF DWC_EFLASHB.DWC_TorqueControl.DWC_PATPS4 DEPOSIT ABSOLUTE /end AXIS_DESCR
/end CHARACTERISTIC
/begin CHARACTERISTIC DWC_EFLASHB.DWC_TorqueControl.DWC_PATCLIMITUP_ZERO "" CURVE 0x8060D28C RB_PT_PCT_SWC_DWC_RecordLayouts_RL_CurveGrouped_sint16_4_uint8_4 64000.0 RB_PT_PCT_SWC_DWC_CompuMethods_ident -32000. 32000. FORMAT "%10.5"
 /begin ANNOTATION ANNOTATION_LABEL "Description (coming from AUTOSAR DESC field)" /begin ANNOTATION_TEXT "Gradient of integrator limits - up\r\n" /end ANNOTATION_TEXT /end ANNOTATION
 /begin AXIS_DESCR COM_AXIS NO_INPUT_QUANTITY RB_PT_PCT_SWC_DWC_CompuMethods_ratio_0p4 4 0.0 102. FORMAT "%10.5" AXIS_PTS_REF DWC_EFLASHB.DWC_TorqueControl.DWC_PATPS4 DEPOSIT ABSOLUTE /end AXIS_DESCR
/end CHARACTERISTIC
/begin CHARACTERISTIC DWC_EFLASHB.DWC_TorqueControl.DWC_PATCMAXLIMIT "" CURVE 0x8060D294 RB_PT_PCT_SWC_DWC_RecordLayouts_RL_CurveGrouped_sint16_5_uint8_5 4000.0 RB_PT_PCT_SWC_DWC_CompuMethods_ratio_0p1 -2000. 2000. FORMAT "%10.5"
 /begin ANNOTATION ANNOTATION_LABEL "Description (coming from AUTOSAR DESC field)" /begin ANNOTATION_TEXT "Limit (max) of TC integrator\r\n" /end ANNOTATION_TEXT /end ANNOTATION
 /begin AXIS_DESCR COM_AXIS NO_INPUT_QUANTITY RB_PT_PCT_SWC_DWC_CompuMethods_ratio_0p4 5 0.0 102. FORMAT "%10.5" AXIS_PTS_REF DWC_EFLASHB.DWC_TorqueControl.DWC_PATPS5 DEPOSIT ABSOLUTE /end AXIS_DESCR
/end CHARACTERISTIC
/begin CHARACTERISTIC DWC_EFLASHB.DWC_TorqueControl.DWC_PATCMAXLIMIT_ALT "" CURVE 0x8060D29E RB_PT_PCT_SWC_DWC_RecordLayouts_RL_CurveGrouped_sint16_5_uint8_5 4000.0 RB_PT_PCT_SWC_DWC_CompuMethods_ratio_0p1 -2000. 2000. FORMAT "%10.5"
 /begin ANNOTATION ANNOTATION_LABEL "Description (coming from AUTOSAR DESC field)" /begin ANNOTATION_TEXT "Limit (max) of TC integrator\r\n" /end ANNOTATION_TEXT /end ANNOTATION
 /begin AXIS_DESCR COM_AXIS NO_INPUT_QUANTITY RB_PT_PCT_SWC_DWC_CompuMethods_ratio_0p4 5 0.0 102. FORMAT "%10.5" AXIS_PTS_REF DWC_EFLASHB.DWC_TorqueControl.DWC_PATPS5 DEPOSIT ABSOLUTE /end AXIS_DESCR
/end CHARACTERISTIC
/begin CHARACTERISTIC DWC_EFLASHB.DWC_TorqueControl.DWC_PATCMAXLIMIT_ZERO "" CURVE 0x8060D2A8 RB_PT_PCT_SWC_DWC_RecordLayouts_RL_CurveGrouped_sint16_5_uint8_5 4000.0 RB_PT_PCT_SWC_DWC_CompuMethods_ratio_0p1 -2000. 2000. FORMAT "%10.5"
 /begin ANNOTATION ANNOTATION_LABEL "Description (coming from AUTOSAR DESC field)" /begin ANNOTATION_TEXT "Limit (max) of TC integrator\r\n" /end ANNOTATION_TEXT /end ANNOTATION
 /begin AXIS_DESCR COM_AXIS NO_INPUT_QUANTITY RB_PT_PCT_SWC_DWC_CompuMethods_ratio_0p4 5 0.0 102. FORMAT "%10.5" AXIS_PTS_REF DWC_EFLASHB.DWC_TorqueControl.DWC_PATPS5 DEPOSIT ABSOLUTE /end AXIS_DESCR
/end CHARACTERISTIC
/begin CHARACTERISTIC DWC_EFLASHB.DWC_TorqueControl.DWC_PATCMINLIMIT "" CURVE 0x8060D2B2 RB_PT_PCT_SWC_DWC_RecordLayouts_RL_CurveGrouped_sint16_5_uint8_5 4000.0 RB_PT_PCT_SWC_DWC_CompuMethods_ratio_0p1 -2000. 2000. FORMAT "%10.5"
 /begin ANNOTATION ANNOTATION_LABEL "Description (coming from AUTOSAR DESC field)" /begin ANNOTATION_TEXT "Limit (min) of TC integrator\r\n" /end ANNOTATION_TEXT /end ANNOTATION
 /begin AXIS_DESCR COM_AXIS NO_INPUT_QUANTITY RB_PT_PCT_SWC_DWC_CompuMethods_ratio_0p4 5 0.0 102. FORMAT "%10.5" AXIS_PTS_REF DWC_EFLASHB.DWC_TorqueControl.DWC_PATPS5 DEPOSIT ABSOLUTE /end AXIS_DESCR
/end CHARACTERISTIC
/begin CHARACTERISTIC DWC_EFLASHB.DWC_TorqueControl.DWC_PATCMINLIMIT_ALT "" CURVE 0x8060D2BC RB_PT_PCT_SWC_DWC_RecordLayouts_RL_CurveGrouped_sint16_5_uint8_5 4000.0 RB_PT_PCT_SWC_DWC_CompuMethods_ratio_0p1 -2000. 2000. FORMAT "%10.5"
 /begin ANNOTATION ANNOTATION_LABEL "Description (coming from AUTOSAR DESC field)" /begin ANNOTATION_TEXT "Limit (min) of TC integrator\r\n" /end ANNOTATION_TEXT /end ANNOTATION
 /begin AXIS_DESCR COM_AXIS NO_INPUT_QUANTITY RB_PT_PCT_SWC_DWC_CompuMethods_ratio_0p4 5 0.0 102. FORMAT "%10.5" AXIS_PTS_REF DWC_EFLASHB.DWC_TorqueControl.DWC_PATPS5 DEPOSIT ABSOLUTE /end AXIS_DESCR
/end CHARACTERISTIC
/begin CHARACTERISTIC DWC_EFLASHB.DWC_TorqueControl.DWC_PATCMINLIMIT_ZERO "" CURVE 0x8060D2C6 RB_PT_PCT_SWC_DWC_RecordLayouts_RL_CurveGrouped_sint16_5_uint8_5 4000.0 RB_PT_PCT_SWC_DWC_CompuMethods_ratio_0p1 -2000. 2000. FORMAT "%10.5"
 /begin ANNOTATION ANNOTATION_LABEL "Description (coming from AUTOSAR DESC field)" /begin ANNOTATION_TEXT "Limit (min) of TC integrator\r\n" /end ANNOTATION_TEXT /end ANNOTATION
 /begin AXIS_DESCR COM_AXIS NO_INPUT_QUANTITY RB_PT_PCT_SWC_DWC_CompuMethods_ratio_0p4 5 0.0 102. FORMAT "%10.5" AXIS_PTS_REF DWC_EFLASHB.DWC_TorqueControl.DWC_PATPS5 DEPOSIT ABSOLUTE /end AXIS_DESCR
/end CHARACTERISTIC
/begin CHARACTERISTIC DWC_EFLASHB.DWC_TorqueControl.DWC_PATQFILTEROPENING "" MAP 0x8060D2D0 RB_PT_PCT_SWC_DWC_RecordLayouts_RL_Map_uint16_25_sint16_5_sint16_5 1.0 RB_PT_PCT_SWC_DWC_CompuMethods_ratio_0p001__2 0.0 1. FORMAT "%10.5"
 /begin ANNOTATION ANNOTATION_LABEL "Description (coming from AUTOSAR DESC field)"
  /begin ANNOTATION_TEXT "Coefficient of clutch torque reduction when opening the clutch\r\n" /end ANNOTATION_TEXT
 /end ANNOTATION
 /begin AXIS_DESCR STD_AXIS NO_INPUT_QUANTITY RB_PT_PCT_SWC_DWC_CompuMethods_ident 5 -20000. 20000. FORMAT "%10.5" DEPOSIT ABSOLUTE /end AXIS_DESCR
 /begin AXIS_DESCR STD_AXIS NO_INPUT_QUANTITY RB_PT_PCT_SWC_DWC_CompuMethods_ratio_0p1 5 0.0 2000. FORMAT "%10.5" DEPOSIT ABSOLUTE /end AXIS_DESCR
/end CHARACTERISTIC
/begin CHARACTERISTIC DWC_EFLASHB.DWC_TorqueControl.DWC_PATQFILTEROPENINGESP "" VALUE 0x8060B3FE DefaultValueRecordLayout_AUTOSAR_Platform_BaseTypes_uint16 1.0 RB_PT_PCT_SWC_DWC_CompuMethods_ratio_0p001__2 0.0 1. FORMAT "%10.5"
 /begin ANNOTATION ANNOTATION_LABEL "Description (coming from AUTOSAR DESC field)"
  /begin ANNOTATION_TEXT "Coefficient of clutch torque reduction when opening the clutch - ESP\r\n" /end ANNOTATION_TEXT
 /end ANNOTATION
/end CHARACTERISTIC
/begin CHARACTERISTIC DWC_EFLASHB.DWC_TorqueControl.DWC_PATQSLOPE1 "" CURVE 0x8060D31A RB_PT_PCT_SWC_DWC_RecordLayouts_RL_CurveGrouped_sint16_4_uint8_4 64000.0 RB_PT_PCT_SWC_DWC_CompuMethods_ident -32000. 32000. FORMAT "%10.5"
 /begin ANNOTATION ANNOTATION_LABEL "Description (coming from AUTOSAR DESC field)" /begin ANNOTATION_TEXT "Clutch torque gradient for phase 1 (prepare)\r\n" /end ANNOTATION_TEXT /end ANNOTATION
 /begin AXIS_DESCR COM_AXIS NO_INPUT_QUANTITY RB_PT_PCT_SWC_DWC_CompuMethods_ratio_0p4 4 0.0 102. FORMAT "%10.5" AXIS_PTS_REF DWC_EFLASHB.DWC_TorqueControl.DWC_PATPS4 DEPOSIT ABSOLUTE /end AXIS_DESCR
/end CHARACTERISTIC
/begin CHARACTERISTIC DWC_EFLASHB.DWC_TorqueControl.DWC_PATQSLOPE1_ALT "" CURVE 0x8060D322 RB_PT_PCT_SWC_DWC_RecordLayouts_RL_CurveGrouped_sint16_4_uint8_4 64000.0 RB_PT_PCT_SWC_DWC_CompuMethods_ident -32000. 32000. FORMAT "%10.5"
 /begin ANNOTATION ANNOTATION_LABEL "Description (coming from AUTOSAR DESC field)" /begin ANNOTATION_TEXT "Clutch torque gradient for phase 1 (prepare)\r\n" /end ANNOTATION_TEXT /end ANNOTATION
 /begin AXIS_DESCR COM_AXIS NO_INPUT_QUANTITY RB_PT_PCT_SWC_DWC_CompuMethods_ratio_0p4 4 0.0 102. FORMAT "%10.5" AXIS_PTS_REF DWC_EFLASHB.DWC_TorqueControl.DWC_PATPS4 DEPOSIT ABSOLUTE /end AXIS_DESCR
/end CHARACTERISTIC
/begin CHARACTERISTIC DWC_EFLASHB.DWC_TorqueControl.DWC_PATQSLOPE1_ZERO "" CURVE 0x8060D32A RB_PT_PCT_SWC_DWC_RecordLayouts_RL_CurveGrouped_sint16_4_uint8_4 64000.0 RB_PT_PCT_SWC_DWC_CompuMethods_ident -32000. 32000. FORMAT "%10.5"
 /begin ANNOTATION ANNOTATION_LABEL "Description (coming from AUTOSAR DESC field)" /begin ANNOTATION_TEXT "Clutch torque gradient for phase 1 (prepare)\r\n" /end ANNOTATION_TEXT /end ANNOTATION
 /begin AXIS_DESCR COM_AXIS NO_INPUT_QUANTITY RB_PT_PCT_SWC_DWC_CompuMethods_ratio_0p4 4 0.0 102. FORMAT "%10.5" AXIS_PTS_REF DWC_EFLASHB.DWC_TorqueControl.DWC_PATPS4 DEPOSIT ABSOLUTE /end AXIS_DESCR
/end CHARACTERISTIC
/begin CHARACTERISTIC DWC_EFLASHB.DWC_TorqueControl.DWC_PATQSLOPE2 "" CURVE 0x8060D332 RB_PT_PCT_SWC_DWC_RecordLayouts_RL_CurveGrouped_sint16_11_uint8_11 64000.0 RB_PT_PCT_SWC_DWC_CompuMethods_ident -32000. 32000. FORMAT "%10.5"
 /begin ANNOTATION ANNOTATION_LABEL "Description (coming from AUTOSAR DESC field)" /begin ANNOTATION_TEXT "Gradient of target torque\r\n" /end ANNOTATION_TEXT /end ANNOTATION
 /begin AXIS_DESCR COM_AXIS NO_INPUT_QUANTITY RB_PT_PCT_SWC_DWC_CompuMethods_ratio_0p4 11 0.0 102. FORMAT "%10.5" AXIS_PTS_REF DWC_EFLASHB.DWC_TorqueControl.DWC_PATPS11 DEPOSIT ABSOLUTE /end AXIS_DESCR
/end CHARACTERISTIC
/begin CHARACTERISTIC DWC_EFLASHB.DWC_TorqueControl.DWC_PATQSLOPE2_ALT "" CURVE 0x8060D348 RB_PT_PCT_SWC_DWC_RecordLayouts_RL_CurveGrouped_sint16_11_uint8_11 64000.0 RB_PT_PCT_SWC_DWC_CompuMethods_ident -32000. 32000. FORMAT "%10.5"
 /begin ANNOTATION ANNOTATION_LABEL "Description (coming from AUTOSAR DESC field)" /begin ANNOTATION_TEXT "Gradient of target torque\r\n" /end ANNOTATION_TEXT /end ANNOTATION
 /begin AXIS_DESCR COM_AXIS NO_INPUT_QUANTITY RB_PT_PCT_SWC_DWC_CompuMethods_ratio_0p4 11 0.0 102. FORMAT "%10.5" AXIS_PTS_REF DWC_EFLASHB.DWC_TorqueControl.DWC_PATPS11 DEPOSIT ABSOLUTE /end AXIS_DESCR
/end CHARACTERISTIC
/begin CHARACTERISTIC DWC_EFLASHB.DWC_TorqueControl.DWC_PATQSLOPE2_ZERO "" CURVE 0x8060D35E RB_PT_PCT_SWC_DWC_RecordLayouts_RL_CurveGrouped_sint16_11_uint8_11 64000.0 RB_PT_PCT_SWC_DWC_CompuMethods_ident -32000. 32000. FORMAT "%10.5"
 /begin ANNOTATION ANNOTATION_LABEL "Description (coming from AUTOSAR DESC field)" /begin ANNOTATION_TEXT "Gradient of target torque\r\n" /end ANNOTATION_TEXT /end ANNOTATION
 /begin AXIS_DESCR COM_AXIS NO_INPUT_QUANTITY RB_PT_PCT_SWC_DWC_CompuMethods_ratio_0p4 11 0.0 102. FORMAT "%10.5" AXIS_PTS_REF DWC_EFLASHB.DWC_TorqueControl.DWC_PATPS11 DEPOSIT ABSOLUTE /end AXIS_DESCR
/end CHARACTERISTIC
/begin CHARACTERISTIC DWC_EFLASHB.DWC_TorqueControl.DWC_PATQSLOPE3 "" CURVE 0x8060D374 RB_PT_PCT_SWC_DWC_RecordLayouts_RL_CurveGrouped_sint16_11_uint8_11 64000.0 RB_PT_PCT_SWC_DWC_CompuMethods_ident -32000. 32000. FORMAT "%10.5"
 /begin ANNOTATION ANNOTATION_LABEL "Description (coming from AUTOSAR DESC field)" /begin ANNOTATION_TEXT "Gradient of target torque\r\n" /end ANNOTATION_TEXT /end ANNOTATION
 /begin AXIS_DESCR COM_AXIS NO_INPUT_QUANTITY RB_PT_PCT_SWC_DWC_CompuMethods_ratio_0p4 11 0.0 102. FORMAT "%10.5" AXIS_PTS_REF DWC_EFLASHB.DWC_TorqueControl.DWC_PATPS11 DEPOSIT ABSOLUTE /end AXIS_DESCR
/end CHARACTERISTIC
/begin CHARACTERISTIC DWC_EFLASHB.DWC_TorqueControl.DWC_PATQSLOPE3_ALT "" CURVE 0x8060D38A RB_PT_PCT_SWC_DWC_RecordLayouts_RL_CurveGrouped_sint16_11_uint8_11 64000.0 RB_PT_PCT_SWC_DWC_CompuMethods_ident -32000. 32000. FORMAT "%10.5"
 /begin ANNOTATION ANNOTATION_LABEL "Description (coming from AUTOSAR DESC field)" /begin ANNOTATION_TEXT "Gradient of target torque\r\n" /end ANNOTATION_TEXT /end ANNOTATION
 /begin AXIS_DESCR COM_AXIS NO_INPUT_QUANTITY RB_PT_PCT_SWC_DWC_CompuMethods_ratio_0p4 11 0.0 102. FORMAT "%10.5" AXIS_PTS_REF DWC_EFLASHB.DWC_TorqueControl.DWC_PATPS11 DEPOSIT ABSOLUTE /end AXIS_DESCR
/end CHARACTERISTIC
/begin CHARACTERISTIC DWC_EFLASHB.DWC_TorqueControl.DWC_PATQSLOPE3_ZERO "" CURVE 0x8060D3A0 RB_PT_PCT_SWC_DWC_RecordLayouts_RL_CurveGrouped_sint16_11_uint8_11 64000.0 RB_PT_PCT_SWC_DWC_CompuMethods_ident -32000. 32000. FORMAT "%10.5"
 /begin ANNOTATION ANNOTATION_LABEL "Description (coming from AUTOSAR DESC field)" /begin ANNOTATION_TEXT "Gradient of target torque\r\n" /end ANNOTATION_TEXT /end ANNOTATION
 /begin AXIS_DESCR COM_AXIS NO_INPUT_QUANTITY RB_PT_PCT_SWC_DWC_CompuMethods_ratio_0p4 11 0.0 102. FORMAT "%10.5" AXIS_PTS_REF DWC_EFLASHB.DWC_TorqueControl.DWC_PATPS11 DEPOSIT ABSOLUTE /end AXIS_DESCR
/end CHARACTERISTIC
/begin CHARACTERISTIC DWC_EFLASHB.DWC_TorqueControl.DWC_PATQSLOPESWITCHPOINT "" CURVE 0x8060D3B6 RB_PT_PCT_SWC_DWC_RecordLayouts_RL_CurveGrouped_uint8_5_uint8_5 1.0 RB_PT_PCT_SWC_DWC_CompuMethods_ratio_0p01 0.0 1. FORMAT "%10.5"
 /begin ANNOTATION ANNOTATION_LABEL "Description (coming from AUTOSAR DESC field)"
  /begin ANNOTATION_TEXT "Factor of PAFinalClutchTargetTq for slope switch point\r\n" /end ANNOTATION_TEXT
 /end ANNOTATION
 /begin AXIS_DESCR COM_AXIS NO_INPUT_QUANTITY RB_PT_PCT_SWC_DWC_CompuMethods_ratio_0p4 5 0.0 102. FORMAT "%10.5" AXIS_PTS_REF DWC_EFLASHB.DWC_TorqueControl.DWC_PATPS5 DEPOSIT ABSOLUTE /end AXIS_DESCR
/end CHARACTERISTIC
/begin CHARACTERISTIC DWC_EFLASHB.DWC_TorqueControl.DWC_PATQSLOPESWITCHPOINT_ALT "" CURVE 0x8060D3BC RB_PT_PCT_SWC_DWC_RecordLayouts_RL_CurveGrouped_uint8_5_uint8_5 1.0 RB_PT_PCT_SWC_DWC_CompuMethods_ratio_0p01 0.0 1. FORMAT "%10.5"
 /begin ANNOTATION ANNOTATION_LABEL "Description (coming from AUTOSAR DESC field)"
  /begin ANNOTATION_TEXT "Factor of PAFinalClutchTargetTq for slope switch point\r\n" /end ANNOTATION_TEXT
 /end ANNOTATION
 /begin AXIS_DESCR COM_AXIS NO_INPUT_QUANTITY RB_PT_PCT_SWC_DWC_CompuMethods_ratio_0p4 5 0.0 102. FORMAT "%10.5" AXIS_PTS_REF DWC_EFLASHB.DWC_TorqueControl.DWC_PATPS5 DEPOSIT ABSOLUTE /end AXIS_DESCR
/end CHARACTERISTIC
/begin CHARACTERISTIC DWC_EFLASHB.DWC_TorqueControl.DWC_PATQSLOPESWITCHPOINT_ZERO "" CURVE 0x8060D3C2 RB_PT_PCT_SWC_DWC_RecordLayouts_RL_CurveGrouped_uint8_5_uint8_5 1.0 RB_PT_PCT_SWC_DWC_CompuMethods_ratio_0p01 0.0 1. FORMAT "%10.5"
 /begin ANNOTATION ANNOTATION_LABEL "Description (coming from AUTOSAR DESC field)"
  /begin ANNOTATION_TEXT "Factor of PAFinalClutchTargetTq for slope switch point\r\n" /end ANNOTATION_TEXT
 /end ANNOTATION
 /begin AXIS_DESCR COM_AXIS NO_INPUT_QUANTITY RB_PT_PCT_SWC_DWC_CompuMethods_ratio_0p4 5 0.0 102. FORMAT "%10.5" AXIS_PTS_REF DWC_EFLASHB.DWC_TorqueControl.DWC_PATPS5 DEPOSIT ABSOLUTE /end AXIS_DESCR
/end CHARACTERISTIC
/begin CHARACTERISTIC DWC_EFLASHB.DWC_TorqueControl.DWC_PAUSEDOUTPUTDECELOFFSET "" VALUE 0x8060B4BC DefaultValueRecordLayout_AUTOSAR_Platform_BaseTypes_boolean 255.0 AUTOSAR_Platform_CompuMethods_boolean 0.0 255. FORMAT "%10.5"
 /begin ANNOTATION ANNOTATION_LABEL "Description (coming from AUTOSAR DESC field)"
  /begin ANNOTATION_TEXT "Flag indicating that decel offset should be based on dOutput speed not dEngine speed\r\n" /end ANNOTATION_TEXT
 /end ANNOTATION
/end CHARACTERISTIC
/begin CHARACTERISTIC DWC_EFLASHB.DWC_TorqueControl.DWC_PAUSESYNCGRADSLOPE3 "" VALUE 0x8060B4BD DefaultValueRecordLayout_AUTOSAR_Platform_BaseTypes_boolean 255.0 AUTOSAR_Platform_CompuMethods_boolean 0.0 255. FORMAT "%10.5"
 /begin ANNOTATION ANNOTATION_LABEL "Description (coming from AUTOSAR DESC field)"
  /begin ANNOTATION_TEXT "Flag requesting that resync speed gradient is used for slope 3 (not driveline gradient)\r\n" /end ANNOTATION_TEXT
 /end ANNOTATION
/end CHARACTERISTIC
/begin CHARACTERISTIC DWC_EFLASHB.DWC_TorqueControl.DWC_POWERONDOWNFAILTIMEOUT "" VALUE 0x8060B400 DefaultValueRecordLayout_AUTOSAR_Platform_BaseTypes_uint16 10.0 RB_PT_PCT_SWC_DWC_CompuMethods_ratio_0p001__2 0.0 10. FORMAT "%10.5"
 /begin ANNOTATION ANNOTATION_LABEL "Description (coming from AUTOSAR DESC field)"
  /begin ANNOTATION_TEXT "Timeout for power on down shifts - in poor gradient conditions\r\n" /end ANNOTATION_TEXT
 /end ANNOTATION
/end CHARACTERISTIC
/begin CHARACTERISTIC DWC_EFLASHB.DWC_TorqueControl.DWC_POWERONDOWNTORQUEDOWNVSERRORTQ "" MAP 0x8060D3C8 RB_PT_PCT_SWC_DWC_RecordLayouts_RL_Map_uint16_25_sint16_5_sint16_5 2000.0 RB_PT_PCT_SWC_DWC_CompuMethods_ratio_0p1 0.0 2000. FORMAT "%10.5"
 /begin ANNOTATION ANNOTATION_LABEL "Description (coming from AUTOSAR DESC field)"
  /begin ANNOTATION_TEXT "Requested torque down vs slip error and engine torque\r\n" /end ANNOTATION_TEXT
 /end ANNOTATION
 /begin AXIS_DESCR STD_AXIS NO_INPUT_QUANTITY RB_PT_PCT_SWC_DWC_CompuMethods_ident 5 -20000. 20000. FORMAT "%10.5" DEPOSIT ABSOLUTE /end AXIS_DESCR
 /begin AXIS_DESCR STD_AXIS NO_INPUT_QUANTITY RB_PT_PCT_SWC_DWC_CompuMethods_ratio_0p1 5 -2000. 2000. FORMAT "%10.5" DEPOSIT ABSOLUTE /end AXIS_DESCR
/end CHARACTERISTIC
/begin CHARACTERISTIC DWC_EFLASHB.DWC_TorqueControl.DWC_POWERONDOWNTORQUEHYST "" VALUE 0x8060B402 DefaultValueRecordLayout_AUTOSAR_Platform_BaseTypes_uint16 2000.0 RB_PT_PCT_SWC_DWC_CompuMethods_ratio_0p1 0.0 2000. FORMAT "%10.5"
 /begin ANNOTATION ANNOTATION_LABEL "Description (coming from AUTOSAR DESC field)" /begin ANNOTATION_TEXT "Hysterisis of power on/off down decision\r\n" /end ANNOTATION_TEXT /end ANNOTATION
/end CHARACTERISTIC
/begin CHARACTERISTIC DWC_EFLASHB.DWC_TorqueControl.DWC_PREBYPASSPARTIALCONDSTEADY "" VALUE 0x8060B4BE DefaultValueRecordLayout_AUTOSAR_Platform_BaseTypes_boolean 255.0 AUTOSAR_Platform_CompuMethods_boolean 0.0 255. FORMAT "%10.5"
 /begin ANNOTATION ANNOTATION_LABEL "Description (coming from AUTOSAR DESC field)"
  /begin ANNOTATION_TEXT "Flag to bypass partial adaption conditions for driver steady rule\r\n" /end ANNOTATION_TEXT
 /end ANNOTATION
/end CHARACTERISTIC
/begin CHARACTERISTIC DWC_EFLASHB.DWC_TorqueControl.DWC_PREDEFAULTIDLESPEED "" VALUE 0x8060B404 DefaultValueRecordLayout_AUTOSAR_Platform_BaseTypes_uint16 20000.0 RB_PT_PCT_SWC_DWC_CompuMethods_ident 0.0 20000. FORMAT "%10.5"
 /begin ANNOTATION ANNOTATION_LABEL "Description (coming from AUTOSAR DESC field)" /begin ANNOTATION_TEXT "Engine nominal idle speed\r\n" /end ANNOTATION_TEXT /end ANNOTATION
/end CHARACTERISTIC
/begin CHARACTERISTIC DWC_EFLASHB.DWC_TorqueControl.DWC_PREDELTAPEDALMAXSTEADY "" VALUE 0x8060B406 DefaultValueRecordLayout_AUTOSAR_Platform_BaseTypes_uint16 2000.0 RB_PT_PCT_SWC_DWC_CompuMethods_ident 0.0 2000. FORMAT "%10.5"
 /begin ANNOTATION ANNOTATION_LABEL "Description (coming from AUTOSAR DESC field)" /begin ANNOTATION_TEXT "Maximum rate of change of pedal for steady driving\r\n" /end ANNOTATION_TEXT /end ANNOTATION
/end CHARACTERISTIC
/begin CHARACTERISTIC DWC_EFLASHB.DWC_TorqueControl.DWC_PREDENGINETORQUEMAXSTEADY "" VALUE 0x8060B408 DefaultValueRecordLayout_AUTOSAR_Platform_BaseTypes_uint16 10000.0 RB_PT_PCT_SWC_DWC_CompuMethods_ident 0.0 10000. FORMAT "%10.5"
 /begin ANNOTATION ANNOTATION_LABEL "Description (coming from AUTOSAR DESC field)"
  /begin ANNOTATION_TEXT "Maximum rate of change of engine torque for steady driving\r\n" /end ANNOTATION_TEXT
 /end ANNOTATION
/end CHARACTERISTIC
/begin CHARACTERISTIC DWC_EFLASHB.DWC_TorqueControl.DWC_PREHIGHIDLECORRECTMAX "" VALUE 0x8060B40A DefaultValueRecordLayout_AUTOSAR_Platform_BaseTypes_uint16 20000.0 RB_PT_PCT_SWC_DWC_CompuMethods_ident 0.0 20000. FORMAT "%10.5"
 /begin ANNOTATION ANNOTATION_LABEL "Description (coming from AUTOSAR DESC field)" /begin ANNOTATION_TEXT "Maximum RPM correction allowed for fast idle\r\n" /end ANNOTATION_TEXT /end ANNOTATION
/end CHARACTERISTIC
/begin CHARACTERISTIC DWC_EFLASHB.DWC_TorqueControl.DWC_PRELatAccFilter.DWC_FIRSTORDERLPCOEFF "" VALUE 0x8060BC66 DefaultValueRecordLayout_AUTOSAR_Platform_BaseTypes_uint8 1.0 RB_PT_PCT_SWC_DWC_CompuMethods_ratio_0p01 0.0 1. FORMAT "%10.5"
 /begin ANNOTATION ANNOTATION_LABEL "Description (coming from AUTOSAR DESC field)" /begin ANNOTATION_TEXT "Coefficient for low pass IIR filter\r\n" /end ANNOTATION_TEXT /end ANNOTATION
/end CHARACTERISTIC
/begin CHARACTERISTIC DWC_EFLASHB.DWC_TorqueControl.DWC_PRELATACCMAXSTEADY "" VALUE 0x8060B4BF DefaultValueRecordLayout_AUTOSAR_Platform_BaseTypes_uint8 1.27 RB_PT_PCT_SWC_DWC_CompuMethods_ratio_0p01 0.0 1.27 FORMAT "%10.5"
 /begin ANNOTATION ANNOTATION_LABEL "Description (coming from AUTOSAR DESC field)" /begin ANNOTATION_TEXT "Maximum lateral acceleration for steady driving\r\n" /end ANNOTATION_TEXT /end ANNOTATION
/end CHARACTERISTIC
/begin CHARACTERISTIC DWC_EFLASHB.DWC_TorqueControl.DWC_PREPEDALMAXSTEADY "" VALUE 0x8060B4C0 DefaultValueRecordLayout_AUTOSAR_Platform_BaseTypes_uint8 102.0 RB_PT_PCT_SWC_DWC_CompuMethods_ratio_0p4 0.0 102. FORMAT "%10.5"
 /begin ANNOTATION ANNOTATION_LABEL "Description (coming from AUTOSAR DESC field)" /begin ANNOTATION_TEXT "Maximum pedal for steady driving\r\n" /end ANNOTATION_TEXT /end ANNOTATION
/end CHARACTERISTIC
/begin CHARACTERISTIC DWC_EFLASHB.DWC_TorqueControl.DWC_PREPEDALMINSTEADY "" VALUE 0x8060B4C1 DefaultValueRecordLayout_AUTOSAR_Platform_BaseTypes_uint8 102.0 RB_PT_PCT_SWC_DWC_CompuMethods_ratio_0p4 0.0 102. FORMAT "%10.5"
 /begin ANNOTATION ANNOTATION_LABEL "Description (coming from AUTOSAR DESC field)" /begin ANNOTATION_TEXT "Minimum pedal for steady driving\r\n" /end ANNOTATION_TEXT /end ANNOTATION
/end CHARACTERISTIC
/begin CHARACTERISTIC DWC_EFLASHB.DWC_TorqueControl.DWC_PRESTEADYGOODTIMEVSMODE "" VAL_BLK 0x8060B318 DefaultValueRecordLayout_AUTOSAR_Platform_BaseTypes_uint16 65.53 RB_PT_PCT_SWC_DWC_CompuMethods_ratio_0p001__2 0.0 65.53 FORMAT "%10.5"
 /begin ANNOTATION ANNOTATION_LABEL "Description (coming from AUTOSAR DESC field)"
  /begin ANNOTATION_TEXT "Time for driver steady before lockup can be removed (vs mode)\r\n" /end ANNOTATION_TEXT
 /end ANNOTATION
 MATRIX_DIM 8 1 1 /end CHARACTERISTIC
/begin CHARACTERISTIC DWC_EFLASHB.DWC_TorqueControl.DWC_PRESWBRAKETHRES "" VALUE 0x8060B40C DefaultValueRecordLayout_AUTOSAR_Platform_BaseTypes_uint16 409.5 RB_PT_PCT_SWC_DWC_CompuMethods_ratio_0p1 0.0 409.5 FORMAT "%10.5"
 /begin ANNOTATION ANNOTATION_LABEL "Description (coming from AUTOSAR DESC field)" /begin ANNOTATION_TEXT "Brake pressure for slipping wheels request\r\n" /end ANNOTATION_TEXT /end ANNOTATION
/end CHARACTERISTIC
/begin CHARACTERISTIC DWC_EFLASHB.DWC_TorqueControl.DWC_PRESWDTHROTTLEDEBOUNCE "" VALUE 0x8060B40E DefaultValueRecordLayout_AUTOSAR_Platform_BaseTypes_uint16 10.0 RB_PT_PCT_SWC_DWC_CompuMethods_ratio_0p001__2 0.0 10. FORMAT "%10.5"
 /begin ANNOTATION ANNOTATION_LABEL "Description (coming from AUTOSAR DESC field)"
  /begin ANNOTATION_TEXT "Debounce time for rate of change of throttle input to slipping wheels request\r\n" /end ANNOTATION_TEXT
 /end ANNOTATION
/end CHARACTERISTIC
/begin CHARACTERISTIC DWC_EFLASHB.DWC_TorqueControl.DWC_PRESWdThrottleMonostable.DWC_DELAYTIME "" VALUE 0x8060BC68 DefaultValueRecordLayout_AUTOSAR_Platform_BaseTypes_uint16 10.0 RB_PT_PCT_SWC_DWC_CompuMethods_ratio_0p001__2 0.0 10. FORMAT "%10.5"
 /begin ANNOTATION ANNOTATION_LABEL "Description (coming from AUTOSAR DESC field)" /begin ANNOTATION_TEXT "Event delay time\r\n" /end ANNOTATION_TEXT /end ANNOTATION
/end CHARACTERISTIC
/begin CHARACTERISTIC DWC_EFLASHB.DWC_TorqueControl.DWC_PRESWDTHROTTLETHRES "" VALUE 0x8060B410 DefaultValueRecordLayout_AUTOSAR_Platform_BaseTypes_sint16 4000.0 RB_PT_PCT_SWC_DWC_CompuMethods_ident -2000. 2000. FORMAT "%10.5"
 /begin ANNOTATION ANNOTATION_LABEL "Description (coming from AUTOSAR DESC field)"
  /begin ANNOTATION_TEXT "Throttle percent rate of change for slipping wheels trigger\r\n" /end ANNOTATION_TEXT
 /end ANNOTATION
/end CHARACTERISTIC
/begin CHARACTERISTIC DWC_EFLASHB.DWC_TorqueControl.DWC_PRESWMINTORQUEMAXPCCU "" VALUE 0x8060B412 DefaultValueRecordLayout_AUTOSAR_Platform_BaseTypes_uint16 2000.0 RB_PT_PCT_SWC_DWC_CompuMethods_ratio_0p1 0.0 2000. FORMAT "%10.5"
 /begin ANNOTATION ANNOTATION_LABEL "Description (coming from AUTOSAR DESC field)"
  /begin ANNOTATION_TEXT "Min maximum engine torque to allow slipping wheel launch\r\n" /end ANNOTATION_TEXT
 /end ANNOTATION
/end CHARACTERISTIC
/begin CHARACTERISTIC DWC_EFLASHB.DWC_TorqueControl.DWC_PRESWMODEFORAVAIL "" VAL_BLK 0x8060B328 DefaultValueRecordLayout_AUTOSAR_Platform_BaseTypes_boolean 255.0 AUTOSAR_Platform_CompuMethods_boolean 0.0 255. FORMAT "%10.5"
 /begin ANNOTATION ANNOTATION_LABEL "Description (coming from AUTOSAR DESC field)"
  /begin ANNOTATION_TEXT "Flag indicating availablity of slipping wheels launch vs DWC mode\r\n" /end ANNOTATION_TEXT
 /end ANNOTATION
 MATRIX_DIM 8 1 1 /end CHARACTERISTIC
/begin CHARACTERISTIC DWC_EFLASHB.DWC_TorqueControl.DWC_PRESWPBRAKEABORT "" VALUE 0x8060B414 DefaultValueRecordLayout_AUTOSAR_Platform_BaseTypes_uint16 409.5 RB_PT_PCT_SWC_DWC_CompuMethods_ratio_0p1 0.0 409.5 FORMAT "%10.5"
 /begin ANNOTATION ANNOTATION_LABEL "Description (coming from AUTOSAR DESC field)" /begin ANNOTATION_TEXT "Brake pressure for slipping wheels abort\r\n" /end ANNOTATION_TEXT /end ANNOTATION
/end CHARACTERISTIC
/begin CHARACTERISTIC DWC_EFLASHB.DWC_TorqueControl.DWC_PRESWTHROTTLEABORT "" VALUE 0x8060B4C2 DefaultValueRecordLayout_AUTOSAR_Platform_BaseTypes_uint8 102.0 RB_PT_PCT_SWC_DWC_CompuMethods_ratio_0p4 0.0 102. FORMAT "%10.5"
 /begin ANNOTATION ANNOTATION_LABEL "Description (coming from AUTOSAR DESC field)" /begin ANNOTATION_TEXT "Throttle percent for slipping wheels abort\r\n" /end ANNOTATION_TEXT /end ANNOTATION
/end CHARACTERISTIC
/begin CHARACTERISTIC DWC_EFLASHB.DWC_TorqueControl.DWC_PRESWTHROTTLETHRES "" VALUE 0x8060B4C3 DefaultValueRecordLayout_AUTOSAR_Platform_BaseTypes_uint8 102.0 RB_PT_PCT_SWC_DWC_CompuMethods_ratio_0p4 0.0 102. FORMAT "%10.5"
 /begin ANNOTATION ANNOTATION_LABEL "Description (coming from AUTOSAR DESC field)" /begin ANNOTATION_TEXT "Throttle percent for slipping wheels enable\r\n" /end ANNOTATION_TEXT /end ANNOTATION
/end CHARACTERISTIC
/begin CHARACTERISTIC DWC_EFLASHB.DWC_TorqueControl.DWC_PRESWVREFTHRES "" VALUE 0x8060B416 DefaultValueRecordLayout_AUTOSAR_Platform_BaseTypes_sint16 20.0 RB_PT_PCT_SWC_DWC_CompuMethods_ratio_0p01 0.0 20. FORMAT "%10.5"
 /begin ANNOTATION ANNOTATION_LABEL "Description (coming from AUTOSAR DESC field)"
  /begin ANNOTATION_TEXT "Creep actual speed, below which spinning wheels launch is allowed\r\n" /end ANNOTATION_TEXT
 /end ANNOTATION
/end CHARACTERISTIC
/begin CHARACTERISTIC DWC_EFLASHB.DWC_TorqueControl.DWC_PREUPSHIFTCOMINGFACTOR "" MAP 0x8060D412 RB_PT_PCT_SWC_DWC_RecordLayouts_RL_Map_uint16_49_uint16_7_sint16_7 1.0 RB_PT_PCT_SWC_DWC_CompuMethods_ratio_0p001__2 0.0 1. FORMAT "%10.5"
 /begin ANNOTATION ANNOTATION_LABEL "Description (coming from AUTOSAR DESC field)"
  /begin ANNOTATION_TEXT "Factor of coming clutch torque to use during torque phase/speed phase for up shifts\r\n" /end ANNOTATION_TEXT
 /end ANNOTATION
 /begin AXIS_DESCR STD_AXIS NO_INPUT_QUANTITY RB_PT_PCT_SWC_DWC_CompuMethods_ident 7 0.0 20000. FORMAT "%10.5" DEPOSIT ABSOLUTE /end AXIS_DESCR
 /begin AXIS_DESCR STD_AXIS NO_INPUT_QUANTITY RB_PT_PCT_SWC_DWC_CompuMethods_ratio_0p1 7 -2000. 2000. FORMAT "%10.5" DEPOSIT ABSOLUTE /end AXIS_DESCR
/end CHARACTERISTIC
/begin CHARACTERISTIC DWC_EFLASHB.DWC_TorqueControl.DWC_PREUPSHIFTCOMINGFACTORGEAR "" VAL_BLK 0x8060B2E8 DefaultValueRecordLayout_AUTOSAR_Platform_BaseTypes_uint16 1.0 RB_PT_PCT_SWC_DWC_CompuMethods_ratio_0p001__2 0.0 1. FORMAT "%10.5"
 /begin ANNOTATION ANNOTATION_LABEL "Description (coming from AUTOSAR DESC field)" /begin ANNOTATION_TEXT "Gear factor for coming clutch during upshifts\r\n" /end ANNOTATION_TEXT /end ANNOTATION
 MATRIX_DIM 12 1 1 /end CHARACTERISTIC
/begin CHARACTERISTIC DWC_EFLASHB.DWC_TorqueControl.DWC_PREUPSHIFTCOMINGMODEPUSH "" MAP 0x8060D494 RB_PT_PCT_SWC_DWC_RecordLayouts_RL_Map_uint16_24_uint16_8_uint16_3 1.0 RB_PT_PCT_SWC_DWC_CompuMethods_ratio_0p001__2 0.0 1. FORMAT "%10.5"
 /begin ANNOTATION ANNOTATION_LABEL "Description (coming from AUTOSAR DESC field)"
  /begin ANNOTATION_TEXT "Factor for upshift coming use based on mode and push request (0.0 = no underclamp, 1.0 = full underclamp)\r\n" /end ANNOTATION_TEXT
 /end ANNOTATION
 /begin AXIS_DESCR STD_AXIS NO_INPUT_QUANTITY RB_PT_PCT_SWC_DWC_CompuMethods_ident 8 0.0 7. FORMAT "%10.5" DEPOSIT ABSOLUTE /end AXIS_DESCR
 /begin AXIS_DESCR STD_AXIS NO_INPUT_QUANTITY RB_PT_PCT_SWC_DWC_CompuMethods_ratio_0p001__2 3 0.0 1. FORMAT "%10.5" DEPOSIT ABSOLUTE /end AXIS_DESCR
/end CHARACTERISTIC
/begin CHARACTERISTIC DWC_EFLASHB.DWC_TorqueControl.DWC_PREUSEMINIDLEINIDLESPEED "" VALUE 0x8060B4C4 DefaultValueRecordLayout_AUTOSAR_Platform_BaseTypes_boolean 255.0 AUTOSAR_Platform_CompuMethods_boolean 0.0 255. FORMAT "%10.5"
 /begin ANNOTATION ANNOTATION_LABEL "Description (coming from AUTOSAR DESC field)"
  /begin ANNOTATION_TEXT "Flag to use min idle request input MAXED with idle speed\r\n" /end ANNOTATION_TEXT
 /end ANNOTATION
/end CHARACTERISTIC
/begin CHARACTERISTIC DWC_EFLASHB.DWC_TorqueControl.DWC_RPMANTISTALLACTIVE "" VALUE 0x8060B418 DefaultValueRecordLayout_AUTOSAR_Platform_BaseTypes_uint16 20000.0 RB_PT_PCT_SWC_DWC_CompuMethods_ident 0.0 20000. FORMAT "%10.5"
 /begin ANNOTATION ANNOTATION_LABEL "Description (coming from AUTOSAR DESC field)" /begin ANNOTATION_TEXT "RPM at which the hard anti-stall is activated\r\n" /end ANNOTATION_TEXT /end ANNOTATION
/end CHARACTERISTIC
/begin CHARACTERISTIC DWC_EFLASHB.DWC_TorqueControl.DWC_RPMANTISTALLCANCEL "" VALUE 0x8060B41A DefaultValueRecordLayout_AUTOSAR_Platform_BaseTypes_uint16 20000.0 RB_PT_PCT_SWC_DWC_CompuMethods_ident 0.0 20000. FORMAT "%10.5"
 /begin ANNOTATION ANNOTATION_LABEL "Description (coming from AUTOSAR DESC field)" /begin ANNOTATION_TEXT "RPM at which the hard anti-stall is activated\r\n" /end ANNOTATION_TEXT /end ANNOTATION
/end CHARACTERISTIC
/begin CHARACTERISTIC DWC_EFLASHB.DWC_TorqueControl.DWC_SHIFTTYPEINDEXECO "" VALUE 0x8060B4C5 DefaultValueRecordLayout_AUTOSAR_Platform_BaseTypes_sint8 2.0 RB_PT_PCT_SWC_DWC_CompuMethods_ratio_0p01 -1. 1. FORMAT "%10.5"
 /begin ANNOTATION ANNOTATION_LABEL "Description (coming from AUTOSAR DESC field)"
  /begin ANNOTATION_TEXT "Shift type index to apply for ECO mode power-on upshifts\r\n" /end ANNOTATION_TEXT
 /end ANNOTATION
/end CHARACTERISTIC
/begin CHARACTERISTIC DWC_EFLASHB.DWC_TorqueControl.DWC_SHIFTTYPEINDEXLAUNCH "" VALUE 0x8060B4C6 DefaultValueRecordLayout_AUTOSAR_Platform_BaseTypes_sint8 2.0 RB_PT_PCT_SWC_DWC_CompuMethods_ratio_0p01 -1. 1. FORMAT "%10.5"
 /begin ANNOTATION ANNOTATION_LABEL "Description (coming from AUTOSAR DESC field)"
  /begin ANNOTATION_TEXT "Shift type index to apply for ECO mode power-on upshifts\r\n" /end ANNOTATION_TEXT
 /end ANNOTATION
/end CHARACTERISTIC
/begin CHARACTERISTIC DWC_EFLASHB.DWC_TorqueControl.DWC_SHIFTTYPEINDEXMAP1 "" MAP 0x8060D4DE RB_PT_PCT_SWC_DWC_RecordLayouts_RL_Map_sint8_70_uint16_7_sint8_10 2.0 RB_PT_PCT_SWC_DWC_CompuMethods_ratio_0p01 -1. 1. FORMAT "%10.5"
 /begin ANNOTATION ANNOTATION_LABEL "Description (coming from AUTOSAR DESC field)"
  /begin ANNOTATION_TEXT "Map of shift type index vs. engine speed and aggression\r\n" /end ANNOTATION_TEXT
 /end ANNOTATION
 /begin AXIS_DESCR STD_AXIS NO_INPUT_QUANTITY RB_PT_PCT_SWC_DWC_CompuMethods_ident 7 0.0 20000. FORMAT "%10.5" DEPOSIT ABSOLUTE /end AXIS_DESCR
 /begin AXIS_DESCR STD_AXIS NO_INPUT_QUANTITY RB_PT_PCT_SWC_DWC_CompuMethods_ident 10 -100. 100. FORMAT "%10.5" DEPOSIT ABSOLUTE /end AXIS_DESCR
/end CHARACTERISTIC
/begin CHARACTERISTIC DWC_EFLASHB.DWC_TorqueControl.DWC_SHIFTTYPEINDEXMAP2 "" MAP 0x8060D540 RB_PT_PCT_SWC_DWC_RecordLayouts_RL_Map_sint8_70_uint16_7_sint8_10 2.0 RB_PT_PCT_SWC_DWC_CompuMethods_ratio_0p01 -1. 1. FORMAT "%10.5"
 /begin ANNOTATION ANNOTATION_LABEL "Description (coming from AUTOSAR DESC field)"
  /begin ANNOTATION_TEXT "Map of shift type index vs. engine speed and aggression\r\n" /end ANNOTATION_TEXT
 /end ANNOTATION
 /begin AXIS_DESCR STD_AXIS NO_INPUT_QUANTITY RB_PT_PCT_SWC_DWC_CompuMethods_ident 7 0.0 20000. FORMAT "%10.5" DEPOSIT ABSOLUTE /end AXIS_DESCR
 /begin AXIS_DESCR STD_AXIS NO_INPUT_QUANTITY RB_PT_PCT_SWC_DWC_CompuMethods_ident 10 -100. 100. FORMAT "%10.5" DEPOSIT ABSOLUTE /end AXIS_DESCR
/end CHARACTERISTIC
/begin CHARACTERISTIC DWC_EFLASHB.DWC_TorqueControl.DWC_SHIFTTYPEINDEXMAP3 "" MAP 0x8060D5A2 RB_PT_PCT_SWC_DWC_RecordLayouts_RL_Map_sint8_70_uint16_7_sint8_10 2.0 RB_PT_PCT_SWC_DWC_CompuMethods_ratio_0p01 -1. 1. FORMAT "%10.5"
 /begin ANNOTATION ANNOTATION_LABEL "Description (coming from AUTOSAR DESC field)"
  /begin ANNOTATION_TEXT "Map of shift type index vs. engine speed and aggression\r\n" /end ANNOTATION_TEXT
 /end ANNOTATION
 /begin AXIS_DESCR STD_AXIS NO_INPUT_QUANTITY RB_PT_PCT_SWC_DWC_CompuMethods_ident 7 0.0 20000. FORMAT "%10.5" DEPOSIT ABSOLUTE /end AXIS_DESCR
 /begin AXIS_DESCR STD_AXIS NO_INPUT_QUANTITY RB_PT_PCT_SWC_DWC_CompuMethods_ident 10 -100. 100. FORMAT "%10.5" DEPOSIT ABSOLUTE /end AXIS_DESCR
/end CHARACTERISTIC
/begin CHARACTERISTIC DWC_EFLASHB.DWC_TorqueControl.DWC_SHIFTTYPEINDEXMAP4 "" MAP 0x8060D604 RB_PT_PCT_SWC_DWC_RecordLayouts_RL_Map_sint8_70_uint16_7_sint8_10 2.0 RB_PT_PCT_SWC_DWC_CompuMethods_ratio_0p01 -1. 1. FORMAT "%10.5"
 /begin ANNOTATION ANNOTATION_LABEL "Description (coming from AUTOSAR DESC field)"
  /begin ANNOTATION_TEXT "Map of shift type index vs. engine speed and aggression\r\n" /end ANNOTATION_TEXT
 /end ANNOTATION
 /begin AXIS_DESCR STD_AXIS NO_INPUT_QUANTITY RB_PT_PCT_SWC_DWC_CompuMethods_ident 7 0.0 20000. FORMAT "%10.5" DEPOSIT ABSOLUTE /end AXIS_DESCR
 /begin AXIS_DESCR STD_AXIS NO_INPUT_QUANTITY RB_PT_PCT_SWC_DWC_CompuMethods_ident 10 -100. 100. FORMAT "%10.5" DEPOSIT ABSOLUTE /end AXIS_DESCR
/end CHARACTERISTIC
/begin CHARACTERISTIC DWC_EFLASHB.DWC_TorqueControl.DWC_SHIFTTYPEMAPSELECT "" VAL_BLK 0x8060B330 DefaultValueRecordLayout_AUTOSAR_Platform_BaseTypes_uint8 3.0 RB_PT_PCT_SWC_DWC_CompuMethods_ident 1. 4. FORMAT "%10.5"
 /begin ANNOTATION ANNOTATION_LABEL "Description (coming from AUTOSAR DESC field)" /begin ANNOTATION_TEXT "Map select for shift type index maps\r\n" /end ANNOTATION_TEXT /end ANNOTATION
 MATRIX_DIM 8 1 1 /end CHARACTERISTIC
/begin CHARACTERISTIC DWC_EFLASHB.DWC_TorqueControl.DWC_SLCAccelFiltAdapt.DWC_FIRSTORDERLPCOEFF "" VALUE 0x8060BC6A DefaultValueRecordLayout_AUTOSAR_Platform_BaseTypes_uint8 1.0 RB_PT_PCT_SWC_DWC_CompuMethods_ratio_0p01 0.0 1. FORMAT "%10.5"
 /begin ANNOTATION ANNOTATION_LABEL "Description (coming from AUTOSAR DESC field)" /begin ANNOTATION_TEXT "Coefficient for low pass IIR filter\r\n" /end ANNOTATION_TEXT /end ANNOTATION
/end CHARACTERISTIC
/begin CHARACTERISTIC DWC_EFLASHB.DWC_TorqueControl.DWC_SLCAdaptMSConditions.DWC_PARTIALMASK "" VALUE 0x8060BC6C DefaultValueRecordLayout_AUTOSAR_Platform_BaseTypes_uint16 65535.0 RB_PT_PCT_SWC_DWC_CompuMethods_ident 0.0 65535. FORMAT "%10.5"
 /begin ANNOTATION ANNOTATION_LABEL "Description (coming from AUTOSAR DESC field)" /begin ANNOTATION_TEXT "Mask for approval of the inputs\r\n" /end ANNOTATION_TEXT /end ANNOTATION
/end CHARACTERISTIC
/begin CHARACTERISTIC DWC_EFLASHB.DWC_TorqueControl.DWC_SLCAdaptMSConditions.DWC_PASSMASK "" VALUE 0x8060BC6E DefaultValueRecordLayout_AUTOSAR_Platform_BaseTypes_uint16 65535.0 RB_PT_PCT_SWC_DWC_CompuMethods_ident 0.0 65535. FORMAT "%10.5"
 /begin ANNOTATION ANNOTATION_LABEL "Description (coming from AUTOSAR DESC field)" /begin ANNOTATION_TEXT "Mask for approval of the inputs\r\n" /end ANNOTATION_TEXT /end ANNOTATION
/end CHARACTERISTIC
/begin CHARACTERISTIC DWC_EFLASHB.DWC_TorqueControl.DWC_SLCCLOSEDSTATEMAXSLIP "" VALUE 0x8060B41C DefaultValueRecordLayout_AUTOSAR_Platform_BaseTypes_uint16 20000.0 RB_PT_PCT_SWC_DWC_CompuMethods_ident 0.0 20000. FORMAT "%10.5"
 /begin ANNOTATION ANNOTATION_LABEL "Description (coming from AUTOSAR DESC field)"
  /begin ANNOTATION_TEXT "Maximum slip considered for clutch closed state (one shot)\r\n" /end ANNOTATION_TEXT
 /end ANNOTATION
/end CHARACTERISTIC
/begin CHARACTERISTIC DWC_EFLASHB.DWC_TorqueControl.DWC_SLCDENGINETORQUEMAXMSADAPT "" VALUE 0x8060B41E DefaultValueRecordLayout_AUTOSAR_Platform_BaseTypes_uint16 10000.0 RB_PT_PCT_SWC_DWC_CompuMethods_ident 0.0 10000. FORMAT "%10.5"
 /begin ANNOTATION ANNOTATION_LABEL "Description (coming from AUTOSAR DESC field)"
  /begin ANNOTATION_TEXT "Maximum rate of change of engine torque for MS adaptation\r\n" /end ANNOTATION_TEXT
 /end ANNOTATION
/end CHARACTERISTIC
/begin CHARACTERISTIC DWC_EFLASHB.DWC_TorqueControl.DWC_SLCDRIVECOASTCHANGESLIP "" VALUE 0x8060B420 DefaultValueRecordLayout_AUTOSAR_Platform_BaseTypes_uint16 20000.0 RB_PT_PCT_SWC_DWC_CompuMethods_ident 0.0 20000. FORMAT "%10.5"
 /begin ANNOTATION ANNOTATION_LABEL "Description (coming from AUTOSAR DESC field)" /begin ANNOTATION_TEXT "Slip required to change from drive to coast and back\r\n" /end ANNOTATION_TEXT /end ANNOTATION
/end CHARACTERISTIC
/begin CHARACTERISTIC DWC_EFLASHB.DWC_TorqueControl.DWC_SLCESPEEDABOVEIDLEFORASGSLIPRULE "" VALUE 0x8060B422 DefaultValueRecordLayout_AUTOSAR_Platform_BaseTypes_uint16 20000.0 RB_PT_PCT_SWC_DWC_CompuMethods_ident 0.0 20000. FORMAT "%10.5"
 /begin ANNOTATION ANNOTATION_LABEL "Description (coming from AUTOSAR DESC field)"
  /begin ANNOTATION_TEXT "Engine speed above idle before slip too high can be set\r\n" /end ANNOTATION_TEXT
 /end ANNOTATION
/end CHARACTERISTIC
/begin CHARACTERISTIC DWC_EFLASHB.DWC_TorqueControl.DWC_SLCGEARTORQUEFORFILTSLIP "" VAL_BLK 0x8060B300 DefaultValueRecordLayout_AUTOSAR_Platform_BaseTypes_uint16 2000.0 RB_PT_PCT_SWC_DWC_CompuMethods_ratio_0p1 0.0 2000. FORMAT "%10.5"
 /begin ANNOTATION ANNOTATION_LABEL "Description (coming from AUTOSAR DESC field)" /begin ANNOTATION_TEXT "Maximum torque, above which filtered slip is used\r\n" /end ANNOTATION_TEXT /end ANNOTATION
 MATRIX_DIM 12 1 1 /end CHARACTERISTIC
/begin CHARACTERISTIC DWC_EFLASHB.DWC_TorqueControl.DWC_SLCINTEGRALGAIN "" VALUE 0x8060B424 DefaultValueRecordLayout_AUTOSAR_Platform_BaseTypes_uint16 0.15 RB_PT_PCT_SWC_DWC_CompuMethods_ratio_0p00001 0.0 0.15 FORMAT "%10.5"
 /begin ANNOTATION ANNOTATION_LABEL "Description (coming from AUTOSAR DESC field)" /begin ANNOTATION_TEXT "Integral gain of slip controller\r\n" /end ANNOTATION_TEXT /end ANNOTATION
/end CHARACTERISTIC
/begin CHARACTERISTIC DWC_EFLASHB.DWC_TorqueControl.DWC_SLCINTEGRALGAINSCHEDADAPTNORM "" CURVE 0x8060D666 RB_PT_PCT_SWC_DWC_RecordLayouts_RL_Curve_uint16_5_sint16_5 0.15 RB_PT_PCT_SWC_DWC_CompuMethods_ratio_0p00001 0.0 0.15 FORMAT "%10.5"
 /begin ANNOTATION ANNOTATION_LABEL "Description (coming from AUTOSAR DESC field)" /begin ANNOTATION_TEXT "Scheduled I gain - adaption\r\n" /end ANNOTATION_TEXT /end ANNOTATION
 /begin AXIS_DESCR STD_AXIS NO_INPUT_QUANTITY RB_PT_PCT_SWC_DWC_CompuMethods_ident 5 -20000. 20000. FORMAT "%10.5" DEPOSIT ABSOLUTE /end AXIS_DESCR
/end CHARACTERISTIC
/begin CHARACTERISTIC DWC_EFLASHB.DWC_TorqueControl.DWC_SLCINTEGRALGAINSCHEDADAPTPOWEROFF "" CURVE 0x8060D67C RB_PT_PCT_SWC_DWC_RecordLayouts_RL_Curve_uint16_5_sint16_5 0.15 RB_PT_PCT_SWC_DWC_CompuMethods_ratio_0p00001 0.0 0.15 FORMAT "%10.5"
 /begin ANNOTATION ANNOTATION_LABEL "Description (coming from AUTOSAR DESC field)" /begin ANNOTATION_TEXT "Scheduled I gain - adaption power off\r\n" /end ANNOTATION_TEXT /end ANNOTATION
 /begin AXIS_DESCR STD_AXIS NO_INPUT_QUANTITY RB_PT_PCT_SWC_DWC_CompuMethods_ident 5 -20000. 20000. FORMAT "%10.5" DEPOSIT ABSOLUTE /end AXIS_DESCR
/end CHARACTERISTIC
/begin CHARACTERISTIC DWC_EFLASHB.DWC_TorqueControl.DWC_SLCINTEGRALGAINSCHEDMICRO "" CURVE 0x8060D692 RB_PT_PCT_SWC_DWC_RecordLayouts_RL_Curve_uint16_5_sint16_5 0.15 RB_PT_PCT_SWC_DWC_CompuMethods_ratio_0p00001 0.0 0.15 FORMAT "%10.5"
 /begin ANNOTATION ANNOTATION_LABEL "Description (coming from AUTOSAR DESC field)" /begin ANNOTATION_TEXT "Scheduled I gain - microslip\r\n" /end ANNOTATION_TEXT /end ANNOTATION
 /begin AXIS_DESCR STD_AXIS NO_INPUT_QUANTITY RB_PT_PCT_SWC_DWC_CompuMethods_ident 5 -20000. 20000. FORMAT "%10.5" DEPOSIT ABSOLUTE /end AXIS_DESCR
/end CHARACTERISTIC
/begin CHARACTERISTIC DWC_EFLASHB.DWC_TorqueControl.DWC_SLCINTEGRALGAINSCHEDMICROPA "" MAP 0x8060D6A8 RB_PT_PCT_SWC_DWC_RecordLayouts_RL_Map_uint16_25_sint16_5_sint16_5 0.15 RB_PT_PCT_SWC_DWC_CompuMethods_ratio_0p00001 0.0 0.15 FORMAT "%10.5"
 /begin ANNOTATION ANNOTATION_LABEL "Description (coming from AUTOSAR DESC field)"
  /begin ANNOTATION_TEXT "Integral gain of controller for microslip in pullaway gears\r\n" /end ANNOTATION_TEXT
 /end ANNOTATION
 /begin AXIS_DESCR STD_AXIS NO_INPUT_QUANTITY RB_PT_PCT_SWC_DWC_CompuMethods_ident 5 -20000. 20000. FORMAT "%10.5" DEPOSIT ABSOLUTE /end AXIS_DESCR
 /begin AXIS_DESCR STD_AXIS NO_INPUT_QUANTITY RB_PT_PCT_SWC_DWC_CompuMethods_ratio_0p1 5 -2000. 2000. FORMAT "%10.5" DEPOSIT ABSOLUTE /end AXIS_DESCR
/end CHARACTERISTIC
/begin CHARACTERISTIC DWC_EFLASHB.DWC_TorqueControl.DWC_SLCINTEGRALGAINSCHEDMICRORECONNECT "" MAP 0x8060D6F2 RB_PT_PCT_SWC_DWC_RecordLayouts_RL_Map_uint16_25_uint16_5_sint16_5 0.15 RB_PT_PCT_SWC_DWC_CompuMethods_ratio_0p00001 0.0 0.15 FORMAT "%10.5"
 /begin ANNOTATION ANNOTATION_LABEL "Description (coming from AUTOSAR DESC field)"
  /begin ANNOTATION_TEXT "Integral gain of controller for microslip during reconnect\r\n" /end ANNOTATION_TEXT
 /end ANNOTATION
 /begin AXIS_DESCR STD_AXIS NO_INPUT_QUANTITY RB_PT_PCT_SWC_DWC_CompuMethods_ident 5 0.0 20000. FORMAT "%10.5" DEPOSIT ABSOLUTE /end AXIS_DESCR
 /begin AXIS_DESCR STD_AXIS NO_INPUT_QUANTITY RB_PT_PCT_SWC_DWC_CompuMethods_ratio_0p1 5 -2000. 2000. FORMAT "%10.5" DEPOSIT ABSOLUTE /end AXIS_DESCR
/end CHARACTERISTIC
/begin CHARACTERISTIC DWC_EFLASHB.DWC_TorqueControl.DWC_SLCINTEGRALGAINSCHEDMICRORECONNERROR "" CURVE 0x8060D73C RB_PT_PCT_SWC_DWC_RecordLayouts_RL_Curve_uint8_5_sint16_5 1.0 RB_PT_PCT_SWC_DWC_CompuMethods_ratio_0p01 0.0 1. FORMAT "%10.5"
 /begin ANNOTATION ANNOTATION_LABEL "Description (coming from AUTOSAR DESC field)"
  /begin ANNOTATION_TEXT "Factor of integral gain to use for reconnect based on error\r\n" /end ANNOTATION_TEXT
 /end ANNOTATION
 /begin AXIS_DESCR STD_AXIS NO_INPUT_QUANTITY RB_PT_PCT_SWC_DWC_CompuMethods_ident 5 -20000. 20000. FORMAT "%10.5" DEPOSIT ABSOLUTE /end AXIS_DESCR
/end CHARACTERISTIC
/begin CHARACTERISTIC DWC_EFLASHB.DWC_TorqueControl.DWC_SLCINTEGRALGAINSCHEDPOWERONDOWN "" CURVE 0x8060D74E RB_PT_PCT_SWC_DWC_RecordLayouts_RL_Curve_uint16_5_sint16_5 0.15 RB_PT_PCT_SWC_DWC_CompuMethods_ratio_0p00001 0.0 0.15 FORMAT "%10.5"
 /begin ANNOTATION ANNOTATION_LABEL "Description (coming from AUTOSAR DESC field)" /begin ANNOTATION_TEXT "Scheduled I gain - power on down shifts\r\n" /end ANNOTATION_TEXT /end ANNOTATION
 /begin AXIS_DESCR STD_AXIS NO_INPUT_QUANTITY RB_PT_PCT_SWC_DWC_CompuMethods_ident 5 -20000. 20000. FORMAT "%10.5" DEPOSIT ABSOLUTE /end AXIS_DESCR
/end CHARACTERISTIC
/begin CHARACTERISTIC DWC_EFLASHB.DWC_TorqueControl.DWC_SLCINTEGRALGAINTORQUEPHASE "" CURVE 0x8060D764 RB_PT_PCT_SWC_DWC_RecordLayouts_RL_Curve_uint16_5_sint16_5 0.15 RB_PT_PCT_SWC_DWC_CompuMethods_ratio_0p00001 0.0 0.15 FORMAT "%10.5"
 /begin ANNOTATION ANNOTATION_LABEL "Description (coming from AUTOSAR DESC field)" /begin ANNOTATION_TEXT "Scheduled I gain - TORQUEPHASE\r\n" /end ANNOTATION_TEXT /end ANNOTATION
 /begin AXIS_DESCR STD_AXIS NO_INPUT_QUANTITY RB_PT_PCT_SWC_DWC_CompuMethods_ident 5 -20000. 20000. FORMAT "%10.5" DEPOSIT ABSOLUTE /end AXIS_DESCR
/end CHARACTERISTIC
/end MODULE
/end PROJECT
