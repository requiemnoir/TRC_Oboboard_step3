ASAP2_VERSION 1 60
/begin PROJECT LB74x_TCU "5201C535"
/begin HEADER "" VERSION "5201C535" PROJECT_NO LB74x_TCU /end HEADER
/begin MODULE DIM ""
/begin MOD_COMMON "" BYTE_ORDER MSB_LAST ALIGNMENT_BYTE 1 ALIGNMENT_WORD 2 ALIGNMENT_LONG 4 ALIGNMENT_INT64 4 ALIGNMENT_FLOAT32_IEEE 4 ALIGNMENT_FLOAT64_IEEE 4 DATA_SIZE 32 /end MOD_COMMON
/begin CHARACTERISTIC Com_tiBYPASS_TDG1_19_Placeholder_RxRxTout_C "Calibration parameter to control Rx Ipdu Timeout for BYPASS_TDG1_19_Placeholder_Rx (multiplied by 0.005s)" VALUE 0x8061CD5E DefaultValueRecordLayout_AUTOSAR_Platform_BaseTypes_uint16 65535.0 RB_RBA_Common_CentralElements_CompuMethods_Identical 0.0 65535. FORMAT "%5.0" /end CHARACTERISTIC
/begin CHARACTERISTIC Com_tiBYPASS_TDG1_20_Placeholder_RxRxTout_C "Calibration parameter to control Rx Ipdu Timeout for BYPASS_TDG1_20_Placeholder_Rx (multiplied by 0.005s)" VALUE 0x8061CD5C DefaultValueRecordLayout_AUTOSAR_Platform_BaseTypes_uint16 65535.0 RB_RBA_Common_CentralElements_CompuMethods_Identical 0.0 65535. FORMAT "%5.0" /end CHARACTERISTIC
/begin CHARACTERISTIC Com_tiBYPASS_TDG1_21_RxRxTout_C "Calibration parameter to control Rx Ipdu Timeout for BYPASS_TDG1_21_Rx (multiplied by 0.005s)" VALUE 0x8061CD5A DefaultValueRecordLayout_AUTOSAR_Platform_BaseTypes_uint16 65535.0 RB_RBA_Common_CentralElements_CompuMethods_Identical 0.0 65535. FORMAT "%5.0" /end CHARACTERISTIC
/begin CHARACTERISTIC Com_tiBYPASS_TDG1_22_RxRxTout_C "Calibration parameter to control Rx Ipdu Timeout for BYPASS_TDG1_22_Rx (multiplied by 0.005s)" VALUE 0x8061CD58 DefaultValueRecordLayout_AUTOSAR_Platform_BaseTypes_uint16 65535.0 RB_RBA_Common_CentralElements_CompuMethods_Identical 0.0 65535. FORMAT "%5.0" /end CHARACTERISTIC
/begin CHARACTERISTIC Com_tiBremse_EV_01_RxRxTout_C "Calibration parameter to control Rx Ipdu Timeout for Bremse_EV_01_Rx (multiplied by 0.005s)" VALUE 0x8061CD56 DefaultValueRecordLayout_AUTOSAR_Platform_BaseTypes_uint16 65535.0 RB_RBA_Common_CentralElements_CompuMethods_Identical 0.0 65535. FORMAT "%5.0" /end CHARACTERISTIC
/begin CHARACTERISTIC Com_tiBremse_EV_02_RxRxTout_C "Calibration parameter to control Rx Ipdu Timeout for Bremse_EV_02_Rx (multiplied by 0.005s)" VALUE 0x8061CD54 DefaultValueRecordLayout_AUTOSAR_Platform_BaseTypes_uint16 65535.0 RB_RBA_Common_CentralElements_CompuMethods_Identical 0.0 65535. FORMAT "%5.0" /end CHARACTERISTIC
/begin CHARACTERISTIC Com_tiCharisma_01_RxRxTout_C "Calibration parameter to control Rx Ipdu Timeout for Charisma_01_Rx (multiplied by 0.005s)" VALUE 0x8061CD52 DefaultValueRecordLayout_AUTOSAR_Platform_BaseTypes_uint16 65535.0 RB_RBA_Common_CentralElements_CompuMethods_Identical 0.0 65535. FORMAT "%5.0" /end CHARACTERISTIC
/begin CHARACTERISTIC Com_tiCool_Act_Sts_RxRxTout_C "Calibration parameter to control Rx Ipdu Timeout for Cool_Act_Sts_Rx (multiplied by 0.005s)" VALUE 0x8061CD50 DefaultValueRecordLayout_AUTOSAR_Platform_BaseTypes_uint16 65535.0 RB_RBA_Common_CentralElements_CompuMethods_Identical 0.0 65535. FORMAT "%5.0" /end CHARACTERISTIC
/begin CHARACTERISTIC Com_tiDiagnose_01_RxRxTout_C "Calibration parameter to control Rx Ipdu Timeout for Diagnose_01_Rx (multiplied by 0.005s)" VALUE 0x8061CD4E DefaultValueRecordLayout_AUTOSAR_Platform_BaseTypes_uint16 65535.0 RB_RBA_Common_CentralElements_CompuMethods_Identical 0.0 65535. FORMAT "%5.0" /end CHARACTERISTIC
/begin CHARACTERISTIC Com_tiEBKV_01_RxRxTout_C "Calibration parameter to control Rx Ipdu Timeout for EBKV_01_Rx (multiplied by 0.005s)" VALUE 0x8061CD4C DefaultValueRecordLayout_AUTOSAR_Platform_BaseTypes_uint16 65535.0 RB_RBA_Common_CentralElements_CompuMethods_Identical 0.0 65535. FORMAT "%5.0" /end CHARACTERISTIC
/begin CHARACTERISTIC Com_tiEM1_HYB_06_RxRxTout_C "Calibration parameter to control Rx Ipdu Timeout for EM1_HYB_06_Rx (multiplied by 0.005s)" VALUE 0x8061CD4A DefaultValueRecordLayout_AUTOSAR_Platform_BaseTypes_uint16 65535.0 RB_RBA_Common_CentralElements_CompuMethods_Identical 0.0 65535. FORMAT "%5.0" /end CHARACTERISTIC
/begin CHARACTERISTIC Com_tiEM1_HYB_12_RxRxTout_C "Calibration parameter to control Rx Ipdu Timeout for EM1_HYB_12_Rx (multiplied by 0.005s)" VALUE 0x8061CD48 DefaultValueRecordLayout_AUTOSAR_Platform_BaseTypes_uint16 65535.0 RB_RBA_Common_CentralElements_CompuMethods_Identical 0.0 65535. FORMAT "%5.0" /end CHARACTERISTIC
/begin CHARACTERISTIC Com_tiEPB_01_RxRxTout_C "Calibration parameter to control Rx Ipdu Timeout for EPB_01_Rx (multiplied by 0.005s)" VALUE 0x8061CD46 DefaultValueRecordLayout_AUTOSAR_Platform_BaseTypes_uint16 65535.0 RB_RBA_Common_CentralElements_CompuMethods_Identical 0.0 65535. FORMAT "%5.0" /end CHARACTERISTIC
/begin CHARACTERISTIC Com_tiESP_03_RxRxTout_C "Calibration parameter to control Rx Ipdu Timeout for ESP_03_Rx (multiplied by 0.005s)" VALUE 0x8061CD44 DefaultValueRecordLayout_AUTOSAR_Platform_BaseTypes_uint16 65535.0 RB_RBA_Common_CentralElements_CompuMethods_Identical 0.0 65535. FORMAT "%5.0" /end CHARACTERISTIC
/begin CHARACTERISTIC Com_tiESP_05_RxRxTout_C "Calibration parameter to control Rx Ipdu Timeout for ESP_05_Rx (multiplied by 0.005s)" VALUE 0x8061CD42 DefaultValueRecordLayout_AUTOSAR_Platform_BaseTypes_uint16 65535.0 RB_RBA_Common_CentralElements_CompuMethods_Identical 0.0 65535. FORMAT "%5.0" /end CHARACTERISTIC
/begin CHARACTERISTIC Com_tiESP_07_RxRxTout_C "Calibration parameter to control Rx Ipdu Timeout for ESP_07_Rx (multiplied by 0.005s)" VALUE 0x8061CD40 DefaultValueRecordLayout_AUTOSAR_Platform_BaseTypes_uint16 65535.0 RB_RBA_Common_CentralElements_CompuMethods_Identical 0.0 65535. FORMAT "%5.0" /end CHARACTERISTIC
/begin CHARACTERISTIC Com_tiESP_08_RxRxTout_C "Calibration parameter to control Rx Ipdu Timeout for ESP_08_Rx (multiplied by 0.005s)" VALUE 0x8061CD3E DefaultValueRecordLayout_AUTOSAR_Platform_BaseTypes_uint16 65535.0 RB_RBA_Common_CentralElements_CompuMethods_Identical 0.0 65535. FORMAT "%5.0" /end CHARACTERISTIC
/begin CHARACTERISTIC Com_tiESP_15_RxRxTout_C "Calibration parameter to control Rx Ipdu Timeout for ESP_15_Rx (multiplied by 0.005s)" VALUE 0x8061CD3C DefaultValueRecordLayout_AUTOSAR_Platform_BaseTypes_uint16 65535.0 RB_RBA_Common_CentralElements_CompuMethods_Identical 0.0 65535. FORMAT "%5.0" /end CHARACTERISTIC
/begin CHARACTERISTIC Com_tiESP_20_RxRxTout_C "Calibration parameter to control Rx Ipdu Timeout for ESP_20_Rx (multiplied by 0.005s)" VALUE 0x8061CD3A DefaultValueRecordLayout_AUTOSAR_Platform_BaseTypes_uint16 65535.0 RB_RBA_Common_CentralElements_CompuMethods_Identical 0.0 65535. FORMAT "%5.0" /end CHARACTERISTIC
/begin CHARACTERISTIC Com_tiESP_21_RxRxTout_C "Calibration parameter to control Rx Ipdu Timeout for ESP_21_Rx (multiplied by 0.005s)" VALUE 0x8061CD38 DefaultValueRecordLayout_AUTOSAR_Platform_BaseTypes_uint16 65535.0 RB_RBA_Common_CentralElements_CompuMethods_Identical 0.0 65535. FORMAT "%5.0" /end CHARACTERISTIC
/begin CHARACTERISTIC Com_tiESP_22_RxRxTout_C "Calibration parameter to control Rx Ipdu Timeout for ESP_22_Rx (multiplied by 0.005s)" VALUE 0x8061CD36 DefaultValueRecordLayout_AUTOSAR_Platform_BaseTypes_uint16 65535.0 RB_RBA_Common_CentralElements_CompuMethods_Identical 0.0 65535. FORMAT "%5.0" /end CHARACTERISTIC
/begin CHARACTERISTIC Com_tiESP_23_RxRxTout_C "Calibration parameter to control Rx Ipdu Timeout for ESP_23_Rx (multiplied by 0.005s)" VALUE 0x8061CD34 DefaultValueRecordLayout_AUTOSAR_Platform_BaseTypes_uint16 65535.0 RB_RBA_Common_CentralElements_CompuMethods_Identical 0.0 65535. FORMAT "%5.0" /end CHARACTERISTIC
/begin CHARACTERISTIC Com_tiESP_24_RxRxTout_C "Calibration parameter to control Rx Ipdu Timeout for ESP_24_Rx (multiplied by 0.005s)" VALUE 0x8061CD32 DefaultValueRecordLayout_AUTOSAR_Platform_BaseTypes_uint16 65535.0 RB_RBA_Common_CentralElements_CompuMethods_Identical 0.0 65535. FORMAT "%5.0" /end CHARACTERISTIC
/begin CHARACTERISTIC Com_tiESP_26_RxRxTout_C "Calibration parameter to control Rx Ipdu Timeout for ESP_26_Rx (multiplied by 0.005s)" VALUE 0x8061CD30 DefaultValueRecordLayout_AUTOSAR_Platform_BaseTypes_uint16 65535.0 RB_RBA_Common_CentralElements_CompuMethods_Identical 0.0 65535. FORMAT "%5.0" /end CHARACTERISTIC
/begin CHARACTERISTIC Com_tiESP_28_RxRxTout_C "Calibration parameter to control Rx Ipdu Timeout for ESP_28_Rx (multiplied by 0.005s)" VALUE 0x8061CD2E DefaultValueRecordLayout_AUTOSAR_Platform_BaseTypes_uint16 65535.0 RB_RBA_Common_CentralElements_CompuMethods_Identical 0.0 65535. FORMAT "%5.0" /end CHARACTERISTIC
/begin CHARACTERISTIC Com_tiESP_31_RxRxTout_C "Calibration parameter to control Rx Ipdu Timeout for ESP_31_Rx (multiplied by 0.005s)" VALUE 0x8061CD2C DefaultValueRecordLayout_AUTOSAR_Platform_BaseTypes_uint16 65535.0 RB_RBA_Common_CentralElements_CompuMethods_Identical 0.0 65535. FORMAT "%5.0" /end CHARACTERISTIC
/begin CHARACTERISTIC Com_tiESP_32_RxRxTout_C "Calibration parameter to control Rx Ipdu Timeout for ESP_32_Rx (multiplied by 0.005s)" VALUE 0x8061CD2A DefaultValueRecordLayout_AUTOSAR_Platform_BaseTypes_uint16 65535.0 RB_RBA_Common_CentralElements_CompuMethods_Identical 0.0 65535. FORMAT "%5.0" /end CHARACTERISTIC
/begin CHARACTERISTIC Com_tiESP_33_RxRxTout_C "Calibration parameter to control Rx Ipdu Timeout for ESP_33_Rx (multiplied by 0.005s)" VALUE 0x8061CD28 DefaultValueRecordLayout_AUTOSAR_Platform_BaseTypes_uint16 65535.0 RB_RBA_Common_CentralElements_CompuMethods_Identical 0.0 65535. FORMAT "%5.0" /end CHARACTERISTIC
/begin CHARACTERISTIC Com_tiESP_41_RxRxTout_C "Calibration parameter to control Rx Ipdu Timeout for ESP_41_Rx (multiplied by 0.005s)" VALUE 0x8061CD26 DefaultValueRecordLayout_AUTOSAR_Platform_BaseTypes_uint16 65535.0 RB_RBA_Common_CentralElements_CompuMethods_Identical 0.0 65535. FORMAT "%5.0" /end CHARACTERISTIC
/begin CHARACTERISTIC Com_tiESP_44_RxRxTout_C "Calibration parameter to control Rx Ipdu Timeout for ESP_44_Rx (multiplied by 0.005s)" VALUE 0x8061CD24 DefaultValueRecordLayout_AUTOSAR_Platform_BaseTypes_uint16 65535.0 RB_RBA_Common_CentralElements_CompuMethods_Identical 0.0 65535. FORMAT "%5.0" /end CHARACTERISTIC
/begin CHARACTERISTIC Com_tiKlemmen_Status_01_RxRxTout_C "Calibration parameter to control Rx Ipdu Timeout for Klemmen_Status_01_Rx (multiplied by 0.005s)" VALUE 0x8061CD22 DefaultValueRecordLayout_AUTOSAR_Platform_BaseTypes_uint16 65535.0 RB_RBA_Common_CentralElements_CompuMethods_Identical 0.0 65535. FORMAT "%5.0" /end CHARACTERISTIC
/begin CHARACTERISTIC Com_tiKlima_11_RxRxTout_C "Calibration parameter to control Rx Ipdu Timeout for Klima_11_Rx (multiplied by 0.005s)" VALUE 0x8061CD20 DefaultValueRecordLayout_AUTOSAR_Platform_BaseTypes_uint16 65535.0 RB_RBA_Common_CentralElements_CompuMethods_Identical 0.0 65535. FORMAT "%5.0" /end CHARACTERISTIC
/begin CHARACTERISTIC Com_tiKombi_02_RxRxTout_C "Calibration parameter to control Rx Ipdu Timeout for Kombi_02_Rx (multiplied by 0.005s)" VALUE 0x8061CD1E DefaultValueRecordLayout_AUTOSAR_Platform_BaseTypes_uint16 65535.0 RB_RBA_Common_CentralElements_CompuMethods_Identical 0.0 65535. FORMAT "%5.0" /end CHARACTERISTIC
/begin CHARACTERISTIC Com_tiLCV_01_RxRxTout_C "Calibration parameter to control Rx Ipdu Timeout for LCV_01_Rx (multiplied by 0.005s)" VALUE 0x8061CD1C DefaultValueRecordLayout_AUTOSAR_Platform_BaseTypes_uint16 65535.0 RB_RBA_Common_CentralElements_CompuMethods_Identical 0.0 65535. FORMAT "%5.0" /end CHARACTERISTIC
/begin CHARACTERISTIC Com_tiLWI_01_RxRxTout_C "Calibration parameter to control Rx Ipdu Timeout for LWI_01_Rx (multiplied by 0.005s)" VALUE 0x8061CD1A DefaultValueRecordLayout_AUTOSAR_Platform_BaseTypes_uint16 65535.0 RB_RBA_Common_CentralElements_CompuMethods_Identical 0.0 65535. FORMAT "%5.0" /end CHARACTERISTIC
/begin CHARACTERISTIC Com_tiMFL_Tasten_01_RxRxTout_C "Calibration parameter to control Rx Ipdu Timeout for MFL_Tasten_01_Rx (multiplied by 0.005s)" VALUE 0x8061CD18 DefaultValueRecordLayout_AUTOSAR_Platform_BaseTypes_uint16 65535.0 RB_RBA_Common_CentralElements_CompuMethods_Identical 0.0 65535. FORMAT "%5.0" /end CHARACTERISTIC
/begin CHARACTERISTIC Com_tiMSG_EM1_18_RxRxTout_C "Calibration parameter to control Rx Ipdu Timeout for MSG_EM1_18_Rx (multiplied by 0.005s)" VALUE 0x8061CD16 DefaultValueRecordLayout_AUTOSAR_Platform_BaseTypes_uint16 65535.0 RB_RBA_Common_CentralElements_CompuMethods_Identical 0.0 65535. FORMAT "%5.0" /end CHARACTERISTIC
/begin CHARACTERISTIC Com_tiMSG_EM1_29_RxRxTout_C "Calibration parameter to control Rx Ipdu Timeout for MSG_EM1_29_Rx (multiplied by 0.005s)" VALUE 0x8061CD14 DefaultValueRecordLayout_AUTOSAR_Platform_BaseTypes_uint16 65535.0 RB_RBA_Common_CentralElements_CompuMethods_Identical 0.0 65535. FORMAT "%5.0" /end CHARACTERISTIC
/begin CHARACTERISTIC Com_tiMotor_01_RxRxTout_C "Calibration parameter to control Rx Ipdu Timeout for Motor_01_Rx (multiplied by 0.005s)" VALUE 0x8061CD12 DefaultValueRecordLayout_AUTOSAR_Platform_BaseTypes_uint16 65535.0 RB_RBA_Common_CentralElements_CompuMethods_Identical 0.0 65535. FORMAT "%5.0" /end CHARACTERISTIC
/begin CHARACTERISTIC Com_tiMotor_02_RxRxTout_C "Calibration parameter to control Rx Ipdu Timeout for Motor_02_Rx (multiplied by 0.005s)" VALUE 0x8061CD10 DefaultValueRecordLayout_AUTOSAR_Platform_BaseTypes_uint16 65535.0 RB_RBA_Common_CentralElements_CompuMethods_Identical 0.0 65535. FORMAT "%5.0" /end CHARACTERISTIC
/begin CHARACTERISTIC Com_tiMotor_03_RxRxTout_C "Calibration parameter to control Rx Ipdu Timeout for Motor_03_Rx (multiplied by 0.005s)" VALUE 0x8061CD0E DefaultValueRecordLayout_AUTOSAR_Platform_BaseTypes_uint16 65535.0 RB_RBA_Common_CentralElements_CompuMethods_Identical 0.0 65535. FORMAT "%5.0" /end CHARACTERISTIC
/begin CHARACTERISTIC Com_tiMotor_07_RxRxTout_C "Calibration parameter to control Rx Ipdu Timeout for Motor_07_Rx (multiplied by 0.005s)" VALUE 0x8061CD0C DefaultValueRecordLayout_AUTOSAR_Platform_BaseTypes_uint16 65535.0 RB_RBA_Common_CentralElements_CompuMethods_Identical 0.0 65535. FORMAT "%5.0" /end CHARACTERISTIC
/begin CHARACTERISTIC Com_tiMotor_11_RxRxTout_C "Calibration parameter to control Rx Ipdu Timeout for Motor_11_Rx (multiplied by 0.005s)" VALUE 0x8061CD0A DefaultValueRecordLayout_AUTOSAR_Platform_BaseTypes_uint16 65535.0 RB_RBA_Common_CentralElements_CompuMethods_Identical 0.0 65535. FORMAT "%5.0" /end CHARACTERISTIC
/begin CHARACTERISTIC Com_tiMotor_12_RxRxTout_C "Calibration parameter to control Rx Ipdu Timeout for Motor_12_Rx (multiplied by 0.005s)" VALUE 0x8061CD08 DefaultValueRecordLayout_AUTOSAR_Platform_BaseTypes_uint16 65535.0 RB_RBA_Common_CentralElements_CompuMethods_Identical 0.0 65535. FORMAT "%5.0" /end CHARACTERISTIC
/begin CHARACTERISTIC Com_tiMotor_14_RxRxTout_C "Calibration parameter to control Rx Ipdu Timeout for Motor_14_Rx (multiplied by 0.005s)" VALUE 0x8061CD06 DefaultValueRecordLayout_AUTOSAR_Platform_BaseTypes_uint16 65535.0 RB_RBA_Common_CentralElements_CompuMethods_Identical 0.0 65535. FORMAT "%5.0" /end CHARACTERISTIC
/begin CHARACTERISTIC Com_tiMotor_16_RxRxTout_C "Calibration parameter to control Rx Ipdu Timeout for Motor_16_Rx (multiplied by 0.005s)" VALUE 0x8061CD04 DefaultValueRecordLayout_AUTOSAR_Platform_BaseTypes_uint16 65535.0 RB_RBA_Common_CentralElements_CompuMethods_Identical 0.0 65535. FORMAT "%5.0" /end CHARACTERISTIC
/begin CHARACTERISTIC Com_tiMotor_17_RxRxTout_C "Calibration parameter to control Rx Ipdu Timeout for Motor_17_Rx (multiplied by 0.005s)" VALUE 0x8061CD02 DefaultValueRecordLayout_AUTOSAR_Platform_BaseTypes_uint16 65535.0 RB_RBA_Common_CentralElements_CompuMethods_Identical 0.0 65535. FORMAT "%5.0" /end CHARACTERISTIC
/begin CHARACTERISTIC Com_tiMotor_18_RxRxTout_C "Calibration parameter to control Rx Ipdu Timeout for Motor_18_Rx (multiplied by 0.005s)" VALUE 0x8061CD00 DefaultValueRecordLayout_AUTOSAR_Platform_BaseTypes_uint16 65535.0 RB_RBA_Common_CentralElements_CompuMethods_Identical 0.0 65535. FORMAT "%5.0" /end CHARACTERISTIC
/begin CHARACTERISTIC Com_tiMotor_20_RxRxTout_C "Calibration parameter to control Rx Ipdu Timeout for Motor_20_Rx (multiplied by 0.005s)" VALUE 0x8061CCFE DefaultValueRecordLayout_AUTOSAR_Platform_BaseTypes_uint16 65535.0 RB_RBA_Common_CentralElements_CompuMethods_Identical 0.0 65535. FORMAT "%5.0" /end CHARACTERISTIC
/begin CHARACTERISTIC Com_tiMotor_27_RxRxTout_C "Calibration parameter to control Rx Ipdu Timeout for Motor_27_Rx (multiplied by 0.005s)" VALUE 0x8061CCFC DefaultValueRecordLayout_AUTOSAR_Platform_BaseTypes_uint16 65535.0 RB_RBA_Common_CentralElements_CompuMethods_Identical 0.0 65535. FORMAT "%5.0" /end CHARACTERISTIC
/begin CHARACTERISTIC Com_tiMotor_28_RxRxTout_C "Calibration parameter to control Rx Ipdu Timeout for Motor_28_Rx (multiplied by 0.005s)" VALUE 0x8061CCFA DefaultValueRecordLayout_AUTOSAR_Platform_BaseTypes_uint16 65535.0 RB_RBA_Common_CentralElements_CompuMethods_Identical 0.0 65535. FORMAT "%5.0" /end CHARACTERISTIC
/begin CHARACTERISTIC Com_tiMotor_35_RxRxTout_C "Calibration parameter to control Rx Ipdu Timeout for Motor_35_Rx (multiplied by 0.005s)" VALUE 0x8061CCF8 DefaultValueRecordLayout_AUTOSAR_Platform_BaseTypes_uint16 65535.0 RB_RBA_Common_CentralElements_CompuMethods_Identical 0.0 65535. FORMAT "%5.0" /end CHARACTERISTIC
/begin CHARACTERISTIC Com_tiMotor_38_LB_RxRxTout_C "Calibration parameter to control Rx Ipdu Timeout for Motor_38_LB_Rx (multiplied by 0.005s)" VALUE 0x8061CCF6 DefaultValueRecordLayout_AUTOSAR_Platform_BaseTypes_uint16 65535.0 RB_RBA_Common_CentralElements_CompuMethods_Identical 0.0 65535. FORMAT "%5.0" /end CHARACTERISTIC
/begin CHARACTERISTIC Com_tiMotor_47_RxRxTout_C "Calibration parameter to control Rx Ipdu Timeout for Motor_47_Rx (multiplied by 0.005s)" VALUE 0x8061CCF4 DefaultValueRecordLayout_AUTOSAR_Platform_BaseTypes_uint16 65535.0 RB_RBA_Common_CentralElements_CompuMethods_Identical 0.0 65535. FORMAT "%5.0" /end CHARACTERISTIC
/begin CHARACTERISTIC Com_tiMotor_Code_01_RxRxTout_C "Calibration parameter to control Rx Ipdu Timeout for Motor_Code_01_Rx (multiplied by 0.005s)" VALUE 0x8061CCF2 DefaultValueRecordLayout_AUTOSAR_Platform_BaseTypes_uint16 65535.0 RB_RBA_Common_CentralElements_CompuMethods_Identical 0.0 65535. FORMAT "%5.0" /end CHARACTERISTIC
/begin CHARACTERISTIC Com_tiMotor_Hybrid_11_RxRxTout_C "Calibration parameter to control Rx Ipdu Timeout for Motor_Hybrid_11_Rx (multiplied by 0.005s)" VALUE 0x8061CCF0 DefaultValueRecordLayout_AUTOSAR_Platform_BaseTypes_uint16 65535.0 RB_RBA_Common_CentralElements_CompuMethods_Identical 0.0 65535. FORMAT "%5.0" /end CHARACTERISTIC
/begin CHARACTERISTIC Com_tiMotor_TS_01_RxRxTout_C "Calibration parameter to control Rx Ipdu Timeout for Motor_TS_01_Rx (multiplied by 0.005s)" VALUE 0x8061CCEE DefaultValueRecordLayout_AUTOSAR_Platform_BaseTypes_uint16 65535.0 RB_RBA_Common_CentralElements_CompuMethods_Identical 0.0 65535. FORMAT "%5.0" /end CHARACTERISTIC
/begin CHARACTERISTIC Com_tiMotor_TS_02_RxRxTout_C "Calibration parameter to control Rx Ipdu Timeout for Motor_TS_02_Rx (multiplied by 0.005s)" VALUE 0x8061CCEC DefaultValueRecordLayout_AUTOSAR_Platform_BaseTypes_uint16 65535.0 RB_RBA_Common_CentralElements_CompuMethods_Identical 0.0 65535. FORMAT "%5.0" /end CHARACTERISTIC
/begin CHARACTERISTIC Com_tiMotor_TS_03_RxRxTout_C "Calibration parameter to control Rx Ipdu Timeout for Motor_TS_03_Rx (multiplied by 0.005s)" VALUE 0x8061CCEA DefaultValueRecordLayout_AUTOSAR_Platform_BaseTypes_uint16 65535.0 RB_RBA_Common_CentralElements_CompuMethods_Identical 0.0 65535. FORMAT "%5.0" /end CHARACTERISTIC
/begin CHARACTERISTIC Com_tiNVEM_02_RxRxTout_C "Calibration parameter to control Rx Ipdu Timeout for NVEM_02_Rx (multiplied by 0.005s)" VALUE 0x8061CCE8 DefaultValueRecordLayout_AUTOSAR_Platform_BaseTypes_uint16 65535.0 RB_RBA_Common_CentralElements_CompuMethods_Identical 0.0 65535. FORMAT "%5.0" /end CHARACTERISTIC
/begin CHARACTERISTIC Com_tiNVEM_05_RxRxTout_C "Calibration parameter to control Rx Ipdu Timeout for NVEM_05_Rx (multiplied by 0.005s)" VALUE 0x8061CCE6 DefaultValueRecordLayout_AUTOSAR_Platform_BaseTypes_uint16 65535.0 RB_RBA_Common_CentralElements_CompuMethods_Identical 0.0 65535. FORMAT "%5.0" /end CHARACTERISTIC
/begin CHARACTERISTIC Com_tiOBD_01_RxRxTout_C "Calibration parameter to control Rx Ipdu Timeout for OBD_01_Rx (multiplied by 0.005s)" VALUE 0x8061CCE4 DefaultValueRecordLayout_AUTOSAR_Platform_BaseTypes_uint16 65535.0 RB_RBA_Common_CentralElements_CompuMethods_Identical 0.0 65535. FORMAT "%5.0" /end CHARACTERISTIC
/begin CHARACTERISTIC Com_tiOBD_02_RxRxTout_C "Calibration parameter to control Rx Ipdu Timeout for OBD_02_Rx (multiplied by 0.005s)" VALUE 0x8061CCE2 DefaultValueRecordLayout_AUTOSAR_Platform_BaseTypes_uint16 65535.0 RB_RBA_Common_CentralElements_CompuMethods_Identical 0.0 65535. FORMAT "%5.0" /end CHARACTERISTIC
/begin CHARACTERISTIC Com_tiSARA_06_RxRxTout_C "Calibration parameter to control Rx Ipdu Timeout for SARA_06_Rx (multiplied by 0.005s)" VALUE 0x8061CCE0 DefaultValueRecordLayout_AUTOSAR_Platform_BaseTypes_uint16 65535.0 RB_RBA_Common_CentralElements_CompuMethods_Identical 0.0 65535. FORMAT "%5.0" /end CHARACTERISTIC
/begin CHARACTERISTIC Com_tiSysteminfo_01_RxRxTout_C "Calibration parameter to control Rx Ipdu Timeout for Systeminfo_01_Rx (multiplied by 0.005s)" VALUE 0x8061CCDE DefaultValueRecordLayout_AUTOSAR_Platform_BaseTypes_uint16 65535.0 RB_RBA_Common_CentralElements_CompuMethods_Identical 0.0 65535. FORMAT "%5.0" /end CHARACTERISTIC
/begin CHARACTERISTIC Com_tiTSG_FT_02_RxRxTout_C "Calibration parameter to control Rx Ipdu Timeout for TSG_FT_02_Rx (multiplied by 0.005s)" VALUE 0x8061CCDC DefaultValueRecordLayout_AUTOSAR_Platform_BaseTypes_uint16 65535.0 RB_RBA_Common_CentralElements_CompuMethods_Identical 0.0 65535. FORMAT "%5.0" /end CHARACTERISTIC
/begin CHARACTERISTIC Com_tiTSK_06_RxRxTout_C "Calibration parameter to control Rx Ipdu Timeout for TSK_06_Rx (multiplied by 0.005s)" VALUE 0x8061CCDA DefaultValueRecordLayout_AUTOSAR_Platform_BaseTypes_uint16 65535.0 RB_RBA_Common_CentralElements_CompuMethods_Identical 0.0 65535. FORMAT "%5.0" /end CHARACTERISTIC
/begin CHARACTERISTIC Com_tiTSK_08_RxRxTout_C "Calibration parameter to control Rx Ipdu Timeout for TSK_08_Rx (multiplied by 0.005s)" VALUE 0x8061CCD8 DefaultValueRecordLayout_AUTOSAR_Platform_BaseTypes_uint16 65535.0 RB_RBA_Common_CentralElements_CompuMethods_Identical 0.0 65535. FORMAT "%5.0" /end CHARACTERISTIC
/begin CHARACTERISTIC Com_tiVIN_01_0_RxRxTout_C "Calibration parameter to control Rx Ipdu Timeout for VIN_01_0_Rx (multiplied by 0.005s)" VALUE 0x8061CCD6 DefaultValueRecordLayout_AUTOSAR_Platform_BaseTypes_uint16 65535.0 RB_RBA_Common_CentralElements_CompuMethods_Identical 0.0 65535. FORMAT "%5.0" /end CHARACTERISTIC
/begin CHARACTERISTIC Com_tiVIN_01_1_RxRxTout_C "Calibration parameter to control Rx Ipdu Timeout for VIN_01_1_Rx (multiplied by 0.005s)" VALUE 0x8061CCD4 DefaultValueRecordLayout_AUTOSAR_Platform_BaseTypes_uint16 65535.0 RB_RBA_Common_CentralElements_CompuMethods_Identical 0.0 65535. FORMAT "%5.0" /end CHARACTERISTIC
/begin CHARACTERISTIC Com_tiVIN_01_2_RxRxTout_C "Calibration parameter to control Rx Ipdu Timeout for VIN_01_2_Rx (multiplied by 0.005s)" VALUE 0x8061CCD2 DefaultValueRecordLayout_AUTOSAR_Platform_BaseTypes_uint16 65535.0 RB_RBA_Common_CentralElements_CompuMethods_Identical 0.0 65535. FORMAT "%5.0" /end CHARACTERISTIC
/begin CHARACTERISTIC Com_swtMsgMon_ACC_06_C "Activation monitoring for message ACC_06 and for signal groups (if contained in message) (value != 0 to activate protection)" VALUE 0x8061CC20 DefaultValueRecordLayout_AUTOSAR_Platform_BaseTypes_uint8 255.0 DefaultIdenticalCompu 0.0 255. FORMAT "%5.0" /end CHARACTERISTIC
/begin CHARACTERISTIC Com_swtMsgMon_ACC_07_C "Activation monitoring for message ACC_07 and for signal groups (if contained in message) (value != 0 to activate protection)" VALUE 0x8061CC1F DefaultValueRecordLayout_AUTOSAR_Platform_BaseTypes_uint8 255.0 DefaultIdenticalCompu 0.0 255. FORMAT "%5.0" /end CHARACTERISTIC
/begin CHARACTERISTIC Com_swtMsgMon_Airbag_01_C "Activation monitoring for message Airbag_01 and for signal groups (if contained in message) (value != 0 to activate protection)" VALUE 0x8061CC1E DefaultValueRecordLayout_AUTOSAR_Platform_BaseTypes_uint8 255.0 DefaultIdenticalCompu 0.0 255. FORMAT "%5.0" /end CHARACTERISTIC
/begin CHARACTERISTIC Com_swtMsgMon_Airbag_02_C "Activation monitoring for message Airbag_02 and for signal groups (if contained in message) (value != 0 to activate protection)" VALUE 0x8061CC1D DefaultValueRecordLayout_AUTOSAR_Platform_BaseTypes_uint8 255.0 DefaultIdenticalCompu 0.0 255. FORMAT "%5.0" /end CHARACTERISTIC
/begin CHARACTERISTIC Com_swtMsgMon_Bremse_EV_01_C "Activation monitoring for message Bremse_EV_01 and for signal groups (if contained in message) (value != 0 to activate protection)" VALUE 0x8061CC1C DefaultValueRecordLayout_AUTOSAR_Platform_BaseTypes_uint8 255.0 DefaultIdenticalCompu 0.0 255. FORMAT "%5.0" /end CHARACTERISTIC
/begin CHARACTERISTIC Com_swtMsgMon_Bremse_EV_02_C "Activation monitoring for message Bremse_EV_02 and for signal groups (if contained in message) (value != 0 to activate protection)" VALUE 0x8061CC1B DefaultValueRecordLayout_AUTOSAR_Platform_BaseTypes_uint8 255.0 DefaultIdenticalCompu 0.0 255. FORMAT "%5.0" /end CHARACTERISTIC
/begin CHARACTERISTIC Com_swtMsgMon_EBKV_01_C "Activation monitoring for message EBKV_01 and for signal groups (if contained in message) (value != 0 to activate protection)" VALUE 0x8061CC1A DefaultValueRecordLayout_AUTOSAR_Platform_BaseTypes_uint8 255.0 DefaultIdenticalCompu 0.0 255. FORMAT "%5.0" /end CHARACTERISTIC
/begin CHARACTERISTIC Com_swtMsgMon_EM1_HYB_12_C "Activation monitoring for message EM1_HYB_12 and for signal groups (if contained in message) (value != 0 to activate protection)" VALUE 0x8061CC19 DefaultValueRecordLayout_AUTOSAR_Platform_BaseTypes_uint8 255.0 DefaultIdenticalCompu 0.0 255. FORMAT "%5.0" /end CHARACTERISTIC
/begin CHARACTERISTIC Com_swtMsgMon_EPB_01_C "Activation monitoring for message EPB_01 and for signal groups (if contained in message) (value != 0 to activate protection)" VALUE 0x8061CC18 DefaultValueRecordLayout_AUTOSAR_Platform_BaseTypes_uint8 255.0 DefaultIdenticalCompu 0.0 255. FORMAT "%5.0" /end CHARACTERISTIC
/begin CHARACTERISTIC Com_swtMsgMon_ESP_03_C "Activation monitoring for message ESP_03 and for signal groups (if contained in message) (value != 0 to activate protection)" VALUE 0x8061CC17 DefaultValueRecordLayout_AUTOSAR_Platform_BaseTypes_uint8 255.0 DefaultIdenticalCompu 0.0 255. FORMAT "%5.0" /end CHARACTERISTIC
/begin CHARACTERISTIC Com_swtMsgMon_ESP_05_C "Activation monitoring for message ESP_05 and for signal groups (if contained in message) (value != 0 to activate protection)" VALUE 0x8061CC16 DefaultValueRecordLayout_AUTOSAR_Platform_BaseTypes_uint8 255.0 DefaultIdenticalCompu 0.0 255. FORMAT "%5.0" /end CHARACTERISTIC
/begin CHARACTERISTIC Com_swtMsgMon_ESP_07_C "Activation monitoring for message ESP_07 and for signal groups (if contained in message) (value != 0 to activate protection)" VALUE 0x8061CC15 DefaultValueRecordLayout_AUTOSAR_Platform_BaseTypes_uint8 255.0 DefaultIdenticalCompu 0.0 255. FORMAT "%5.0" /end CHARACTERISTIC
/begin CHARACTERISTIC Com_swtMsgMon_ESP_08_C "Activation monitoring for message ESP_08 and for signal groups (if contained in message) (value != 0 to activate protection)" VALUE 0x8061CC14 DefaultValueRecordLayout_AUTOSAR_Platform_BaseTypes_uint8 255.0 DefaultIdenticalCompu 0.0 255. FORMAT "%5.0" /end CHARACTERISTIC
/begin CHARACTERISTIC Com_swtMsgMon_ESP_15_C "Activation monitoring for message ESP_15 and for signal groups (if contained in message) (value != 0 to activate protection)" VALUE 0x8061CC13 DefaultValueRecordLayout_AUTOSAR_Platform_BaseTypes_uint8 255.0 DefaultIdenticalCompu 0.0 255. FORMAT "%5.0" /end CHARACTERISTIC
/begin CHARACTERISTIC Com_swtMsgMon_ESP_20_C "Activation monitoring for message ESP_20 and for signal groups (if contained in message) (value != 0 to activate protection)" VALUE 0x8061CC12 DefaultValueRecordLayout_AUTOSAR_Platform_BaseTypes_uint8 255.0 DefaultIdenticalCompu 0.0 255. FORMAT "%5.0" /end CHARACTERISTIC
/begin CHARACTERISTIC Com_swtMsgMon_ESP_21_C "Activation monitoring for message ESP_21 and for signal groups (if contained in message) (value != 0 to activate protection)" VALUE 0x8061CC11 DefaultValueRecordLayout_AUTOSAR_Platform_BaseTypes_uint8 255.0 DefaultIdenticalCompu 0.0 255. FORMAT "%5.0" /end CHARACTERISTIC
/begin CHARACTERISTIC Com_swtMsgMon_ESP_22_C "Activation monitoring for message ESP_22 and for signal groups (if contained in message) (value != 0 to activate protection)" VALUE 0x8061CC10 DefaultValueRecordLayout_AUTOSAR_Platform_BaseTypes_uint8 255.0 DefaultIdenticalCompu 0.0 255. FORMAT "%5.0" /end CHARACTERISTIC
/begin CHARACTERISTIC Com_swtMsgMon_ESP_23_C "Activation monitoring for message ESP_23 and for signal groups (if contained in message) (value != 0 to activate protection)" VALUE 0x8061CC0F DefaultValueRecordLayout_AUTOSAR_Platform_BaseTypes_uint8 255.0 DefaultIdenticalCompu 0.0 255. FORMAT "%5.0" /end CHARACTERISTIC
/begin CHARACTERISTIC Com_swtMsgMon_ESP_24_C "Activation monitoring for message ESP_24 and for signal groups (if contained in message) (value != 0 to activate protection)" VALUE 0x8061CC0E DefaultValueRecordLayout_AUTOSAR_Platform_BaseTypes_uint8 255.0 DefaultIdenticalCompu 0.0 255. FORMAT "%5.0" /end CHARACTERISTIC
/begin CHARACTERISTIC Com_swtMsgMon_ESP_28_C "Activation monitoring for message ESP_28 and for signal groups (if contained in message) (value != 0 to activate protection)" VALUE 0x8061CC0D DefaultValueRecordLayout_AUTOSAR_Platform_BaseTypes_uint8 255.0 DefaultIdenticalCompu 0.0 255. FORMAT "%5.0" /end CHARACTERISTIC
/begin CHARACTERISTIC Com_swtMsgMon_ESP_31_C "Activation monitoring for message ESP_31 and for signal groups (if contained in message) (value != 0 to activate protection)" VALUE 0x8061CC0C DefaultValueRecordLayout_AUTOSAR_Platform_BaseTypes_uint8 255.0 DefaultIdenticalCompu 0.0 255. FORMAT "%5.0" /end CHARACTERISTIC
/begin CHARACTERISTIC Com_swtMsgMon_ESP_32_C "Activation monitoring for message ESP_32 and for signal groups (if contained in message) (value != 0 to activate protection)" VALUE 0x8061CC0B DefaultValueRecordLayout_AUTOSAR_Platform_BaseTypes_uint8 255.0 DefaultIdenticalCompu 0.0 255. FORMAT "%5.0" /end CHARACTERISTIC
/begin CHARACTERISTIC Com_swtMsgMon_ESP_33_C "Activation monitoring for message ESP_33 and for signal groups (if contained in message) (value != 0 to activate protection)" VALUE 0x8061CC0A DefaultValueRecordLayout_AUTOSAR_Platform_BaseTypes_uint8 255.0 DefaultIdenticalCompu 0.0 255. FORMAT "%5.0" /end CHARACTERISTIC
/begin CHARACTERISTIC Com_swtMsgMon_ESP_41_C "Activation monitoring for message ESP_41 and for signal groups (if contained in message) (value != 0 to activate protection)" VALUE 0x8061CC09 DefaultValueRecordLayout_AUTOSAR_Platform_BaseTypes_uint8 255.0 DefaultIdenticalCompu 0.0 255. FORMAT "%5.0" /end CHARACTERISTIC
/begin CHARACTERISTIC Com_swtMsgMon_ESP_44_C "Activation monitoring for message ESP_44 and for signal groups (if contained in message) (value != 0 to activate protection)" VALUE 0x8061CC08 DefaultValueRecordLayout_AUTOSAR_Platform_BaseTypes_uint8 255.0 DefaultIdenticalCompu 0.0 255. FORMAT "%5.0" /end CHARACTERISTIC
/begin CHARACTERISTIC Com_swtMsgMon_Klemmen_Status_01_C "Activation monitoring for message Klemmen_Status_01 and for signal groups (if contained in message) (value != 0 to activate protection)" VALUE 0x8061CC07 DefaultValueRecordLayout_AUTOSAR_Platform_BaseTypes_uint8 255.0 DefaultIdenticalCompu 0.0 255. FORMAT "%5.0" /end CHARACTERISTIC
/begin CHARACTERISTIC Com_swtMsgMon_LCV_01_C "Activation monitoring for message LCV_01 and for signal groups (if contained in message) (value != 0 to activate protection)" VALUE 0x8061CC06 DefaultValueRecordLayout_AUTOSAR_Platform_BaseTypes_uint8 255.0 DefaultIdenticalCompu 0.0 255. FORMAT "%5.0" /end CHARACTERISTIC
/begin CHARACTERISTIC Com_swtMsgMon_LWI_01_C "Activation monitoring for message LWI_01 and for signal groups (if contained in message) (value != 0 to activate protection)" VALUE 0x8061CC05 DefaultValueRecordLayout_AUTOSAR_Platform_BaseTypes_uint8 255.0 DefaultIdenticalCompu 0.0 255. FORMAT "%5.0" /end CHARACTERISTIC
/begin CHARACTERISTIC Com_swtMsgMon_Motor_01_C "Activation monitoring for message Motor_01 and for signal groups (if contained in message) (value != 0 to activate protection)" VALUE 0x8061CC04 DefaultValueRecordLayout_AUTOSAR_Platform_BaseTypes_uint8 255.0 DefaultIdenticalCompu 0.0 255. FORMAT "%5.0" /end CHARACTERISTIC
/begin CHARACTERISTIC Com_swtMsgMon_Motor_02_C "Activation monitoring for message Motor_02 and for signal groups (if contained in message) (value != 0 to activate protection)" VALUE 0x8061CC03 DefaultValueRecordLayout_AUTOSAR_Platform_BaseTypes_uint8 255.0 DefaultIdenticalCompu 0.0 255. FORMAT "%5.0" /end CHARACTERISTIC
/begin CHARACTERISTIC Com_swtMsgMon_Motor_03_C "Activation monitoring for message Motor_03 and for signal groups (if contained in message) (value != 0 to activate protection)" VALUE 0x8061CC02 DefaultValueRecordLayout_AUTOSAR_Platform_BaseTypes_uint8 255.0 DefaultIdenticalCompu 0.0 255. FORMAT "%5.0" /end CHARACTERISTIC
/begin CHARACTERISTIC Com_swtMsgMon_Motor_11_C "Activation monitoring for message Motor_11 and for signal groups (if contained in message) (value != 0 to activate protection)" VALUE 0x8061CC01 DefaultValueRecordLayout_AUTOSAR_Platform_BaseTypes_uint8 255.0 DefaultIdenticalCompu 0.0 255. FORMAT "%5.0" /end CHARACTERISTIC
/begin CHARACTERISTIC Com_swtMsgMon_Motor_12_C "Activation monitoring for message Motor_12 and for signal groups (if contained in message) (value != 0 to activate protection)" VALUE 0x8061CC00 DefaultValueRecordLayout_AUTOSAR_Platform_BaseTypes_uint8 255.0 DefaultIdenticalCompu 0.0 255. FORMAT "%5.0" /end CHARACTERISTIC
/begin CHARACTERISTIC Com_swtMsgMon_Motor_14_C "Activation monitoring for message Motor_14 and for signal groups (if contained in message) (value != 0 to activate protection)" VALUE 0x8061CBFF DefaultValueRecordLayout_AUTOSAR_Platform_BaseTypes_uint8 255.0 DefaultIdenticalCompu 0.0 255. FORMAT "%5.0" /end CHARACTERISTIC
/begin CHARACTERISTIC Com_swtMsgMon_Motor_20_C "Activation monitoring for message Motor_20 and for signal groups (if contained in message) (value != 0 to activate protection)" VALUE 0x8061CBFE DefaultValueRecordLayout_AUTOSAR_Platform_BaseTypes_uint8 255.0 DefaultIdenticalCompu 0.0 255. FORMAT "%5.0" /end CHARACTERISTIC
/begin CHARACTERISTIC Com_swtMsgMon_Motor_27_C "Activation monitoring for message Motor_27 and for signal groups (if contained in message) (value != 0 to activate protection)" VALUE 0x8061CBFD DefaultValueRecordLayout_AUTOSAR_Platform_BaseTypes_uint8 255.0 DefaultIdenticalCompu 0.0 255. FORMAT "%5.0" /end CHARACTERISTIC
/begin CHARACTERISTIC Com_swtMsgMon_Motor_28_C "Activation monitoring for message Motor_28 and for signal groups (if contained in message) (value != 0 to activate protection)" VALUE 0x8061CBFC DefaultValueRecordLayout_AUTOSAR_Platform_BaseTypes_uint8 255.0 DefaultIdenticalCompu 0.0 255. FORMAT "%5.0" /end CHARACTERISTIC
/begin CHARACTERISTIC Com_swtMsgMon_Motor_Code_01_C "Activation monitoring for message Motor_Code_01 and for signal groups (if contained in message) (value != 0 to activate protection)" VALUE 0x8061CBFB DefaultValueRecordLayout_AUTOSAR_Platform_BaseTypes_uint8 255.0 DefaultIdenticalCompu 0.0 255. FORMAT "%5.0" /end CHARACTERISTIC
/begin CHARACTERISTIC Com_swtMsgMon_Motor_TS_01_C "Activation monitoring for message Motor_TS_01 and for signal groups (if contained in message) (value != 0 to activate protection)" VALUE 0x8061CBFA DefaultValueRecordLayout_AUTOSAR_Platform_BaseTypes_uint8 255.0 DefaultIdenticalCompu 0.0 255. FORMAT "%5.0" /end CHARACTERISTIC
/begin CHARACTERISTIC Com_swtMsgMon_Motor_TS_02_C "Activation monitoring for message Motor_TS_02 and for signal groups (if contained in message) (value != 0 to activate protection)" VALUE 0x8061CBF9 DefaultValueRecordLayout_AUTOSAR_Platform_BaseTypes_uint8 255.0 DefaultIdenticalCompu 0.0 255. FORMAT "%5.0" /end CHARACTERISTIC
/begin CHARACTERISTIC Com_swtMsgMon_Motor_TS_03_C "Activation monitoring for message Motor_TS_03 and for signal groups (if contained in message) (value != 0 to activate protection)" VALUE 0x8061CBF8 DefaultValueRecordLayout_AUTOSAR_Platform_BaseTypes_uint8 255.0 DefaultIdenticalCompu 0.0 255. FORMAT "%5.0" /end CHARACTERISTIC
/begin CHARACTERISTIC Com_swtMsgMon_SARA_06_C "Activation monitoring for message SARA_06 and for signal groups (if contained in message) (value != 0 to activate protection)" VALUE 0x8061CBF7 DefaultValueRecordLayout_AUTOSAR_Platform_BaseTypes_uint8 255.0 DefaultIdenticalCompu 0.0 255. FORMAT "%5.0" /end CHARACTERISTIC
/begin CHARACTERISTIC Com_swtMsgMon_TSG_FT_02_C "Activation monitoring for message TSG_FT_02 and for signal groups (if contained in message) (value != 0 to activate protection)" VALUE 0x8061CBF6 DefaultValueRecordLayout_AUTOSAR_Platform_BaseTypes_uint8 255.0 DefaultIdenticalCompu 0.0 255. FORMAT "%5.0" /end CHARACTERISTIC
/begin CHARACTERISTIC Com_swtMsgMon_TSK_06_C "Activation monitoring for message TSK_06 and for signal groups (if contained in message) (value != 0 to activate protection)" VALUE 0x8061CBF5 DefaultValueRecordLayout_AUTOSAR_Platform_BaseTypes_uint8 255.0 DefaultIdenticalCompu 0.0 255. FORMAT "%5.0" /end CHARACTERISTIC
/begin CHARACTERISTIC Com_swtMsgMon_TSK_08_C "Activation monitoring for message TSK_08 and for signal groups (if contained in message) (value != 0 to activate protection)" VALUE 0x8061CBF4 DefaultValueRecordLayout_AUTOSAR_Platform_BaseTypes_uint8 255.0 DefaultIdenticalCompu 0.0 255. FORMAT "%5.0" /end CHARACTERISTIC
/begin CHARACTERISTIC DST_CALIB.DST__LB63x_CluIce0ToSail "" VALUE 0x8060706C DefaultValueRecordLayout_AUTOSAR_Platform_BaseTypes_boolean 255.0 AUTOSAR_Platform_CompuMethods_boolean 0.0 255. FORMAT "%10.5"
 /begin ANNOTATION ANNOTATION_LABEL "Description (coming from AUTOSAR DESC field)"
  /begin ANNOTATION_TEXT "If true, if IOP_CluutchStateICE is 0 then geared neutral will be requested\r\n" /end ANNOTATION_TEXT
 /end ANNOTATION
/end CHARACTERISTIC
/begin CHARACTERISTIC DST_CALIB.DST__LB63x_P2P3ToNoRequest "" VALUE 0x8060706D DefaultValueRecordLayout_AUTOSAR_Platform_BaseTypes_boolean 255.0 AUTOSAR_Platform_CompuMethods_boolean 0.0 255. FORMAT "%10.5"
 /begin ANNOTATION ANNOTATION_LABEL "Description (coming from AUTOSAR DESC field)" /begin ANNOTATION_TEXT "If true, Huybrid mode will be set to decouple\r\n" /end ANNOTATION_TEXT /end ANNOTATION
/end CHARACTERISTIC
/begin CHARACTERISTIC DST_CALIB.DST__LB63x_SailInR "" VALUE 0x8060706E DefaultValueRecordLayout_AUTOSAR_Platform_BaseTypes_boolean 255.0 AUTOSAR_Platform_CompuMethods_boolean 0.0 255. FORMAT "%10.5"
 /begin ANNOTATION ANNOTATION_LABEL "Description (coming from AUTOSAR DESC field)"
  /begin ANNOTATION_TEXT "If true, Geared Neutral (gears selected but clutch open) when in Reverse\r\n" /end ANNOTATION_TEXT
 /end ANNOTATION
/end CHARACTERISTIC
/begin CHARACTERISTIC DST_CALIB.DST__LB63x_SailInREngineOff "" VALUE 0x8060706F DefaultValueRecordLayout_AUTOSAR_Platform_BaseTypes_boolean 255.0 AUTOSAR_Platform_CompuMethods_boolean 0.0 255. FORMAT "%10.5"
 /begin ANNOTATION ANNOTATION_LABEL "Description (coming from AUTOSAR DESC field)"
  /begin ANNOTATION_TEXT "If true, if IOP_CluutchStateICE is 0 then geared neutral will be requested\r\n" /end ANNOTATION_TEXT
 /end ANNOTATION
/end CHARACTERISTIC
/begin CHARACTERISTIC DST_CALIB.DST_1TYREDIAMETER "" VALUE 0x80606FC8 DefaultValueRecordLayout_AUTOSAR_Platform_BaseTypes_uint16 20000.0 RB_PT_PCT_SWC_DST_CompuMethods_ident 0.0 20000. FORMAT "%10.5"
 /begin ANNOTATION ANNOTATION_LABEL "Description (coming from AUTOSAR DESC field)" /begin ANNOTATION_TEXT "Tyre diameter\r\n" /end ANNOTATION_TEXT /end ANNOTATION
/end CHARACTERISTIC
/begin CHARACTERISTIC DST_CALIB.DST_1TYREPROFILE "" VALUE 0x80606FCA DefaultValueRecordLayout_AUTOSAR_Platform_BaseTypes_uint16 100.0 RB_PT_PCT_SWC_DST_CompuMethods_ident 0.0 100. FORMAT "%10.5"
 /begin ANNOTATION ANNOTATION_LABEL "Description (coming from AUTOSAR DESC field)" /begin ANNOTATION_TEXT "Tyre profile\r\n" /end ANNOTATION_TEXT /end ANNOTATION
/end CHARACTERISTIC
/begin CHARACTERISTIC DST_CALIB.DST_1TYREWIDTH "" VALUE 0x80606FCC DefaultValueRecordLayout_AUTOSAR_Platform_BaseTypes_uint16 1000.0 RB_PT_PCT_SWC_DST_CompuMethods_ident 0.0 1000. FORMAT "%10.5"
 /begin ANNOTATION ANNOTATION_LABEL "Description (coming from AUTOSAR DESC field)" /begin ANNOTATION_TEXT "Tyre width\r\n" /end ANNOTATION_TEXT /end ANNOTATION
/end CHARACTERISTIC
/begin CHARACTERISTIC DST_CALIB.DST_4WD_ParallelALWAYSFOLLOWCluICE "" VALUE 0x80607028 DefaultValueRecordLayout_AUTOSAR_Platform_BaseTypes_boolean 255.0 AUTOSAR_Platform_CompuMethods_boolean 0.0 255. FORMAT "%10.5"
 /begin ANNOTATION ANNOTATION_LABEL "Description (coming from AUTOSAR DESC field)"
  /begin ANNOTATION_TEXT "If true and IOP_ClutchStateOCE is 1 then Hybrid mode will be set to 4WD parallel not 4WD_Idle or 4WD_EDrive\r\n" /end ANNOTATION_TEXT
 /end ANNOTATION
/end CHARACTERISTIC
/begin CHARACTERISTIC DST_CALIB.DST_ALLOWHOLDGEARSFREEZEPSG "" VALUE 0x80607029 DefaultValueRecordLayout_AUTOSAR_Platform_BaseTypes_uint8 255.0 DefaultIdenticalCompu 0.0 255. FORMAT "%10.5"
 /begin ANNOTATION ANNOTATION_LABEL "Description (coming from AUTOSAR DESC field)" /begin ANNOTATION_TEXT "If true, throttle increasing will freeze preselect\r\n" /end ANNOTATION_TEXT /end ANNOTATION
/end CHARACTERISTIC
/begin CHARACTERISTIC DST_CALIB.DST_ASGRequest.DST_ASGKICKDOWNS "" VALUE 0x806070C4 DefaultValueRecordLayout_AUTOSAR_Platform_BaseTypes_boolean 255.0 AUTOSAR_Platform_CompuMethods_boolean 0.0 255. FORMAT "%10.5"
 /begin ANNOTATION ANNOTATION_LABEL "Description (coming from AUTOSAR DESC field)" /begin ANNOTATION_TEXT "If true kickdowns can be requested as ASG shifts\r\n" /end ANNOTATION_TEXT /end ANNOTATION
/end CHARACTERISTIC
/begin CHARACTERISTIC DST_CALIB.DST_ASGRequest.DST_ASGLOWTEMPRPMDEMANDTHRESH "" VALUE 0x806070BA DefaultValueRecordLayout_AUTOSAR_Platform_BaseTypes_sint16 20000.0 RB_PT_PCT_SWC_DST_CompuMethods_DST_Ident 0.0 20000. FORMAT "%10.5"
 /begin ANNOTATION ANNOTATION_LABEL "Description (coming from AUTOSAR DESC field)"
  /begin ANNOTATION_TEXT "Upper limit for downshift request to request ASG shift\r\n" /end ANNOTATION_TEXT
 /end ANNOTATION
/end CHARACTERISTIC
/begin CHARACTERISTIC DST_CALIB.DST_ASGRequest.DST_ASGLOWTEMPTHRESH "" VALUE 0x806070BC DefaultValueRecordLayout_AUTOSAR_Platform_BaseTypes_sint16 250.0 RB_PT_PCT_SWC_DST_CompuMethods_ident -50. 200. FORMAT "%10.5"
 /begin ANNOTATION ANNOTATION_LABEL "Description (coming from AUTOSAR DESC field)"
  /begin ANNOTATION_TEXT "Trans oil temperature below which down-shifts will be requested as ASG\r\n" /end ANNOTATION_TEXT
 /end ANNOTATION
/end CHARACTERISTIC
/begin CHARACTERISTIC DST_CALIB.DST_ASGRequest.DST_ASGLOWTEMPTHRESMAXTHROTTLE "" VALUE 0x806070C5 DefaultValueRecordLayout_AUTOSAR_Platform_BaseTypes_uint8 102.0 RB_PT_PCT_SWC_DST_CompuMethods_ratio_0p4 0.0 102. FORMAT "%10.5"
 /begin ANNOTATION ANNOTATION_LABEL "Description (coming from AUTOSAR DESC field)"
  /begin ANNOTATION_TEXT "Throttle must be below this value to request an ASG auto roll-out downshift\r\n" /end ANNOTATION_TEXT
 /end ANNOTATION
/end CHARACTERISTIC
/begin CHARACTERISTIC DST_CALIB.DST_ASGRequest.DST_ASGSPECIFICKDs "" VAL_BLK 0x80607072 DefaultValueRecordLayout_AUTOSAR_Platform_BaseTypes_boolean 255.0 AUTOSAR_Platform_CompuMethods_boolean 0.0 255. FORMAT "%10.5"
 /begin ANNOTATION ANNOTATION_LABEL "Description (coming from AUTOSAR DESC field)"
  /begin ANNOTATION_TEXT "Defines current target gear and Demand gear to allow specific ASG kickdown requests\r\n" /end ANNOTATION_TEXT
 /end ANNOTATION
 MATRIX_DIM 8 9 1 /end CHARACTERISTIC
/begin CHARACTERISTIC DST_CALIB.DST_ASGRequest.DST_ASGSPECIFICKDsENABLE "" VALUE 0x806070C6 DefaultValueRecordLayout_AUTOSAR_Platform_BaseTypes_boolean 255.0 AUTOSAR_Platform_CompuMethods_boolean 0.0 255. FORMAT "%10.5"
 /begin ANNOTATION ANNOTATION_LABEL "Description (coming from AUTOSAR DESC field)" /begin ANNOTATION_TEXT "If true, specific kickdowns can be ASG shifts\r\n" /end ANNOTATION_TEXT /end ANNOTATION
/end CHARACTERISTIC
/begin CHARACTERISTIC DST_CALIB.DST_ASGRequest.DST_IDIOTDETECTIONCONFIG "" VALUE 0x806070C7 DefaultValueRecordLayout_AUTOSAR_Platform_BaseTypes_uint8 2.0 RB_PT_PCT_SWC_DST_CompuMethods_ident 0.0 2. FORMAT "%10.5"
 /begin ANNOTATION ANNOTATION_LABEL "Description (coming from AUTOSAR DESC field)"
  /begin ANNOTATION_TEXT "0 - Idiot off, 1 - Active only for downshifts, 2 - Active for up and downshifts\r\n" /end ANNOTATION_TEXT
 /end ANNOTATION
/end CHARACTERISTIC
/begin CHARACTERISTIC DST_CALIB.DST_ASGRequest.DST_IDIOTINCSTEP "" VALUE 0x806070BE DefaultValueRecordLayout_AUTOSAR_Platform_BaseTypes_uint16 655.35 RB_PT_PCT_SWC_DST_CompuMethods_DST_Time 0.0 655.35 FORMAT "%10.5" /end CHARACTERISTIC
/begin CHARACTERISTIC DST_CALIB.DST_ASGRequest.DST_IDIOTMAXASGTIME "" VALUE 0x806070C0 DefaultValueRecordLayout_AUTOSAR_Platform_BaseTypes_uint16 655.35 RB_PT_PCT_SWC_DST_CompuMethods_DST_Time 0.0 655.35 FORMAT "%10.5"
 /begin ANNOTATION ANNOTATION_LABEL "Description (coming from AUTOSAR DESC field)" /begin ANNOTATION_TEXT "Maximum time ASG shifts can be latched\r\n" /end ANNOTATION_TEXT /end ANNOTATION
/end CHARACTERISTIC
/begin CHARACTERISTIC DST_CALIB.DST_ASGRequest.DST_IDIOTTRIGGER "" VALUE 0x806070C2 DefaultValueRecordLayout_AUTOSAR_Platform_BaseTypes_uint16 655.35 RB_PT_PCT_SWC_DST_CompuMethods_DST_Time 0.0 655.35 FORMAT "%10.5" /end CHARACTERISTIC
/begin CHARACTERISTIC DST_CALIB.DST_BOB_DEMANDGEAR "" VALUE 0x80607039 DefaultValueRecordLayout_AUTOSAR_Platform_BaseTypes_uint8 11.0 RB_PT_PCT_SWC_DST_CompuMethods_ident 0.0 11. FORMAT "%10.5"
 /begin ANNOTATION ANNOTATION_LABEL "Description (coming from AUTOSAR DESC field)" /begin ANNOTATION_TEXT "Demand gear BOB output\r\n" /end ANNOTATION_TEXT /end ANNOTATION
/end CHARACTERISTIC
/begin CHARACTERISTIC DST_CALIB.DST_BOB_DRIVINGMODE "" VALUE 0x8060703A DefaultValueRecordLayout_AUTOSAR_Platform_BaseTypes_uint8 11.0 RB_PT_PCT_SWC_DST_CompuMethods_Enumerations_DST_Mode 0.0 11. FORMAT "%10.5"
 /begin ANNOTATION ANNOTATION_LABEL "Description (coming from AUTOSAR DESC field)" /begin ANNOTATION_TEXT "BOB override value for DST_DrivingMode\r\n" /end ANNOTATION_TEXT /end ANNOTATION
/end CHARACTERISTIC
/begin CHARACTERISTIC DST_CALIB.DST_BOB_DRIVINGMODEENABLE "" VALUE 0x8060703B DefaultValueRecordLayout_AUTOSAR_Platform_BaseTypes_boolean 255.0 AUTOSAR_Platform_CompuMethods_boolean 0.0 255. FORMAT "%10.5"
 /begin ANNOTATION ANNOTATION_LABEL "Description (coming from AUTOSAR DESC field)" /begin ANNOTATION_TEXT "Flag to enble development BOB for DST Outputs\r\n" /end ANNOTATION_TEXT /end ANNOTATION
/end CHARACTERISTIC
/begin CHARACTERISTIC DST_CALIB.DST_BOB_GEARSENABLE "" VALUE 0x8060703C DefaultValueRecordLayout_AUTOSAR_Platform_BaseTypes_boolean 255.0 AUTOSAR_Platform_CompuMethods_boolean 0.0 255. FORMAT "%10.5"
 /begin ANNOTATION ANNOTATION_LABEL "Description (coming from AUTOSAR DESC field)" /begin ANNOTATION_TEXT "Flag to enble development BOB for DST Outputs\r\n" /end ANNOTATION_TEXT /end ANNOTATION
/end CHARACTERISTIC
/begin CHARACTERISTIC DST_CALIB.DST_BOB_HYBRIDMODE "" VALUE 0x8060703D DefaultValueRecordLayout_AUTOSAR_Platform_BaseTypes_uint8 14.0 RB_PT_PCT_SWC_DST_CompuMethods_Enumerations_DST_ModeHyb 0.0 14. FORMAT "%10.5"
 /begin ANNOTATION ANNOTATION_LABEL "Description (coming from AUTOSAR DESC field)" /begin ANNOTATION_TEXT "BOB override for DST_HybridModeInt\r\n" /end ANNOTATION_TEXT /end ANNOTATION
/end CHARACTERISTIC
/begin CHARACTERISTIC DST_CALIB.DST_BOB_HYBRIDMODEENABLE "" VALUE 0x8060703E DefaultValueRecordLayout_AUTOSAR_Platform_BaseTypes_boolean 255.0 AUTOSAR_Platform_CompuMethods_boolean 0.0 255. FORMAT "%10.5"
 /begin ANNOTATION ANNOTATION_LABEL "Description (coming from AUTOSAR DESC field)" /begin ANNOTATION_TEXT "Flag to enble development BOB for DST Outputs\r\n" /end ANNOTATION_TEXT /end ANNOTATION
/end CHARACTERISTIC
/begin CHARACTERISTIC DST_CALIB.DST_BOB_PRESELECTGEAR "" VALUE 0x8060703F DefaultValueRecordLayout_AUTOSAR_Platform_BaseTypes_uint8 11.0 RB_PT_PCT_SWC_DST_CompuMethods_ident 0.0 11. FORMAT "%10.5"
 /begin ANNOTATION ANNOTATION_LABEL "Description (coming from AUTOSAR DESC field)" /begin ANNOTATION_TEXT "Demand gear BOB output\r\n" /end ANNOTATION_TEXT /end ANNOTATION
/end CHARACTERISTIC
/begin CHARACTERISTIC DST_CALIB.DST_BOBIN_BRAKEPRESS "" VALUE 0x80606FD0 DefaultValueRecordLayout_AUTOSAR_Platform_BaseTypes_uint16 409.5 RB_PT_PCT_SWC_DST_CompuMethods_ratio_0p1 0.0 409.5 FORMAT "%10.5"
 /begin ANNOTATION ANNOTATION_LABEL "Description (coming from AUTOSAR DESC field)" /begin ANNOTATION_TEXT "DST BOB override for brake pressure\r\n" /end ANNOTATION_TEXT /end ANNOTATION
/end CHARACTERISTIC
/begin CHARACTERISTIC DST_CALIB.DST_BOBIN_BRAKESW "" VALUE 0x8060702A DefaultValueRecordLayout_AUTOSAR_Platform_BaseTypes_boolean 255.0 AUTOSAR_Platform_CompuMethods_boolean 0.0 255. FORMAT "%10.5"
 /begin ANNOTATION ANNOTATION_LABEL "Description (coming from AUTOSAR DESC field)" /begin ANNOTATION_TEXT "DST BOB override for Brake switch\r\n" /end ANNOTATION_TEXT /end ANNOTATION
/end CHARACTERISTIC
/begin CHARACTERISTIC DST_CALIB.DST_BOBIN_DOWNSWITCHSTATUS "" VALUE 0x8060702B DefaultValueRecordLayout_AUTOSAR_Platform_BaseTypes_boolean 255.0 AUTOSAR_Platform_CompuMethods_boolean 0.0 255. FORMAT "%10.5"
 /begin ANNOTATION ANNOTATION_LABEL "Description (coming from AUTOSAR DESC field)" /begin ANNOTATION_TEXT "DST BOB override for downshift status\r\n" /end ANNOTATION_TEXT /end ANNOTATION
/end CHARACTERISTIC
/begin CHARACTERISTIC DST_CALIB.DST_BOBIN_HYBMODE "" VALUE 0x8060702C DefaultValueRecordLayout_AUTOSAR_Platform_BaseTypes_uint8 255.0 RB_PT_PCT_SWC_DST_CompuMethods_ident 0.0 255. FORMAT "%10.5"
 /begin ANNOTATION ANNOTATION_LABEL "Description (coming from AUTOSAR DESC field)" /begin ANNOTATION_TEXT "DST BOB override for hybrid mode request\r\n" /end ANNOTATION_TEXT /end ANNOTATION
/end CHARACTERISTIC
/begin CHARACTERISTIC DST_CALIB.DST_BOBIN_INIDONE "" VALUE 0x8060702D DefaultValueRecordLayout_AUTOSAR_Platform_BaseTypes_boolean 255.0 AUTOSAR_Platform_CompuMethods_boolean 0.0 255. FORMAT "%10.5"
 /begin ANNOTATION ANNOTATION_LABEL "Description (coming from AUTOSAR DESC field)" /begin ANNOTATION_TEXT "DST BOB override for  INI done\r\n" /end ANNOTATION_TEXT /end ANNOTATION
/end CHARACTERISTIC
/begin CHARACTERISTIC DST_CALIB.DST_BOBIN_KL15 "" VALUE 0x8060702E DefaultValueRecordLayout_AUTOSAR_Platform_BaseTypes_boolean 255.0 AUTOSAR_Platform_CompuMethods_boolean 0.0 255. FORMAT "%10.5"
 /begin ANNOTATION ANNOTATION_LABEL "Description (coming from AUTOSAR DESC field)" /begin ANNOTATION_TEXT "DST BOB override for KL15\r\n" /end ANNOTATION_TEXT /end ANNOTATION
/end CHARACTERISTIC
/begin CHARACTERISTIC DST_CALIB.DST_BOBIN_M "" VALUE 0x8060702F DefaultValueRecordLayout_AUTOSAR_Platform_BaseTypes_boolean 255.0 AUTOSAR_Platform_CompuMethods_boolean 0.0 255. FORMAT "%10.5"
 /begin ANNOTATION ANNOTATION_LABEL "Description (coming from AUTOSAR DESC field)" /begin ANNOTATION_TEXT "DST BOB override for  M button\r\n" /end ANNOTATION_TEXT /end ANNOTATION
/end CHARACTERISTIC
/begin CHARACTERISTIC DST_CALIB.DST_BOBIN_P "" VALUE 0x80607030 DefaultValueRecordLayout_AUTOSAR_Platform_BaseTypes_boolean 255.0 AUTOSAR_Platform_CompuMethods_boolean 0.0 255. FORMAT "%10.5"
 /begin ANNOTATION ANNOTATION_LABEL "Description (coming from AUTOSAR DESC field)" /begin ANNOTATION_TEXT "DST BOB override for P button\r\n" /end ANNOTATION_TEXT /end ANNOTATION
/end CHARACTERISTIC
/begin CHARACTERISTIC DST_CALIB.DST_BOBIN_PADDLEDOWN "" VALUE 0x80607031 DefaultValueRecordLayout_AUTOSAR_Platform_BaseTypes_boolean 255.0 AUTOSAR_Platform_CompuMethods_boolean 0.0 255. FORMAT "%10.5"
 /begin ANNOTATION ANNOTATION_LABEL "Description (coming from AUTOSAR DESC field)" /begin ANNOTATION_TEXT "DST BOB override for down paddle input\r\n" /end ANNOTATION_TEXT /end ANNOTATION
/end CHARACTERISTIC
/begin CHARACTERISTIC DST_CALIB.DST_BOBIN_PADDLEUP "" VALUE 0x80607032 DefaultValueRecordLayout_AUTOSAR_Platform_BaseTypes_boolean 255.0 AUTOSAR_Platform_CompuMethods_boolean 0.0 255. FORMAT "%10.5"
 /begin ANNOTATION ANNOTATION_LABEL "Description (coming from AUTOSAR DESC field)" /begin ANNOTATION_TEXT "DST BOB override for up paddle\r\n" /end ANNOTATION_TEXT /end ANNOTATION
/end CHARACTERISTIC
/begin CHARACTERISTIC DST_CALIB.DST_BOBIN_PARKBUTTONSTATUS "" VALUE 0x80607033 DefaultValueRecordLayout_AUTOSAR_Platform_BaseTypes_boolean 255.0 AUTOSAR_Platform_CompuMethods_boolean 0.0 255. FORMAT "%10.5"
 /begin ANNOTATION ANNOTATION_LABEL "Description (coming from AUTOSAR DESC field)" /begin ANNOTATION_TEXT "DST BOB override for park button status\r\n" /end ANNOTATION_TEXT /end ANNOTATION
/end CHARACTERISTIC
/begin CHARACTERISTIC DST_CALIB.DST_BOBIN_R "" VALUE 0x80607034 DefaultValueRecordLayout_AUTOSAR_Platform_BaseTypes_boolean 255.0 AUTOSAR_Platform_CompuMethods_boolean 0.0 255. FORMAT "%10.5"
 /begin ANNOTATION ANNOTATION_LABEL "Description (coming from AUTOSAR DESC field)" /begin ANNOTATION_TEXT "DST BOB override for R button input\r\n" /end ANNOTATION_TEXT /end ANNOTATION
/end CHARACTERISTIC
/begin CHARACTERISTIC DST_CALIB.DST_BOBIN_REVERSESWITCHSTATUS "" VALUE 0x80607035 DefaultValueRecordLayout_AUTOSAR_Platform_BaseTypes_boolean 255.0 AUTOSAR_Platform_CompuMethods_boolean 0.0 255. FORMAT "%10.5"
 /begin ANNOTATION ANNOTATION_LABEL "Description (coming from AUTOSAR DESC field)" /begin ANNOTATION_TEXT "DST BOB override for reverse switch status\r\n" /end ANNOTATION_TEXT /end ANNOTATION
/end CHARACTERISTIC
/begin CHARACTERISTIC DST_CALIB.DST_BOBIN_THROTTLE "" VALUE 0x80607036 DefaultValueRecordLayout_AUTOSAR_Platform_BaseTypes_uint8 102.0 RB_PT_PCT_SWC_DST_CompuMethods_ratio_0p4 0.0 102. FORMAT "%10.5"
 /begin ANNOTATION ANNOTATION_LABEL "Description (coming from AUTOSAR DESC field)" /begin ANNOTATION_TEXT "DST BOB override for  throttle\r\n" /end ANNOTATION_TEXT /end ANNOTATION
/end CHARACTERISTIC
/begin CHARACTERISTIC DST_CALIB.DST_BOBIN_UPSWITCHSTATUS "" VALUE 0x80607037 DefaultValueRecordLayout_AUTOSAR_Platform_BaseTypes_boolean 255.0 AUTOSAR_Platform_CompuMethods_boolean 0.0 255. FORMAT "%10.5"
 /begin ANNOTATION ANNOTATION_LABEL "Description (coming from AUTOSAR DESC field)" /begin ANNOTATION_TEXT "DST BOB override for upshift status\r\n" /end ANNOTATION_TEXT /end ANNOTATION
/end CHARACTERISTIC
/begin CHARACTERISTIC DST_CALIB.DST_BOBINS "" VALUE 0x80606FCE DefaultValueRecordLayout_AUTOSAR_Platform_BaseTypes_uint16 65535.0 RB_PT_PCT_SWC_DST_CompuMethods_ident 0.0 65535. FORMAT "%10.5"
 /begin ANNOTATION ANNOTATION_LABEL "Description (coming from AUTOSAR DESC field)" /begin ANNOTATION_TEXT "Set to 21930 to override some inputs to DST\r\n" /end ANNOTATION_TEXT /end ANNOTATION
/end CHARACTERISTIC
/begin CHARACTERISTIC DST_CALIB.DST_BOBSTATUSLONGACC "" VALUE 0x80607038 DefaultValueRecordLayout_AUTOSAR_Platform_BaseTypes_boolean 255.0 AUTOSAR_Platform_CompuMethods_boolean 0.0 255. FORMAT "%10.5"
 /begin ANNOTATION ANNOTATION_LABEL "Description (coming from AUTOSAR DESC field)" /begin ANNOTATION_TEXT "DST BOB override for status of the long acc sensor\r\n" /end ANNOTATION_TEXT /end ANNOTATION
/end CHARACTERISTIC
/begin CHARACTERISTIC DST_CALIB.DST_BYPASSDWCSELFTEST "" VALUE 0x80607040 DefaultValueRecordLayout_AUTOSAR_Platform_BaseTypes_uint8 255.0 DefaultIdenticalCompu 0.0 255. FORMAT "%10.5"
 /begin ANNOTATION ANNOTATION_LABEL "Description (coming from AUTOSAR DESC field)"
  /begin ANNOTATION_TEXT "If true then self test is not required to select gears\r\n" /end ANNOTATION_TEXT
 /end ANNOTATION
/end CHARACTERISTIC
/begin CHARACTERISTIC DST_CALIB.DST_CANCELLATCHEDMANUAL "" VAL_BLK 0x80606F65 DefaultValueRecordLayout_AUTOSAR_Platform_BaseTypes_boolean 255.0 AUTOSAR_Platform_CompuMethods_boolean 0.0 255. FORMAT "%10.5"
 /begin ANNOTATION ANNOTATION_LABEL "Description (coming from AUTOSAR DESC field)"
  /begin ANNOTATION_TEXT "If true, this value of IOP_DriveModeTrans will force to manual mode\r\n" /end ANNOTATION_TEXT
 /end ANNOTATION
 MATRIX_DIM 16 1 1 /end CHARACTERISTIC
/begin CHARACTERISTIC DST_CALIB.DST_COUNTS4CHARGERATTACHEDWARN "" VALUE 0x80606FD2 DefaultValueRecordLayout_AUTOSAR_Platform_BaseTypes_uint16 65535.0 RB_PT_PCT_SWC_DST_CompuMethods_ident 0.0 65535. FORMAT "%10.5"
 /begin ANNOTATION ANNOTATION_LABEL "Description (coming from AUTOSAR DESC field)"
  /begin ANNOTATION_TEXT "Number of program loops the charger attached warning will be displayed for\r\n" /end ANNOTATION_TEXT
 /end ANNOTATION
/end CHARACTERISTIC
/begin CHARACTERISTIC DST_CALIB.DST_CRUISEACTIVE "" VAL_BLK 0x80606FB5 DefaultValueRecordLayout_AUTOSAR_Platform_BaseTypes_uint8 255.0 DefaultIdenticalCompu 0.0 255. FORMAT "%10.5" MATRIX_DIM 8 1 1 /end CHARACTERISTIC
/begin CHARACTERISTIC DST_CALIB.DST_CRUISESTATUS "" VALUE 0x80607041 DefaultValueRecordLayout_AUTOSAR_Platform_BaseTypes_uint8 3.0 RB_PT_PCT_SWC_DST_CompuMethods_Enumerations_DST_CruiseStatus 0.0 3. FORMAT "%10.5"
 /begin ANNOTATION ANNOTATION_LABEL "Description (coming from AUTOSAR DESC field)"
  /begin ANNOTATION_TEXT "Gives ability to change the internal throttle pedal based on cruise control status\r\n" /end ANNOTATION_TEXT
 /end ANNOTATION
/end CHARACTERISTIC
/begin CHARACTERISTIC DST_CALIB.DST_DEFAULTNORMALMODE "" VALUE 0x80607042 DefaultValueRecordLayout_AUTOSAR_Platform_BaseTypes_uint8 15.0 RB_PT_PCT_SWC_DST_CompuMethods_ident 0.0 15. FORMAT "%10.5"
 /begin ANNOTATION ANNOTATION_LABEL "Description (coming from AUTOSAR DESC field)"
  /begin ANNOTATION_TEXT "If normal mode is forced (manual unavaialble etc) this is the shift map to use\r\n" /end ANNOTATION_TEXT
 /end ANNOTATION
/end CHARACTERISTIC
/begin CHARACTERISTIC DST_CALIB.DST_DetectInstability.DST_CHANGES2FREEZE "" VALUE 0x806071C4 DefaultValueRecordLayout_AUTOSAR_Platform_BaseTypes_uint8 7.0 RB_PT_PCT_SWC_DST_CompuMethods_ident 1. 8. FORMAT "%10.5"
 /begin ANNOTATION ANNOTATION_LABEL "Description (coming from AUTOSAR DESC field)" /begin ANNOTATION_TEXT "Number of gear changes to freeze the output\r\n" /end ANNOTATION_TEXT /end ANNOTATION
/end CHARACTERISTIC
/begin CHARACTERISTIC DST_CALIB.DST_DetectInstability.DST_MINCOUNTSBETWEENCHNG "" VALUE 0x806071C5 DefaultValueRecordLayout_AUTOSAR_Platform_BaseTypes_uint8 252.0 RB_PT_PCT_SWC_DST_CompuMethods_ident 3. 255. FORMAT "%10.5"
 /begin ANNOTATION ANNOTATION_LABEL "Description (coming from AUTOSAR DESC field)"
  /begin ANNOTATION_TEXT "Minimum program loops between gear changes before instability counter starts\r\n" /end ANNOTATION_TEXT
 /end ANNOTATION
/end CHARACTERISTIC
/begin CHARACTERISTIC DST_CALIB.DST_DetectInstability.DST_UNSTABLEHOLDCOUNT "" VALUE 0x806071C6 DefaultValueRecordLayout_AUTOSAR_Platform_BaseTypes_uint8 155.0 RB_PT_PCT_SWC_DST_CompuMethods_ident 100. 255. FORMAT "%10.5"
 /begin ANNOTATION ANNOTATION_LABEL "Description (coming from AUTOSAR DESC field)"
  /begin ANNOTATION_TEXT "Loops to hold the preselect and demand gear after instability has been detected\r\n" /end ANNOTATION_TEXT
 /end ANNOTATION
/end CHARACTERISTIC
/begin CHARACTERISTIC DST_CALIB.DST_DG.DST_DGSelect.DST_MINRPMUPSHIFTALTITUDE "" MAP 0x806070FE RB_PT_PCT_SWC_DST_RecordLayouts_RL_Map_sint16_60_uint8_5_uint8_12 20000.0 RB_PT_PCT_SWC_DST_CompuMethods_DST_Ident 0.0 20000. FORMAT "%10.5"
 /begin AXIS_DESCR STD_AXIS NO_INPUT_QUANTITY RB_PT_PCT_SWC_DST_CompuMethods_ratio_0p4 5 0.0 102. FORMAT "%10.5" DEPOSIT ABSOLUTE /end AXIS_DESCR
 /begin AXIS_DESCR STD_AXIS NO_INPUT_QUANTITY RB_PT_PCT_SWC_DST_CompuMethods_ident 12 0.0 11. FORMAT "%10.5" DEPOSIT ABSOLUTE /end AXIS_DESCR
/end CHARACTERISTIC
/begin CHARACTERISTIC DST_CALIB.DST_DG.DST_DGSelect.DST_MODECHANGEDOWNCRUISEENABLE "" VALUE 0x806070F6 DefaultValueRecordLayout_AUTOSAR_Platform_BaseTypes_uint8 255.0 DefaultIdenticalCompu 0.0 255. FORMAT "%10.5"
 /begin ANNOTATION ANNOTATION_LABEL "Description (coming from AUTOSAR DESC field)" /begin ANNOTATION_TEXT "Enable mode change downshift when in cruise\r\n" /end ANNOTATION_TEXT /end ANNOTATION
/end CHARACTERISTIC
/begin CHARACTERISTIC DST_CALIB.DST_DG.DST_DGSelect.DST_MODECHANGEDOWNGEARS "" VAL_BLK 0x806070D8 DefaultValueRecordLayout_AUTOSAR_Platform_BaseTypes_uint8 11.0 RB_PT_PCT_SWC_DST_CompuMethods_ident 0.0 11. FORMAT "%10.5"
 /begin ANNOTATION ANNOTATION_LABEL "Description (coming from AUTOSAR DESC field)" /begin ANNOTATION_TEXT "Number of gears to downsift based on last gear\r\n" /end ANNOTATION_TEXT /end ANNOTATION
 MATRIX_DIM 12 1 1 /end CHARACTERISTIC
/begin CHARACTERISTIC DST_CALIB.DST_DG.DST_DGSelect.DST_MODECHANGEDOWNMANENABLE "" VALUE 0x806070F7 DefaultValueRecordLayout_AUTOSAR_Platform_BaseTypes_uint8 255.0 DefaultIdenticalCompu 0.0 255. FORMAT "%10.5"
 /begin ANNOTATION ANNOTATION_LABEL "Description (coming from AUTOSAR DESC field)" /begin ANNOTATION_TEXT "Enable mode change downshift when in cruise\r\n" /end ANNOTATION_TEXT /end ANNOTATION
/end CHARACTERISTIC
/begin CHARACTERISTIC DST_CALIB.DST_DG.DST_DGSelect.DST_MODECHANGEDOWNMAXACCEL "" VALUE 0x806070E4 DefaultValueRecordLayout_AUTOSAR_Platform_BaseTypes_sint16 4.0 RB_PT_PCT_SWC_DST_CompuMethods_ratio_0p01 -2. 2. FORMAT "%10.5"
 /begin ANNOTATION ANNOTATION_LABEL "Description (coming from AUTOSAR DESC field)" /begin ANNOTATION_TEXT "Maximum acceleration to enable mode change downshift\r\n" /end ANNOTATION_TEXT /end ANNOTATION
/end CHARACTERISTIC
/begin CHARACTERISTIC DST_CALIB.DST_DG.DST_DGSelect.DST_MODECHANGEDOWNMAXGRAD "" VALUE 0x806070E6 DefaultValueRecordLayout_AUTOSAR_Platform_BaseTypes_sint16 65.4 RB_PT_PCT_SWC_DST_CompuMethods_ratio_0p001 -32.7 32.7 FORMAT "%10.5"
 /begin ANNOTATION ANNOTATION_LABEL "Description (coming from AUTOSAR DESC field)" /begin ANNOTATION_TEXT "Maximum gradient to allow mode change downshift\r\n" /end ANNOTATION_TEXT /end ANNOTATION
/end CHARACTERISTIC
/begin CHARACTERISTIC DST_CALIB.DST_DG.DST_DGSelect.DST_MODECHANGEDOWNMAXLATACC "" VALUE 0x806070F8 DefaultValueRecordLayout_AUTOSAR_Platform_BaseTypes_uint8 1.27 RB_PT_PCT_SWC_DST_CompuMethods_ratio_0p01 0.0 1.27 FORMAT "%10.5"
 /begin ANNOTATION ANNOTATION_LABEL "Description (coming from AUTOSAR DESC field)"
  /begin ANNOTATION_TEXT "Maximum lateral acceleration to allow mode change downshifts\r\n" /end ANNOTATION_TEXT
 /end ANNOTATION
/end CHARACTERISTIC
/begin CHARACTERISTIC DST_CALIB.DST_DG.DST_DGSelect.DST_MODECHANGEDOWNMAXTHROTTLE "" VALUE 0x806070F9 DefaultValueRecordLayout_AUTOSAR_Platform_BaseTypes_uint8 102.0 RB_PT_PCT_SWC_DST_CompuMethods_ratio_0p4 0.0 102. FORMAT "%10.5"
 /begin ANNOTATION ANNOTATION_LABEL "Description (coming from AUTOSAR DESC field)" /begin ANNOTATION_TEXT "Maximum throttle to trigger mode change downshifts\r\n" /end ANNOTATION_TEXT /end ANNOTATION
/end CHARACTERISTIC
/begin CHARACTERISTIC DST_CALIB.DST_DG.DST_DGSelect.DST_MODECHANGEDOWNMINACCEL "" VALUE 0x806070E8 DefaultValueRecordLayout_AUTOSAR_Platform_BaseTypes_sint16 4.0 RB_PT_PCT_SWC_DST_CompuMethods_ratio_0p01 -2. 2. FORMAT "%10.5"
 /begin ANNOTATION ANNOTATION_LABEL "Description (coming from AUTOSAR DESC field)" /begin ANNOTATION_TEXT "Maximum acceleration to enable mode change downshift\r\n" /end ANNOTATION_TEXT /end ANNOTATION
/end CHARACTERISTIC
/begin CHARACTERISTIC DST_CALIB.DST_DG.DST_DGSelect.DST_MODECHANGEDOWNMINGRAD "" VALUE 0x806070EA DefaultValueRecordLayout_AUTOSAR_Platform_BaseTypes_sint16 65.4 RB_PT_PCT_SWC_DST_CompuMethods_ratio_0p001 -32.7 32.7 FORMAT "%10.5"
 /begin ANNOTATION ANNOTATION_LABEL "Description (coming from AUTOSAR DESC field)" /begin ANNOTATION_TEXT "Maximum gradient to allow mode change downshift\r\n" /end ANNOTATION_TEXT /end ANNOTATION
/end CHARACTERISTIC
/begin CHARACTERISTIC DST_CALIB.DST_DG.DST_DGSelect.DST_MODECHANGEDOWNMINKMH "" VALUE 0x806070EC DefaultValueRecordLayout_AUTOSAR_Platform_BaseTypes_uint16 500.0 RB_PT_PCT_SWC_DST_CompuMethods_kph_0p1 0.0 500. FORMAT "%10.5"
 /begin ANNOTATION ANNOTATION_LABEL "Description (coming from AUTOSAR DESC field)" /begin ANNOTATION_TEXT "Minimum speed for mode change downshift\r\n" /end ANNOTATION_TEXT /end ANNOTATION
/end CHARACTERISTIC
/begin CHARACTERISTIC DST_CALIB.DST_DG.DST_DGSelect.DST_MODECHANGEDOWNMODES "" VAL_BLK 0x806070C8 DefaultValueRecordLayout_AUTOSAR_Platform_BaseTypes_uint8 255.0 DefaultIdenticalCompu 0.0 255. FORMAT "%10.5" MATRIX_DIM 16 1 1 /end CHARACTERISTIC
/begin CHARACTERISTIC DST_CALIB.DST_DG.DST_DGSelect.DST_MODECHANGEDOWNSHIFTMODELAST "" VALUE 0x806070FA DefaultValueRecordLayout_AUTOSAR_Platform_BaseTypes_uint8 16.0 RB_PT_PCT_SWC_DST_CompuMethods_ident 0.0 16. FORMAT "%10.5"
 /begin ANNOTATION ANNOTATION_LABEL "Description (coming from AUTOSAR DESC field)"
  /begin ANNOTATION_TEXT "Highest shift mode for mode change downshift to be active\r\n" /end ANNOTATION_TEXT
 /end ANNOTATION
/end CHARACTERISTIC
/begin CHARACTERISTIC DST_CALIB.DST_DG.DST_DGSelect.DST_MODECHANGEDOWNSHIFTMODELIM "" VALUE 0x806070FB DefaultValueRecordLayout_AUTOSAR_Platform_BaseTypes_uint8 16.0 RB_PT_PCT_SWC_DST_CompuMethods_ident 0.0 16. FORMAT "%10.5"
 /begin ANNOTATION ANNOTATION_LABEL "Description (coming from AUTOSAR DESC field)"
  /begin ANNOTATION_TEXT "Highest shift mode for mode change downshift to be active\r\n" /end ANNOTATION_TEXT
 /end ANNOTATION
/end CHARACTERISTIC
/begin CHARACTERISTIC DST_CALIB.DST_DG.DST_DGSelect.DST_MODECHANGEDOWNSHIFTMODEMIN "" VALUE 0x806070FC DefaultValueRecordLayout_AUTOSAR_Platform_BaseTypes_uint8 16.0 RB_PT_PCT_SWC_DST_CompuMethods_ident 0.0 16. FORMAT "%10.5"
 /begin ANNOTATION ANNOTATION_LABEL "Description (coming from AUTOSAR DESC field)"
  /begin ANNOTATION_TEXT "Highest shift mode for mode change downshift to be active\r\n" /end ANNOTATION_TEXT
 /end ANNOTATION
/end CHARACTERISTIC
/begin CHARACTERISTIC DST_CALIB.DST_DG.DST_DGSelect.DST_PRESSURENOTOK4LOWRPM "" VALUE 0x806070EE DefaultValueRecordLayout_AUTOSAR_Platform_BaseTypes_uint16 2.0 RB_PT_PCT_SWC_DST_CompuMethods_ratio_0p001 0.0 2. FORMAT "%10.5"
 /begin ANNOTATION ANNOTATION_LABEL "Description (coming from AUTOSAR DESC field)" /begin ANNOTATION_TEXT "Pressure above which normal shifting is restored\r\n" /end ANNOTATION_TEXT /end ANNOTATION
/end CHARACTERISTIC
/begin CHARACTERISTIC DST_CALIB.DST_DG.DST_DGSelect.DST_PRESSUREOK4LOWRPM "" VALUE 0x806070F0 DefaultValueRecordLayout_AUTOSAR_Platform_BaseTypes_uint16 2.0 RB_PT_PCT_SWC_DST_CompuMethods_ratio_0p001 0.0 2. FORMAT "%10.5"
 /begin ANNOTATION ANNOTATION_LABEL "Description (coming from AUTOSAR DESC field)" /begin ANNOTATION_TEXT "Pressure above which normal shifting is restored\r\n" /end ANNOTATION_TEXT /end ANNOTATION
/end CHARACTERISTIC
/begin CHARACTERISTIC DST_CALIB.DST_DG.DST_DGSelect.DST_TIMEDOWNSHIFTHOLDINHIBITTME "" VALUE 0x806070F2 DefaultValueRecordLayout_AUTOSAR_Platform_BaseTypes_uint16 655.35 RB_PT_PCT_SWC_DST_CompuMethods_DST_Time 0.0 655.35 FORMAT "%10.5" /end CHARACTERISTIC
/begin CHARACTERISTIC DST_CALIB.DST_DG.DST_DGSelect.DST_TIMEDOWNSHIFTHOLDLOWERGEAR "" VALUE 0x806070F4 DefaultValueRecordLayout_AUTOSAR_Platform_BaseTypes_uint16 655.35 RB_PT_PCT_SWC_DST_CompuMethods_DST_Time 0.0 655.35 FORMAT "%10.5" /end CHARACTERISTIC
/begin CHARACTERISTIC DST_CALIB.DST_DG.DST_ShiftPointsAndComp.DST_CompensationManager.DST_CORNERHOLDTIMEROWSELECT "" VAL_BLK 0x8060718C DefaultValueRecordLayout_AUTOSAR_Platform_BaseTypes_uint8 1.0 RB_PT_PCT_SWC_DST_CompuMethods_ident 0.0 1. FORMAT "%10.5"
 /begin ANNOTATION ANNOTATION_LABEL "Description (coming from AUTOSAR DESC field)" /begin ANNOTATION_TEXT "Use to select row 0 or 1 of DST_CORNERHOLDTIME2D\r\n" /end ANNOTATION_TEXT /end ANNOTATION
 MATRIX_DIM 17 1 1 /end CHARACTERISTIC
/begin CHARACTERISTIC DST_CALIB.DST_DG.DST_ShiftPointsAndComp.DST_CompensationManager.DST_DECELHOLDTIMELIMIT_PEDAL "" CURVE 0x806071AE RB_PT_PCT_SWC_DST_RecordLayouts_RL_Curve_sint16_4_uint8_4 10.0 RB_PT_PCT_SWC_DST_CompuMethods_DST_Time 0.0 10. FORMAT "%10.5"
 /begin ANNOTATION ANNOTATION_LABEL "Description (coming from AUTOSAR DESC field)"
  /begin ANNOTATION_TEXT "Upper limit of Decel hold time based on Driver demand\r\n" /end ANNOTATION_TEXT
 /end ANNOTATION
 /begin AXIS_DESCR STD_AXIS NO_INPUT_QUANTITY RB_PT_PCT_SWC_DST_CompuMethods_ratio_0p4 4 0.0 102. FORMAT "%10.5" DEPOSIT ABSOLUTE /end AXIS_DESCR
/end CHARACTERISTIC
/begin CHARACTERISTIC DST_CALIB.DST_DG.DST_ShiftPointsAndComp.DST_CompensationManager.DST_DECELHOLDTIMEROWSELECT "" VAL_BLK 0x8060719D DefaultValueRecordLayout_AUTOSAR_Platform_BaseTypes_uint8 1.0 RB_PT_PCT_SWC_DST_CompuMethods_ident 0.0 1. FORMAT "%10.5"
 /begin ANNOTATION ANNOTATION_LABEL "Description (coming from AUTOSAR DESC field)" /begin ANNOTATION_TEXT "Select row 0 or 1 of DST_DECELHOLDTIME2D\r\n" /end ANNOTATION_TEXT /end ANNOTATION
 MATRIX_DIM 17 1 1 /end CHARACTERISTIC
/begin CHARACTERISTIC DST_CALIB.DST_DG.DST_ShiftPointsAndComp.DST_ShiftCompensation.DST_DECELUPPERLIMITCLAMP "" VALUE 0x806071BC DefaultValueRecordLayout_AUTOSAR_Platform_BaseTypes_uint16 20000.0 RB_PT_PCT_SWC_DST_CompuMethods_DST_Ident 0.0 20000. FORMAT "%10.5"
 /begin ANNOTATION ANNOTATION_LABEL "Description (coming from AUTOSAR DESC field)" /begin ANNOTATION_TEXT "Lower limit of DecelRpmUpperLimit\r\n" /end ANNOTATION_TEXT /end ANNOTATION
/end CHARACTERISTIC
/begin CHARACTERISTIC DST_CALIB.DST_DG.DST_ShiftPointsAndComp.DST_ShiftCompensation.DST_DOWNSHIFTIDLEUPPERLIMIT "" VALUE 0x806071BE DefaultValueRecordLayout_AUTOSAR_Platform_BaseTypes_uint16 20000.0 RB_PT_PCT_SWC_DST_CompuMethods_ident 0.0 20000. FORMAT "%10.5"
 /begin ANNOTATION ANNOTATION_LABEL "Description (coming from AUTOSAR DESC field)"
  /begin ANNOTATION_TEXT "Upper limit allowed to cause early downshifts due to idle speed\r\n" /end ANNOTATION_TEXT
 /end ANNOTATION
/end CHARACTERISTIC
/begin CHARACTERISTIC DST_CALIB.DST_DG.DST_ShiftPointsAndComp.DST_ShiftCompensation.DST_PULLAWAY2NDPREVENT1TO2STATIC "" VALUE 0x806071C0 DefaultValueRecordLayout_AUTOSAR_Platform_BaseTypes_boolean 255.0 AUTOSAR_Platform_CompuMethods_boolean 0.0 255. FORMAT "%10.5"
 /begin ANNOTATION ANNOTATION_LABEL "Description (coming from AUTOSAR DESC field)"
  /begin ANNOTATION_TEXT "If true prevents a 1 to 2 shift when static or low speed when 2nd gear pullaway becomes availalbe\r\n" /end ANNOTATION_TEXT
 /end ANNOTATION
/end CHARACTERISTIC
/begin CHARACTERISTIC DST_CALIB.DST_DG.DST_ShiftPointsAndComp.DST_ShiftMaps.DST_ALWAYSUPSHIFTCATALYSTHOT "" VALUE 0x806071C2 DefaultValueRecordLayout_AUTOSAR_Platform_BaseTypes_boolean 255.0 AUTOSAR_Platform_CompuMethods_boolean 0.0 255. FORMAT "%10.5"
 /begin ANNOTATION ANNOTATION_LABEL "Description (coming from AUTOSAR DESC field)"
  /begin ANNOTATION_TEXT "If true and IOP_CatalystOverHeat is true, it will not bounce off the rev limit\r\n" /end ANNOTATION_TEXT
 /end ANNOTATION
/end CHARACTERISTIC
/begin CHARACTERISTIC DST_CALIB.DST_DISABLEP3INNorP "" VALUE 0x80607043 DefaultValueRecordLayout_AUTOSAR_Platform_BaseTypes_boolean 255.0 AUTOSAR_Platform_CompuMethods_boolean 0.0 255. FORMAT "%10.5"
 /begin ANNOTATION ANNOTATION_LABEL "Description (coming from AUTOSAR DESC field)" /begin ANNOTATION_TEXT "If true, P3 mode should be disabled in N or P\r\n" /end ANNOTATION_TEXT /end ANNOTATION
/end CHARACTERISTIC
/begin CHARACTERISTIC DST_CALIB.DST_DriverInterface.DST_AUTO2NPADDLEFAILKMHENABLE "" VALUE 0x806071C8 DefaultValueRecordLayout_AUTOSAR_Platform_BaseTypes_uint16 12.0 RB_PT_PCT_SWC_DST_CompuMethods_kph_0p1 0.0 12. FORMAT "%10.5"
 /begin ANNOTATION ANNOTATION_LABEL "Description (coming from AUTOSAR DESC field)"
  /begin ANNOTATION_TEXT "Cal above 12kmh will required L2 rule 40 enable code change.  Vehicle speed below which N will be selected if a paddle has failed and the speed has exceeded a threshold\r\n" /end ANNOTATION_TEXT
 /end ANNOTATION
/end CHARACTERISTIC
/begin CHARACTERISTIC DST_CALIB.DST_DriverInterface.DST_AUTO2NPADDLEFAILKMHTRIGGER "" VALUE 0x806071CA DefaultValueRecordLayout_AUTOSAR_Platform_BaseTypes_uint16 500.0 RB_PT_PCT_SWC_DST_CompuMethods_kph_0p1 0.0 500. FORMAT "%10.5"
 /begin ANNOTATION ANNOTATION_LABEL "Description (coming from AUTOSAR DESC field)"
  /begin ANNOTATION_TEXT "Vehicle speed below which N will be selected if a paddle has failed and the speed has exceeded a threshold\r\n" /end ANNOTATION_TEXT
 /end ANNOTATION
/end CHARACTERISTIC
/begin CHARACTERISTIC DST_CALIB.DST_DriverInterface.DST_FORCE2MANUALLATCHES "" VALUE 0x806071D4 DefaultValueRecordLayout_AUTOSAR_Platform_BaseTypes_uint8 255.0 DefaultIdenticalCompu 0.0 255. FORMAT "%10.5"
 /begin ANNOTATION ANNOTATION_LABEL "Description (coming from AUTOSAR DESC field)"
  /begin ANNOTATION_TEXT "If true, request to go to manual mode latches if based on mode\r\n" /end ANNOTATION_TEXT
 /end ANNOTATION
/end CHARACTERISTIC
/begin CHARACTERISTIC DST_CALIB.DST_DriverInterface.DST_INPUTFAILTIME "" VALUE 0x806071CC DefaultValueRecordLayout_AUTOSAR_Platform_BaseTypes_uint16 655.35 RB_PT_PCT_SWC_DST_CompuMethods_DST_Time 0.0 655.35 FORMAT "%10.5"
 /begin ANNOTATION ANNOTATION_LABEL "Description (coming from AUTOSAR DESC field)" /begin ANNOTATION_TEXT "Time before backup strategy is active\r\n" /end ANNOTATION_TEXT /end ANNOTATION
/end CHARACTERISTIC
/begin CHARACTERISTIC DST_CALIB.DST_DriverInterface.DST_INPUTRECOVERTIME "" VALUE 0x806071CE DefaultValueRecordLayout_AUTOSAR_Platform_BaseTypes_uint16 655.35 RB_PT_PCT_SWC_DST_CompuMethods_DST_Time 0.0 655.35 FORMAT "%10.5"
 /begin ANNOTATION ANNOTATION_LABEL "Description (coming from AUTOSAR DESC field)"
  /begin ANNOTATION_TEXT "Time after driver input is OK before normal strategy resumes\r\n" /end ANNOTATION_TEXT
 /end ANNOTATION
/end CHARACTERISTIC
/begin CHARACTERISTIC DST_CALIB.DST_DriverInterface.DST_MBUTTONHOLD2DTIME "" VALUE 0x806071D0 DefaultValueRecordLayout_AUTOSAR_Platform_BaseTypes_uint16 655.35 RB_PT_PCT_SWC_DST_CompuMethods_DST_Time 0.0 655.35 FORMAT "%10.5"
 /begin ANNOTATION ANNOTATION_LABEL "Description (coming from AUTOSAR DESC field)" /begin ANNOTATION_TEXT "Seconds to hold M to get D if paddles failed\r\n" /end ANNOTATION_TEXT /end ANNOTATION
/end CHARACTERISTIC
/begin CHARACTERISTIC DST_CALIB.DST_DriverInterface.DST_REFSPDCANISTERENMAN "" VALUE 0x806071D2 DefaultValueRecordLayout_AUTOSAR_Platform_BaseTypes_uint16 500.0 RB_PT_PCT_SWC_DST_CompuMethods_kph_0p1 0.0 500. FORMAT "%10.5"
 /begin ANNOTATION ANNOTATION_LABEL "Description (coming from AUTOSAR DESC field)"
  /begin ANNOTATION_TEXT "Disable canister full strategy if reference speed below this value and strategy no longer being requested\r\n" /end ANNOTATION_TEXT
 /end ANNOTATION
/end CHARACTERISTIC
/begin CHARACTERISTIC DST_CALIB.DST_ENABLE2NDPULLAWAY "" VALUE 0x80607044 DefaultValueRecordLayout_AUTOSAR_Platform_BaseTypes_uint8 255.0 DefaultIdenticalCompu 0.0 255. FORMAT "%10.5"
 /begin ANNOTATION ANNOTATION_LABEL "Description (coming from AUTOSAR DESC field)" /begin ANNOTATION_TEXT "If true, 2nd gear pullaway logic is enabled\r\n" /end ANNOTATION_TEXT /end ANNOTATION
/end CHARACTERISTIC
/begin CHARACTERISTIC DST_CALIB.DST_ENABLEADAPTIONGAC "" VALUE 0x80607045 DefaultValueRecordLayout_AUTOSAR_Platform_BaseTypes_boolean 255.0 AUTOSAR_Platform_CompuMethods_boolean 0.0 255. FORMAT "%10.5"
 /begin ANNOTATION ANNOTATION_LABEL "Description (coming from AUTOSAR DESC field)" /begin ANNOTATION_TEXT "If true, GAC_FlgEOLRq is listened to\r\n" /end ANNOTATION_TEXT /end ANNOTATION
/end CHARACTERISTIC
/begin CHARACTERISTIC DST_CALIB.DST_ENABLEADAPTIONPCL "" VALUE 0x80607046 DefaultValueRecordLayout_AUTOSAR_Platform_BaseTypes_boolean 255.0 AUTOSAR_Platform_CompuMethods_boolean 0.0 255. FORMAT "%10.5"
 /begin ANNOTATION ANNOTATION_LABEL "Description (coming from AUTOSAR DESC field)" /begin ANNOTATION_TEXT "If true, PCL_FlgDecoupleRequest is listened to\r\n" /end ANNOTATION_TEXT /end ANNOTATION
/end CHARACTERISTIC
/begin CHARACTERISTIC DST_CALIB.DST_ENABLEVSS1CLEANDWC "" VALUE 0x80607047 DefaultValueRecordLayout_AUTOSAR_Platform_BaseTypes_boolean 255.0 AUTOSAR_Platform_CompuMethods_boolean 0.0 255. FORMAT "%10.5"
 /begin ANNOTATION ANNOTATION_LABEL "Description (coming from AUTOSAR DESC field)" /begin ANNOTATION_TEXT "If true, DWC_FlgDecoupleRequest is listen to\r\n" /end ANNOTATION_TEXT /end ANNOTATION
/end CHARACTERISTIC
/begin CHARACTERISTIC DST_CALIB.DST_ENGAGERMAXKMH "" VALUE 0x80606FD4 DefaultValueRecordLayout_AUTOSAR_Platform_BaseTypes_uint16 500.0 RB_PT_PCT_SWC_DST_CompuMethods_kph_0p1 0.0 500. FORMAT "%10.5"
 /begin ANNOTATION ANNOTATION_LABEL "Description (coming from AUTOSAR DESC field)"
  /begin ANNOTATION_TEXT "Vehicle speed above which mechanical reverse will not be engaged\r\n" /end ANNOTATION_TEXT
 /end ANNOTATION
/end CHARACTERISTIC
/begin CHARACTERISTIC DST_CALIB.DST_ENGAGERMINENGSPD "" VALUE 0x80606FD6 DefaultValueRecordLayout_AUTOSAR_Platform_BaseTypes_uint16 20000.0 RB_PT_PCT_SWC_DST_CompuMethods_ident 0.0 20000. FORMAT "%10.5"
 /begin ANNOTATION ANNOTATION_LABEL "Description (coming from AUTOSAR DESC field)"
  /begin ANNOTATION_TEXT "Minimum engine speed before Reverse will be mechanically selected\r\n" /end ANNOTATION_TEXT
 /end ANNOTATION
/end CHARACTERISTIC
/begin CHARACTERISTIC DST_CALIB.DST_ENGAGERMINENGSPDto1st "" VALUE 0x80606FD8 DefaultValueRecordLayout_AUTOSAR_Platform_BaseTypes_uint16 20000.0 RB_PT_PCT_SWC_DST_CompuMethods_ident 0.0 20000. FORMAT "%10.5"
 /begin ANNOTATION ANNOTATION_LABEL "Description (coming from AUTOSAR DESC field)"
  /begin ANNOTATION_TEXT "Minimum engine speed before Reverse will be mechanically selected\r\n" /end ANNOTATION_TEXT
 /end ANNOTATION
/end CHARACTERISTIC
/begin CHARACTERISTIC DST_CALIB.DST_ENGAGERWHILSTRMAXKMHOFF "" VALUE 0x80606FDA DefaultValueRecordLayout_AUTOSAR_Platform_BaseTypes_uint16 500.0 RB_PT_PCT_SWC_DST_CompuMethods_kph_0p1 0.0 500. FORMAT "%10.5"
 /begin ANNOTATION ANNOTATION_LABEL "Description (coming from AUTOSAR DESC field)"
  /begin ANNOTATION_TEXT "Vehicle speed above which mechanical reverse will not be engaged\r\n" /end ANNOTATION_TEXT
 /end ANNOTATION
/end CHARACTERISTIC
/begin CHARACTERISTIC DST_CALIB.DST_ENGAGERWHILSTRMAXKMHON "" VALUE 0x80606FDC DefaultValueRecordLayout_AUTOSAR_Platform_BaseTypes_uint16 500.0 RB_PT_PCT_SWC_DST_CompuMethods_kph_0p1 0.0 500. FORMAT "%10.5"
 /begin ANNOTATION ANNOTATION_LABEL "Description (coming from AUTOSAR DESC field)"
  /begin ANNOTATION_TEXT "Vehicle speed above which mechanical reverse will not be engaged\r\n" /end ANNOTATION_TEXT
 /end ANNOTATION
/end CHARACTERISTIC
/begin CHARACTERISTIC DST_CALIB.DST_ENGREVLIMITMAX "" VALUE 0x80606FDE DefaultValueRecordLayout_AUTOSAR_Platform_BaseTypes_uint16 20000.0 RB_PT_PCT_SWC_DST_CompuMethods_ident 0.0 20000. FORMAT "%10.5"
 /begin ANNOTATION ANNOTATION_LABEL "Description (coming from AUTOSAR DESC field)" /begin ANNOTATION_TEXT "Upper limit applied to IOP_EngRevLimit\r\n" /end ANNOTATION_TEXT /end ANNOTATION
/end CHARACTERISTIC
/begin CHARACTERISTIC DST_CALIB.DST_ENGRPMKEEPGEARSINNEUTRAL "" VALUE 0x80606FE0 DefaultValueRecordLayout_AUTOSAR_Platform_BaseTypes_uint16 20000.0 RB_PT_PCT_SWC_DST_CompuMethods_ident 0.0 20000. FORMAT "%10.5"
 /begin ANNOTATION ANNOTATION_LABEL "Description (coming from AUTOSAR DESC field)"
  /begin ANNOTATION_TEXT "engine speed below whch demand and preselect gears will be set to zero\r\n" /end ANNOTATION_TEXT
 /end ANNOTATION
/end CHARACTERISTIC
/begin CHARACTERISTIC DST_CALIB.DST_ENGSPEEDMINLIMIT "" VALUE 0x80606FE2 DefaultValueRecordLayout_AUTOSAR_Platform_BaseTypes_uint16 20000.0 RB_PT_PCT_SWC_DST_CompuMethods_ident 0.0 20000. FORMAT "%10.5"
 /begin ANNOTATION ANNOTATION_LABEL "Description (coming from AUTOSAR DESC field)"
  /begin ANNOTATION_TEXT "Lowest value to use of Engine speed limit from engine\r\n" /end ANNOTATION_TEXT
 /end ANNOTATION
/end CHARACTERISTIC
/begin CHARACTERISTIC DST_CALIB.DST_EPBPARKREQUESTS "" VALUE 0x80607048 DefaultValueRecordLayout_AUTOSAR_Platform_BaseTypes_boolean 255.0 AUTOSAR_Platform_CompuMethods_boolean 0.0 255. FORMAT "%10.5"
 /begin ANNOTATION ANNOTATION_LABEL "Description (coming from AUTOSAR DESC field)"
  /begin ANNOTATION_TEXT "If true, supports EPB requesting the Park brake to engage\r\n" /end ANNOTATION_TEXT
 /end ANNOTATION
/end CHARACTERISTIC
/begin CHARACTERISTIC DST_CALIB.DST_EVPRESELECTSTRATEGYBASEDONSHIFTMODE "" VAL_BLK 0x80606F54 DefaultValueRecordLayout_AUTOSAR_Platform_BaseTypes_uint8 255.0 DefaultIdenticalCompu 0.0 255. FORMAT "%10.5"
 /begin ANNOTATION ANNOTATION_LABEL "Description (coming from AUTOSAR DESC field)"
  /begin ANNOTATION_TEXT "Depending on shift mode, preselect strategy can be enabled\r\n" /end ANNOTATION_TEXT
 /end ANNOTATION
 MATRIX_DIM 17 1 1 /end CHARACTERISTIC
/begin CHARACTERISTIC DST_CALIB.DST_EVStart.DST_BYPASSSTOPSTARTFLAG "" VALUE 0x80607202 DefaultValueRecordLayout_AUTOSAR_Platform_BaseTypes_uint8 255.0 DefaultIdenticalCompu 0.0 255. FORMAT "%10.5" /end CHARACTERISTIC
/begin CHARACTERISTIC DST_CALIB.DST_EVStart.DST_CLUICE0BYPASSSUPPORTGEAR "" VALUE 0x80607203 DefaultValueRecordLayout_AUTOSAR_Platform_BaseTypes_boolean 255.0 AUTOSAR_Platform_CompuMethods_boolean 0.0 255. FORMAT "%10.5" /end CHARACTERISTIC
/begin CHARACTERISTIC DST_CALIB.DST_EVStart.DST_CLUICE0BYPASSTORQUEONFROZXEN "" VALUE 0x80607204 DefaultValueRecordLayout_AUTOSAR_Platform_BaseTypes_boolean 255.0 AUTOSAR_Platform_CompuMethods_boolean 0.0 255. FORMAT "%10.5" /end CHARACTERISTIC
/begin CHARACTERISTIC DST_CALIB.DST_EVStart.DST_DISABLEEV3RD "" VALUE 0x80607205 DefaultValueRecordLayout_AUTOSAR_Platform_BaseTypes_uint8 255.0 DefaultIdenticalCompu 0.0 255. FORMAT "%10.5" /end CHARACTERISTIC
/begin CHARACTERISTIC DST_CALIB.DST_EVStart.DST_DISABLEEVSTART2ND "" VALUE 0x80607206 DefaultValueRecordLayout_AUTOSAR_Platform_BaseTypes_uint8 255.0 DefaultIdenticalCompu 0.0 255. FORMAT "%10.5"
 /begin ANNOTATION ANNOTATION_LABEL "Description (coming from AUTOSAR DESC field)"
  /begin ANNOTATION_TEXT "If true, 2nd gear will not be used for the EV start, only 5th and 6th\r\n" /end ANNOTATION_TEXT
 /end ANNOTATION
/end CHARACTERISTIC
/begin CHARACTERISTIC DST_CALIB.DST_EVStart.DST_EVSTART_NODGTEMP "" VALUE 0x806071F6 DefaultValueRecordLayout_AUTOSAR_Platform_BaseTypes_sint16 250.0 RB_PT_PCT_SWC_DST_CompuMethods_ident -50. 200. FORMAT "%10.5"
 /begin ANNOTATION ANNOTATION_LABEL "Description (coming from AUTOSAR DESC field)"
  /begin ANNOTATION_TEXT "Temperature below which no demand gear is required during EV start\r\n" /end ANNOTATION_TEXT
 /end ANNOTATION
/end CHARACTERISTIC
/begin CHARACTERISTIC DST_CALIB.DST_EVStart.DST_EVSTART_NOGEARSRPM "" VALUE 0x806071F8 DefaultValueRecordLayout_AUTOSAR_Platform_BaseTypes_uint16 20000.0 RB_PT_PCT_SWC_DST_CompuMethods_ident 0.0 20000. FORMAT "%10.5"
 /begin ANNOTATION ANNOTATION_LABEL "Description (coming from AUTOSAR DESC field)" /begin ANNOTATION_TEXT "Engine speed when cold gears will be set to 0\r\n" /end ANNOTATION_TEXT /end ANNOTATION
/end CHARACTERISTIC
/begin CHARACTERISTIC DST_CALIB.DST_EVStart.DST_EVSTART_NOPSGTEMP "" VALUE 0x806071FA DefaultValueRecordLayout_AUTOSAR_Platform_BaseTypes_sint16 250.0 RB_PT_PCT_SWC_DST_CompuMethods_ident -50. 200. FORMAT "%10.5"
 /begin ANNOTATION ANNOTATION_LABEL "Description (coming from AUTOSAR DESC field)"
  /begin ANNOTATION_TEXT "Temperature below which no preselect gear is required during EV start\r\n" /end ANNOTATION_TEXT
 /end ANNOTATION
/end CHARACTERISTIC
/begin CHARACTERISTIC DST_CALIB.DST_EVStart.DST_EVSTART_REFSPDTO8th "" VALUE 0x806071FC DefaultValueRecordLayout_AUTOSAR_Platform_BaseTypes_uint16 500.0 RB_PT_PCT_SWC_DST_CompuMethods_kph_0p1 0.0 500. FORMAT "%10.5"
 /begin ANNOTATION ANNOTATION_LABEL "Description (coming from AUTOSAR DESC field)"
  /begin ANNOTATION_TEXT "Vehicle speed above which the start gear for EV start will be 8th\r\n" /end ANNOTATION_TEXT
 /end ANNOTATION
/end CHARACTERISTIC
/begin CHARACTERISTIC DST_CALIB.DST_EVStart.DST_EVSTART1_WAITFORPEDAL "" VALUE 0x806071EE DefaultValueRecordLayout_AUTOSAR_Platform_BaseTypes_uint16 655.35 RB_PT_PCT_SWC_DST_CompuMethods_DST_Time 0.0 655.35 FORMAT "%10.5"
 /begin ANNOTATION ANNOTATION_LABEL "Description (coming from AUTOSAR DESC field)" /begin ANNOTATION_TEXT "Wait for a short time for the driver pedal to settle\r\n" /end ANNOTATION_TEXT /end ANNOTATION
/end CHARACTERISTIC
/begin CHARACTERISTIC DST_CALIB.DST_EVStart.DST_EVSTART2_TIMEFORTORQUEONSUPPORT "" VALUE 0x806071F0 DefaultValueRecordLayout_AUTOSAR_Platform_BaseTypes_uint16 655.35 RB_PT_PCT_SWC_DST_CompuMethods_DST_Time 0.0 655.35 FORMAT "%10.5"
 /begin ANNOTATION ANNOTATION_LABEL "Description (coming from AUTOSAR DESC field)"
  /begin ANNOTATION_TEXT "Maximum time allowed to get torque onto the support gear\r\n" /end ANNOTATION_TEXT
 /end ANNOTATION
/end CHARACTERISTIC
/begin CHARACTERISTIC DST_CALIB.DST_EVStart.DST_EVSTART3_TIMEFORTORQUEONFROZEN "" VALUE 0x806071F2 DefaultValueRecordLayout_AUTOSAR_Platform_BaseTypes_uint16 655.35 RB_PT_PCT_SWC_DST_CompuMethods_DST_Time 0.0 655.35 FORMAT "%10.5"
 /begin ANNOTATION ANNOTATION_LABEL "Description (coming from AUTOSAR DESC field)"
  /begin ANNOTATION_TEXT "Maximum time allowed to get torque onto the support gear\r\n" /end ANNOTATION_TEXT
 /end ANNOTATION
/end CHARACTERISTIC
/begin CHARACTERISTIC DST_CALIB.DST_EVStart.DST_EVSTART4_WAITONFROZENGEAR "" VALUE 0x806071F4 DefaultValueRecordLayout_AUTOSAR_Platform_BaseTypes_uint16 655.35 RB_PT_PCT_SWC_DST_CompuMethods_DST_Time 0.0 655.35 FORMAT "%10.5"
 /begin ANNOTATION ANNOTATION_LABEL "Description (coming from AUTOSAR DESC field)"
  /begin ANNOTATION_TEXT "Time to wait on frozen gear before going to shift maps\r\n" /end ANNOTATION_TEXT
 /end ANNOTATION
/end CHARACTERISTIC
/begin CHARACTERISTIC DST_CALIB.DST_EVStart.DST_EVSTARTPSGOUTPUT "" VAL_BLK 0x806071D6 DefaultValueRecordLayout_AUTOSAR_Platform_BaseTypes_uint8 11.0 RB_PT_PCT_SWC_DST_CompuMethods_ident 0.0 11. FORMAT "%10.5"
 /begin ANNOTATION ANNOTATION_LABEL "Description (coming from AUTOSAR DESC field)" /begin ANNOTATION_TEXT "Preselect depending on EVDemandOutput\r\n" /end ANNOTATION_TEXT /end ANNOTATION
 MATRIX_DIM 12 1 1 /end CHARACTERISTIC
/begin CHARACTERISTIC DST_CALIB.DST_EVStart.DST_FROZENGEARTOEVOUTPUT "" VAL_BLK 0x806071E2 DefaultValueRecordLayout_AUTOSAR_Platform_BaseTypes_uint8 11.0 RB_PT_PCT_SWC_DST_CompuMethods_ident 0.0 11. FORMAT "%10.5"
 /begin ANNOTATION ANNOTATION_LABEL "Description (coming from AUTOSAR DESC field)" /begin ANNOTATION_TEXT "If True the EV Demand Output will be set to 6\r\n" /end ANNOTATION_TEXT /end ANNOTATION
 MATRIX_DIM 12 1 1 /end CHARACTERISTIC
/begin CHARACTERISTIC DST_CALIB.DST_EVStart.DST_KMHMINFOREVSTART "" VALUE 0x806071FE DefaultValueRecordLayout_AUTOSAR_Platform_BaseTypes_uint16 500.0 RB_PT_PCT_SWC_DST_CompuMethods_kph_0p1 0.0 500. FORMAT "%10.5"
 /begin ANNOTATION ANNOTATION_LABEL "Description (coming from AUTOSAR DESC field)" /begin ANNOTATION_TEXT "Minimum vehicle speed to perfrom EV start\r\n" /end ANNOTATION_TEXT /end ANNOTATION
/end CHARACTERISTIC
/begin CHARACTERISTIC DST_CALIB.DST_EVStart.DST_LOWESTGEARPOSEVSTART "" VALUE 0x80607207 DefaultValueRecordLayout_AUTOSAR_Platform_BaseTypes_uint8 11.0 RB_PT_PCT_SWC_DST_CompuMethods_ident 0.0 11. FORMAT "%10.5"
 /begin ANNOTATION ANNOTATION_LABEL "Description (coming from AUTOSAR DESC field)" /begin ANNOTATION_TEXT "Lowest gear to enter into DemandGearFrozen\r\n" /end ANNOTATION_TEXT /end ANNOTATION
/end CHARACTERISTIC
/begin CHARACTERISTIC DST_CALIB.DST_EVStart.DST_MAXTIMEFOREVSTART "" VALUE 0x80607200 DefaultValueRecordLayout_AUTOSAR_Platform_BaseTypes_uint16 655.35 RB_PT_PCT_SWC_DST_CompuMethods_DST_Time 0.0 655.35 FORMAT "%10.5" /end CHARACTERISTIC
/begin CHARACTERISTIC DST_CALIB.DST_EVStart.DST_REVERSECANBEEV "" VALUE 0x80607208 DefaultValueRecordLayout_AUTOSAR_Platform_BaseTypes_uint8 255.0 DefaultIdenticalCompu 0.0 255. FORMAT "%10.5"
 /begin ANNOTATION ANNOTATION_LABEL "Description (coming from AUTOSAR DESC field)" /begin ANNOTATION_TEXT "enable to allow reverse to be an EV mode\r\n" /end ANNOTATION_TEXT /end ANNOTATION
/end CHARACTERISTIC
/begin CHARACTERISTIC DST_CALIB.DST_FLGSAILWHILECOASTTOD "" VALUE 0x80607049 DefaultValueRecordLayout_AUTOSAR_Platform_BaseTypes_uint8 255.0 DefaultIdenticalCompu 0.0 255. FORMAT "%10.5"
 /begin ANNOTATION ANNOTATION_LABEL "Description (coming from AUTOSAR DESC field)"
  /begin ANNOTATION_TEXT "flag to enable the abort of shuttling gear selection strategy on park or neutral modes\r\n" /end ANNOTATION_TEXT
 /end ANNOTATION
/end CHARACTERISTIC
/begin CHARACTERISTIC DST_CALIB.DST_GACEOLDoneOverride "" VALUE 0x8060704A DefaultValueRecordLayout_AUTOSAR_Platform_BaseTypes_boolean 255.0 AUTOSAR_Platform_CompuMethods_boolean 0.0 255. FORMAT "%10.5"
 /begin ANNOTATION ANNOTATION_LABEL "Description (coming from AUTOSAR DESC field)"
  /begin ANNOTATION_TEXT "If true GAC_FlgEOL done flag is ignored for pressure available to be set true\r\n" /end ANNOTATION_TEXT
 /end ANNOTATION
/end CHARACTERISTIC
/begin CHARACTERISTIC DST_CALIB.DST_GearShiftIndicator.DST_GSIDOWNSHIFTABOVEIDLE "" VALUE 0x8060720A DefaultValueRecordLayout_AUTOSAR_Platform_BaseTypes_uint16 20000.0 RB_PT_PCT_SWC_DST_CompuMethods_ident 0.0 20000. FORMAT "%10.5"
 /begin ANNOTATION ANNOTATION_LABEL "Description (coming from AUTOSAR DESC field)" /begin ANNOTATION_TEXT "Rpm above idle speed to recommend a downshift\r\n" /end ANNOTATION_TEXT /end ANNOTATION
/end CHARACTERISTIC
/begin CHARACTERISTIC DST_CALIB.DST_GearShiftIndicator.DST_GSIMINRPMDOWN "" CURVE 0x8060720C RB_PT_PCT_SWC_DST_RecordLayouts_RL_Curve_sint16_6_uint8_6 20000.0 RB_PT_PCT_SWC_DST_CompuMethods_DST_Ident 0.0 20000. FORMAT "%10.5"
 /begin ANNOTATION ANNOTATION_LABEL "Description (coming from AUTOSAR DESC field)" /begin ANNOTATION_TEXT "Minimum recommended gear\r\n" /end ANNOTATION_TEXT /end ANNOTATION
 /begin AXIS_DESCR STD_AXIS NO_INPUT_QUANTITY RB_PT_PCT_SWC_DST_CompuMethods_ratio_0p4 6 0.0 102. FORMAT "%10.5" DEPOSIT ABSOLUTE /end AXIS_DESCR
/end CHARACTERISTIC
/begin CHARACTERISTIC DST_CALIB.DST_GearShiftIndicator.DST_GSIRPMHYST "" CURVE 0x80607220 RB_PT_PCT_SWC_DST_RecordLayouts_RL_Curve_sint16_6_uint8_6 20000.0 RB_PT_PCT_SWC_DST_CompuMethods_DST_Ident 0.0 20000. FORMAT "%10.5"
 /begin ANNOTATION ANNOTATION_LABEL "Description (coming from AUTOSAR DESC field)" /begin ANNOTATION_TEXT "Gear hystereesis for gear recomendation\r\n" /end ANNOTATION_TEXT /end ANNOTATION
 /begin AXIS_DESCR STD_AXIS NO_INPUT_QUANTITY RB_PT_PCT_SWC_DST_CompuMethods_ratio_0p4 6 0.0 102. FORMAT "%10.5" DEPOSIT ABSOLUTE /end AXIS_DESCR
/end CHARACTERISTIC
/begin CHARACTERISTIC DST_CALIB.DST_In_DriverDemand.DST_MODEPEDALKDOVERRIDE "" VALUE 0x80607254 DefaultValueRecordLayout_AUTOSAR_Platform_BaseTypes_boolean 255.0 AUTOSAR_Platform_CompuMethods_boolean 0.0 255. FORMAT "%10.5"
 /begin ANNOTATION ANNOTATION_LABEL "Description (coming from AUTOSAR DESC field)"
  /begin ANNOTATION_TEXT "If false, the KD input is not used to limit the pedal angle\r\n" /end ANNOTATION_TEXT
 /end ANNOTATION
/end CHARACTERISTIC
/begin CHARACTERISTIC DST_CALIB.DST_In_DriverDemand.DST_MODEPEDALLIMITcal "" VAL_BLK 0x80607234 DefaultValueRecordLayout_AUTOSAR_Platform_BaseTypes_uint16 110.0 RB_PT_PCT_SWC_DST_CompuMethods_ratio_0p1 0.0 110. FORMAT "%10.5"
 /begin ANNOTATION ANNOTATION_LABEL "Description (coming from AUTOSAR DESC field)" /begin ANNOTATION_TEXT "Pedal limit bases on hybrid mode\r\n" /end ANNOTATION_TEXT /end ANNOTATION
 MATRIX_DIM 15 1 1 /end CHARACTERISTIC
/begin CHARACTERISTIC DST_CALIB.DST_In_DriverDemand.DST_MODEPEDALRAMPDELAY "" VALUE 0x80607255 DefaultValueRecordLayout_AUTOSAR_Platform_BaseTypes_uint8 2.55 RB_PT_PCT_SWC_DST_CompuMethods_time_0p01 0.0 2.55 FORMAT "%10.5"
 /begin ANNOTATION ANNOTATION_LABEL "Description (coming from AUTOSAR DESC field)"
  /begin ANNOTATION_TEXT "After a changing in hybrid mode, time before the pedal limit starts to change\r\n" /end ANNOTATION_TEXT
 /end ANNOTATION
/end CHARACTERISTIC
/begin CHARACTERISTIC DST_CALIB.DST_In_DriverDemand.DST_MODEPEDALRAMPUP "" VALUE 0x80607252 DefaultValueRecordLayout_AUTOSAR_Platform_BaseTypes_uint16 110.0 RB_PT_PCT_SWC_DST_CompuMethods_ratio_0p1 0.0 110. FORMAT "%10.5"
 /begin ANNOTATION ANNOTATION_LABEL "Description (coming from AUTOSAR DESC field)" /begin ANNOTATION_TEXT "Increase in pedal limit\r\n" /end ANNOTATION_TEXT /end ANNOTATION
/end CHARACTERISTIC
/begin CHARACTERISTIC DST_CALIB.DST_In_DriverDemand.DST_THROTTLEdTLOOPS "" VALUE 0x80607258 DefaultValueRecordLayout_AUTOSAR_Platform_BaseTypes_uint8 255.0 RB_PT_PCT_SWC_DST_CompuMethods_ident 0.0 255. FORMAT "%10.5"
 /begin ANNOTATION ANNOTATION_LABEL "Description (coming from AUTOSAR DESC field)" /begin ANNOTATION_TEXT "10 would give pedal dT over 100ms\r\n" /end ANNOTATION_TEXT /end ANNOTATION
/end CHARACTERISTIC
/begin CHARACTERISTIC DST_CALIB.DST_In_DriverDemand.DST_THROTTLEdTONESAMPE "" VALUE 0x80607259 DefaultValueRecordLayout_AUTOSAR_Platform_BaseTypes_uint8 102.0 RB_PT_PCT_SWC_DST_CompuMethods_ratio_0p4 0.0 102. FORMAT "%10.5"
 /begin ANNOTATION ANNOTATION_LABEL "Description (coming from AUTOSAR DESC field)" /begin ANNOTATION_TEXT "Rapid pedal increase percent\r\n" /end ANNOTATION_TEXT /end ANNOTATION
/end CHARACTERISTIC
/begin CHARACTERISTIC DST_CALIB.DST_In_DriverDemand.DST_THROTTLEdTPCNT "" VALUE 0x8060725A DefaultValueRecordLayout_AUTOSAR_Platform_BaseTypes_uint8 102.0 RB_PT_PCT_SWC_DST_CompuMethods_ratio_0p4 0.0 102. FORMAT "%10.5"
 /begin ANNOTATION ANNOTATION_LABEL "Description (coming from AUTOSAR DESC field)" /begin ANNOTATION_TEXT "Rapid pedal increase percent\r\n" /end ANNOTATION_TEXT /end ANNOTATION
/end CHARACTERISTIC
/begin CHARACTERISTIC DST_CALIB.DST_In_DriverDemand.DST_THROTTLEMAX2STEADY "" VALUE 0x80607256 DefaultValueRecordLayout_AUTOSAR_Platform_BaseTypes_uint8 102.0 RB_PT_PCT_SWC_DST_CompuMethods_ratio_0p4 0.0 102. FORMAT "%10.5" /end CHARACTERISTIC
/begin CHARACTERISTIC DST_CALIB.DST_In_DriverDemand.DST_THROTTLESTEADYDELAY "" VALUE 0x80607257 DefaultValueRecordLayout_AUTOSAR_Platform_BaseTypes_uint8 255.0 RB_PT_PCT_SWC_DST_CompuMethods_ident 0.0 255. FORMAT "%10.5"
 /begin ANNOTATION ANNOTATION_LABEL "Description (coming from AUTOSAR DESC field)" /begin ANNOTATION_TEXT "Delay after steady\r\n" /end ANNOTATION_TEXT /end ANNOTATION
/end CHARACTERISTIC
/begin CHARACTERISTIC DST_CALIB.DST_In_OpShftGrad.DST_ALTITUDEDRIFT "" VALUE 0x8060725C DefaultValueRecordLayout_AUTOSAR_Platform_BaseTypes_uint16 0.1 RB_PT_PCT_SWC_DST_CompuMethods_ratio_0p00001 0.0 0.1 FORMAT "%10.5"
 /begin ANNOTATION ANNOTATION_LABEL "Description (coming from AUTOSAR DESC field)"
  /begin ANNOTATION_TEXT "Rate at which the calculated altitude can move towards the altitude from ambient air pressure\r\n" /end ANNOTATION_TEXT
 /end ANNOTATION
/end CHARACTERISTIC
/begin CHARACTERISTIC DST_CALIB.DST_In_OpShftGrad.DST_ALTITUDEDRIFTENABLE "" VALUE 0x80607274 DefaultValueRecordLayout_AUTOSAR_Platform_BaseTypes_boolean 255.0 AUTOSAR_Platform_CompuMethods_boolean 0.0 255. FORMAT "%10.5"
 /begin ANNOTATION ANNOTATION_LABEL "Description (coming from AUTOSAR DESC field)"
  /begin ANNOTATION_TEXT "If true, calculated altitude can drift towards the altitude from ambient air pressure\r\n" /end ANNOTATION_TEXT
 /end ANNOTATION
/end CHARACTERISTIC
/begin CHARACTERISTIC DST_CALIB.DST_In_OpShftGrad.DST_ALTITUDEERRGRADDISABLE "" VALUE 0x8060725E DefaultValueRecordLayout_AUTOSAR_Platform_BaseTypes_uint16 7000.0 RB_PT_PCT_SWC_DST_CompuMethods_ident 0.0 7000. FORMAT "%10.5"
 /begin ANNOTATION ANNOTATION_LABEL "Description (coming from AUTOSAR DESC field)"
  /begin ANNOTATION_TEXT "Difference in calculated gradient and gradient from ambient air pressure to disable the gradient signal\r\n" /end ANNOTATION_TEXT
 /end ANNOTATION
/end CHARACTERISTIC
/begin CHARACTERISTIC DST_CALIB.DST_In_OpShftGrad.DST_GRADFAILEDLATCH "" VALUE 0x80607275 DefaultValueRecordLayout_AUTOSAR_Platform_BaseTypes_boolean 255.0 AUTOSAR_Platform_CompuMethods_boolean 0.0 255. FORMAT "%10.5" /end CHARACTERISTIC
/begin CHARACTERISTIC DST_CALIB.DST_In_OpShftGrad.DST_GRADFORCEUPDATE "" VALUE 0x80607276 DefaultValueRecordLayout_AUTOSAR_Platform_BaseTypes_boolean 255.0 AUTOSAR_Platform_CompuMethods_boolean 0.0 255. FORMAT "%10.5"
 /begin ANNOTATION ANNOTATION_LABEL "Description (coming from AUTOSAR DESC field)" /begin ANNOTATION_TEXT "Forces the gradient to be calculated\r\n" /end ANNOTATION_TEXT /end ANNOTATION
/end CHARACTERISTIC
/begin CHARACTERISTIC DST_CALIB.DST_In_OpShftGrad.DST_GRADIENTROCINCRAMP "" VALUE 0x80607260 DefaultValueRecordLayout_AUTOSAR_Platform_BaseTypes_uint16 1.0 RB_PT_PCT_SWC_DST_CompuMethods_ratio_0p001 0.0 1. FORMAT "%10.5"
 /begin ANNOTATION ANNOTATION_LABEL "Description (coming from AUTOSAR DESC field)"
  /begin ANNOTATION_TEXT "Maximum increase rate of gradient ROC (instant decrease from noise, gradual increase).  Up-side-down peak hold and decay\r\n" /end ANNOTATION_TEXT
 /end ANNOTATION
/end CHARACTERISTIC
/begin CHARACTERISTIC DST_CALIB.DST_In_OpShftGrad.DST_GRADINTEGRATORGAIN "" CURVE 0x8060727C RB_PT_PCT_SWC_DST_RecordLayouts_RL_Curve_uint16_7_sint16_7 32.0 RB_PT_PCT_SWC_DST_CompuMethods_ratio_0p001 0.0 32. FORMAT "%10.5"
 /begin ANNOTATION ANNOTATION_LABEL "Description (coming from AUTOSAR DESC field)"
  /begin ANNOTATION_TEXT "Inrease rate of Gradient ROC integrator based on gradient error\r\n" /end ANNOTATION_TEXT
 /end ANNOTATION
 /begin AXIS_DESCR STD_AXIS NO_INPUT_QUANTITY RB_PT_PCT_SWC_DST_CompuMethods_ratio_0p001 7 0.0 32.7 FORMAT "%10.5" DEPOSIT ABSOLUTE /end AXIS_DESCR
/end CHARACTERISTIC
/begin CHARACTERISTIC DST_CALIB.DST_In_OpShftGrad.DST_GRADINTEGRATORLIMIT "" CURVE 0x8060729A RB_PT_PCT_SWC_DST_RecordLayouts_RL_Curve_uint16_7_sint16_7 32.0 RB_PT_PCT_SWC_DST_CompuMethods_ratio_0p001 0.0 32. FORMAT "%10.5"
 /begin ANNOTATION ANNOTATION_LABEL "Description (coming from AUTOSAR DESC field)"
  /begin ANNOTATION_TEXT "Maximum rate of change of gradient integrator based on Gradient error\r\n" /end ANNOTATION_TEXT
 /end ANNOTATION
 /begin AXIS_DESCR STD_AXIS NO_INPUT_QUANTITY RB_PT_PCT_SWC_DST_CompuMethods_ratio_0p001 7 0.0 32.7 FORMAT "%10.5" DEPOSIT ABSOLUTE /end AXIS_DESCR
/end CHARACTERISTIC
/begin CHARACTERISTIC DST_CALIB.DST_In_OpShftGrad.DST_GRADINTEGRATORMIN "" VALUE 0x80607262 DefaultValueRecordLayout_AUTOSAR_Platform_BaseTypes_uint16 32.0 RB_PT_PCT_SWC_DST_CompuMethods_ratio_0p001 0.0 32. FORMAT "%10.5"
 /begin ANNOTATION ANNOTATION_LABEL "Description (coming from AUTOSAR DESC field)" /begin ANNOTATION_TEXT "Minimum value for gradient integrator\r\n" /end ANNOTATION_TEXT /end ANNOTATION
/end CHARACTERISTIC
/begin CHARACTERISTIC DST_CALIB.DST_In_OpShftGrad.DST_GRADOFFSETLEARN "" VALUE 0x80607277 DefaultValueRecordLayout_AUTOSAR_Platform_BaseTypes_boolean 255.0 AUTOSAR_Platform_CompuMethods_boolean 0.0 255. FORMAT "%10.5"
 /begin ANNOTATION ANNOTATION_LABEL "Description (coming from AUTOSAR DESC field)" /begin ANNOTATION_TEXT "Rising edge sets gradient offset\r\n" /end ANNOTATION_TEXT /end ANNOTATION
/end CHARACTERISTIC
/begin CHARACTERISTIC DST_CALIB.DST_In_OpShftGrad.DST_GRADPWRCOUNTHOLDZERO "" VALUE 0x80607264 DefaultValueRecordLayout_AUTOSAR_Platform_BaseTypes_uint16 65535.0 RB_PT_PCT_SWC_DST_CompuMethods_ident 0.0 65535. FORMAT "%10.5"
 /begin ANNOTATION ANNOTATION_LABEL "Description (coming from AUTOSAR DESC field)" /begin ANNOTATION_TEXT "Counts until the gradient is updated\r\n" /end ANNOTATION_TEXT /end ANNOTATION
/end CHARACTERISTIC
/begin CHARACTERISTIC DST_CALIB.DST_In_OpShftGrad.DST_GRADPWRCOUNTSENSORONLY "" VALUE 0x80607266 DefaultValueRecordLayout_AUTOSAR_Platform_BaseTypes_uint16 65535.0 RB_PT_PCT_SWC_DST_CompuMethods_ident 0.0 65535. FORMAT "%10.5"
 /begin ANNOTATION ANNOTATION_LABEL "Description (coming from AUTOSAR DESC field)" /begin ANNOTATION_TEXT "Counts until the gradient is updated\r\n" /end ANNOTATION_TEXT /end ANNOTATION
/end CHARACTERISTIC
/begin CHARACTERISTIC DST_CALIB.DST_In_OpShftGrad.DST_GRADRAMPJERKSENSOR "" CURVE 0x806072B8 RB_PT_PCT_SWC_DST_RecordLayouts_RL_Curve_uint16_5_sint16_5 32.0 RB_PT_PCT_SWC_DST_CompuMethods_ratio_0p001 0.0 32. FORMAT "%10.5"
 /begin ANNOTATION ANNOTATION_LABEL "Description (coming from AUTOSAR DESC field)"
  /begin ANNOTATION_TEXT "Rate of change of gradient based on vehicle acceleration\r\n" /end ANNOTATION_TEXT
 /end ANNOTATION
 /begin AXIS_DESCR STD_AXIS NO_INPUT_QUANTITY RB_PT_PCT_SWC_DST_CompuMethods_ratio_0p01 5 0.0 320. FORMAT "%10.5" DEPOSIT ABSOLUTE /end AXIS_DESCR
/end CHARACTERISTIC
/begin CHARACTERISTIC DST_CALIB.DST_In_OpShftGrad.DST_GRADRAMPJERKWHEELS "" CURVE 0x806072CE RB_PT_PCT_SWC_DST_RecordLayouts_RL_Curve_uint16_5_sint16_5 32.0 RB_PT_PCT_SWC_DST_CompuMethods_ratio_0p001 0.0 32. FORMAT "%10.5"
 /begin ANNOTATION ANNOTATION_LABEL "Description (coming from AUTOSAR DESC field)"
  /begin ANNOTATION_TEXT "Rate of change of gradient based on vehicle acceleration\r\n" /end ANNOTATION_TEXT
 /end ANNOTATION
 /begin AXIS_DESCR STD_AXIS NO_INPUT_QUANTITY RB_PT_PCT_SWC_DST_CompuMethods_ratio_0p01 5 0.0 320. FORMAT "%10.5" DEPOSIT ABSOLUTE /end AXIS_DESCR
/end CHARACTERISTIC
/begin CHARACTERISTIC DST_CALIB.DST_In_OpShftGrad.DST_GRADRAMPWHEELACCEL "" CURVE 0x806072E4 RB_PT_PCT_SWC_DST_RecordLayouts_RL_Curve_uint16_5_sint16_5 32.0 RB_PT_PCT_SWC_DST_CompuMethods_ratio_0p001 0.0 32. FORMAT "%10.5"
 /begin ANNOTATION ANNOTATION_LABEL "Description (coming from AUTOSAR DESC field)"
  /begin ANNOTATION_TEXT "Rate of change of gradient based on vehicle acceleration\r\n" /end ANNOTATION_TEXT
 /end ANNOTATION
 /begin AXIS_DESCR STD_AXIS NO_INPUT_QUANTITY RB_PT_PCT_SWC_DST_CompuMethods_ratio_0p0001 5 -2. 2. FORMAT "%10.5" DEPOSIT ABSOLUTE /end AXIS_DESCR
/end CHARACTERISTIC
/begin CHARACTERISTIC DST_CALIB.DST_In_OpShftGrad.DST_GRADRAMPWHEELDIFF "" MAP 0x806072FA RB_PT_PCT_SWC_DST_RecordLayouts_RL_Map_uint16_25_uint16_5_uint16_5 32.0 RB_PT_PCT_SWC_DST_CompuMethods_ratio_0p001 0.0 32. FORMAT "%10.5"
 /begin ANNOTATION ANNOTATION_LABEL "Description (coming from AUTOSAR DESC field)"
  /begin ANNOTATION_TEXT "Difference in left and right wheel speeds, especially at low speeds\r\n" /end ANNOTATION_TEXT
 /end ANNOTATION
 /begin AXIS_DESCR STD_AXIS NO_INPUT_QUANTITY RB_PT_PCT_SWC_DST_CompuMethods_kph_0p1 5 0.0 10. FORMAT "%10.5" DEPOSIT ABSOLUTE /end AXIS_DESCR
 /begin AXIS_DESCR STD_AXIS NO_INPUT_QUANTITY RB_PT_PCT_SWC_DST_CompuMethods_kph_0p1 5 0.0 500. FORMAT "%10.5" DEPOSIT ABSOLUTE /end AXIS_DESCR
/end CHARACTERISTIC
/begin CHARACTERISTIC DST_CALIB.DST_In_OpShftGrad.DST_GRADVSPRESSUREFAILTIME "" VALUE 0x80607268 DefaultValueRecordLayout_AUTOSAR_Platform_BaseTypes_uint16 655.35 RB_PT_PCT_SWC_DST_CompuMethods_DST_Time 0.0 655.35 FORMAT "%10.5"
 /begin ANNOTATION ANNOTATION_LABEL "Description (coming from AUTOSAR DESC field)"
  /begin ANNOTATION_TEXT "Debounce counter when altitude calculation makes gradient implausible\r\n" /end ANNOTATION_TEXT
 /end ANNOTATION
/end CHARACTERISTIC
/begin CHARACTERISTIC DST_CALIB.DST_In_OpShftGrad.DST_GRADWHEELSUNSIGNED "" VALUE 0x80607278 DefaultValueRecordLayout_AUTOSAR_Platform_BaseTypes_boolean 255.0 AUTOSAR_Platform_CompuMethods_boolean 0.0 255. FORMAT "%10.5"
 /begin ANNOTATION ANNOTATION_LABEL "Description (coming from AUTOSAR DESC field)" /begin ANNOTATION_TEXT "True if reference speed is unsigned\r\n" /end ANNOTATION_TEXT /end ANNOTATION
/end CHARACTERISTIC
/begin CHARACTERISTIC DST_CALIB.DST_In_OpShftGrad.DST_GSENSORLOWACTIVITY "" VALUE 0x8060726A DefaultValueRecordLayout_AUTOSAR_Platform_BaseTypes_sint16 4.0 RB_PT_PCT_SWC_DST_CompuMethods_ratio_0p0001 -2. 2. FORMAT "%10.5"
 /begin ANNOTATION ANNOTATION_LABEL "Description (coming from AUTOSAR DESC field)"
  /begin ANNOTATION_TEXT "Threshold to see if the long acc sensor reading has frozen\r\n" /end ANNOTATION_TEXT
 /end ANNOTATION
/end CHARACTERISTIC
/begin CHARACTERISTIC DST_CALIB.DST_In_OpShftGrad.DST_GWHEELSHIGHACTIVITY "" VALUE 0x8060726C DefaultValueRecordLayout_AUTOSAR_Platform_BaseTypes_sint16 4.0 RB_PT_PCT_SWC_DST_CompuMethods_ratio_0p0001 -2. 2. FORMAT "%10.5"
 /begin ANNOTATION ANNOTATION_LABEL "Description (coming from AUTOSAR DESC field)"
  /begin ANNOTATION_TEXT "Threshold above which wheels appear to be changing speed and can be used for calculation of gradient\r\n" /end ANNOTATION_TEXT
 /end ANNOTATION
/end CHARACTERISTIC
/begin CHARACTERISTIC DST_CALIB.DST_In_OpShftGrad.DST_LATACCSTATUSDISABLEGRAD "" VALUE 0x80607279 DefaultValueRecordLayout_AUTOSAR_Platform_BaseTypes_uint8 255.0 DefaultIdenticalCompu 0.0 255. FORMAT "%10.5" /end CHARACTERISTIC
/begin CHARACTERISTIC DST_CALIB.DST_In_OpShftGrad.DST_LONGACCSENSORMAX "" VALUE 0x8060726E DefaultValueRecordLayout_AUTOSAR_Platform_BaseTypes_sint16 4.0 RB_PT_PCT_SWC_DST_CompuMethods_ratio_0p01 -2. 2. FORMAT "%10.5"
 /begin ANNOTATION ANNOTATION_LABEL "Description (coming from AUTOSAR DESC field)" /begin ANNOTATION_TEXT "Maximum expected value\r\n" /end ANNOTATION_TEXT /end ANNOTATION
/end CHARACTERISTIC
/begin CHARACTERISTIC DST_CALIB.DST_In_OpShftGrad.DST_LONGACCSENSORMIN "" VALUE 0x80607270 DefaultValueRecordLayout_AUTOSAR_Platform_BaseTypes_sint16 4.0 RB_PT_PCT_SWC_DST_CompuMethods_ratio_0p01 -2. 2. FORMAT "%10.5"
 /begin ANNOTATION ANNOTATION_LABEL "Description (coming from AUTOSAR DESC field)" /begin ANNOTATION_TEXT "Minimum expected value\r\n" /end ANNOTATION_TEXT /end ANNOTATION
/end CHARACTERISTIC
/begin CHARACTERISTIC DST_CALIB.DST_In_OpShftGrad.DST_PressureToAltitude "" CURVE 0x80607344 RB_PT_PCT_SWC_DST_RecordLayouts_RL_Curve_sint16_9_uint16_9 8000.0 RB_PT_PCT_SWC_DST_CompuMethods_ident -1000. 7000. FORMAT "%10.5"
 /begin ANNOTATION ANNOTATION_LABEL "Description (coming from AUTOSAR DESC field)" /begin ANNOTATION_TEXT "Conversion from mBar to m altitde\r\n" /end ANNOTATION_TEXT /end ANNOTATION
 /begin AXIS_DESCR STD_AXIS NO_INPUT_QUANTITY RB_PT_PCT_SWC_DST_CompuMethods_ratio_0p001 9 0.0 2. FORMAT "%10.5" DEPOSIT ABSOLUTE /end AXIS_DESCR
/end CHARACTERISTIC
/begin CHARACTERISTIC DST_CALIB.DST_In_OpShftGrad.DST_PWRUPCNT2GRADCALC "" VALUE 0x80607272 DefaultValueRecordLayout_AUTOSAR_Platform_BaseTypes_uint16 65535.0 RB_PT_PCT_SWC_DST_CompuMethods_ident 0.0 65535. FORMAT "%10.5"
 /begin ANNOTATION ANNOTATION_LABEL "Description (coming from AUTOSAR DESC field)"
  /begin ANNOTATION_TEXT "Count values before the gradient calculation is enabled\r\n" /end ANNOTATION_TEXT
 /end ANNOTATION
/end CHARACTERISTIC
/begin CHARACTERISTIC DST_CALIB.DST_In_OpShftGrad.DST_USEWHEELACCUNTILGRADOK "" VALUE 0x8060727A DefaultValueRecordLayout_AUTOSAR_Platform_BaseTypes_uint8 255.0 DefaultIdenticalCompu 0.0 255. FORMAT "%10.5"
 /begin ANNOTATION ANNOTATION_LABEL "Description (coming from AUTOSAR DESC field)"
  /begin ANNOTATION_TEXT "If true, the wheel acceleration will be used until the gradient calculation is OK\r\n" /end ANNOTATION_TEXT
 /end ANNOTATION
/end CHARACTERISTIC
/begin CHARACTERISTIC DST_CALIB.DST_Ini.DST_HIGHRPMCONTINUOUSRPM "" VALUE 0x8060736A DefaultValueRecordLayout_AUTOSAR_Platform_BaseTypes_sint16 20000.0 RB_PT_PCT_SWC_DST_CompuMethods_ident 0.0 20000. FORMAT "%10.5"
 /begin ANNOTATION ANNOTATION_LABEL "Description (coming from AUTOSAR DESC field)"
  /begin ANNOTATION_TEXT "RPm the transmission can only sustain for a certain time\r\n" /end ANNOTATION_TEXT
 /end ANNOTATION
/end CHARACTERISTIC
/begin CHARACTERISTIC DST_CALIB.DST_Ini.DST_HIGHRPMCONTINUOUSTIME "" VALUE 0x8060736C DefaultValueRecordLayout_AUTOSAR_Platform_BaseTypes_uint16 655.35 RB_PT_PCT_SWC_DST_CompuMethods_DST_Time 0.0 655.35 FORMAT "%10.5"
 /begin ANNOTATION ANNOTATION_LABEL "Description (coming from AUTOSAR DESC field)" /begin ANNOTATION_TEXT "Time the transmission can sustain high rpm\r\n" /end ANNOTATION_TEXT /end ANNOTATION
/end CHARACTERISTIC
/begin CHARACTERISTIC DST_CALIB.DST_Ini.DST_HIGHRPMMAXTIME "" VALUE 0x8060736E DefaultValueRecordLayout_AUTOSAR_Platform_BaseTypes_uint16 655.35 RB_PT_PCT_SWC_DST_CompuMethods_DST_Time 0.0 655.35 FORMAT "%10.5"
 /begin ANNOTATION ANNOTATION_LABEL "Description (coming from AUTOSAR DESC field)"
  /begin ANNOTATION_TEXT "The rpm the upper limit will be reduced by after the high rpm time has been exceeded\r\n" /end ANNOTATION_TEXT
 /end ANNOTATION
/end CHARACTERISTIC
/begin CHARACTERISTIC DST_CALIB.DST_Ini.DST_HIGHRPMRECOVERY "" CURVE 0x80607378 RB_PT_PCT_SWC_DST_RecordLayouts_RL_Curve_sint16_8_uint16_8 20000.0 RB_PT_PCT_SWC_DST_CompuMethods_ident 0.0 20000. FORMAT "%10.5"
 /begin ANNOTATION ANNOTATION_LABEL "Description (coming from AUTOSAR DESC field)"
  /begin ANNOTATION_TEXT "After the max rpm has been reduced, this increases the limit as DST_HighRpmRecoveryTimer increases\r\n" /end ANNOTATION_TEXT
 /end ANNOTATION
 /begin AXIS_DESCR STD_AXIS NO_INPUT_QUANTITY RB_PT_PCT_SWC_DST_CompuMethods_DST_Time 8 0.0 655.35 FORMAT "%10.5" DEPOSIT ABSOLUTE /end AXIS_DESCR
/end CHARACTERISTIC
/begin CHARACTERISTIC DST_CALIB.DST_Ini.DST_INHIBITUPDECRATE "" VALUE 0x80607376 DefaultValueRecordLayout_AUTOSAR_Platform_BaseTypes_uint8 255.0 RB_PT_PCT_SWC_DST_CompuMethods_ident 0.0 255. FORMAT "%10.5"
 /begin ANNOTATION ANNOTATION_LABEL "Description (coming from AUTOSAR DESC field)"
  /begin ANNOTATION_TEXT "Rate of decrease of rpm to inhibit unshifts if reduced.\r\n" /end ANNOTATION_TEXT
 /end ANNOTATION
/end CHARACTERISTIC
/begin CHARACTERISTIC DST_CALIB.DST_Ini.DST_OP2KMHMAX "" VALUE 0x80607370 DefaultValueRecordLayout_AUTOSAR_Platform_BaseTypes_uint16 0.99 RB_PT_PCT_SWC_DST_CompuMethods_ratio_0p001 0.01 1. FORMAT "%10.5"
 /begin ANNOTATION ANNOTATION_LABEL "Description (coming from AUTOSAR DESC field)" /begin ANNOTATION_TEXT "Maximum adaption value of output to kmh\r\n" /end ANNOTATION_TEXT /end ANNOTATION
/end CHARACTERISTIC
/begin CHARACTERISTIC DST_CALIB.DST_Ini.DST_OP2KMHMIN "" VALUE 0x80607372 DefaultValueRecordLayout_AUTOSAR_Platform_BaseTypes_uint16 0.99 RB_PT_PCT_SWC_DST_CompuMethods_ratio_0p001 0.01 1. FORMAT "%10.5"
 /begin ANNOTATION ANNOTATION_LABEL "Description (coming from AUTOSAR DESC field)" /begin ANNOTATION_TEXT "Minimum adaption value of output to kmh\r\n" /end ANNOTATION_TEXT /end ANNOTATION
/end CHARACTERISTIC
/begin CHARACTERISTIC DST_CALIB.DST_Ini.DST_REDUCEOP2KMH "" VALUE 0x80607374 DefaultValueRecordLayout_AUTOSAR_Platform_BaseTypes_uint16 0.7999999999999999 RB_PT_PCT_SWC_DST_CompuMethods_ratio_0p001 0.6 1.4 FORMAT "%10.5"
 /begin ANNOTATION ANNOTATION_LABEL "Description (coming from AUTOSAR DESC field)"
  /begin ANNOTATION_TEXT "Factor to reduce OP2 KMH.  Result is vehicle speed is less reliant\r\n" /end ANNOTATION_TEXT
 /end ANNOTATION
/end CHARACTERISTIC
/begin CHARACTERISTIC DST_CALIB.DST_LATACCMAXSHIFT "" VALUE 0x8060704B DefaultValueRecordLayout_AUTOSAR_Platform_BaseTypes_uint8 1.27 RB_PT_PCT_SWC_DST_CompuMethods_ratio_0p01 0.0 1.27 FORMAT "%10.5"
 /begin ANNOTATION ANNOTATION_LABEL "Description (coming from AUTOSAR DESC field)" /begin ANNOTATION_TEXT "Lateral acceleration above which shifts are disabled\r\n" /end ANNOTATION_TEXT /end ANNOTATION
/end CHARACTERISTIC
/begin CHARACTERISTIC DST_CALIB.DST_LatAccWheels.DST_LATACCBACKUPFROMWHEELS "" VALUE 0x806073A8 DefaultValueRecordLayout_AUTOSAR_Platform_BaseTypes_boolean 255.0 AUTOSAR_Platform_CompuMethods_boolean 0.0 255. FORMAT "%10.5"
 /begin ANNOTATION ANNOTATION_LABEL "Description (coming from AUTOSAR DESC field)" /begin ANNOTATION_TEXT "If true, lateral acceleration is from the wheels\r\n" /end ANNOTATION_TEXT /end ANNOTATION
/end CHARACTERISTIC
/begin CHARACTERISTIC DST_CALIB.DST_LatAccWheels.DST_LATACCDELTAFAIL1D "" CURVE 0x806073B4 RB_PT_PCT_SWC_DST_RecordLayouts_RL_Curve_uint8_6_uint16_6 1.27 RB_PT_PCT_SWC_DST_CompuMethods_ratio_0p01 0.0 1.27 FORMAT "%10.5"
 /begin ANNOTATION ANNOTATION_LABEL "Description (coming from AUTOSAR DESC field)"
  /begin ANNOTATION_TEXT "m/s speed input.  Lateral acceleration difference output\r\n" /end ANNOTATION_TEXT
 /end ANNOTATION
 /begin AXIS_DESCR STD_AXIS NO_INPUT_QUANTITY RB_PT_PCT_SWC_DST_CompuMethods_ratio_0p002 6 0.0 131.07 FORMAT "%10.5" DEPOSIT ABSOLUTE /end AXIS_DESCR
/end CHARACTERISTIC
/begin CHARACTERISTIC DST_CALIB.DST_LatAccWheels.DST_LATACCDELTAHEALENABLE "" VALUE 0x806073A9 DefaultValueRecordLayout_AUTOSAR_Platform_BaseTypes_uint8 1.27 RB_PT_PCT_SWC_DST_CompuMethods_ratio_0p01 0.0 1.27 FORMAT "%10.5"
 /begin ANNOTATION ANNOTATION_LABEL "Description (coming from AUTOSAR DESC field)"
  /begin ANNOTATION_TEXT "Low lat acc threshold to compare to high threshold to check for error\r\n" /end ANNOTATION_TEXT
 /end ANNOTATION
/end CHARACTERISTIC
/begin CHARACTERISTIC DST_CALIB.DST_LatAccWheels.DST_LATACCDELTAOK "" VALUE 0x806073AA DefaultValueRecordLayout_AUTOSAR_Platform_BaseTypes_uint8 1.27 RB_PT_PCT_SWC_DST_CompuMethods_ratio_0p01 0.0 1.27 FORMAT "%10.5"
 /begin ANNOTATION ANNOTATION_LABEL "Description (coming from AUTOSAR DESC field)"
  /begin ANNOTATION_TEXT "Low lat acc threshold to compare to high threshold to check for error\r\n" /end ANNOTATION_TEXT
 /end ANNOTATION
/end CHARACTERISTIC
/begin CHARACTERISTIC DST_CALIB.DST_LatAccWheels.DST_LATACCFILTGAIN "" VALUE 0x806073AB DefaultValueRecordLayout_AUTOSAR_Platform_BaseTypes_uint8 1.0 RB_PT_PCT_SWC_DST_CompuMethods_ratio_0p01 0.0 1. FORMAT "%10.5"
 /begin ANNOTATION ANNOTATION_LABEL "Description (coming from AUTOSAR DESC field)"
  /begin ANNOTATION_TEXT "Filter gain calculating lateral acceleration from the wheels\r\n" /end ANNOTATION_TEXT
 /end ANNOTATION
/end CHARACTERISTIC
/begin CHARACTERISTIC DST_CALIB.DST_LatAccWheels.DST_LATACCFROMWHEELS "" VALUE 0x806073AC DefaultValueRecordLayout_AUTOSAR_Platform_BaseTypes_boolean 255.0 AUTOSAR_Platform_CompuMethods_boolean 0.0 255. FORMAT "%10.5"
 /begin ANNOTATION ANNOTATION_LABEL "Description (coming from AUTOSAR DESC field)" /begin ANNOTATION_TEXT "If true, lateral acceleration is from the wheels\r\n" /end ANNOTATION_TEXT /end ANNOTATION
/end CHARACTERISTIC
/begin CHARACTERISTIC DST_CALIB.DST_LatAccWheels.DST_LATACCPLAUSCOUNTDOWN "" VALUE 0x806073AD DefaultValueRecordLayout_AUTOSAR_Platform_BaseTypes_uint8 255.0 RB_PT_PCT_SWC_DST_CompuMethods_ident 0.0 255. FORMAT "%10.5"
 /begin ANNOTATION ANNOTATION_LABEL "Description (coming from AUTOSAR DESC field)" /begin ANNOTATION_TEXT "Rate at which plausibility timer counts down\r\n" /end ANNOTATION_TEXT /end ANNOTATION
/end CHARACTERISTIC
/begin CHARACTERISTIC DST_CALIB.DST_LatAccWheels.DST_LATACCPLAUSCOUNTER2FAILED "" VALUE 0x8060739A DefaultValueRecordLayout_AUTOSAR_Platform_BaseTypes_uint16 65535.0 RB_PT_PCT_SWC_DST_CompuMethods_ident 0.0 65535. FORMAT "%10.5"
 /begin ANNOTATION ANNOTATION_LABEL "Description (coming from AUTOSAR DESC field)"
  /begin ANNOTATION_TEXT "Counter above which lateral acceleration plausibility has failed\r\n" /end ANNOTATION_TEXT
 /end ANNOTATION
/end CHARACTERISTIC
/begin CHARACTERISTIC DST_CALIB.DST_LatAccWheels.DST_LATACCPLAUSCOUNTERMAX "" VALUE 0x8060739C DefaultValueRecordLayout_AUTOSAR_Platform_BaseTypes_uint16 65535.0 RB_PT_PCT_SWC_DST_CompuMethods_ident 0.0 65535. FORMAT "%10.5"
 /begin ANNOTATION ANNOTATION_LABEL "Description (coming from AUTOSAR DESC field)" /begin ANNOTATION_TEXT "Maximum counter value of plausibility timer\r\n" /end ANNOTATION_TEXT /end ANNOTATION
/end CHARACTERISTIC
/begin CHARACTERISTIC DST_CALIB.DST_LatAccWheels.DST_LATACCPLAUSCOUNTUP "" VALUE 0x806073AE DefaultValueRecordLayout_AUTOSAR_Platform_BaseTypes_uint8 255.0 RB_PT_PCT_SWC_DST_CompuMethods_ident 0.0 255. FORMAT "%10.5"
 /begin ANNOTATION ANNOTATION_LABEL "Description (coming from AUTOSAR DESC field)" /begin ANNOTATION_TEXT "Rate at which plausibility timer counts down\r\n" /end ANNOTATION_TEXT /end ANNOTATION
/end CHARACTERISTIC
/begin CHARACTERISTIC DST_CALIB.DST_LatAccWheels.DST_LATACCPLAUSDISABLESPEED "" VALUE 0x8060739E DefaultValueRecordLayout_AUTOSAR_Platform_BaseTypes_uint16 131.07 RB_PT_PCT_SWC_DST_CompuMethods_ratio_0p002 0.0 131.07 FORMAT "%10.5"
 /begin ANNOTATION ANNOTATION_LABEL "Description (coming from AUTOSAR DESC field)"
  /begin ANNOTATION_TEXT "Vehicle speed (in m/s) above which lateral acceleration plausibility is disabled\r\n" /end ANNOTATION_TEXT
 /end ANNOTATION
/end CHARACTERISTIC
/begin CHARACTERISTIC DST_CALIB.DST_LatAccWheels.DST_LATACCREJECTDELTA_AXLE "" VALUE 0x806073A0 DefaultValueRecordLayout_AUTOSAR_Platform_BaseTypes_uint16 500.0 RB_PT_PCT_SWC_DST_CompuMethods_ratio_0p01 0.0 500. FORMAT "%10.5"
 /begin ANNOTATION ANNOTATION_LABEL "Description (coming from AUTOSAR DESC field)" /begin ANNOTATION_TEXT "Reject wheels due to cross axle speed difference\r\n" /end ANNOTATION_TEXT /end ANNOTATION
/end CHARACTERISTIC
/begin CHARACTERISTIC DST_CALIB.DST_LatAccWheels.DST_LATACCREJECTDELTA_ROC "" VALUE 0x806073A2 DefaultValueRecordLayout_AUTOSAR_Platform_BaseTypes_uint16 500.0 RB_PT_PCT_SWC_DST_CompuMethods_ratio_0p01 0.0 500. FORMAT "%10.5"
 /begin ANNOTATION ANNOTATION_LABEL "Description (coming from AUTOSAR DESC field)" /begin ANNOTATION_TEXT "Reject wheels due to cross axle speed difference\r\n" /end ANNOTATION_TEXT /end ANNOTATION
/end CHARACTERISTIC
/begin CHARACTERISTIC DST_CALIB.DST_LatAccWheels.DST_LATACCREJECTDELTA_SIDE "" VALUE 0x806073A4 DefaultValueRecordLayout_AUTOSAR_Platform_BaseTypes_uint16 500.0 RB_PT_PCT_SWC_DST_CompuMethods_ratio_0p01 0.0 500. FORMAT "%10.5"
 /begin ANNOTATION ANNOTATION_LABEL "Description (coming from AUTOSAR DESC field)" /begin ANNOTATION_TEXT "Reject wheels due to cross axle speed difference\r\n" /end ANNOTATION_TEXT /end ANNOTATION
/end CHARACTERISTIC
/begin CHARACTERISTIC DST_CALIB.DST_LatAccWheels.DST_LATACCREJECTPAUSETIME "" VALUE 0x806073AF DefaultValueRecordLayout_AUTOSAR_Platform_BaseTypes_uint8 2.55 RB_PT_PCT_SWC_DST_CompuMethods_DST_Time 0.0 2.55 FORMAT "%10.5"
 /begin ANNOTATION ANNOTATION_LABEL "Description (coming from AUTOSAR DESC field)"
  /begin ANNOTATION_TEXT "If there is a reason to reject the lat acc this is the time the calculated lat acc will be paused\r\n" /end ANNOTATION_TEXT
 /end ANNOTATION
/end CHARACTERISTIC
/begin CHARACTERISTIC DST_CALIB.DST_LatAccWheels.DST_LATACCREJECTRESETTIME "" VALUE 0x806073A6 DefaultValueRecordLayout_AUTOSAR_Platform_BaseTypes_uint16 655.35 RB_PT_PCT_SWC_DST_CompuMethods_DST_Time 0.0 655.35 FORMAT "%10.5"
 /begin ANNOTATION ANNOTATION_LABEL "Description (coming from AUTOSAR DESC field)" /begin ANNOTATION_TEXT "If no update in this time then reset Lat Acc\r\n" /end ANNOTATION_TEXT /end ANNOTATION
/end CHARACTERISTIC
/begin CHARACTERISTIC DST_CALIB.DST_LatAccWheels.DST_LATACCREJECTSTATUS "" VALUE 0x806073B0 DefaultValueRecordLayout_AUTOSAR_Platform_BaseTypes_boolean 255.0 AUTOSAR_Platform_CompuMethods_boolean 0.0 255. FORMAT "%10.5"
 /begin ANNOTATION ANNOTATION_LABEL "Description (coming from AUTOSAR DESC field)" /begin ANNOTATION_TEXT "Reset Lat acc if any wheel is failed\r\n" /end ANNOTATION_TEXT /end ANNOTATION
/end CHARACTERISTIC
/begin CHARACTERISTIC DST_CALIB.DST_LatAccWheels.DST_PAUSELATACCPLAUSABS "" VALUE 0x806073B1 DefaultValueRecordLayout_AUTOSAR_Platform_BaseTypes_uint8 255.0 DefaultIdenticalCompu 0.0 255. FORMAT "%10.5"
 /begin ANNOTATION ANNOTATION_LABEL "Description (coming from AUTOSAR DESC field)"
  /begin ANNOTATION_TEXT "If true, lat acc plausibility will be reset if ABS / ESP intervention\r\n" /end ANNOTATION_TEXT
 /end ANNOTATION
/end CHARACTERISTIC
/begin CHARACTERISTIC DST_CALIB.DST_LatAccWheels.DST_RESETLATACCPLAUSABS "" VALUE 0x806073B2 DefaultValueRecordLayout_AUTOSAR_Platform_BaseTypes_uint8 255.0 DefaultIdenticalCompu 0.0 255. FORMAT "%10.5"
 /begin ANNOTATION ANNOTATION_LABEL "Description (coming from AUTOSAR DESC field)"
  /begin ANNOTATION_TEXT "If true, lat acc plausibility will be reset if ABS / ESP intervention\r\n" /end ANNOTATION_TEXT
 /end ANNOTATION
/end CHARACTERISTIC
/begin CHARACTERISTIC DST_CALIB.DST_LATCHDIRECTIONMAKEFALSE "" VALUE 0x8060704C DefaultValueRecordLayout_AUTOSAR_Platform_BaseTypes_uint8 255.0 DefaultIdenticalCompu 0.0 255. FORMAT "%10.5" /end CHARACTERISTIC
/begin CHARACTERISTIC DST_CALIB.DST_LATINALAUNCHSHIFTMODE "" VALUE 0x8060704D DefaultValueRecordLayout_AUTOSAR_Platform_BaseTypes_uint8 16.0 RB_PT_PCT_SWC_DST_CompuMethods_ident 0.0 16. FORMAT "%10.5"
 /begin ANNOTATION ANNOTATION_LABEL "Description (coming from AUTOSAR DESC field)"
  /begin ANNOTATION_TEXT "The shift mode (maps) to use when performing a launch\r\n" /end ANNOTATION_TEXT
 /end ANNOTATION
/end CHARACTERISTIC
/begin CHARACTERISTIC DST_CALIB.DST_LAUNCHABORTSTOPSHIFTMODE "" VALUE 0x8060704E DefaultValueRecordLayout_AUTOSAR_Platform_BaseTypes_boolean 255.0 AUTOSAR_Platform_CompuMethods_boolean 0.0 255. FORMAT "%10.5"
 /begin ANNOTATION ANNOTATION_LABEL "Description (coming from AUTOSAR DESC field)"
  /begin ANNOTATION_TEXT "If launch goes to abort then stop special launch shift mode\r\n" /end ANNOTATION_TEXT
 /end ANNOTATION
/end CHARACTERISTIC
/begin CHARACTERISTIC DST_CALIB.DST_LAUNCHDISPLAYMANAUTOMAPS "" VALUE 0x8060704F DefaultValueRecordLayout_AUTOSAR_Platform_BaseTypes_boolean 255.0 AUTOSAR_Platform_CompuMethods_boolean 0.0 255. FORMAT "%10.5"
 /begin ANNOTATION ANNOTATION_LABEL "Description (coming from AUTOSAR DESC field)"
  /begin ANNOTATION_TEXT "If true in auto shift maps Manual will be displayed if lauch active\r\n" /end ANNOTATION_TEXT
 /end ANNOTATION
/end CHARACTERISTIC
/begin CHARACTERISTIC DST_CALIB.DST_LAUNCHDISPLAYMANMANMAPS "" VALUE 0x80607050 DefaultValueRecordLayout_AUTOSAR_Platform_BaseTypes_boolean 255.0 AUTOSAR_Platform_CompuMethods_boolean 0.0 255. FORMAT "%10.5"
 /begin ANNOTATION ANNOTATION_LABEL "Description (coming from AUTOSAR DESC field)"
  /begin ANNOTATION_TEXT "If true and in launch mode manual will be displayed when shift mode is greater than 10\r\n" /end ANNOTATION_TEXT
 /end ANNOTATION
/end CHARACTERISTIC
/begin CHARACTERISTIC DST_CALIB.DST_LAUNCHINACTIVESTOPSHIFTMODE "" VALUE 0x80607051 DefaultValueRecordLayout_AUTOSAR_Platform_BaseTypes_boolean 255.0 AUTOSAR_Platform_CompuMethods_boolean 0.0 255. FORMAT "%10.5"
 /begin ANNOTATION ANNOTATION_LABEL "Description (coming from AUTOSAR DESC field)"
  /begin ANNOTATION_TEXT "If true, if the launch mode goes to inactive the DST will not longer request the special launch shift mode\r\n" /end ANNOTATION_TEXT
 /end ANNOTATION
/end CHARACTERISTIC
/begin CHARACTERISTIC DST_CALIB.DST_LAUNCHMODECHANGEDISPLAY "" VALUE 0x80607052 DefaultValueRecordLayout_AUTOSAR_Platform_BaseTypes_boolean 255.0 AUTOSAR_Platform_CompuMethods_boolean 0.0 255. FORMAT "%10.5"
 /begin ANNOTATION ANNOTATION_LABEL "Description (coming from AUTOSAR DESC field)"
  /begin ANNOTATION_TEXT "If true and in launch mode, this display will change between manual and auto\r\n" /end ANNOTATION_TEXT
 /end ANNOTATION
/end CHARACTERISTIC
/begin CHARACTERISTIC DST_CALIB.DST_LAUNCHSHIFTPOINTSREQUEST "" VALUE 0x80607053 DefaultValueRecordLayout_AUTOSAR_Platform_BaseTypes_boolean 255.0 AUTOSAR_Platform_CompuMethods_boolean 0.0 255. FORMAT "%10.5"
 /begin ANNOTATION ANNOTATION_LABEL "Description (coming from AUTOSAR DESC field)"
  /begin ANNOTATION_TEXT "If true, the shift maps to be used will be special for a launch mode\r\n" /end ANNOTATION_TEXT
 /end ANNOTATION
/end CHARACTERISTIC
/begin CHARACTERISTIC DST_CALIB.DST_LAUNCHTHROTTLECANCEL "" VALUE 0x80607054 DefaultValueRecordLayout_AUTOSAR_Platform_BaseTypes_uint8 102.0 RB_PT_PCT_SWC_DST_CompuMethods_ratio_0p4 0.0 102. FORMAT "%10.5"
 /begin ANNOTATION ANNOTATION_LABEL "Description (coming from AUTOSAR DESC field)"
  /begin ANNOTATION_TEXT "Throttle angle below which launch mode shift map is cancelled\r\n" /end ANNOTATION_TEXT
 /end ANNOTATION
/end CHARACTERISTIC
/begin CHARACTERISTIC DST_CALIB.DST_LodiParkInterface.DST_ALLOWPARKDISENGAGE "" VALUE 0x806073F8 DefaultValueRecordLayout_AUTOSAR_Platform_BaseTypes_boolean 255.0 AUTOSAR_Platform_CompuMethods_boolean 0.0 255. FORMAT "%10.5"
 /begin ANNOTATION ANNOTATION_LABEL "Description (coming from AUTOSAR DESC field)"
  /begin ANNOTATION_TEXT "For testing.  If false the state machine will think the pawl has not disengaged\r\n" /end ANNOTATION_TEXT
 /end ANNOTATION
/end CHARACTERISTIC
/begin CHARACTERISTIC DST_CALIB.DST_LodiParkInterface.DST_BOB_PARK "" VALUE 0x806073F9 DefaultValueRecordLayout_AUTOSAR_Platform_BaseTypes_boolean 255.0 AUTOSAR_Platform_CompuMethods_boolean 0.0 255. FORMAT "%10.5"
 /begin ANNOTATION ANNOTATION_LABEL "Description (coming from AUTOSAR DESC field)"
  /begin ANNOTATION_TEXT "If true DST_BOB_PARKENGAGE used to change between Park and Not Park\r\n" /end ANNOTATION_TEXT
 /end ANNOTATION
/end CHARACTERISTIC
/begin CHARACTERISTIC DST_CALIB.DST_LodiParkInterface.DST_BOB_PARKENGAGE "" VALUE 0x806073FA DefaultValueRecordLayout_AUTOSAR_Platform_BaseTypes_boolean 255.0 AUTOSAR_Platform_CompuMethods_boolean 0.0 255. FORMAT "%10.5"
 /begin ANNOTATION ANNOTATION_LABEL "Description (coming from AUTOSAR DESC field)" /begin ANNOTATION_TEXT "If true and BOB enabled then Park will be requested\r\n" /end ANNOTATION_TEXT /end ANNOTATION
/end CHARACTERISTIC
/begin CHARACTERISTIC DST_CALIB.DST_LodiParkInterface.DST_DISENGAGEDT1_FLOWOFF "" VALUE 0x806073C8 DefaultValueRecordLayout_AUTOSAR_Platform_BaseTypes_uint16 655.35 RB_PT_PCT_SWC_DST_CompuMethods_DST_Time 0.0 655.35 FORMAT "%10.5" /end CHARACTERISTIC
/begin CHARACTERISTIC DST_CALIB.DST_LodiParkInterface.DST_DISENGAGEDT2_PRESSOFF "" VALUE 0x806073CA DefaultValueRecordLayout_AUTOSAR_Platform_BaseTypes_uint16 655.35 RB_PT_PCT_SWC_DST_CompuMethods_DST_Time 0.0 655.35 FORMAT "%10.5" /end CHARACTERISTIC
/begin CHARACTERISTIC DST_CALIB.DST_LodiParkInterface.DST_DISENGAGEDT3_ADAPTDIS "" VALUE 0x806073CC DefaultValueRecordLayout_AUTOSAR_Platform_BaseTypes_uint16 655.35 RB_PT_PCT_SWC_DST_CompuMethods_DST_Time 0.0 655.35 FORMAT "%10.5" /end CHARACTERISTIC
/begin CHARACTERISTIC DST_CALIB.DST_LodiParkInterface.DST_ENGAGEDT1_FLOWOFF "" VALUE 0x806073CE DefaultValueRecordLayout_AUTOSAR_Platform_BaseTypes_uint16 655.35 RB_PT_PCT_SWC_DST_CompuMethods_DST_Time 0.0 655.35 FORMAT "%10.5" /end CHARACTERISTIC
/begin CHARACTERISTIC DST_CALIB.DST_LodiParkInterface.DST_ENGAGEDT2_PRESSOFF "" VALUE 0x806073D0 DefaultValueRecordLayout_AUTOSAR_Platform_BaseTypes_uint16 655.35 RB_PT_PCT_SWC_DST_CompuMethods_DST_Time 0.0 655.35 FORMAT "%10.5" /end CHARACTERISTIC
/begin CHARACTERISTIC DST_CALIB.DST_LodiParkInterface.DST_ENGAGEDT3_ADAPTENG "" VALUE 0x806073D2 DefaultValueRecordLayout_AUTOSAR_Platform_BaseTypes_uint16 655.35 RB_PT_PCT_SWC_DST_CompuMethods_DST_Time 0.0 655.35 FORMAT "%10.5" /end CHARACTERISTIC
/begin CHARACTERISTIC DST_CALIB.DST_LodiParkInterface.DST_EPBFAILCOUNTS "" VALUE 0x806073FB DefaultValueRecordLayout_AUTOSAR_Platform_BaseTypes_uint8 255.0 RB_PT_PCT_SWC_DST_CompuMethods_ident 0.0 255. FORMAT "%10.5"
 /begin ANNOTATION ANNOTATION_LABEL "Description (coming from AUTOSAR DESC field)"
  /begin ANNOTATION_TEXT "Counts to allow the EPB to report engaged from requesting it to engage\r\n" /end ANNOTATION_TEXT
 /end ANNOTATION
/end CHARACTERISTIC
/begin CHARACTERISTIC DST_CALIB.DST_LodiParkInterface.DST_EPBINPARKALWAYS "" VALUE 0x806073FC DefaultValueRecordLayout_AUTOSAR_Platform_BaseTypes_boolean 255.0 AUTOSAR_Platform_CompuMethods_boolean 0.0 255. FORMAT "%10.5"
 /begin ANNOTATION ANNOTATION_LABEL "Description (coming from AUTOSAR DESC field)" /begin ANNOTATION_TEXT "If true, the EPB will always be requested in Park\r\n" /end ANNOTATION_TEXT /end ANNOTATION
/end CHARACTERISTIC
/begin CHARACTERISTIC DST_CALIB.DST_LodiParkInterface.DST_PARKDISENGAGEMAXTIME "" VALUE 0x806073D4 DefaultValueRecordLayout_AUTOSAR_Platform_BaseTypes_uint16 655.35 RB_PT_PCT_SWC_DST_CompuMethods_DST_Time 0.0 655.35 FORMAT "%10.5"
 /begin ANNOTATION ANNOTATION_LABEL "Description (coming from AUTOSAR DESC field)" /begin ANNOTATION_TEXT "Maximum time allowed to disengage Park\r\n" /end ANNOTATION_TEXT /end ANNOTATION
/end CHARACTERISTIC
/begin CHARACTERISTIC DST_CALIB.DST_LodiParkInterface.DST_PARKDISENGAGEWARNTIME "" VALUE 0x806073D6 DefaultValueRecordLayout_AUTOSAR_Platform_BaseTypes_uint16 655.35 RB_PT_PCT_SWC_DST_CompuMethods_DST_Time 0.0 655.35 FORMAT "%10.5"
 /begin ANNOTATION ANNOTATION_LABEL "Description (coming from AUTOSAR DESC field)" /begin ANNOTATION_TEXT "Maximum time allowed to disengage Park\r\n" /end ANNOTATION_TEXT /end ANNOTATION
/end CHARACTERISTIC
/begin CHARACTERISTIC DST_CALIB.DST_LodiParkInterface.DST_PARKENGAGEMAXTIME "" VALUE 0x806073D8 DefaultValueRecordLayout_AUTOSAR_Platform_BaseTypes_uint16 655.35 RB_PT_PCT_SWC_DST_CompuMethods_DST_Time 0.0 655.35 FORMAT "%10.5"
 /begin ANNOTATION ANNOTATION_LABEL "Description (coming from AUTOSAR DESC field)" /begin ANNOTATION_TEXT "Maximum time allowed to engage Park\r\n" /end ANNOTATION_TEXT /end ANNOTATION
/end CHARACTERISTIC
/begin CHARACTERISTIC DST_CALIB.DST_LodiParkInterface.DST_PARKENGAGEMAXTIMEB4EPB "" VALUE 0x806073DA DefaultValueRecordLayout_AUTOSAR_Platform_BaseTypes_uint16 655.35 RB_PT_PCT_SWC_DST_CompuMethods_DST_Time 0.0 655.35 FORMAT "%10.5"
 /begin ANNOTATION ANNOTATION_LABEL "Description (coming from AUTOSAR DESC field)" /begin ANNOTATION_TEXT "Maximum time allowed to engage Park\r\n" /end ANNOTATION_TEXT /end ANNOTATION
/end CHARACTERISTIC
/begin CHARACTERISTIC DST_CALIB.DST_LodiParkInterface.DST_PARKFAILENGAGEDBNCE "" VALUE 0x806073FD DefaultValueRecordLayout_AUTOSAR_Platform_BaseTypes_uint8 255.0 RB_PT_PCT_SWC_DST_CompuMethods_ident 0.0 255. FORMAT "%10.5"
 /begin ANNOTATION ANNOTATION_LABEL "Description (coming from AUTOSAR DESC field)" /begin ANNOTATION_TEXT "Loops Park needs to be not engaged\r\n" /end ANNOTATION_TEXT /end ANNOTATION
/end CHARACTERISTIC
/begin CHARACTERISTIC DST_CALIB.DST_LodiParkInterface.DST_PARKFLOWDISENGAGE "" VALUE 0x806073DC DefaultValueRecordLayout_AUTOSAR_Platform_BaseTypes_sint16 64.0 RB_PT_PCT_SWC_DST_CompuMethods_ratio_0p001 -32. 32. FORMAT "%10.5"
 /begin ANNOTATION ANNOTATION_LABEL "Description (coming from AUTOSAR DESC field)" /begin ANNOTATION_TEXT "Requested flow rate to disengage\r\n" /end ANNOTATION_TEXT /end ANNOTATION
/end CHARACTERISTIC
/begin CHARACTERISTIC DST_CALIB.DST_LodiParkInterface.DST_PARKFLOWENGAGE "" VALUE 0x806073DE DefaultValueRecordLayout_AUTOSAR_Platform_BaseTypes_sint16 64.0 RB_PT_PCT_SWC_DST_CompuMethods_ratio_0p001 -32. 32. FORMAT "%10.5"
 /begin ANNOTATION ANNOTATION_LABEL "Description (coming from AUTOSAR DESC field)" /begin ANNOTATION_TEXT "Requested flow rate to engage park\r\n" /end ANNOTATION_TEXT /end ANNOTATION
/end CHARACTERISTIC
/begin CHARACTERISTIC DST_CALIB.DST_LodiParkInterface.DST_PARKFLOWENGAGED "" VALUE 0x806073E0 DefaultValueRecordLayout_AUTOSAR_Platform_BaseTypes_sint16 64.0 RB_PT_PCT_SWC_DST_CompuMethods_ratio_0p001 -32. 32. FORMAT "%10.5"
 /begin ANNOTATION ANNOTATION_LABEL "Description (coming from AUTOSAR DESC field)" /begin ANNOTATION_TEXT "Flow request for park when Park is engaged\r\n" /end ANNOTATION_TEXT /end ANNOTATION
/end CHARACTERISTIC
/begin CHARACTERISTIC DST_CALIB.DST_LodiParkInterface.DST_PARKFLOWENGAGEPROF "" CURVE 0x80607400 RB_PT_PCT_SWC_DST_RecordLayouts_RL_Curve_sint16_10_uint16_10 64.0 RB_PT_PCT_SWC_DST_CompuMethods_ratio_0p001 -32. 32. FORMAT "%10.5"
 /begin ANNOTATION ANNOTATION_LABEL "Description (coming from AUTOSAR DESC field)"
  /begin ANNOTATION_TEXT "Calibrate to allow mini minse of valve or soften engagement\r\n" /end ANNOTATION_TEXT
 /end ANNOTATION
 /begin AXIS_DESCR STD_AXIS NO_INPUT_QUANTITY RB_PT_PCT_SWC_DST_CompuMethods_DST_Time 10 0.0 655.35 FORMAT "%10.5" DEPOSIT ABSOLUTE /end AXIS_DESCR
/end CHARACTERISTIC
/begin CHARACTERISTIC DST_CALIB.DST_LodiParkInterface.DST_PARKLEARNGAIN "" VALUE 0x806073FE DefaultValueRecordLayout_AUTOSAR_Platform_BaseTypes_uint8 1.0 RB_PT_PCT_SWC_DST_CompuMethods_ratio_0p01 0.0 1. FORMAT "%10.5"
 /begin ANNOTATION ANNOTATION_LABEL "Description (coming from AUTOSAR DESC field)" /begin ANNOTATION_TEXT "Fraction of new position to apply to learnt position\r\n" /end ANNOTATION_TEXT /end ANNOTATION
/end CHARACTERISTIC
/begin CHARACTERISTIC DST_CALIB.DST_LodiParkInterface.DST_PARKMAXENGAGESPEED "" VALUE 0x806073E2 DefaultValueRecordLayout_AUTOSAR_Platform_BaseTypes_uint16 500.0 RB_PT_PCT_SWC_DST_CompuMethods_kph_0p1 0.0 500. FORMAT "%10.5"
 /begin ANNOTATION ANNOTATION_LABEL "Description (coming from AUTOSAR DESC field)" /begin ANNOTATION_TEXT "Maximum speed to allow park to engage\r\n" /end ANNOTATION_TEXT /end ANNOTATION
/end CHARACTERISTIC
/begin CHARACTERISTIC DST_CALIB.DST_LodiParkInterface.DST_PARKWARNHOLDTIME "" VALUE 0x806073E4 DefaultValueRecordLayout_AUTOSAR_Platform_BaseTypes_uint16 655.35 RB_PT_PCT_SWC_DST_CompuMethods_DST_Time 0.0 655.35 FORMAT "%10.5"
 /begin ANNOTATION ANNOTATION_LABEL "Description (coming from AUTOSAR DESC field)" /begin ANNOTATION_TEXT "Time to maintain the park warning flag\r\n" /end ANNOTATION_TEXT /end ANNOTATION
/end CHARACTERISTIC
/begin CHARACTERISTIC DST_CALIB.DST_LodiParkInterface.DST_POSPARKDISENGAGEDDefault "" VALUE 0x806073E6 DefaultValueRecordLayout_AUTOSAR_Platform_BaseTypes_sint16 40.0 RB_PT_PCT_SWC_DST_CompuMethods_ratio_0p001 -20. 20. FORMAT "%10.5"
 /begin ANNOTATION ANNOTATION_LABEL "Description (coming from AUTOSAR DESC field)" /begin ANNOTATION_TEXT "Reset value of the disengaged position\r\n" /end ANNOTATION_TEXT /end ANNOTATION
/end CHARACTERISTIC
/begin CHARACTERISTIC DST_CALIB.DST_LodiParkInterface.DST_POSPARKDISENGAGEDHIGH "" VALUE 0x806073E8 DefaultValueRecordLayout_AUTOSAR_Platform_BaseTypes_sint16 40.0 RB_PT_PCT_SWC_DST_CompuMethods_ratio_0p001 -20. 20. FORMAT "%10.5"
 /begin ANNOTATION ANNOTATION_LABEL "Description (coming from AUTOSAR DESC field)"
  /begin ANNOTATION_TEXT "Adapted engaged position of park brake that is higher than expected.\r\n" /end ANNOTATION_TEXT
 /end ANNOTATION
/end CHARACTERISTIC
/begin CHARACTERISTIC DST_CALIB.DST_LodiParkInterface.DST_POSPARKDISENGAGEDLOW "" VALUE 0x806073EA DefaultValueRecordLayout_AUTOSAR_Platform_BaseTypes_sint16 40.0 RB_PT_PCT_SWC_DST_CompuMethods_ratio_0p001 -20. 20. FORMAT "%10.5"
 /begin ANNOTATION ANNOTATION_LABEL "Description (coming from AUTOSAR DESC field)"
  /begin ANNOTATION_TEXT "Adapted engaged position of park brake that is higher than expected.\r\n" /end ANNOTATION_TEXT
 /end ANNOTATION
/end CHARACTERISTIC
/begin CHARACTERISTIC DST_CALIB.DST_LodiParkInterface.DST_POSPARKENGAGEDDefault "" VALUE 0x806073EC DefaultValueRecordLayout_AUTOSAR_Platform_BaseTypes_sint16 40.0 RB_PT_PCT_SWC_DST_CompuMethods_ratio_0p001 -20. 20. FORMAT "%10.5"
 /begin ANNOTATION ANNOTATION_LABEL "Description (coming from AUTOSAR DESC field)" /begin ANNOTATION_TEXT "Reset value of the engaged position\r\n" /end ANNOTATION_TEXT /end ANNOTATION
/end CHARACTERISTIC
/begin CHARACTERISTIC DST_CALIB.DST_LodiParkInterface.DST_POSPARKENGAGEDHIGH "" VALUE 0x806073EE DefaultValueRecordLayout_AUTOSAR_Platform_BaseTypes_sint16 40.0 RB_PT_PCT_SWC_DST_CompuMethods_ratio_0p001 -20. 20. FORMAT "%10.5"
 /begin ANNOTATION ANNOTATION_LABEL "Description (coming from AUTOSAR DESC field)"
  /begin ANNOTATION_TEXT "Adapted engaged position of park brake that is higher than expected.\r\n" /end ANNOTATION_TEXT
 /end ANNOTATION
/end CHARACTERISTIC
/begin CHARACTERISTIC DST_CALIB.DST_LodiParkInterface.DST_POSPARKENGAGEDLOW "" VALUE 0x806073F0 DefaultValueRecordLayout_AUTOSAR_Platform_BaseTypes_sint16 40.0 RB_PT_PCT_SWC_DST_CompuMethods_ratio_0p001 -20. 20. FORMAT "%10.5"
 /begin ANNOTATION ANNOTATION_LABEL "Description (coming from AUTOSAR DESC field)"
  /begin ANNOTATION_TEXT "Adapted engaged position of park brake that is higher than expected.\r\n" /end ANNOTATION_TEXT
 /end ANNOTATION
/end CHARACTERISTIC
/begin CHARACTERISTIC DST_CALIB.DST_LodiParkInterface.DST_POSPARKLEARNOFFSET "" VALUE 0x806073F2 DefaultValueRecordLayout_AUTOSAR_Platform_BaseTypes_sint16 40.0 RB_PT_PCT_SWC_DST_CompuMethods_ratio_0p001 -20. 20. FORMAT "%10.5"
 /begin ANNOTATION ANNOTATION_LABEL "Description (coming from AUTOSAR DESC field)"
  /begin ANNOTATION_TEXT "Position to subtract / add to the min/max limits when adapting\r\n" /end ANNOTATION_TEXT
 /end ANNOTATION
/end CHARACTERISTIC
/begin CHARACTERISTIC DST_CALIB.DST_LodiParkInterface.DST_POSPARKMAXTRIGADAPTDISENGAGE "" VALUE 0x806073F4 DefaultValueRecordLayout_AUTOSAR_Platform_BaseTypes_sint16 40.0 RB_PT_PCT_SWC_DST_CompuMethods_ratio_0p001 -20. 20. FORMAT "%10.5"
 /begin ANNOTATION ANNOTATION_LABEL "Description (coming from AUTOSAR DESC field)" /begin ANNOTATION_TEXT "Lower limit to allow park to adat\r\n" /end ANNOTATION_TEXT /end ANNOTATION
/end CHARACTERISTIC
/begin CHARACTERISTIC DST_CALIB.DST_LodiParkInterface.DST_POSPARKMAXTRIGADAPTENGAGED "" VALUE 0x806073F6 DefaultValueRecordLayout_AUTOSAR_Platform_BaseTypes_sint16 40.0 RB_PT_PCT_SWC_DST_CompuMethods_ratio_0p001 -20. 20. FORMAT "%10.5"
 /begin ANNOTATION ANNOTATION_LABEL "Description (coming from AUTOSAR DESC field)" /begin ANNOTATION_TEXT "Upper limit to allow park to adapt\r\n" /end ANNOTATION_TEXT /end ANNOTATION
/end CHARACTERISTIC
/begin CHARACTERISTIC DST_CALIB.DST_LodiParkInterface.DST_PRESSUREDISENGAGEOil "" CURVE 0x8060742A RB_PT_PCT_SWC_DST_RecordLayouts_RL_Curve_uint16_6_sint16_6 32.0 RB_PT_PCT_SWC_DST_CompuMethods_ratio_0p001 0.0 32. FORMAT "%10.5"
 /begin ANNOTATION ANNOTATION_LABEL "Description (coming from AUTOSAR DESC field)"
  /begin ANNOTATION_TEXT "Requestee actuation pressure based on transs oil temperature\r\n" /end ANNOTATION_TEXT
 /end ANNOTATION
 /begin AXIS_DESCR STD_AXIS NO_INPUT_QUANTITY RB_PT_PCT_SWC_DST_CompuMethods_ident 6 -50. 200. FORMAT "%10.5" DEPOSIT ABSOLUTE /end AXIS_DESCR
/end CHARACTERISTIC
/begin CHARACTERISTIC DST_CALIB.DST_LodiParkInterface.DST_PRESSUREDISENGAGETime "" CURVE 0x80607444 RB_PT_PCT_SWC_DST_RecordLayouts_RL_Curve_uint16_5_uint16_5 32.0 RB_PT_PCT_SWC_DST_CompuMethods_ratio_0p001 0.0 32. FORMAT "%10.5"
 /begin ANNOTATION ANNOTATION_LABEL "Description (coming from AUTOSAR DESC field)" /begin ANNOTATION_TEXT "Pressure based on time engaging\r\n" /end ANNOTATION_TEXT /end ANNOTATION
 /begin AXIS_DESCR STD_AXIS NO_INPUT_QUANTITY RB_PT_PCT_SWC_DST_CompuMethods_DST_Time 5 0.0 655.35 FORMAT "%10.5" DEPOSIT ABSOLUTE /end AXIS_DESCR
/end CHARACTERISTIC
/begin CHARACTERISTIC DST_CALIB.DST_LodiParkInterface.DST_PRESSUREENGAGEOil "" CURVE 0x8060745A RB_PT_PCT_SWC_DST_RecordLayouts_RL_Curve_uint16_6_sint16_6 32.0 RB_PT_PCT_SWC_DST_CompuMethods_ratio_0p001 0.0 32. FORMAT "%10.5"
 /begin ANNOTATION ANNOTATION_LABEL "Description (coming from AUTOSAR DESC field)"
  /begin ANNOTATION_TEXT "Requestee actuation pressure based on transs oil temperature\r\n" /end ANNOTATION_TEXT
 /end ANNOTATION
 /begin AXIS_DESCR STD_AXIS NO_INPUT_QUANTITY RB_PT_PCT_SWC_DST_CompuMethods_ident 6 -50. 200. FORMAT "%10.5" DEPOSIT ABSOLUTE /end AXIS_DESCR
/end CHARACTERISTIC
/begin CHARACTERISTIC DST_CALIB.DST_LodiParkInterface.DST_PRESSUREENGAGETime "" CURVE 0x80607474 RB_PT_PCT_SWC_DST_RecordLayouts_RL_Curve_uint16_5_uint16_5 32.0 RB_PT_PCT_SWC_DST_CompuMethods_ratio_0p001 0.0 32. FORMAT "%10.5"
 /begin ANNOTATION ANNOTATION_LABEL "Description (coming from AUTOSAR DESC field)" /begin ANNOTATION_TEXT "Engagement pressre based on time to engage\r\n" /end ANNOTATION_TEXT /end ANNOTATION
 /begin AXIS_DESCR STD_AXIS NO_INPUT_QUANTITY RB_PT_PCT_SWC_DST_CompuMethods_DST_Time 5 0.0 655.35 FORMAT "%10.5" DEPOSIT ABSOLUTE /end AXIS_DESCR
/end CHARACTERISTIC
/begin CHARACTERISTIC DST_CALIB.DST_LodiParkInterface.DST_RESETPARKPOSITIONS "" VALUE 0x806073FF DefaultValueRecordLayout_AUTOSAR_Platform_BaseTypes_boolean 255.0 AUTOSAR_Platform_CompuMethods_boolean 0.0 255. FORMAT "%10.5"
 /begin ANNOTATION ANNOTATION_LABEL "Description (coming from AUTOSAR DESC field)"
  /begin ANNOTATION_TEXT "If true the park adapted positions will be reset to the default values\r\n" /end ANNOTATION_TEXT
 /end ANNOTATION
/end CHARACTERISTIC
/begin CHARACTERISTIC DST_CALIB.DST_LONACCMAXSHIFT "" VALUE 0x80606FE4 DefaultValueRecordLayout_AUTOSAR_Platform_BaseTypes_sint16 4.0 RB_PT_PCT_SWC_DST_CompuMethods_ratio_0p01 -2. 2. FORMAT "%10.5"
 /begin ANNOTATION ANNOTATION_LABEL "Description (coming from AUTOSAR DESC field)"
  /begin ANNOTATION_TEXT "Longitudinal acceleration above which shifting will be disabled\r\n" /end ANNOTATION_TEXT
 /end ANNOTATION
/end CHARACTERISTIC
/begin CHARACTERISTIC DST_CALIB.DST_LONGACCFAULTIGNOREMONITOR "" VALUE 0x80607055 DefaultValueRecordLayout_AUTOSAR_Platform_BaseTypes_uint8 255.0 DefaultIdenticalCompu 0.0 255. FORMAT "%10.5" /end CHARACTERISTIC
/begin CHARACTERISTIC DST_CALIB.DST_LONGACCMINSHIFT "" VALUE 0x80606FE6 DefaultValueRecordLayout_AUTOSAR_Platform_BaseTypes_sint16 4.0 RB_PT_PCT_SWC_DST_CompuMethods_ratio_0p01 -2. 2. FORMAT "%10.5"
 /begin ANNOTATION ANNOTATION_LABEL "Description (coming from AUTOSAR DESC field)"
  /begin ANNOTATION_TEXT "Minimum longitudinal acceleration below which shifting will be disabled\r\n" /end ANNOTATION_TEXT
 /end ANNOTATION
/end CHARACTERISTIC
/begin CHARACTERISTIC DST_CALIB.DST_MANDISABLEDRIVEMODE "" VAL_BLK 0x80606F75 DefaultValueRecordLayout_AUTOSAR_Platform_BaseTypes_boolean 255.0 AUTOSAR_Platform_CompuMethods_boolean 0.0 255. FORMAT "%10.5"
 /begin ANNOTATION ANNOTATION_LABEL "Description (coming from AUTOSAR DESC field)"
  /begin ANNOTATION_TEXT "Depending on IOP_DriveModeTrans, can be used to disable manual shifting modes\r\n" /end ANNOTATION_TEXT
 /end ANNOTATION
 MATRIX_DIM 16 1 1 /end CHARACTERISTIC
/begin CHARACTERISTIC DST_CALIB.DST_MANSHIFTINGPADDLESOFF "" VALUE 0x80607056 DefaultValueRecordLayout_AUTOSAR_Platform_BaseTypes_boolean 255.0 AUTOSAR_Platform_CompuMethods_boolean 0.0 255. FORMAT "%10.5"
 /begin ANNOTATION ANNOTATION_LABEL "Description (coming from AUTOSAR DESC field)"
  /begin ANNOTATION_TEXT "If true and DST_ManShiftingDisable is True, the shift paddles will be ignored\r\n" /end ANNOTATION_TEXT
 /end ANNOTATION
/end CHARACTERISTIC
/begin CHARACTERISTIC DST_CALIB.DST_MANUALMODEONLY "" VAL_BLK 0x80606F85 DefaultValueRecordLayout_AUTOSAR_Platform_BaseTypes_boolean 255.0 AUTOSAR_Platform_CompuMethods_boolean 0.0 255. FORMAT "%10.5"
 /begin ANNOTATION ANNOTATION_LABEL "Description (coming from AUTOSAR DESC field)"
  /begin ANNOTATION_TEXT "If true, this value of IOP_DriveModeTrans will force to manual mode\r\n" /end ANNOTATION_TEXT
 /end ANNOTATION
 MATRIX_DIM 16 1 1 /end CHARACTERISTIC
/begin CHARACTERISTIC DST_CALIB.DST_MINENGSPDFORMANUAL "" VALUE 0x80606FE8 DefaultValueRecordLayout_AUTOSAR_Platform_BaseTypes_uint16 20000.0 RB_PT_PCT_SWC_DST_CompuMethods_ident 0.0 20000. FORMAT "%10.5" /end CHARACTERISTIC
/begin CHARACTERISTIC DST_CALIB.DST_MODEFAULT2NEUTRAL "" VALUE 0x80607057 DefaultValueRecordLayout_AUTOSAR_Platform_BaseTypes_uint8 255.0 RB_PT_PCT_SWC_DST_CompuMethods_ident 0.0 255. FORMAT "%10.5"
 /begin ANNOTATION ANNOTATION_LABEL "Description (coming from AUTOSAR DESC field)"
  /begin ANNOTATION_TEXT "Number of program loops before an L2 request for Neutral is performed (debounce)\r\n" /end ANNOTATION_TEXT
 /end ANNOTATION
/end CHARACTERISTIC
/begin CHARACTERISTIC DST_CALIB.DST_ModeSelectGeneric.DST_AGGRESSIONSPORTINDEX "" MAP 0x806075BE RB_PT_PCT_SWC_DST_RecordLayouts_RL_Map_uint8_16_uint8_8_uint8_2 2.0 RB_PT_PCT_SWC_DST_CompuMethods_ident 1. 3. FORMAT "%10.5"
 /begin ANNOTATION ANNOTATION_LABEL "Description (coming from AUTOSAR DESC field)"
  /begin ANNOTATION_TEXT "Convert aggression to upper and lower valuve of sport index (hyst)\r\n" /end ANNOTATION_TEXT
 /end ANNOTATION
 /begin AXIS_DESCR STD_AXIS NO_INPUT_QUANTITY RB_PT_PCT_SWC_DST_CompuMethods_percent_0p5 8 0.0 100. FORMAT "%10.5" DEPOSIT ABSOLUTE /end AXIS_DESCR
 /begin AXIS_DESCR STD_AXIS NO_INPUT_QUANTITY RB_PT_PCT_SWC_DST_CompuMethods_ident 2 0.0 1. FORMAT "%10.5" DEPOSIT ABSOLUTE /end AXIS_DESCR
/end CHARACTERISTIC
/begin CHARACTERISTIC DST_CALIB.DST_ModeSelectGeneric.DST_GRADPEAKHOLDDECAYNEG "" VALUE 0x806074D4 DefaultValueRecordLayout_AUTOSAR_Platform_BaseTypes_uint16 32.7 RB_PT_PCT_SWC_DST_CompuMethods_ratio_0p001 0.0 32.7 FORMAT "%10.5"
 /begin ANNOTATION ANNOTATION_LABEL "Description (coming from AUTOSAR DESC field)" /begin ANNOTATION_TEXT "Decay rate of peak held negative gradient\r\n" /end ANNOTATION_TEXT /end ANNOTATION
/end CHARACTERISTIC
/begin CHARACTERISTIC DST_CALIB.DST_ModeSelectGeneric.DST_GRADPEAKHOLDDECAYPOS "" VALUE 0x806074D6 DefaultValueRecordLayout_AUTOSAR_Platform_BaseTypes_uint16 32.7 RB_PT_PCT_SWC_DST_CompuMethods_ratio_0p001 0.0 32.7 FORMAT "%10.5"
 /begin ANNOTATION ANNOTATION_LABEL "Description (coming from AUTOSAR DESC field)" /begin ANNOTATION_TEXT "Decay rate of peak held negative gradient\r\n" /end ANNOTATION_TEXT /end ANNOTATION
/end CHARACTERISTIC
/begin CHARACTERISTIC DST_CALIB.DST_ModeSelectGeneric.DST_GRADPEAKHOLDTIMENEG "" VALUE 0x806074D8 DefaultValueRecordLayout_AUTOSAR_Platform_BaseTypes_uint16 655.35 RB_PT_PCT_SWC_DST_CompuMethods_DST_Time 0.0 655.35 FORMAT "%10.5"
 /begin ANNOTATION ANNOTATION_LABEL "Description (coming from AUTOSAR DESC field)" /begin ANNOTATION_TEXT "Time the negative peak held gradient will be held\r\n" /end ANNOTATION_TEXT /end ANNOTATION
/end CHARACTERISTIC
/begin CHARACTERISTIC DST_CALIB.DST_ModeSelectGeneric.DST_GRADPEAKHOLDTIMEPOS "" VALUE 0x806074DA DefaultValueRecordLayout_AUTOSAR_Platform_BaseTypes_uint16 655.35 RB_PT_PCT_SWC_DST_CompuMethods_DST_Time 0.0 655.35 FORMAT "%10.5"
 /begin ANNOTATION ANNOTATION_LABEL "Description (coming from AUTOSAR DESC field)" /begin ANNOTATION_TEXT "Time the negative peak held gradient will be held\r\n" /end ANNOTATION_TEXT /end ANNOTATION
/end CHARACTERISTIC
/begin CHARACTERISTIC DST_CALIB.DST_ModeSelectGeneric.DST_INI2PIFSTOPPED "" VALUE 0x806074EA DefaultValueRecordLayout_AUTOSAR_Platform_BaseTypes_boolean 255.0 AUTOSAR_Platform_CompuMethods_boolean 0.0 255. FORMAT "%10.5"
 /begin ANNOTATION ANNOTATION_LABEL "Description (coming from AUTOSAR DESC field)"
  /begin ANNOTATION_TEXT "If true, regardless of the park brake state, on power up and vehicle stationary, Park will be engaged\r\n" /end ANNOTATION_TEXT
 /end ANNOTATION
/end CHARACTERISTIC
/begin CHARACTERISTIC DST_CALIB.DST_ModeSelectGeneric.DST_MANUALMODEPTRAINMODE "" VAL_BLK 0x806074AC DefaultValueRecordLayout_AUTOSAR_Platform_BaseTypes_boolean 255.0 AUTOSAR_Platform_CompuMethods_boolean 0.0 255. FORMAT "%10.5"
 /begin ANNOTATION ANNOTATION_LABEL "Description (coming from AUTOSAR DESC field)"
  /begin ANNOTATION_TEXT "Allows or prevents manual mode depending on powertrain mode\r\n" /end ANNOTATION_TEXT
 /end ANNOTATION
 MATRIX_DIM 16 1 1 /end CHARACTERISTIC
/begin CHARACTERISTIC DST_CALIB.DST_ModeSelectGeneric.DST_PARKMAXENGAGESPEED "" VALUE 0x806074DC DefaultValueRecordLayout_AUTOSAR_Platform_BaseTypes_uint16 500.0 RB_PT_PCT_SWC_DST_CompuMethods_kph_0p1 0.0 500. FORMAT "%10.5"
 /begin ANNOTATION ANNOTATION_LABEL "Description (coming from AUTOSAR DESC field)" /begin ANNOTATION_TEXT "Maximum speed allowed to select Park\r\n" /end ANNOTATION_TEXT /end ANNOTATION
/end CHARACTERISTIC
/begin CHARACTERISTIC DST_CALIB.DST_ModeSelectGeneric.DST_PARKWITHKL5OFF "" VALUE 0x806074EB DefaultValueRecordLayout_AUTOSAR_Platform_BaseTypes_boolean 255.0 AUTOSAR_Platform_CompuMethods_boolean 0.0 255. FORMAT "%10.5"
 /begin ANNOTATION ANNOTATION_LABEL "Description (coming from AUTOSAR DESC field)"
  /begin ANNOTATION_TEXT "If true, park will always be engaged when KL15 is switch off\r\n" /end ANNOTATION_TEXT
 /end ANNOTATION
/end CHARACTERISTIC
/begin CHARACTERISTIC DST_CALIB.DST_ModeSelectGeneric.DST_POWERTRAIN2MODE "" VAL_BLK 0x806074BC DefaultValueRecordLayout_AUTOSAR_Platform_BaseTypes_uint8 11.0 RB_PT_PCT_SWC_DST_CompuMethods_Enumerations_DST_Mode 0.0 11. FORMAT "%10.5"
 /begin ANNOTATION ANNOTATION_LABEL "Description (coming from AUTOSAR DESC field)" /begin ANNOTATION_TEXT "Conversion from powertrain mode to transmission mode\r\n" /end ANNOTATION_TEXT /end ANNOTATION
 MATRIX_DIM 16 1 1 /end CHARACTERISTIC
/begin CHARACTERISTIC DST_CALIB.DST_ModeSelectGeneric.DST_POWERUPTIME "" VALUE 0x806074DE DefaultValueRecordLayout_AUTOSAR_Platform_BaseTypes_uint16 655.35 RB_PT_PCT_SWC_DST_CompuMethods_DST_Time 0.0 655.35 FORMAT "%10.5"
 /begin ANNOTATION ANNOTATION_LABEL "Description (coming from AUTOSAR DESC field)"
  /begin ANNOTATION_TEXT "Time the vehicle has been powered up before allowing normal operation\r\n" /end ANNOTATION_TEXT
 /end ANNOTATION
/end CHARACTERISTIC
/begin CHARACTERISTIC DST_CALIB.DST_ModeSelectGeneric.DST_RoadDetect.DST_CITYEXITTIME "" MAP 0x806074F4 RB_PT_PCT_SWC_DST_RecordLayouts_RL_Map_uint16_85_uint16_5_uint8_17 655.35 RB_PT_PCT_SWC_DST_CompuMethods_DST_Time 0.0 655.35 FORMAT "%10.5"
 /begin ANNOTATION ANNOTATION_LABEL "Description (coming from AUTOSAR DESC field)"
  /begin ANNOTATION_TEXT "Time to exit City based on shift mode and reference speed\r\n" /end ANNOTATION_TEXT
 /end ANNOTATION
 /begin AXIS_DESCR STD_AXIS NO_INPUT_QUANTITY RB_PT_PCT_SWC_DST_CompuMethods_kph_0p1 5 0.0 500. FORMAT "%10.5" DEPOSIT ABSOLUTE /end AXIS_DESCR
 /begin AXIS_DESCR STD_AXIS NO_INPUT_QUANTITY RB_PT_PCT_SWC_DST_CompuMethods_ident 17 0.0 16. FORMAT "%10.5" DEPOSIT ABSOLUTE /end AXIS_DESCR
/end CHARACTERISTIC
/begin CHARACTERISTIC DST_CALIB.DST_ModeSelectGeneric.DST_RoadDetect.DST_STOPGOCANCEL "" VALUE 0x806074F0 DefaultValueRecordLayout_AUTOSAR_Platform_BaseTypes_uint16 500.0 RB_PT_PCT_SWC_DST_CompuMethods_kph_0p1 0.0 500. FORMAT "%10.5"
 /begin ANNOTATION ANNOTATION_LABEL "Description (coming from AUTOSAR DESC field)" /begin ANNOTATION_TEXT "Vehicle speed above which stop go counter is reset\r\n" /end ANNOTATION_TEXT /end ANNOTATION
/end CHARACTERISTIC
/begin CHARACTERISTIC DST_CALIB.DST_ModeSelectGeneric.DST_RoadDetect.DST_STOPGOINCREASEHI "" VALUE 0x806074F2 DefaultValueRecordLayout_AUTOSAR_Platform_BaseTypes_uint16 500.0 RB_PT_PCT_SWC_DST_CompuMethods_kph_0p1 0.0 500. FORMAT "%10.5"
 /begin ANNOTATION ANNOTATION_LABEL "Description (coming from AUTOSAR DESC field)" /begin ANNOTATION_TEXT "Vehicle speed above which counter will be increased\r\n" /end ANNOTATION_TEXT /end ANNOTATION
/end CHARACTERISTIC
/begin CHARACTERISTIC DST_CALIB.DST_ModeSelectGeneric.DST_SLOWDOWNFORMODECHANGEDISPLAYTIME "" VALUE 0x806074E0 DefaultValueRecordLayout_AUTOSAR_Platform_BaseTypes_uint16 65535.0 RB_PT_PCT_SWC_DST_CompuMethods_ident 0.0 65535. FORMAT "%10.5"
 /begin ANNOTATION ANNOTATION_LABEL "Description (coming from AUTOSAR DESC field)" /begin ANNOTATION_TEXT "Counts\r\n" /end ANNOTATION_TEXT /end ANNOTATION
/end CHARACTERISTIC
/begin CHARACTERISTIC DST_CALIB.DST_ModeSelectGeneric.DST_SPORTINCMODECHNG "" VAL_BLK 0x806074CC DefaultValueRecordLayout_AUTOSAR_Platform_BaseTypes_sint16 102.0 RB_PT_PCT_SWC_DST_CompuMethods_ratio_0p005 0.0 102. FORMAT "%10.5"
 /begin ANNOTATION ANNOTATION_LABEL "Description (coming from AUTOSAR DESC field)"
  /begin ANNOTATION_TEXT "Increaser in Throttle Peak held due to change to Sport\r\n" /end ANNOTATION_TEXT
 /end ANNOTATION
 MATRIX_DIM 4 1 1 /end CHARACTERISTIC
/begin CHARACTERISTIC DST_CALIB.DST_ModeSelectGeneric.DST_SPORTINDEX_KMH "" CURVE 0x806075DC RB_PT_PCT_SWC_DST_RecordLayouts_RL_Curve_uint8_6_uint16_6 100.0 RB_PT_PCT_SWC_DST_CompuMethods_percent_0p5 0.0 100. FORMAT "%10.5"
 /begin ANNOTATION ANNOTATION_LABEL "Description (coming from AUTOSAR DESC field)" /begin ANNOTATION_TEXT "Impact on sport index from vehicle speed\r\n" /end ANNOTATION_TEXT /end ANNOTATION
 /begin AXIS_DESCR STD_AXIS NO_INPUT_QUANTITY RB_PT_PCT_SWC_DST_CompuMethods_kph_0p1 6 0.0 500. FORMAT "%10.5" DEPOSIT ABSOLUTE /end AXIS_DESCR
/end CHARACTERISTIC
/begin CHARACTERISTIC DST_CALIB.DST_ModeSelectGeneric.DST_SPORTINDEX_KMHDECAY "" VALUE 0x806074EF DefaultValueRecordLayout_AUTOSAR_Platform_BaseTypes_uint8 25.5 RB_PT_PCT_SWC_DST_CompuMethods_kph_0p1 0.0 25.5 FORMAT "%10.5"
 /begin ANNOTATION ANNOTATION_LABEL "Description (coming from AUTOSAR DESC field)" /begin ANNOTATION_TEXT "Rate of decrease in peak speed used in sport index\r\n" /end ANNOTATION_TEXT /end ANNOTATION
/end CHARACTERISTIC
/begin CHARACTERISTIC DST_CALIB.DST_ModeSelectGeneric.DST_SPORTINDEX_THROTTLE "" CURVE 0x806075F0 RB_PT_PCT_SWC_DST_RecordLayouts_RL_Curve_uint8_6_sint16_6 100.0 RB_PT_PCT_SWC_DST_CompuMethods_percent_0p5 0.0 100. FORMAT "%10.5"
 /begin ANNOTATION ANNOTATION_LABEL "Description (coming from AUTOSAR DESC field)" /begin ANNOTATION_TEXT "Impact on sport index from driver demand\r\n" /end ANNOTATION_TEXT /end ANNOTATION
 /begin AXIS_DESCR STD_AXIS NO_INPUT_QUANTITY RB_PT_PCT_SWC_DST_CompuMethods_ratio_0p005 6 0.0 102. FORMAT "%10.5" DEPOSIT ABSOLUTE /end AXIS_DESCR
/end CHARACTERISTIC
/begin CHARACTERISTIC DST_CALIB.DST_ModeSelectGeneric.DST_SPORTINDEXPAUSEMAXTHROTTLE "" VALUE 0x806074EC DefaultValueRecordLayout_AUTOSAR_Platform_BaseTypes_uint8 102.0 RB_PT_PCT_SWC_DST_CompuMethods_ratio_0p4 0.0 102. FORMAT "%10.5"
 /begin ANNOTATION ANNOTATION_LABEL "Description (coming from AUTOSAR DESC field)"
  /begin ANNOTATION_TEXT "Sport index will be pause after a shift if the throttle is between DST_SPORTINDEXPAUSEMINTHROTTLE and MAXTHROTTLE\r\n" /end ANNOTATION_TEXT
 /end ANNOTATION
/end CHARACTERISTIC
/begin CHARACTERISTIC DST_CALIB.DST_ModeSelectGeneric.DST_SPORTINDEXPAUSEMINTHROTTLE "" VALUE 0x806074ED DefaultValueRecordLayout_AUTOSAR_Platform_BaseTypes_uint8 102.0 RB_PT_PCT_SWC_DST_CompuMethods_ratio_0p4 0.0 102. FORMAT "%10.5"
 /begin ANNOTATION ANNOTATION_LABEL "Description (coming from AUTOSAR DESC field)"
  /begin ANNOTATION_TEXT "Sport index will be pause after a shift if the throttle is between DST_SPORTINDEXPAUSEMINTHROTTLE and MAXTHROTTLE\r\n" /end ANNOTATION_TEXT
 /end ANNOTATION
/end CHARACTERISTIC
/begin CHARACTERISTIC DST_CALIB.DST_ModeSelectGeneric.DST_SPORTINDEXRESETSPEED "" VALUE 0x806074E2 DefaultValueRecordLayout_AUTOSAR_Platform_BaseTypes_uint16 500.0 RB_PT_PCT_SWC_DST_CompuMethods_kph_0p1 0.0 500. FORMAT "%10.5"
 /begin ANNOTATION ANNOTATION_LABEL "Description (coming from AUTOSAR DESC field)"
  /begin ANNOTATION_TEXT "When the reference speed is below this speed a timer will increase.  When the timer exceeds DST_SPORTINDEXRESETTIME the sport index will be set to 0\r\n" /end ANNOTATION_TEXT
 /end ANNOTATION
/end CHARACTERISTIC
/begin CHARACTERISTIC DST_CALIB.DST_ModeSelectGeneric.DST_SPORTINDEXRESETTIME "" VALUE 0x806074E4 DefaultValueRecordLayout_AUTOSAR_Platform_BaseTypes_uint16 655.35 RB_PT_PCT_SWC_DST_CompuMethods_DST_Time 0.0 655.35 FORMAT "%10.5"
 /begin ANNOTATION ANNOTATION_LABEL "Description (coming from AUTOSAR DESC field)"
  /begin ANNOTATION_TEXT "Time below DST_SPORTINDEXRESETSPEED to reset the sport index to 1\r\n" /end ANNOTATION_TEXT
 /end ANNOTATION
/end CHARACTERISTIC
/begin CHARACTERISTIC DST_CALIB.DST_ModeSelectGeneric.DST_SPORTINDEXTHROTTLEALWAYSUPDATE "" VALUE 0x806074EE DefaultValueRecordLayout_AUTOSAR_Platform_BaseTypes_uint8 102.0 RB_PT_PCT_SWC_DST_CompuMethods_ratio_0p4 0.0 102. FORMAT "%10.5"
 /begin ANNOTATION ANNOTATION_LABEL "Description (coming from AUTOSAR DESC field)"
  /begin ANNOTATION_TEXT "Throttle angle above which sport index will always be updated\r\n" /end ANNOTATION_TEXT
 /end ANNOTATION
/end CHARACTERISTIC
/begin CHARACTERISTIC DST_CALIB.DST_ModeSelectGeneric.DST_TIME2BRAKEDECAYRESETGa "" VAL_BLK 0x8060748A DefaultValueRecordLayout_AUTOSAR_Platform_BaseTypes_uint8 2.0 RB_PT_PCT_SWC_DST_CompuMethods_ratio_0p01 0.0 2. FORMAT "%10.5"
 /begin ANNOTATION ANNOTATION_LABEL "Description (coming from AUTOSAR DESC field)"
  /begin ANNOTATION_TEXT "Braking G above which DST_Tome2BrakeDecay is set high\r\n" /end ANNOTATION_TEXT
 /end ANNOTATION
 MATRIX_DIM 17 1 1 /end CHARACTERISTIC
/begin CHARACTERISTIC DST_CALIB.DST_ModeSelectGeneric.DST_TIME2CORNERRESETG "" VAL_BLK 0x8060749B DefaultValueRecordLayout_AUTOSAR_Platform_BaseTypes_uint8 1.27 RB_PT_PCT_SWC_DST_CompuMethods_ratio_0p01 0.0 1.27 FORMAT "%10.5"
 /begin ANNOTATION ANNOTATION_LABEL "Description (coming from AUTOSAR DESC field)"
  /begin ANNOTATION_TEXT "Depending on shift mode, lateral acceleration that will cause the peak held  to be updated and high timer reset\r\n" /end ANNOTATION_TEXT
 /end ANNOTATION
 MATRIX_DIM 17 1 1 /end CHARACTERISTIC
/begin CHARACTERISTIC DST_CALIB.DST_ModeSelectGeneric.DST_TIMEPOSTENGRUNKEEPENGOFFMAPS "" VALUE 0x806074E6 DefaultValueRecordLayout_AUTOSAR_Platform_BaseTypes_uint16 655.35 RB_PT_PCT_SWC_DST_CompuMethods_DST_Time 0.0 655.35 FORMAT "%10.5"
 /begin ANNOTATION ANNOTATION_LABEL "Description (coming from AUTOSAR DESC field)"
  /begin ANNOTATION_TEXT "If the engine has been running for less than this time, maintain the engine off shift maps\r\n" /end ANNOTATION_TEXT
 /end ANNOTATION
/end CHARACTERISTIC
/begin CHARACTERISTIC DST_CALIB.DST_ModeSelectGeneric.DST_TIMEPOSTSHIFTSPORTINDEXRUN "" VALUE 0x806074E8 DefaultValueRecordLayout_AUTOSAR_Platform_BaseTypes_uint16 655.35 RB_PT_PCT_SWC_DST_CompuMethods_DST_Time 0.0 655.35 FORMAT "%10.5"
 /begin ANNOTATION ANNOTATION_LABEL "Description (coming from AUTOSAR DESC field)"
  /begin ANNOTATION_TEXT "Sport index is not updated after a shift for this time\r\n" /end ANNOTATION_TEXT
 /end ANNOTATION
/end CHARACTERISTIC
/begin CHARACTERISTIC DST_CALIB.DST_P3BACKUP_KMHDis "" VALUE 0x80606FEA DefaultValueRecordLayout_AUTOSAR_Platform_BaseTypes_uint16 500.0 RB_PT_PCT_SWC_DST_CompuMethods_kph_0p1 0.0 500. FORMAT "%10.5"
 /begin ANNOTATION ANNOTATION_LABEL "Description (coming from AUTOSAR DESC field)"
  /begin ANNOTATION_TEXT "Above this speed do not request P3 as it will be in a backup mode that causes much higher EM1 speeds\r\n" /end ANNOTATION_TEXT
 /end ANNOTATION
/end CHARACTERISTIC
/begin CHARACTERISTIC DST_CALIB.DST_P3BACKUP_KMHEn "" VALUE 0x80606FEC DefaultValueRecordLayout_AUTOSAR_Platform_BaseTypes_uint16 500.0 RB_PT_PCT_SWC_DST_CompuMethods_kph_0p1 0.0 500. FORMAT "%10.5"
 /begin ANNOTATION ANNOTATION_LABEL "Description (coming from AUTOSAR DESC field)"
  /begin ANNOTATION_TEXT "Above this speed do not request P3 as it will be in a backup mode that causes much higher EM1 speeds\r\n" /end ANNOTATION_TEXT
 /end ANNOTATION
/end CHARACTERISTIC
/begin CHARACTERISTIC DST_CALIB.DST_PARKMAXENGAGESPEED "" VALUE 0x80606FEE DefaultValueRecordLayout_AUTOSAR_Platform_BaseTypes_uint16 500.0 RB_PT_PCT_SWC_DST_CompuMethods_kph_0p1 0.0 500. FORMAT "%10.5"
 /begin ANNOTATION ANNOTATION_LABEL "Description (coming from AUTOSAR DESC field)" /begin ANNOTATION_TEXT "Maximum speed to engage park\r\n" /end ANNOTATION_TEXT /end ANNOTATION
/end CHARACTERISTIC
/begin CHARACTERISTIC DST_CALIB.DST_PARKSLOWCOUNT "" VALUE 0x80607058 DefaultValueRecordLayout_AUTOSAR_Platform_BaseTypes_uint8 255.0 RB_PT_PCT_SWC_DST_CompuMethods_ident 0.0 255. FORMAT "%10.5"
 /begin ANNOTATION ANNOTATION_LABEL "Description (coming from AUTOSAR DESC field)" /begin ANNOTATION_TEXT "Too slow to engage park so display Park\r\n" /end ANNOTATION_TEXT /end ANNOTATION
/end CHARACTERISTIC
/begin CHARACTERISTIC DST_CALIB.DST_POWERDOWNCOUNTS_N "" VALUE 0x80606FC0 DefaultValueRecordLayout_AUTOSAR_Platform_BaseTypes_uint32 400000.0 RB_PT_PCT_SWC_DST_CompuMethods_ident 0.0 400000. FORMAT "%10.5"
 /begin ANNOTATION ANNOTATION_LABEL "Description (coming from AUTOSAR DESC field)" /begin ANNOTATION_TEXT "Program loops DST will hold the power up\r\n" /end ANNOTATION_TEXT /end ANNOTATION
/end CHARACTERISTIC
/begin CHARACTERISTIC DST_CALIB.DST_POWERDOWNCOUNTS_P "" VALUE 0x80606FC4 DefaultValueRecordLayout_AUTOSAR_Platform_BaseTypes_uint32 400000.0 RB_PT_PCT_SWC_DST_CompuMethods_ident 0.0 400000. FORMAT "%10.5"
 /begin ANNOTATION ANNOTATION_LABEL "Description (coming from AUTOSAR DESC field)" /begin ANNOTATION_TEXT "Program loops DST will hold the power up\r\n" /end ANNOTATION_TEXT /end ANNOTATION
/end CHARACTERISTIC
/begin CHARACTERISTIC DST_CALIB.DST_POWERDOWNDONTCHECKPAWL "" VALUE 0x80607059 DefaultValueRecordLayout_AUTOSAR_Platform_BaseTypes_uint8 255.0 DefaultIdenticalCompu 0.0 255. FORMAT "%10.5"
 /begin ANNOTATION ANNOTATION_LABEL "Description (coming from AUTOSAR DESC field)"
  /begin ANNOTATION_TEXT "If true, provided the car is in Park it will power down\r\n" /end ANNOTATION_TEXT
 /end ANNOTATION
/end CHARACTERISTIC
/begin CHARACTERISTIC DST_CALIB.DST_POWERDOWNPARKVALVEOFF "" VALUE 0x8060705A DefaultValueRecordLayout_AUTOSAR_Platform_BaseTypes_boolean 255.0 AUTOSAR_Platform_CompuMethods_boolean 0.0 255. FORMAT "%10.5"
 /begin ANNOTATION ANNOTATION_LABEL "Description (coming from AUTOSAR DESC field)"
  /begin ANNOTATION_TEXT "Option to disable the park control valve when DST power down is ok\r\n" /end ANNOTATION_TEXT
 /end ANNOTATION
/end CHARACTERISTIC
/begin CHARACTERISTIC DST_CALIB.DST_POWERTRAIN2CHRISMA "" VAL_BLK 0x80606F95 DefaultValueRecordLayout_AUTOSAR_Platform_BaseTypes_uint8 8.0 RB_PT_PCT_SWC_DST_CompuMethods_Enumerations_IOP_CANDriveStrategy 0.0 8. FORMAT "%10.5"
 /begin ANNOTATION ANNOTATION_LABEL "Description (coming from AUTOSAR DESC field)" /begin ANNOTATION_TEXT "Conversion for mode display\r\n" /end ANNOTATION_TEXT /end ANNOTATION
 MATRIX_DIM 16 1 1 /end CHARACTERISTIC
/begin CHARACTERISTIC DST_CALIB.DST_POWERTRAIN2FAHPROGRAMM "" VAL_BLK 0x80606FA5 DefaultValueRecordLayout_AUTOSAR_Platform_BaseTypes_uint8 13.0 RB_PT_PCT_SWC_DST_CompuMethods_Enumerations_IOP_CANShiftMode 0.0 13. FORMAT "%10.5"
 /begin ANNOTATION ANNOTATION_LABEL "Description (coming from AUTOSAR DESC field)" /begin ANNOTATION_TEXT "Conversion for mode display\r\n" /end ANNOTATION_TEXT /end ANNOTATION
 MATRIX_DIM 16 1 1 /end CHARACTERISTIC
/begin CHARACTERISTIC DST_CALIB.DST_PSG.DST_PRESELECTTEMPDISABLE "" VALUE 0x80607656 DefaultValueRecordLayout_AUTOSAR_Platform_BaseTypes_sint16 250.0 RB_PT_PCT_SWC_DST_CompuMethods_ident -50. 200. FORMAT "%10.5"
 /begin ANNOTATION ANNOTATION_LABEL "Description (coming from AUTOSAR DESC field)" /begin ANNOTATION_TEXT "Temperature below which preselect is disabled\r\n" /end ANNOTATION_TEXT /end ANNOTATION
/end CHARACTERISTIC
/begin CHARACTERISTIC DST_CALIB.DST_PSG.DST_PRESELECTZEROLATCHTIME "" VALUE 0x80607658 DefaultValueRecordLayout_AUTOSAR_Platform_BaseTypes_uint16 655.35 RB_PT_PCT_SWC_DST_CompuMethods_DST_Time 0.0 655.35 FORMAT "%10.5"
 /begin ANNOTATION ANNOTATION_LABEL "Description (coming from AUTOSAR DESC field)" /begin ANNOTATION_TEXT "TIme to latch a preselect zero request\r\n" /end ANNOTATION_TEXT /end ANNOTATION
/end CHARACTERISTIC
/begin CHARACTERISTIC DST_CALIB.DST_PSG.DST_PSGUPCANCELBELOWIDLE "" VALUE 0x8060765A DefaultValueRecordLayout_AUTOSAR_Platform_BaseTypes_uint16 20000.0 RB_PT_PCT_SWC_DST_CompuMethods_ident 0.0 20000. FORMAT "%10.5"
 /begin ANNOTATION ANNOTATION_LABEL "Description (coming from AUTOSAR DESC field)" /begin ANNOTATION_TEXT "Disable preselect up below idle speed threshold\r\n" /end ANNOTATION_TEXT /end ANNOTATION
/end CHARACTERISTIC
/begin CHARACTERISTIC DST_CALIB.DST_PSG.DST_PSGUPENABLEABOVEIDLE "" VALUE 0x8060765C DefaultValueRecordLayout_AUTOSAR_Platform_BaseTypes_uint16 20000.0 RB_PT_PCT_SWC_DST_CompuMethods_ident 0.0 20000. FORMAT "%10.5"
 /begin ANNOTATION ANNOTATION_LABEL "Description (coming from AUTOSAR DESC field)" /begin ANNOTATION_TEXT "Enable preselect up above idle speed\r\n" /end ANNOTATION_TEXT /end ANNOTATION
/end CHARACTERISTIC
/begin CHARACTERISTIC DST_CALIB.DST_PSG.DST_PSGZEROMAXTIMEPOSTSHIFT "" VALUE 0x8060765E DefaultValueRecordLayout_AUTOSAR_Platform_BaseTypes_uint16 655.35 RB_PT_PCT_SWC_DST_CompuMethods_DST_Time 0.0 655.35 FORMAT "%10.5"
 /begin ANNOTATION ANNOTATION_LABEL "Description (coming from AUTOSAR DESC field)" /begin ANNOTATION_TEXT "TIme to latch a preselect zero request\r\n" /end ANNOTATION_TEXT /end ANNOTATION
/end CHARACTERISTIC
/begin CHARACTERISTIC DST_CALIB.DST_PSG.DST_REFSPDWHEELSLIPMARGIN "" VALUE 0x80607664 DefaultValueRecordLayout_AUTOSAR_Platform_BaseTypes_uint8 1.0 RB_PT_PCT_SWC_DST_CompuMethods_ratio_0p01 1. 2. FORMAT "%10.5"
 /begin ANNOTATION ANNOTATION_LABEL "Description (coming from AUTOSAR DESC field)"
  /begin ANNOTATION_TEXT "Fraction above reference speed that wheels are considered to be slipping\r\n" /end ANNOTATION_TEXT
 /end ANNOTATION
/end CHARACTERISTIC
/begin CHARACTERISTIC DST_CALIB.DST_PSG.DST_REFSPDWHEELSLIPMIN "" VALUE 0x80607660 DefaultValueRecordLayout_AUTOSAR_Platform_BaseTypes_uint16 500.0 RB_PT_PCT_SWC_DST_CompuMethods_kph_0p1 0.0 500. FORMAT "%10.5"
 /begin ANNOTATION ANNOTATION_LABEL "Description (coming from AUTOSAR DESC field)"
  /begin ANNOTATION_TEXT "Minimum wheel speed above reference speed to consider wheels are spinning\r\n" /end ANNOTATION_TEXT
 /end ANNOTATION
/end CHARACTERISTIC
/begin CHARACTERISTIC DST_CALIB.DST_PSG.DST_SPECIALPRESELECT "" VAL_BLK 0x80607604 DefaultValueRecordLayout_AUTOSAR_Platform_BaseTypes_uint8 255.0 RB_PT_PCT_SWC_DST_CompuMethods_ident 0.0 255. FORMAT "%10.5"
 /begin ANNOTATION ANNOTATION_LABEL "Description (coming from AUTOSAR DESC field)" /begin ANNOTATION_TEXT "Special preselect gear request during some shifts\r\n" /end ANNOTATION_TEXT /end ANNOTATION
 MATRIX_DIM 9 9 1 /end CHARACTERISTIC
/begin CHARACTERISTIC DST_CALIB.DST_PSG.DST_SPECIALPSGTIMOUT "" VALUE 0x80607665 DefaultValueRecordLayout_AUTOSAR_Platform_BaseTypes_uint8 2.55 RB_PT_PCT_SWC_DST_CompuMethods_ratio_0p01 0.0 2.55 FORMAT "%10.5"
 /begin ANNOTATION ANNOTATION_LABEL "Description (coming from AUTOSAR DESC field)" /begin ANNOTATION_TEXT "Max time special PSG can be requested\r\n" /end ANNOTATION_TEXT /end ANNOTATION
/end CHARACTERISTIC
/begin CHARACTERISTIC DST_CALIB.DST_PSG.DST_WHEELSDRIVEN_FRONT "" VALUE 0x80607666 DefaultValueRecordLayout_AUTOSAR_Platform_BaseTypes_boolean 255.0 AUTOSAR_Platform_CompuMethods_boolean 0.0 255. FORMAT "%10.5"
 /begin ANNOTATION ANNOTATION_LABEL "Description (coming from AUTOSAR DESC field)" /begin ANNOTATION_TEXT "Set true if frony wheels are driven\r\n" /end ANNOTATION_TEXT /end ANNOTATION
/end CHARACTERISTIC
/begin CHARACTERISTIC DST_CALIB.DST_PSG.DST_WHEELSDRIVEN_REAR "" VALUE 0x80607667 DefaultValueRecordLayout_AUTOSAR_Platform_BaseTypes_boolean 255.0 AUTOSAR_Platform_CompuMethods_boolean 0.0 255. FORMAT "%10.5"
 /begin ANNOTATION ANNOTATION_LABEL "Description (coming from AUTOSAR DESC field)" /begin ANNOTATION_TEXT "Set true if rear wheels are driven\r\n" /end ANNOTATION_TEXT /end ANNOTATION
/end CHARACTERISTIC
/begin CHARACTERISTIC DST_CALIB.DST_PSG.DST_WHEELSLIPDISABLLEPRESELECTCOUNT "" VALUE 0x80607662 DefaultValueRecordLayout_AUTOSAR_Platform_BaseTypes_uint16 65535.0 RB_PT_PCT_SWC_DST_CompuMethods_ident 0.0 65535. FORMAT "%10.5"
 /begin ANNOTATION ANNOTATION_LABEL "Description (coming from AUTOSAR DESC field)"
  /begin ANNOTATION_TEXT "Threshold to disable preselect after wheels have been slipping for a time\r\n" /end ANNOTATION_TEXT
 /end ANNOTATION
/end CHARACTERISTIC
/begin CHARACTERISTIC DST_CALIB.DST_RefSpdCalc.DST_PCNTSLIPUSETRANSSENSORS "" VALUE 0x8060766C DefaultValueRecordLayout_AUTOSAR_Platform_BaseTypes_uint8 255.0 DefaultIdenticalCompu 0.0 255. FORMAT "%10.5"
 /begin ANNOTATION ANNOTATION_LABEL "Description (coming from AUTOSAR DESC field)"
  /begin ANNOTATION_TEXT "If true, the transmission sensors will be used to calculate wheel slip\r\n" /end ANNOTATION_TEXT
 /end ANNOTATION
/end CHARACTERISTIC
/begin CHARACTERISTIC DST_CALIB.DST_RefSpdCalc.DST_REFSPDLIMIT2NONDRIVENWHEELS "" VALUE 0x80607668 DefaultValueRecordLayout_AUTOSAR_Platform_BaseTypes_uint16 500.0 RB_PT_PCT_SWC_DST_CompuMethods_ratio_0p01 0.0 500. FORMAT "%10.5"
 /begin ANNOTATION ANNOTATION_LABEL "Description (coming from AUTOSAR DESC field)"
  /begin ANNOTATION_TEXT "Speed below which non driven wheels will control rate of increase of reference speed\r\n" /end ANNOTATION_TEXT
 /end ANNOTATION
/end CHARACTERISTIC
/begin CHARACTERISTIC DST_CALIB.DST_RefSpdCalc.DST_REFSPDNODECELLIMIT_N_R "" VALUE 0x8060766A DefaultValueRecordLayout_AUTOSAR_Platform_BaseTypes_uint16 500.0 RB_PT_PCT_SWC_DST_CompuMethods_ratio_0p01 0.0 500. FORMAT "%10.5"
 /begin ANNOTATION ANNOTATION_LABEL "Description (coming from AUTOSAR DESC field)"
  /begin ANNOTATION_TEXT "Below this vehicle speed in Reverse or Neutral, dont limit rate of change of ref speed\r\n" /end ANNOTATION_TEXT
 /end ANNOTATION
/end CHARACTERISTIC
/begin CHARACTERISTIC DST_CALIB.DST_REVERSEDEMAND "" VALUE 0x8060705B DefaultValueRecordLayout_AUTOSAR_Platform_BaseTypes_uint8 11.0 RB_PT_PCT_SWC_DST_CompuMethods_ident 0.0 11. FORMAT "%10.5"
 /begin ANNOTATION ANNOTATION_LABEL "Description (coming from AUTOSAR DESC field)" /begin ANNOTATION_TEXT "Demand gear to request when in Reverse\r\n" /end ANNOTATION_TEXT /end ANNOTATION
/end CHARACTERISTIC
/begin CHARACTERISTIC DST_CALIB.DST_REVERSEDEMANDENG "" VALUE 0x8060705C DefaultValueRecordLayout_AUTOSAR_Platform_BaseTypes_uint8 11.0 RB_PT_PCT_SWC_DST_CompuMethods_ident 0.0 11. FORMAT "%10.5" /end CHARACTERISTIC
/begin CHARACTERISTIC DST_CALIB.DST_REVERSEDEMANDEV "" VALUE 0x8060705D DefaultValueRecordLayout_AUTOSAR_Platform_BaseTypes_uint8 11.0 RB_PT_PCT_SWC_DST_CompuMethods_ident 0.0 11. FORMAT "%10.5" /end CHARACTERISTIC
/begin CHARACTERISTIC DST_CALIB.DST_REVERSEDEMANDTOOFAST "" VALUE 0x8060705E DefaultValueRecordLayout_AUTOSAR_Platform_BaseTypes_uint8 11.0 RB_PT_PCT_SWC_DST_CompuMethods_ident 0.0 11. FORMAT "%10.5"
 /begin ANNOTATION ANNOTATION_LABEL "Description (coming from AUTOSAR DESC field)" /begin ANNOTATION_TEXT "Demand gear to request when in Reverse\r\n" /end ANNOTATION_TEXT /end ANNOTATION
/end CHARACTERISTIC
/begin CHARACTERISTIC DST_CALIB.DST_REVERSEPRESELECT "" VALUE 0x8060705F DefaultValueRecordLayout_AUTOSAR_Platform_BaseTypes_uint8 11.0 RB_PT_PCT_SWC_DST_CompuMethods_ident 0.0 11. FORMAT "%10.5"
 /begin ANNOTATION ANNOTATION_LABEL "Description (coming from AUTOSAR DESC field)" /begin ANNOTATION_TEXT "preselect gear to request when in reverse\r\n" /end ANNOTATION_TEXT /end ANNOTATION
/end CHARACTERISTIC
/begin CHARACTERISTIC DST_CALIB.DST_ROLLINGROAD "" VALUE 0x80607060 DefaultValueRecordLayout_AUTOSAR_Platform_BaseTypes_boolean 255.0 AUTOSAR_Platform_CompuMethods_boolean 0.0 255. FORMAT "%10.5"
 /begin ANNOTATION ANNOTATION_LABEL "Description (coming from AUTOSAR DESC field)" /begin ANNOTATION_TEXT "Set true if the vehicle is being used on rollers\r\n" /end ANNOTATION_TEXT /end ANNOTATION
/end CHARACTERISTIC
/begin CHARACTERISTIC DST_CALIB.DST_SailingLogic.DST_SAILOFFTHROTTLE "" VALUE 0x80607670 DefaultValueRecordLayout_AUTOSAR_Platform_BaseTypes_boolean 255.0 AUTOSAR_Platform_CompuMethods_boolean 0.0 255. FORMAT "%10.5"
 /begin ANNOTATION ANNOTATION_LABEL "Description (coming from AUTOSAR DESC field)" /begin ANNOTATION_TEXT "If true, allow sailing off throttle\r\n" /end ANNOTATION_TEXT /end ANNOTATION
/end CHARACTERISTIC
/begin CHARACTERISTIC DST_CALIB.DST_SailingLogic.DST_SAILONBRAKES "" VALUE 0x80607671 DefaultValueRecordLayout_AUTOSAR_Platform_BaseTypes_boolean 255.0 AUTOSAR_Platform_CompuMethods_boolean 0.0 255. FORMAT "%10.5"
 /begin ANNOTATION ANNOTATION_LABEL "Description (coming from AUTOSAR DESC field)" /begin ANNOTATION_TEXT "If true, allow sailing when the brakes are applied\r\n" /end ANNOTATION_TEXT /end ANNOTATION
/end CHARACTERISTIC
/begin CHARACTERISTIC DST_CALIB.DST_SailingLogic.DST_SAILTRIGGERENGSPD "" VALUE 0x8060766E DefaultValueRecordLayout_AUTOSAR_Platform_BaseTypes_uint16 20000.0 RB_PT_PCT_SWC_DST_CompuMethods_ident 0.0 20000. FORMAT "%10.5"
 /begin ANNOTATION ANNOTATION_LABEL "Description (coming from AUTOSAR DESC field)" /begin ANNOTATION_TEXT "Allow sailing below this engine speed\r\n" /end ANNOTATION_TEXT /end ANNOTATION
/end CHARACTERISTIC
/begin CHARACTERISTIC DST_CALIB.DST_SHIFTINHIBITACCELERATION_KMH_EN "" VALUE 0x80606FF0 DefaultValueRecordLayout_AUTOSAR_Platform_BaseTypes_uint16 500.0 RB_PT_PCT_SWC_DST_CompuMethods_kph_0p1 0.0 500. FORMAT "%10.5"
 /begin ANNOTATION ANNOTATION_LABEL "Description (coming from AUTOSAR DESC field)"
  /begin ANNOTATION_TEXT "Vehicle speed above which shifting at high lateral acceleration is enabled\r\n" /end ANNOTATION_TEXT
 /end ANNOTATION
/end CHARACTERISTIC
/begin CHARACTERISTIC DST_CALIB.DST_SPECIALPSGMINTEMP "" VALUE 0x80606FF2 DefaultValueRecordLayout_AUTOSAR_Platform_BaseTypes_sint16 250.0 RB_PT_PCT_SWC_DST_CompuMethods_ident -50. 200. FORMAT "%10.5" /end CHARACTERISTIC
/begin CHARACTERISTIC DST_CALIB.DST_SSDISABLECANCEL "" VALUE 0x80606FF4 DefaultValueRecordLayout_AUTOSAR_Platform_BaseTypes_uint16 65535.0 RB_PT_PCT_SWC_DST_CompuMethods_ident 0.0 65535. FORMAT "%10.5" /end CHARACTERISTIC
/begin CHARACTERISTIC DST_CALIB.DST_SSDISABLEDRIVEGRADNEG "" VALUE 0x80606FF6 DefaultValueRecordLayout_AUTOSAR_Platform_BaseTypes_sint16 65.4 RB_PT_PCT_SWC_DST_CompuMethods_ratio_0p001 -32.7 32.7 FORMAT "%10.5" /end CHARACTERISTIC
/begin CHARACTERISTIC DST_CALIB.DST_SSDISABLEDRIVEGRADPOS "" VALUE 0x80606FF8 DefaultValueRecordLayout_AUTOSAR_Platform_BaseTypes_sint16 65.4 RB_PT_PCT_SWC_DST_CompuMethods_ratio_0p001 -32.7 32.7 FORMAT "%10.5" /end CHARACTERISTIC
/begin CHARACTERISTIC DST_CALIB.DST_SSDISABLEGRADNEG "" VALUE 0x80606FFA DefaultValueRecordLayout_AUTOSAR_Platform_BaseTypes_sint16 65.4 RB_PT_PCT_SWC_DST_CompuMethods_ratio_0p001 -32.7 32.7 FORMAT "%10.5" /end CHARACTERISTIC
/begin CHARACTERISTIC DST_CALIB.DST_SSDISABLEGRADPOS "" VALUE 0x80606FFC DefaultValueRecordLayout_AUTOSAR_Platform_BaseTypes_sint16 65.4 RB_PT_PCT_SWC_DST_CompuMethods_ratio_0p001 -32.7 32.7 FORMAT "%10.5" /end CHARACTERISTIC
/begin CHARACTERISTIC DST_CALIB.DST_SSDISABLEREVGRADNEG "" VALUE 0x80606FFE DefaultValueRecordLayout_AUTOSAR_Platform_BaseTypes_sint16 65.4 RB_PT_PCT_SWC_DST_CompuMethods_ratio_0p001 -32.7 32.7 FORMAT "%10.5" /end CHARACTERISTIC
/begin CHARACTERISTIC DST_CALIB.DST_SSDISABLEREVGRADPOS "" VALUE 0x80607000 DefaultValueRecordLayout_AUTOSAR_Platform_BaseTypes_sint16 65.4 RB_PT_PCT_SWC_DST_CompuMethods_ratio_0p001 -32.7 32.7 FORMAT "%10.5" /end CHARACTERISTIC
/begin CHARACTERISTIC DST_CALIB.DST_SSDISABLETRIG "" VALUE 0x80607002 DefaultValueRecordLayout_AUTOSAR_Platform_BaseTypes_uint16 65535.0 RB_PT_PCT_SWC_DST_CompuMethods_ident 0.0 65535. FORMAT "%10.5" /end CHARACTERISTIC
/begin CHARACTERISTIC DST_CALIB.DST_SSEENABLEDEC "" VALUE 0x80607061 DefaultValueRecordLayout_AUTOSAR_Platform_BaseTypes_uint8 255.0 RB_PT_PCT_SWC_DST_CompuMethods_ident 0.0 255. FORMAT "%10.5" /end CHARACTERISTIC
/begin CHARACTERISTIC DST_CALIB.DST_SSENABLECOUNTMAX "" VALUE 0x80607004 DefaultValueRecordLayout_AUTOSAR_Platform_BaseTypes_uint16 65535.0 RB_PT_PCT_SWC_DST_CompuMethods_ident 0.0 65535. FORMAT "%10.5" /end CHARACTERISTIC
/begin CHARACTERISTIC DST_CALIB.DST_SSENABLEGRADNEG "" VALUE 0x80607006 DefaultValueRecordLayout_AUTOSAR_Platform_BaseTypes_sint16 65.4 RB_PT_PCT_SWC_DST_CompuMethods_ratio_0p001 -32.7 32.7 FORMAT "%10.5" /end CHARACTERISTIC
/begin CHARACTERISTIC DST_CALIB.DST_SSENABLEGRADPOS "" VALUE 0x80607008 DefaultValueRecordLayout_AUTOSAR_Platform_BaseTypes_sint16 65.4 RB_PT_PCT_SWC_DST_CompuMethods_ratio_0p001 -32.7 32.7 FORMAT "%10.5" /end CHARACTERISTIC
/begin CHARACTERISTIC DST_CALIB.DST_SSENABLEINC "" VALUE 0x80607062 DefaultValueRecordLayout_AUTOSAR_Platform_BaseTypes_uint8 255.0 RB_PT_PCT_SWC_DST_CompuMethods_ident 0.0 255. FORMAT "%10.5" /end CHARACTERISTIC
/begin CHARACTERISTIC DST_CALIB.DST_SSENGINESTARTCANCEL "" VALUE 0x8060700A DefaultValueRecordLayout_AUTOSAR_Platform_BaseTypes_uint16 65535.0 RB_PT_PCT_SWC_DST_CompuMethods_ident 0.0 65535. FORMAT "%10.5" /end CHARACTERISTIC
/begin CHARACTERISTIC DST_CALIB.DST_SSENGINESTARTCOUNTMAX "" VALUE 0x8060700C DefaultValueRecordLayout_AUTOSAR_Platform_BaseTypes_uint16 65535.0 RB_PT_PCT_SWC_DST_CompuMethods_ident 0.0 65535. FORMAT "%10.5" /end CHARACTERISTIC
/begin CHARACTERISTIC DST_CALIB.DST_SSENGINESTARTDEC "" VALUE 0x80607063 DefaultValueRecordLayout_AUTOSAR_Platform_BaseTypes_uint8 255.0 RB_PT_PCT_SWC_DST_CompuMethods_ident 0.0 255. FORMAT "%10.5" /end CHARACTERISTIC
/begin CHARACTERISTIC DST_CALIB.DST_SSENGINESTARTINC "" VALUE 0x80607064 DefaultValueRecordLayout_AUTOSAR_Platform_BaseTypes_uint8 255.0 RB_PT_PCT_SWC_DST_CompuMethods_ident 0.0 255. FORMAT "%10.5"
 /begin ANNOTATION ANNOTATION_LABEL "Description (coming from AUTOSAR DESC field)" /begin ANNOTATION_TEXT "Increase step\r\n" /end ANNOTATION_TEXT /end ANNOTATION
/end CHARACTERISTIC
/begin CHARACTERISTIC DST_CALIB.DST_SSENGINESTARTTRIG "" VALUE 0x8060700E DefaultValueRecordLayout_AUTOSAR_Platform_BaseTypes_uint16 65535.0 RB_PT_PCT_SWC_DST_CompuMethods_ident 0.0 65535. FORMAT "%10.5" /end CHARACTERISTIC
/begin CHARACTERISTIC DST_CALIB.DST_SSENGNOTSTARTGRADNEG "" VALUE 0x80607010 DefaultValueRecordLayout_AUTOSAR_Platform_BaseTypes_sint16 65.4 RB_PT_PCT_SWC_DST_CompuMethods_ratio_0p001 -32.7 32.7 FORMAT "%10.5" /end CHARACTERISTIC
/begin CHARACTERISTIC DST_CALIB.DST_SSENGNOTSTARTGRADPOS "" VALUE 0x80607012 DefaultValueRecordLayout_AUTOSAR_Platform_BaseTypes_sint16 65.4 RB_PT_PCT_SWC_DST_CompuMethods_ratio_0p001 -32.7 32.7 FORMAT "%10.5" /end CHARACTERISTIC
/begin CHARACTERISTIC DST_CALIB.DST_SSENGSTARTDRIGRADNEG "" VALUE 0x80607014 DefaultValueRecordLayout_AUTOSAR_Platform_BaseTypes_sint16 65.4 RB_PT_PCT_SWC_DST_CompuMethods_ratio_0p001 -32.7 32.7 FORMAT "%10.5" /end CHARACTERISTIC
/begin CHARACTERISTIC DST_CALIB.DST_SSENGSTARTDRIVEGRADPOS "" VALUE 0x80607016 DefaultValueRecordLayout_AUTOSAR_Platform_BaseTypes_sint16 65.4 RB_PT_PCT_SWC_DST_CompuMethods_ratio_0p001 -32.7 32.7 FORMAT "%10.5" /end CHARACTERISTIC
/begin CHARACTERISTIC DST_CALIB.DST_SSENGSTARTGRADNEG "" VALUE 0x80607018 DefaultValueRecordLayout_AUTOSAR_Platform_BaseTypes_sint16 65.4 RB_PT_PCT_SWC_DST_CompuMethods_ratio_0p001 -32.7 32.7 FORMAT "%10.5" /end CHARACTERISTIC
/begin CHARACTERISTIC DST_CALIB.DST_SSENGSTARTGRADPOS "" VALUE 0x8060701A DefaultValueRecordLayout_AUTOSAR_Platform_BaseTypes_sint16 65.4 RB_PT_PCT_SWC_DST_CompuMethods_ratio_0p001 -32.7 32.7 FORMAT "%10.5" /end CHARACTERISTIC
/begin CHARACTERISTIC DST_CALIB.DST_SSENGSTARTREVGRADNEG "" VALUE 0x8060701C DefaultValueRecordLayout_AUTOSAR_Platform_BaseTypes_sint16 65.4 RB_PT_PCT_SWC_DST_CompuMethods_ratio_0p001 -32.7 32.7 FORMAT "%10.5" /end CHARACTERISTIC
/begin CHARACTERISTIC DST_CALIB.DST_SSENGSTARTREVGRADPOS "" VALUE 0x8060701E DefaultValueRecordLayout_AUTOSAR_Platform_BaseTypes_sint16 65.4 RB_PT_PCT_SWC_DST_CompuMethods_ratio_0p001 -32.7 32.7 FORMAT "%10.5" /end CHARACTERISTIC
/begin CHARACTERISTIC DST_CALIB.DST_SSFAULTENABLE "" VALUE 0x80607065 DefaultValueRecordLayout_AUTOSAR_Platform_BaseTypes_uint8 255.0 DefaultIdenticalCompu 0.0 255. FORMAT "%10.5"
 /begin ANNOTATION ANNOTATION_LABEL "Description (coming from AUTOSAR DESC field)"
  /begin ANNOTATION_TEXT "If true, Long acc fault will set stop start disable.  If false, Long acc fault will set Engine must start to true\r\n" /end ANNOTATION_TEXT
 /end ANNOTATION
/end CHARACTERISTIC
/begin CHARACTERISTIC DST_CALIB.DST_SSFAULTSTART "" VALUE 0x80607066 DefaultValueRecordLayout_AUTOSAR_Platform_BaseTypes_uint8 255.0 DefaultIdenticalCompu 0.0 255. FORMAT "%10.5" /end CHARACTERISTIC
/begin CHARACTERISTIC DST_CALIB.DST_SSFILTERRAWGRAD "" VALUE 0x80607067 DefaultValueRecordLayout_AUTOSAR_Platform_BaseTypes_uint8 255.0 DefaultIdenticalCompu 0.0 255. FORMAT "%10.5"
 /begin ANNOTATION ANNOTATION_LABEL "Description (coming from AUTOSAR DESC field)"
  /begin ANNOTATION_TEXT "If true, the first order filter applies to the Raw gradient\r\n" /end ANNOTATION_TEXT
 /end ANNOTATION
/end CHARACTERISTIC
/begin CHARACTERISTIC DST_CALIB.DST_SSGRADFILTEN "" VALUE 0x80607068 DefaultValueRecordLayout_AUTOSAR_Platform_BaseTypes_uint8 255.0 DefaultIdenticalCompu 0.0 255. FORMAT "%10.5" /end CHARACTERISTIC
/begin CHARACTERISTIC DST_CALIB.DST_SSGRADGAIN "" VALUE 0x80607020 DefaultValueRecordLayout_AUTOSAR_Platform_BaseTypes_uint16 1.0 RB_PT_PCT_SWC_DST_CompuMethods_ratio_0p0001 0.0 1. FORMAT "%10.5"
 /begin ANNOTATION ANNOTATION_LABEL "Description (coming from AUTOSAR DESC field)" /begin ANNOTATION_TEXT "Filter gain for gradient\r\n" /end ANNOTATION_TEXT /end ANNOTATION
/end CHARACTERISTIC
/begin CHARACTERISTIC DST_CALIB.DST_STOPSTARTNPDISABLE "" VALUE 0x80607069 DefaultValueRecordLayout_AUTOSAR_Platform_BaseTypes_uint8 255.0 DefaultIdenticalCompu 0.0 255. FORMAT "%10.5" /end CHARACTERISTIC
/begin CHARACTERISTIC DST_CALIB.DST_STOPSTARTSTATUSMANDISABLE "" VALUE 0x8060706A DefaultValueRecordLayout_AUTOSAR_Platform_BaseTypes_uint8 5.0 RB_PT_PCT_SWC_DST_CompuMethods_ident 0.0 5. FORMAT "%10.5"
 /begin ANNOTATION ANNOTATION_LABEL "Description (coming from AUTOSAR DESC field)"
  /begin ANNOTATION_TEXT "Flag to prevent manaul mode if engine ran out of petrol\r\n" /end ANNOTATION_TEXT
 /end ANNOTATION
/end CHARACTERISTIC
/begin CHARACTERISTIC DST_CALIB.DST_SYNCBNEUTRALNEGLIMIT "" VALUE 0x80607022 DefaultValueRecordLayout_AUTOSAR_Platform_BaseTypes_sint16 40.0 RB_PT_PCT_SWC_DST_CompuMethods_ratio_0p001 -20. 20. FORMAT "%10.5"
 /begin ANNOTATION ANNOTATION_LABEL "Description (coming from AUTOSAR DESC field)" /begin ANNOTATION_TEXT "Negative limit of sync B to be considered in Neutral\r\n" /end ANNOTATION_TEXT /end ANNOTATION
/end CHARACTERISTIC
/begin CHARACTERISTIC DST_CALIB.DST_SYNCBNEUTRALPOSLIMIT "" VALUE 0x80607024 DefaultValueRecordLayout_AUTOSAR_Platform_BaseTypes_sint16 40.0 RB_PT_PCT_SWC_DST_CompuMethods_ratio_0p001 -20. 20. FORMAT "%10.5"
 /begin ANNOTATION ANNOTATION_LABEL "Description (coming from AUTOSAR DESC field)" /begin ANNOTATION_TEXT "Positive limit of sync B to be considered in Neutral\r\n" /end ANNOTATION_TEXT /end ANNOTATION
/end CHARACTERISTIC
/begin CHARACTERISTIC DST_CALIB.DST_TOOFASTFORPWARNCOUNT "" VALUE 0x8060706B DefaultValueRecordLayout_AUTOSAR_Platform_BaseTypes_uint8 255.0 RB_PT_PCT_SWC_DST_CompuMethods_ident 0.0 255. FORMAT "%10.5"
 /begin ANNOTATION ANNOTATION_LABEL "Description (coming from AUTOSAR DESC field)"
  /begin ANNOTATION_TEXT "Counter to control how ogn too fast for P is displayed\r\n" /end ANNOTATION_TEXT
 /end ANNOTATION
/end CHARACTERISTIC
/begin CHARACTERISTIC DST_CALIB.DST_WHEELTRACK "" VALUE 0x80607026 DefaultValueRecordLayout_AUTOSAR_Platform_BaseTypes_uint16 9.6 RB_PT_PCT_SWC_DST_CompuMethods_ratio_0p01 0.4 10. FORMAT "%10.5"
 /begin ANNOTATION ANNOTATION_LABEL "Description (coming from AUTOSAR DESC field)"
  /begin ANNOTATION_TEXT "Distance between the wheels for calculation of lateral acceleration\r\n" /end ANNOTATION_TEXT
 /end ANNOTATION
/end CHARACTERISTIC
/begin CHARACTERISTIC DST_CALIB.L2_PARKFROML2 "" VALUE 0x80607070 DefaultValueRecordLayout_AUTOSAR_Platform_BaseTypes_boolean 255.0 AUTOSAR_Platform_CompuMethods_boolean 0.0 255. FORMAT "%10.5" /end CHARACTERISTIC
/begin CHARACTERISTIC DST_EFLASHB.DST_ASGRequest.DST_ASGAUTODOWNRPMTHRESH "" VAL_BLK 0x80605F08 DefaultValueRecordLayout_AUTOSAR_Platform_BaseTypes_sint16 20000.0 RB_PT_PCT_SWC_DST_CompuMethods_DST_Ident 0.0 20000. FORMAT "%10.5"
 /begin ANNOTATION ANNOTATION_LABEL "Description (coming from AUTOSAR DESC field)"
  /begin ANNOTATION_TEXT "Gear dependant engine speed in target gear to ASG downshift to\r\n" /end ANNOTATION_TEXT
 /end ANNOTATION
 MATRIX_DIM 17 1 1 /end CHARACTERISTIC
/begin CHARACTERISTIC DST_EFLASHB.DST_ASGRequest.DST_ASGDECELDOWNTHROTTLE2CANCEL "" VALUE 0x80606032 DefaultValueRecordLayout_AUTOSAR_Platform_BaseTypes_uint8 102.0 RB_PT_PCT_SWC_DST_CompuMethods_ratio_0p4 0.0 102. FORMAT "%10.5"
 /begin ANNOTATION ANNOTATION_LABEL "Description (coming from AUTOSAR DESC field)" /begin ANNOTATION_TEXT "Throttle angle to set DST_ASGDecelLatch to false\r\n" /end ANNOTATION_TEXT /end ANNOTATION
/end CHARACTERISTIC
/begin CHARACTERISTIC DST_EFLASHB.DST_ASGRequest.DST_ASGDECELDOWNTIMEPOSTBRAKECANCEL "" VALUE 0x80606022 DefaultValueRecordLayout_AUTOSAR_Platform_BaseTypes_uint16 655.35 RB_PT_PCT_SWC_DST_CompuMethods_DST_Time 0.0 655.35 FORMAT "%10.5"
 /begin ANNOTATION ANNOTATION_LABEL "Description (coming from AUTOSAR DESC field)"
  /begin ANNOTATION_TEXT "TImer after the brake has been release to cancel ASGDecel downshift requests\r\n" /end ANNOTATION_TEXT
 /end ANNOTATION
/end CHARACTERISTIC
/begin CHARACTERISTIC DST_EFLASHB.DST_ASGRequest.DST_ASGDECELGTHRESH "" VAL_BLK 0x80605F2A DefaultValueRecordLayout_AUTOSAR_Platform_BaseTypes_sint16 10.0 RB_PT_PCT_SWC_DST_CompuMethods_ratio_0p01 -5. 5. FORMAT "%10.5"
 /begin ANNOTATION ANNOTATION_LABEL "Description (coming from AUTOSAR DESC field)"
  /begin ANNOTATION_TEXT "Depending on Decel mode aggression, acceleration to enter ASG mode\r\n" /end ANNOTATION_TEXT
 /end ANNOTATION
 MATRIX_DIM 17 1 1 /end CHARACTERISTIC
/begin CHARACTERISTIC DST_EFLASHB.DST_ASGRequest.DST_ASGDECELRPMINDEMANDTHRESH "" VAL_BLK 0x80605F4C DefaultValueRecordLayout_AUTOSAR_Platform_BaseTypes_sint16 20000.0 RB_PT_PCT_SWC_DST_CompuMethods_DST_Ident 0.0 20000. FORMAT "%10.5"
 /begin ANNOTATION ANNOTATION_LABEL "Description (coming from AUTOSAR DESC field)"
  /begin ANNOTATION_TEXT "Gear dependant engine speed in target gear to ASG downshift to\r\n" /end ANNOTATION_TEXT
 /end ANNOTATION
 MATRIX_DIM 17 1 1 /end CHARACTERISTIC
/begin CHARACTERISTIC DST_EFLASHB.DST_ASGRequest.DST_ASGDEMANDDELTAASGKICKDOWN "" VAL_BLK 0x80606018 DefaultValueRecordLayout_AUTOSAR_Platform_BaseTypes_boolean 255.0 AUTOSAR_Platform_CompuMethods_boolean 0.0 255. FORMAT "%10.5"
 /begin ANNOTATION ANNOTATION_LABEL "Description (coming from AUTOSAR DESC field)"
  /begin ANNOTATION_TEXT "Array of gear deltas (SEQ_CurrentTorqueGear -DST_DemandGear) for which to perform an ASG kickdown shift\r\n" /end ANNOTATION_TEXT
 /end ANNOTATION
 MATRIX_DIM 10 1 1 /end CHARACTERISTIC
/end MODULE
/end PROJECT
