ASAP2_VERSION 1 60
/begin PROJECT LB74x_TCU "5201C621"
/begin HEADER "" VERSION "5201C621" PROJECT_NO LB74x_TCU /end HEADER
/begin MODULE DIM ""
/begin MOD_COMMON "" BYTE_ORDER MSB_LAST ALIGNMENT_BYTE 1 ALIGNMENT_WORD 2 ALIGNMENT_LONG 4 ALIGNMENT_INT64 4 ALIGNMENT_FLOAT32_IEEE 4 ALIGNMENT_FLOAT64_IEEE 4 DATA_SIZE 32 /end MOD_COMMON
/begin CHARACTERISTIC Com_tiESP_03_RxRxTout_C "Calibration parameter to control Rx Ipdu Timeout for ESP_03_Rx (multiplied by 0.005s)" VALUE 0x8061CF12 DefaultValueRecordLayout_AUTOSAR_Platform_BaseTypes_uint16 65535.0 RB_RBA_Common_CentralElements_CompuMethods_Identical 0.0 65535. FORMAT "%5.0" /end CHARACTERISTIC
/begin CHARACTERISTIC Com_tiESP_05_RxRxTout_C "Calibration parameter to control Rx Ipdu Timeout for ESP_05_Rx (multiplied by 0.005s)" VALUE 0x8061CF10 DefaultValueRecordLayout_AUTOSAR_Platform_BaseTypes_uint16 65535.0 RB_RBA_Common_CentralElements_CompuMethods_Identical 0.0 65535. FORMAT "%5.0" /end CHARACTERISTIC
/begin CHARACTERISTIC Com_tiESP_07_RxRxTout_C "Calibration parameter to control Rx Ipdu Timeout for ESP_07_Rx (multiplied by 0.005s)" VALUE 0x8061CF0E DefaultValueRecordLayout_AUTOSAR_Platform_BaseTypes_uint16 65535.0 RB_RBA_Common_CentralElements_CompuMethods_Identical 0.0 65535. FORMAT "%5.0" /end CHARACTERISTIC
/begin CHARACTERISTIC Com_tiESP_08_RxRxTout_C "Calibration parameter to control Rx Ipdu Timeout for ESP_08_Rx (multiplied by 0.005s)" VALUE 0x8061CF0C DefaultValueRecordLayout_AUTOSAR_Platform_BaseTypes_uint16 65535.0 RB_RBA_Common_CentralElements_CompuMethods_Identical 0.0 65535. FORMAT "%5.0" /end CHARACTERISTIC
/begin CHARACTERISTIC Com_tiESP_15_RxRxTout_C "Calibration parameter to control Rx Ipdu Timeout for ESP_15_Rx (multiplied by 0.005s)" VALUE 0x8061CF0A DefaultValueRecordLayout_AUTOSAR_Platform_BaseTypes_uint16 65535.0 RB_RBA_Common_CentralElements_CompuMethods_Identical 0.0 65535. FORMAT "%5.0" /end CHARACTERISTIC
/begin CHARACTERISTIC Com_tiESP_20_RxRxTout_C "Calibration parameter to control Rx Ipdu Timeout for ESP_20_Rx (multiplied by 0.005s)" VALUE 0x8061CF08 DefaultValueRecordLayout_AUTOSAR_Platform_BaseTypes_uint16 65535.0 RB_RBA_Common_CentralElements_CompuMethods_Identical 0.0 65535. FORMAT "%5.0" /end CHARACTERISTIC
/begin CHARACTERISTIC Com_tiESP_21_RxRxTout_C "Calibration parameter to control Rx Ipdu Timeout for ESP_21_Rx (multiplied by 0.005s)" VALUE 0x8061CF06 DefaultValueRecordLayout_AUTOSAR_Platform_BaseTypes_uint16 65535.0 RB_RBA_Common_CentralElements_CompuMethods_Identical 0.0 65535. FORMAT "%5.0" /end CHARACTERISTIC
/begin CHARACTERISTIC Com_tiESP_22_RxRxTout_C "Calibration parameter to control Rx Ipdu Timeout for ESP_22_Rx (multiplied by 0.005s)" VALUE 0x8061CF04 DefaultValueRecordLayout_AUTOSAR_Platform_BaseTypes_uint16 65535.0 RB_RBA_Common_CentralElements_CompuMethods_Identical 0.0 65535. FORMAT "%5.0" /end CHARACTERISTIC
/begin CHARACTERISTIC Com_tiESP_23_RxRxTout_C "Calibration parameter to control Rx Ipdu Timeout for ESP_23_Rx (multiplied by 0.005s)" VALUE 0x8061CF02 DefaultValueRecordLayout_AUTOSAR_Platform_BaseTypes_uint16 65535.0 RB_RBA_Common_CentralElements_CompuMethods_Identical 0.0 65535. FORMAT "%5.0" /end CHARACTERISTIC
/begin CHARACTERISTIC Com_tiESP_24_RxRxTout_C "Calibration parameter to control Rx Ipdu Timeout for ESP_24_Rx (multiplied by 0.005s)" VALUE 0x8061CF00 DefaultValueRecordLayout_AUTOSAR_Platform_BaseTypes_uint16 65535.0 RB_RBA_Common_CentralElements_CompuMethods_Identical 0.0 65535. FORMAT "%5.0" /end CHARACTERISTIC
/begin CHARACTERISTIC Com_tiESP_26_RxRxTout_C "Calibration parameter to control Rx Ipdu Timeout for ESP_26_Rx (multiplied by 0.005s)" VALUE 0x8061CEFE DefaultValueRecordLayout_AUTOSAR_Platform_BaseTypes_uint16 65535.0 RB_RBA_Common_CentralElements_CompuMethods_Identical 0.0 65535. FORMAT "%5.0" /end CHARACTERISTIC
/begin CHARACTERISTIC Com_tiESP_28_RxRxTout_C "Calibration parameter to control Rx Ipdu Timeout for ESP_28_Rx (multiplied by 0.005s)" VALUE 0x8061CEFC DefaultValueRecordLayout_AUTOSAR_Platform_BaseTypes_uint16 65535.0 RB_RBA_Common_CentralElements_CompuMethods_Identical 0.0 65535. FORMAT "%5.0" /end CHARACTERISTIC
/begin CHARACTERISTIC Com_tiESP_31_RxRxTout_C "Calibration parameter to control Rx Ipdu Timeout for ESP_31_Rx (multiplied by 0.005s)" VALUE 0x8061CEFA DefaultValueRecordLayout_AUTOSAR_Platform_BaseTypes_uint16 65535.0 RB_RBA_Common_CentralElements_CompuMethods_Identical 0.0 65535. FORMAT "%5.0" /end CHARACTERISTIC
/begin CHARACTERISTIC Com_tiESP_32_RxRxTout_C "Calibration parameter to control Rx Ipdu Timeout for ESP_32_Rx (multiplied by 0.005s)" VALUE 0x8061CEF8 DefaultValueRecordLayout_AUTOSAR_Platform_BaseTypes_uint16 65535.0 RB_RBA_Common_CentralElements_CompuMethods_Identical 0.0 65535. FORMAT "%5.0" /end CHARACTERISTIC
/begin CHARACTERISTIC Com_tiESP_33_RxRxTout_C "Calibration parameter to control Rx Ipdu Timeout for ESP_33_Rx (multiplied by 0.005s)" VALUE 0x8061CEF6 DefaultValueRecordLayout_AUTOSAR_Platform_BaseTypes_uint16 65535.0 RB_RBA_Common_CentralElements_CompuMethods_Identical 0.0 65535. FORMAT "%5.0" /end CHARACTERISTIC
/begin CHARACTERISTIC Com_tiESP_41_RxRxTout_C "Calibration parameter to control Rx Ipdu Timeout for ESP_41_Rx (multiplied by 0.005s)" VALUE 0x8061CEF4 DefaultValueRecordLayout_AUTOSAR_Platform_BaseTypes_uint16 65535.0 RB_RBA_Common_CentralElements_CompuMethods_Identical 0.0 65535. FORMAT "%5.0" /end CHARACTERISTIC
/begin CHARACTERISTIC Com_tiESP_44_RxRxTout_C "Calibration parameter to control Rx Ipdu Timeout for ESP_44_Rx (multiplied by 0.005s)" VALUE 0x8061CEF2 DefaultValueRecordLayout_AUTOSAR_Platform_BaseTypes_uint16 65535.0 RB_RBA_Common_CentralElements_CompuMethods_Identical 0.0 65535. FORMAT "%5.0" /end CHARACTERISTIC
/begin CHARACTERISTIC Com_tiKlemmen_Status_01_RxRxTout_C "Calibration parameter to control Rx Ipdu Timeout for Klemmen_Status_01_Rx (multiplied by 0.005s)" VALUE 0x8061CEF0 DefaultValueRecordLayout_AUTOSAR_Platform_BaseTypes_uint16 65535.0 RB_RBA_Common_CentralElements_CompuMethods_Identical 0.0 65535. FORMAT "%5.0" /end CHARACTERISTIC
/begin CHARACTERISTIC Com_tiKlima_11_RxRxTout_C "Calibration parameter to control Rx Ipdu Timeout for Klima_11_Rx (multiplied by 0.005s)" VALUE 0x8061CEEE DefaultValueRecordLayout_AUTOSAR_Platform_BaseTypes_uint16 65535.0 RB_RBA_Common_CentralElements_CompuMethods_Identical 0.0 65535. FORMAT "%5.0" /end CHARACTERISTIC
/begin CHARACTERISTIC Com_tiKombi_02_RxRxTout_C "Calibration parameter to control Rx Ipdu Timeout for Kombi_02_Rx (multiplied by 0.005s)" VALUE 0x8061CEEC DefaultValueRecordLayout_AUTOSAR_Platform_BaseTypes_uint16 65535.0 RB_RBA_Common_CentralElements_CompuMethods_Identical 0.0 65535. FORMAT "%5.0" /end CHARACTERISTIC
/begin CHARACTERISTIC Com_tiLCV_01_RxRxTout_C "Calibration parameter to control Rx Ipdu Timeout for LCV_01_Rx (multiplied by 0.005s)" VALUE 0x8061CEEA DefaultValueRecordLayout_AUTOSAR_Platform_BaseTypes_uint16 65535.0 RB_RBA_Common_CentralElements_CompuMethods_Identical 0.0 65535. FORMAT "%5.0" /end CHARACTERISTIC
/begin CHARACTERISTIC Com_tiLWI_01_RxRxTout_C "Calibration parameter to control Rx Ipdu Timeout for LWI_01_Rx (multiplied by 0.005s)" VALUE 0x8061CEE8 DefaultValueRecordLayout_AUTOSAR_Platform_BaseTypes_uint16 65535.0 RB_RBA_Common_CentralElements_CompuMethods_Identical 0.0 65535. FORMAT "%5.0" /end CHARACTERISTIC
/begin CHARACTERISTIC Com_tiMFL_Tasten_01_RxRxTout_C "Calibration parameter to control Rx Ipdu Timeout for MFL_Tasten_01_Rx (multiplied by 0.005s)" VALUE 0x8061CEE6 DefaultValueRecordLayout_AUTOSAR_Platform_BaseTypes_uint16 65535.0 RB_RBA_Common_CentralElements_CompuMethods_Identical 0.0 65535. FORMAT "%5.0" /end CHARACTERISTIC
/begin CHARACTERISTIC Com_tiMSG_EM1_18_RxRxTout_C "Calibration parameter to control Rx Ipdu Timeout for MSG_EM1_18_Rx (multiplied by 0.005s)" VALUE 0x8061CEE4 DefaultValueRecordLayout_AUTOSAR_Platform_BaseTypes_uint16 65535.0 RB_RBA_Common_CentralElements_CompuMethods_Identical 0.0 65535. FORMAT "%5.0" /end CHARACTERISTIC
/begin CHARACTERISTIC Com_tiMSG_EM1_29_RxRxTout_C "Calibration parameter to control Rx Ipdu Timeout for MSG_EM1_29_Rx (multiplied by 0.005s)" VALUE 0x8061CEE2 DefaultValueRecordLayout_AUTOSAR_Platform_BaseTypes_uint16 65535.0 RB_RBA_Common_CentralElements_CompuMethods_Identical 0.0 65535. FORMAT "%5.0" /end CHARACTERISTIC
/begin CHARACTERISTIC Com_tiMotor_01_RxRxTout_C "Calibration parameter to control Rx Ipdu Timeout for Motor_01_Rx (multiplied by 0.005s)" VALUE 0x8061CEE0 DefaultValueRecordLayout_AUTOSAR_Platform_BaseTypes_uint16 65535.0 RB_RBA_Common_CentralElements_CompuMethods_Identical 0.0 65535. FORMAT "%5.0" /end CHARACTERISTIC
/begin CHARACTERISTIC Com_tiMotor_02_RxRxTout_C "Calibration parameter to control Rx Ipdu Timeout for Motor_02_Rx (multiplied by 0.005s)" VALUE 0x8061CEDE DefaultValueRecordLayout_AUTOSAR_Platform_BaseTypes_uint16 65535.0 RB_RBA_Common_CentralElements_CompuMethods_Identical 0.0 65535. FORMAT "%5.0" /end CHARACTERISTIC
/begin CHARACTERISTIC Com_tiMotor_03_RxRxTout_C "Calibration parameter to control Rx Ipdu Timeout for Motor_03_Rx (multiplied by 0.005s)" VALUE 0x8061CEDC DefaultValueRecordLayout_AUTOSAR_Platform_BaseTypes_uint16 65535.0 RB_RBA_Common_CentralElements_CompuMethods_Identical 0.0 65535. FORMAT "%5.0" /end CHARACTERISTIC
/begin CHARACTERISTIC Com_tiMotor_07_RxRxTout_C "Calibration parameter to control Rx Ipdu Timeout for Motor_07_Rx (multiplied by 0.005s)" VALUE 0x8061CEDA DefaultValueRecordLayout_AUTOSAR_Platform_BaseTypes_uint16 65535.0 RB_RBA_Common_CentralElements_CompuMethods_Identical 0.0 65535. FORMAT "%5.0" /end CHARACTERISTIC
/begin CHARACTERISTIC Com_tiMotor_11_RxRxTout_C "Calibration parameter to control Rx Ipdu Timeout for Motor_11_Rx (multiplied by 0.005s)" VALUE 0x8061CED8 DefaultValueRecordLayout_AUTOSAR_Platform_BaseTypes_uint16 65535.0 RB_RBA_Common_CentralElements_CompuMethods_Identical 0.0 65535. FORMAT "%5.0" /end CHARACTERISTIC
/begin CHARACTERISTIC Com_tiMotor_12_RxRxTout_C "Calibration parameter to control Rx Ipdu Timeout for Motor_12_Rx (multiplied by 0.005s)" VALUE 0x8061CED6 DefaultValueRecordLayout_AUTOSAR_Platform_BaseTypes_uint16 65535.0 RB_RBA_Common_CentralElements_CompuMethods_Identical 0.0 65535. FORMAT "%5.0" /end CHARACTERISTIC
/begin CHARACTERISTIC Com_tiMotor_14_RxRxTout_C "Calibration parameter to control Rx Ipdu Timeout for Motor_14_Rx (multiplied by 0.005s)" VALUE 0x8061CED4 DefaultValueRecordLayout_AUTOSAR_Platform_BaseTypes_uint16 65535.0 RB_RBA_Common_CentralElements_CompuMethods_Identical 0.0 65535. FORMAT "%5.0" /end CHARACTERISTIC
/begin CHARACTERISTIC Com_tiMotor_16_RxRxTout_C "Calibration parameter to control Rx Ipdu Timeout for Motor_16_Rx (multiplied by 0.005s)" VALUE 0x8061CED2 DefaultValueRecordLayout_AUTOSAR_Platform_BaseTypes_uint16 65535.0 RB_RBA_Common_CentralElements_CompuMethods_Identical 0.0 65535. FORMAT "%5.0" /end CHARACTERISTIC
/begin CHARACTERISTIC Com_tiMotor_17_RxRxTout_C "Calibration parameter to control Rx Ipdu Timeout for Motor_17_Rx (multiplied by 0.005s)" VALUE 0x8061CED0 DefaultValueRecordLayout_AUTOSAR_Platform_BaseTypes_uint16 65535.0 RB_RBA_Common_CentralElements_CompuMethods_Identical 0.0 65535. FORMAT "%5.0" /end CHARACTERISTIC
/begin CHARACTERISTIC Com_tiMotor_18_RxRxTout_C "Calibration parameter to control Rx Ipdu Timeout for Motor_18_Rx (multiplied by 0.005s)" VALUE 0x8061CECE DefaultValueRecordLayout_AUTOSAR_Platform_BaseTypes_uint16 65535.0 RB_RBA_Common_CentralElements_CompuMethods_Identical 0.0 65535. FORMAT "%5.0" /end CHARACTERISTIC
/begin CHARACTERISTIC Com_tiMotor_20_RxRxTout_C "Calibration parameter to control Rx Ipdu Timeout for Motor_20_Rx (multiplied by 0.005s)" VALUE 0x8061CECC DefaultValueRecordLayout_AUTOSAR_Platform_BaseTypes_uint16 65535.0 RB_RBA_Common_CentralElements_CompuMethods_Identical 0.0 65535. FORMAT "%5.0" /end CHARACTERISTIC
/begin CHARACTERISTIC Com_tiMotor_27_RxRxTout_C "Calibration parameter to control Rx Ipdu Timeout for Motor_27_Rx (multiplied by 0.005s)" VALUE 0x8061CECA DefaultValueRecordLayout_AUTOSAR_Platform_BaseTypes_uint16 65535.0 RB_RBA_Common_CentralElements_CompuMethods_Identical 0.0 65535. FORMAT "%5.0" /end CHARACTERISTIC
/begin CHARACTERISTIC Com_tiMotor_28_RxRxTout_C "Calibration parameter to control Rx Ipdu Timeout for Motor_28_Rx (multiplied by 0.005s)" VALUE 0x8061CEC8 DefaultValueRecordLayout_AUTOSAR_Platform_BaseTypes_uint16 65535.0 RB_RBA_Common_CentralElements_CompuMethods_Identical 0.0 65535. FORMAT "%5.0" /end CHARACTERISTIC
/begin CHARACTERISTIC Com_tiMotor_35_RxRxTout_C "Calibration parameter to control Rx Ipdu Timeout for Motor_35_Rx (multiplied by 0.005s)" VALUE 0x8061CEC6 DefaultValueRecordLayout_AUTOSAR_Platform_BaseTypes_uint16 65535.0 RB_RBA_Common_CentralElements_CompuMethods_Identical 0.0 65535. FORMAT "%5.0" /end CHARACTERISTIC
/begin CHARACTERISTIC Com_tiMotor_38_LB_RxRxTout_C "Calibration parameter to control Rx Ipdu Timeout for Motor_38_LB_Rx (multiplied by 0.005s)" VALUE 0x8061CEC4 DefaultValueRecordLayout_AUTOSAR_Platform_BaseTypes_uint16 65535.0 RB_RBA_Common_CentralElements_CompuMethods_Identical 0.0 65535. FORMAT "%5.0" /end CHARACTERISTIC
/begin CHARACTERISTIC Com_tiMotor_47_RxRxTout_C "Calibration parameter to control Rx Ipdu Timeout for Motor_47_Rx (multiplied by 0.005s)" VALUE 0x8061CEC2 DefaultValueRecordLayout_AUTOSAR_Platform_BaseTypes_uint16 65535.0 RB_RBA_Common_CentralElements_CompuMethods_Identical 0.0 65535. FORMAT "%5.0" /end CHARACTERISTIC
/begin CHARACTERISTIC Com_tiMotor_67_OBD_RxRxTout_C "Calibration parameter to control Rx Ipdu Timeout for Motor_67_OBD_Rx (multiplied by 0.005s)" VALUE 0x8061CEC0 DefaultValueRecordLayout_AUTOSAR_Platform_BaseTypes_uint16 65535.0 RB_RBA_Common_CentralElements_CompuMethods_Identical 0.0 65535. FORMAT "%5.0" /end CHARACTERISTIC
/begin CHARACTERISTIC Com_tiMotor_82_RxRxTout_C "Calibration parameter to control Rx Ipdu Timeout for Motor_82_Rx (multiplied by 0.005s)" VALUE 0x8061CEBE DefaultValueRecordLayout_AUTOSAR_Platform_BaseTypes_uint16 65535.0 RB_RBA_Common_CentralElements_CompuMethods_Identical 0.0 65535. FORMAT "%5.0" /end CHARACTERISTIC
/begin CHARACTERISTIC Com_tiMotor_Code_01_RxRxTout_C "Calibration parameter to control Rx Ipdu Timeout for Motor_Code_01_Rx (multiplied by 0.005s)" VALUE 0x8061CEBC DefaultValueRecordLayout_AUTOSAR_Platform_BaseTypes_uint16 65535.0 RB_RBA_Common_CentralElements_CompuMethods_Identical 0.0 65535. FORMAT "%5.0" /end CHARACTERISTIC
/begin CHARACTERISTIC Com_tiMotor_Hybrid_11_RxRxTout_C "Calibration parameter to control Rx Ipdu Timeout for Motor_Hybrid_11_Rx (multiplied by 0.005s)" VALUE 0x8061CEBA DefaultValueRecordLayout_AUTOSAR_Platform_BaseTypes_uint16 65535.0 RB_RBA_Common_CentralElements_CompuMethods_Identical 0.0 65535. FORMAT "%5.0" /end CHARACTERISTIC
/begin CHARACTERISTIC Com_tiMotor_TS_01_RxRxTout_C "Calibration parameter to control Rx Ipdu Timeout for Motor_TS_01_Rx (multiplied by 0.005s)" VALUE 0x8061CEB8 DefaultValueRecordLayout_AUTOSAR_Platform_BaseTypes_uint16 65535.0 RB_RBA_Common_CentralElements_CompuMethods_Identical 0.0 65535. FORMAT "%5.0" /end CHARACTERISTIC
/begin CHARACTERISTIC Com_tiMotor_TS_02_RxRxTout_C "Calibration parameter to control Rx Ipdu Timeout for Motor_TS_02_Rx (multiplied by 0.005s)" VALUE 0x8061CEB6 DefaultValueRecordLayout_AUTOSAR_Platform_BaseTypes_uint16 65535.0 RB_RBA_Common_CentralElements_CompuMethods_Identical 0.0 65535. FORMAT "%5.0" /end CHARACTERISTIC
/begin CHARACTERISTIC Com_tiMotor_TS_03_RxRxTout_C "Calibration parameter to control Rx Ipdu Timeout for Motor_TS_03_Rx (multiplied by 0.005s)" VALUE 0x8061CEB4 DefaultValueRecordLayout_AUTOSAR_Platform_BaseTypes_uint16 65535.0 RB_RBA_Common_CentralElements_CompuMethods_Identical 0.0 65535. FORMAT "%5.0" /end CHARACTERISTIC
/begin CHARACTERISTIC Com_tiNVEM_02_RxRxTout_C "Calibration parameter to control Rx Ipdu Timeout for NVEM_02_Rx (multiplied by 0.005s)" VALUE 0x8061CEB2 DefaultValueRecordLayout_AUTOSAR_Platform_BaseTypes_uint16 65535.0 RB_RBA_Common_CentralElements_CompuMethods_Identical 0.0 65535. FORMAT "%5.0" /end CHARACTERISTIC
/begin CHARACTERISTIC Com_tiNVEM_05_RxRxTout_C "Calibration parameter to control Rx Ipdu Timeout for NVEM_05_Rx (multiplied by 0.005s)" VALUE 0x8061CEB0 DefaultValueRecordLayout_AUTOSAR_Platform_BaseTypes_uint16 65535.0 RB_RBA_Common_CentralElements_CompuMethods_Identical 0.0 65535. FORMAT "%5.0" /end CHARACTERISTIC
/begin CHARACTERISTIC Com_tiOBD_01_RxRxTout_C "Calibration parameter to control Rx Ipdu Timeout for OBD_01_Rx (multiplied by 0.005s)" VALUE 0x8061CEAE DefaultValueRecordLayout_AUTOSAR_Platform_BaseTypes_uint16 65535.0 RB_RBA_Common_CentralElements_CompuMethods_Identical 0.0 65535. FORMAT "%5.0" /end CHARACTERISTIC
/begin CHARACTERISTIC Com_tiOBD_02_RxRxTout_C "Calibration parameter to control Rx Ipdu Timeout for OBD_02_Rx (multiplied by 0.005s)" VALUE 0x8061CEAC DefaultValueRecordLayout_AUTOSAR_Platform_BaseTypes_uint16 65535.0 RB_RBA_Common_CentralElements_CompuMethods_Identical 0.0 65535. FORMAT "%5.0" /end CHARACTERISTIC
/begin CHARACTERISTIC Com_tiSARA_06_RxRxTout_C "Calibration parameter to control Rx Ipdu Timeout for SARA_06_Rx (multiplied by 0.005s)" VALUE 0x8061CEAA DefaultValueRecordLayout_AUTOSAR_Platform_BaseTypes_uint16 65535.0 RB_RBA_Common_CentralElements_CompuMethods_Identical 0.0 65535. FORMAT "%5.0" /end CHARACTERISTIC
/begin CHARACTERISTIC Com_tiSysteminfo_01_RxRxTout_C "Calibration parameter to control Rx Ipdu Timeout for Systeminfo_01_Rx (multiplied by 0.005s)" VALUE 0x8061CEA8 DefaultValueRecordLayout_AUTOSAR_Platform_BaseTypes_uint16 65535.0 RB_RBA_Common_CentralElements_CompuMethods_Identical 0.0 65535. FORMAT "%5.0" /end CHARACTERISTIC
/begin CHARACTERISTIC Com_tiTSG_FT_02_RxRxTout_C "Calibration parameter to control Rx Ipdu Timeout for TSG_FT_02_Rx (multiplied by 0.005s)" VALUE 0x8061CEA6 DefaultValueRecordLayout_AUTOSAR_Platform_BaseTypes_uint16 65535.0 RB_RBA_Common_CentralElements_CompuMethods_Identical 0.0 65535. FORMAT "%5.0" /end CHARACTERISTIC
/begin CHARACTERISTIC Com_tiTSK_06_RxRxTout_C "Calibration parameter to control Rx Ipdu Timeout for TSK_06_Rx (multiplied by 0.005s)" VALUE 0x8061CEA4 DefaultValueRecordLayout_AUTOSAR_Platform_BaseTypes_uint16 65535.0 RB_RBA_Common_CentralElements_CompuMethods_Identical 0.0 65535. FORMAT "%5.0" /end CHARACTERISTIC
/begin CHARACTERISTIC Com_tiTSK_08_RxRxTout_C "Calibration parameter to control Rx Ipdu Timeout for TSK_08_Rx (multiplied by 0.005s)" VALUE 0x8061CEA2 DefaultValueRecordLayout_AUTOSAR_Platform_BaseTypes_uint16 65535.0 RB_RBA_Common_CentralElements_CompuMethods_Identical 0.0 65535. FORMAT "%5.0" /end CHARACTERISTIC
/begin CHARACTERISTIC Com_tiVIN_01_0_RxRxTout_C "Calibration parameter to control Rx Ipdu Timeout for VIN_01_0_Rx (multiplied by 0.005s)" VALUE 0x8061CEA0 DefaultValueRecordLayout_AUTOSAR_Platform_BaseTypes_uint16 65535.0 RB_RBA_Common_CentralElements_CompuMethods_Identical 0.0 65535. FORMAT "%5.0" /end CHARACTERISTIC
/begin CHARACTERISTIC Com_tiVIN_01_1_RxRxTout_C "Calibration parameter to control Rx Ipdu Timeout for VIN_01_1_Rx (multiplied by 0.005s)" VALUE 0x8061CE9E DefaultValueRecordLayout_AUTOSAR_Platform_BaseTypes_uint16 65535.0 RB_RBA_Common_CentralElements_CompuMethods_Identical 0.0 65535. FORMAT "%5.0" /end CHARACTERISTIC
/begin CHARACTERISTIC Com_tiVIN_01_2_RxRxTout_C "Calibration parameter to control Rx Ipdu Timeout for VIN_01_2_Rx (multiplied by 0.005s)" VALUE 0x8061CE9C DefaultValueRecordLayout_AUTOSAR_Platform_BaseTypes_uint16 65535.0 RB_RBA_Common_CentralElements_CompuMethods_Identical 0.0 65535. FORMAT "%5.0" /end CHARACTERISTIC
/begin CHARACTERISTIC Com_swtMsgMon_ACC_06_C "Activation monitoring for message ACC_06 and for signal groups (if contained in message) (value != 0 to activate protection)" VALUE 0x8061CCB9 DefaultValueRecordLayout_AUTOSAR_Platform_BaseTypes_uint8 255.0 DefaultIdenticalCompu 0.0 255. FORMAT "%5.0" /end CHARACTERISTIC
/begin CHARACTERISTIC Com_swtMsgMon_ACC_07_C "Activation monitoring for message ACC_07 and for signal groups (if contained in message) (value != 0 to activate protection)" VALUE 0x8061CCB8 DefaultValueRecordLayout_AUTOSAR_Platform_BaseTypes_uint8 255.0 DefaultIdenticalCompu 0.0 255. FORMAT "%5.0" /end CHARACTERISTIC
/begin CHARACTERISTIC Com_swtMsgMon_Airbag_01_C "Activation monitoring for message Airbag_01 and for signal groups (if contained in message) (value != 0 to activate protection)" VALUE 0x8061CCB7 DefaultValueRecordLayout_AUTOSAR_Platform_BaseTypes_uint8 255.0 DefaultIdenticalCompu 0.0 255. FORMAT "%5.0" /end CHARACTERISTIC
/begin CHARACTERISTIC Com_swtMsgMon_Airbag_02_C "Activation monitoring for message Airbag_02 and for signal groups (if contained in message) (value != 0 to activate protection)" VALUE 0x8061CCB6 DefaultValueRecordLayout_AUTOSAR_Platform_BaseTypes_uint8 255.0 DefaultIdenticalCompu 0.0 255. FORMAT "%5.0" /end CHARACTERISTIC
/begin CHARACTERISTIC Com_swtMsgMon_Bremse_EV_01_C "Activation monitoring for message Bremse_EV_01 and for signal groups (if contained in message) (value != 0 to activate protection)" VALUE 0x8061CCB5 DefaultValueRecordLayout_AUTOSAR_Platform_BaseTypes_uint8 255.0 DefaultIdenticalCompu 0.0 255. FORMAT "%5.0" /end CHARACTERISTIC
/begin CHARACTERISTIC Com_swtMsgMon_Bremse_EV_02_C "Activation monitoring for message Bremse_EV_02 and for signal groups (if contained in message) (value != 0 to activate protection)" VALUE 0x8061CCB4 DefaultValueRecordLayout_AUTOSAR_Platform_BaseTypes_uint8 255.0 DefaultIdenticalCompu 0.0 255. FORMAT "%5.0" /end CHARACTERISTIC
/begin CHARACTERISTIC Com_swtMsgMon_EBKV_01_C "Activation monitoring for message EBKV_01 and for signal groups (if contained in message) (value != 0 to activate protection)" VALUE 0x8061CCB3 DefaultValueRecordLayout_AUTOSAR_Platform_BaseTypes_uint8 255.0 DefaultIdenticalCompu 0.0 255. FORMAT "%5.0" /end CHARACTERISTIC
/begin CHARACTERISTIC Com_swtMsgMon_EM1_HYB_12_C "Activation monitoring for message EM1_HYB_12 and for signal groups (if contained in message) (value != 0 to activate protection)" VALUE 0x8061CCB2 DefaultValueRecordLayout_AUTOSAR_Platform_BaseTypes_uint8 255.0 DefaultIdenticalCompu 0.0 255. FORMAT "%5.0" /end CHARACTERISTIC
/begin CHARACTERISTIC Com_swtMsgMon_EPB_01_C "Activation monitoring for message EPB_01 and for signal groups (if contained in message) (value != 0 to activate protection)" VALUE 0x8061CCB1 DefaultValueRecordLayout_AUTOSAR_Platform_BaseTypes_uint8 255.0 DefaultIdenticalCompu 0.0 255. FORMAT "%5.0" /end CHARACTERISTIC
/begin CHARACTERISTIC Com_swtMsgMon_ESP_03_C "Activation monitoring for message ESP_03 and for signal groups (if contained in message) (value != 0 to activate protection)" VALUE 0x8061CCB0 DefaultValueRecordLayout_AUTOSAR_Platform_BaseTypes_uint8 255.0 DefaultIdenticalCompu 0.0 255. FORMAT "%5.0" /end CHARACTERISTIC
/begin CHARACTERISTIC Com_swtMsgMon_ESP_05_C "Activation monitoring for message ESP_05 and for signal groups (if contained in message) (value != 0 to activate protection)" VALUE 0x8061CCAF DefaultValueRecordLayout_AUTOSAR_Platform_BaseTypes_uint8 255.0 DefaultIdenticalCompu 0.0 255. FORMAT "%5.0" /end CHARACTERISTIC
/begin CHARACTERISTIC Com_swtMsgMon_ESP_07_C "Activation monitoring for message ESP_07 and for signal groups (if contained in message) (value != 0 to activate protection)" VALUE 0x8061CCAE DefaultValueRecordLayout_AUTOSAR_Platform_BaseTypes_uint8 255.0 DefaultIdenticalCompu 0.0 255. FORMAT "%5.0" /end CHARACTERISTIC
/begin CHARACTERISTIC Com_swtMsgMon_ESP_08_C "Activation monitoring for message ESP_08 and for signal groups (if contained in message) (value != 0 to activate protection)" VALUE 0x8061CCAD DefaultValueRecordLayout_AUTOSAR_Platform_BaseTypes_uint8 255.0 DefaultIdenticalCompu 0.0 255. FORMAT "%5.0" /end CHARACTERISTIC
/begin CHARACTERISTIC Com_swtMsgMon_ESP_15_C "Activation monitoring for message ESP_15 and for signal groups (if contained in message) (value != 0 to activate protection)" VALUE 0x8061CCAC DefaultValueRecordLayout_AUTOSAR_Platform_BaseTypes_uint8 255.0 DefaultIdenticalCompu 0.0 255. FORMAT "%5.0" /end CHARACTERISTIC
/begin CHARACTERISTIC Com_swtMsgMon_ESP_20_C "Activation monitoring for message ESP_20 and for signal groups (if contained in message) (value != 0 to activate protection)" VALUE 0x8061CCAB DefaultValueRecordLayout_AUTOSAR_Platform_BaseTypes_uint8 255.0 DefaultIdenticalCompu 0.0 255. FORMAT "%5.0" /end CHARACTERISTIC
/begin CHARACTERISTIC Com_swtMsgMon_ESP_21_C "Activation monitoring for message ESP_21 and for signal groups (if contained in message) (value != 0 to activate protection)" VALUE 0x8061CCAA DefaultValueRecordLayout_AUTOSAR_Platform_BaseTypes_uint8 255.0 DefaultIdenticalCompu 0.0 255. FORMAT "%5.0" /end CHARACTERISTIC
/begin CHARACTERISTIC Com_swtMsgMon_ESP_22_C "Activation monitoring for message ESP_22 and for signal groups (if contained in message) (value != 0 to activate protection)" VALUE 0x8061CCA9 DefaultValueRecordLayout_AUTOSAR_Platform_BaseTypes_uint8 255.0 DefaultIdenticalCompu 0.0 255. FORMAT "%5.0" /end CHARACTERISTIC
/begin CHARACTERISTIC Com_swtMsgMon_ESP_23_C "Activation monitoring for message ESP_23 and for signal groups (if contained in message) (value != 0 to activate protection)" VALUE 0x8061CCA8 DefaultValueRecordLayout_AUTOSAR_Platform_BaseTypes_uint8 255.0 DefaultIdenticalCompu 0.0 255. FORMAT "%5.0" /end CHARACTERISTIC
/begin CHARACTERISTIC Com_swtMsgMon_ESP_24_C "Activation monitoring for message ESP_24 and for signal groups (if contained in message) (value != 0 to activate protection)" VALUE 0x8061CCA7 DefaultValueRecordLayout_AUTOSAR_Platform_BaseTypes_uint8 255.0 DefaultIdenticalCompu 0.0 255. FORMAT "%5.0" /end CHARACTERISTIC
/begin CHARACTERISTIC Com_swtMsgMon_ESP_28_C "Activation monitoring for message ESP_28 and for signal groups (if contained in message) (value != 0 to activate protection)" VALUE 0x8061CCA6 DefaultValueRecordLayout_AUTOSAR_Platform_BaseTypes_uint8 255.0 DefaultIdenticalCompu 0.0 255. FORMAT "%5.0" /end CHARACTERISTIC
/begin CHARACTERISTIC Com_swtMsgMon_ESP_31_C "Activation monitoring for message ESP_31 and for signal groups (if contained in message) (value != 0 to activate protection)" VALUE 0x8061CCA5 DefaultValueRecordLayout_AUTOSAR_Platform_BaseTypes_uint8 255.0 DefaultIdenticalCompu 0.0 255. FORMAT "%5.0" /end CHARACTERISTIC
/begin CHARACTERISTIC Com_swtMsgMon_ESP_32_C "Activation monitoring for message ESP_32 and for signal groups (if contained in message) (value != 0 to activate protection)" VALUE 0x8061CCA4 DefaultValueRecordLayout_AUTOSAR_Platform_BaseTypes_uint8 255.0 DefaultIdenticalCompu 0.0 255. FORMAT "%5.0" /end CHARACTERISTIC
/begin CHARACTERISTIC Com_swtMsgMon_ESP_33_C "Activation monitoring for message ESP_33 and for signal groups (if contained in message) (value != 0 to activate protection)" VALUE 0x8061CCA3 DefaultValueRecordLayout_AUTOSAR_Platform_BaseTypes_uint8 255.0 DefaultIdenticalCompu 0.0 255. FORMAT "%5.0" /end CHARACTERISTIC
/begin CHARACTERISTIC Com_swtMsgMon_ESP_41_C "Activation monitoring for message ESP_41 and for signal groups (if contained in message) (value != 0 to activate protection)" VALUE 0x8061CCA2 DefaultValueRecordLayout_AUTOSAR_Platform_BaseTypes_uint8 255.0 DefaultIdenticalCompu 0.0 255. FORMAT "%5.0" /end CHARACTERISTIC
/begin CHARACTERISTIC Com_swtMsgMon_ESP_44_C "Activation monitoring for message ESP_44 and for signal groups (if contained in message) (value != 0 to activate protection)" VALUE 0x8061CCA1 DefaultValueRecordLayout_AUTOSAR_Platform_BaseTypes_uint8 255.0 DefaultIdenticalCompu 0.0 255. FORMAT "%5.0" /end CHARACTERISTIC
/begin CHARACTERISTIC Com_swtMsgMon_Klemmen_Status_01_C "Activation monitoring for message Klemmen_Status_01 and for signal groups (if contained in message) (value != 0 to activate protection)" VALUE 0x8061CCA0 DefaultValueRecordLayout_AUTOSAR_Platform_BaseTypes_uint8 255.0 DefaultIdenticalCompu 0.0 255. FORMAT "%5.0" /end CHARACTERISTIC
/begin CHARACTERISTIC Com_swtMsgMon_LCV_01_C "Activation monitoring for message LCV_01 and for signal groups (if contained in message) (value != 0 to activate protection)" VALUE 0x8061CC9F DefaultValueRecordLayout_AUTOSAR_Platform_BaseTypes_uint8 255.0 DefaultIdenticalCompu 0.0 255. FORMAT "%5.0" /end CHARACTERISTIC
/begin CHARACTERISTIC Com_swtMsgMon_LWI_01_C "Activation monitoring for message LWI_01 and for signal groups (if contained in message) (value != 0 to activate protection)" VALUE 0x8061CC9E DefaultValueRecordLayout_AUTOSAR_Platform_BaseTypes_uint8 255.0 DefaultIdenticalCompu 0.0 255. FORMAT "%5.0" /end CHARACTERISTIC
/begin CHARACTERISTIC Com_swtMsgMon_Motor_01_C "Activation monitoring for message Motor_01 and for signal groups (if contained in message) (value != 0 to activate protection)" VALUE 0x8061CC9D DefaultValueRecordLayout_AUTOSAR_Platform_BaseTypes_uint8 255.0 DefaultIdenticalCompu 0.0 255. FORMAT "%5.0" /end CHARACTERISTIC
/begin CHARACTERISTIC Com_swtMsgMon_Motor_02_C "Activation monitoring for message Motor_02 and for signal groups (if contained in message) (value != 0 to activate protection)" VALUE 0x8061CC9C DefaultValueRecordLayout_AUTOSAR_Platform_BaseTypes_uint8 255.0 DefaultIdenticalCompu 0.0 255. FORMAT "%5.0" /end CHARACTERISTIC
/begin CHARACTERISTIC Com_swtMsgMon_Motor_03_C "Activation monitoring for message Motor_03 and for signal groups (if contained in message) (value != 0 to activate protection)" VALUE 0x8061CC9B DefaultValueRecordLayout_AUTOSAR_Platform_BaseTypes_uint8 255.0 DefaultIdenticalCompu 0.0 255. FORMAT "%5.0" /end CHARACTERISTIC
/begin CHARACTERISTIC Com_swtMsgMon_Motor_11_C "Activation monitoring for message Motor_11 and for signal groups (if contained in message) (value != 0 to activate protection)" VALUE 0x8061CC9A DefaultValueRecordLayout_AUTOSAR_Platform_BaseTypes_uint8 255.0 DefaultIdenticalCompu 0.0 255. FORMAT "%5.0" /end CHARACTERISTIC
/begin CHARACTERISTIC Com_swtMsgMon_Motor_12_C "Activation monitoring for message Motor_12 and for signal groups (if contained in message) (value != 0 to activate protection)" VALUE 0x8061CC99 DefaultValueRecordLayout_AUTOSAR_Platform_BaseTypes_uint8 255.0 DefaultIdenticalCompu 0.0 255. FORMAT "%5.0" /end CHARACTERISTIC
/begin CHARACTERISTIC Com_swtMsgMon_Motor_14_C "Activation monitoring for message Motor_14 and for signal groups (if contained in message) (value != 0 to activate protection)" VALUE 0x8061CC98 DefaultValueRecordLayout_AUTOSAR_Platform_BaseTypes_uint8 255.0 DefaultIdenticalCompu 0.0 255. FORMAT "%5.0" /end CHARACTERISTIC
/begin CHARACTERISTIC Com_swtMsgMon_Motor_20_C "Activation monitoring for message Motor_20 and for signal groups (if contained in message) (value != 0 to activate protection)" VALUE 0x8061CC97 DefaultValueRecordLayout_AUTOSAR_Platform_BaseTypes_uint8 255.0 DefaultIdenticalCompu 0.0 255. FORMAT "%5.0" /end CHARACTERISTIC
/begin CHARACTERISTIC Com_swtMsgMon_Motor_27_C "Activation monitoring for message Motor_27 and for signal groups (if contained in message) (value != 0 to activate protection)" VALUE 0x8061CC96 DefaultValueRecordLayout_AUTOSAR_Platform_BaseTypes_uint8 255.0 DefaultIdenticalCompu 0.0 255. FORMAT "%5.0" /end CHARACTERISTIC
/begin CHARACTERISTIC Com_swtMsgMon_Motor_28_C "Activation monitoring for message Motor_28 and for signal groups (if contained in message) (value != 0 to activate protection)" VALUE 0x8061CC95 DefaultValueRecordLayout_AUTOSAR_Platform_BaseTypes_uint8 255.0 DefaultIdenticalCompu 0.0 255. FORMAT "%5.0" /end CHARACTERISTIC
/begin CHARACTERISTIC Com_swtMsgMon_Motor_Code_01_C "Activation monitoring for message Motor_Code_01 and for signal groups (if contained in message) (value != 0 to activate protection)" VALUE 0x8061CC94 DefaultValueRecordLayout_AUTOSAR_Platform_BaseTypes_uint8 255.0 DefaultIdenticalCompu 0.0 255. FORMAT "%5.0" /end CHARACTERISTIC
/begin CHARACTERISTIC Com_swtMsgMon_Motor_TS_01_C "Activation monitoring for message Motor_TS_01 and for signal groups (if contained in message) (value != 0 to activate protection)" VALUE 0x8061CC93 DefaultValueRecordLayout_AUTOSAR_Platform_BaseTypes_uint8 255.0 DefaultIdenticalCompu 0.0 255. FORMAT "%5.0" /end CHARACTERISTIC
/begin CHARACTERISTIC Com_swtMsgMon_Motor_TS_02_C "Activation monitoring for message Motor_TS_02 and for signal groups (if contained in message) (value != 0 to activate protection)" VALUE 0x8061CC92 DefaultValueRecordLayout_AUTOSAR_Platform_BaseTypes_uint8 255.0 DefaultIdenticalCompu 0.0 255. FORMAT "%5.0" /end CHARACTERISTIC
/begin CHARACTERISTIC Com_swtMsgMon_Motor_TS_03_C "Activation monitoring for message Motor_TS_03 and for signal groups (if contained in message) (value != 0 to activate protection)" VALUE 0x8061CC91 DefaultValueRecordLayout_AUTOSAR_Platform_BaseTypes_uint8 255.0 DefaultIdenticalCompu 0.0 255. FORMAT "%5.0" /end CHARACTERISTIC
/begin CHARACTERISTIC Com_swtMsgMon_SARA_06_C "Activation monitoring for message SARA_06 and for signal groups (if contained in message) (value != 0 to activate protection)" VALUE 0x8061CC90 DefaultValueRecordLayout_AUTOSAR_Platform_BaseTypes_uint8 255.0 DefaultIdenticalCompu 0.0 255. FORMAT "%5.0" /end CHARACTERISTIC
/begin CHARACTERISTIC Com_swtMsgMon_TSG_FT_02_C "Activation monitoring for message TSG_FT_02 and for signal groups (if contained in message) (value != 0 to activate protection)" VALUE 0x8061CC8F DefaultValueRecordLayout_AUTOSAR_Platform_BaseTypes_uint8 255.0 DefaultIdenticalCompu 0.0 255. FORMAT "%5.0" /end CHARACTERISTIC
/begin CHARACTERISTIC Com_swtMsgMon_TSK_06_C "Activation monitoring for message TSK_06 and for signal groups (if contained in message) (value != 0 to activate protection)" VALUE 0x8061CC8E DefaultValueRecordLayout_AUTOSAR_Platform_BaseTypes_uint8 255.0 DefaultIdenticalCompu 0.0 255. FORMAT "%5.0" /end CHARACTERISTIC
/begin CHARACTERISTIC Com_swtMsgMon_TSK_08_C "Activation monitoring for message TSK_08 and for signal groups (if contained in message) (value != 0 to activate protection)" VALUE 0x8061CC8D DefaultValueRecordLayout_AUTOSAR_Platform_BaseTypes_uint8 255.0 DefaultIdenticalCompu 0.0 255. FORMAT "%5.0" /end CHARACTERISTIC
/begin CHARACTERISTIC DST_CALIB.DST__LB63x_CluIce0ToSail "" VALUE 0x806070F4 DefaultValueRecordLayout_AUTOSAR_Platform_BaseTypes_boolean 255.0 AUTOSAR_Platform_CompuMethods_boolean 0.0 255. FORMAT "%10.5"
 /begin ANNOTATION ANNOTATION_LABEL "Description (coming from AUTOSAR DESC field)"
  /begin ANNOTATION_TEXT "If true, if IOP_CluutchStateICE is 0 then geared neutral will be requested\r\n" /end ANNOTATION_TEXT
 /end ANNOTATION
/end CHARACTERISTIC
/begin CHARACTERISTIC DST_CALIB.DST__LB63x_P2P3ToNoRequest "" VALUE 0x806070F5 DefaultValueRecordLayout_AUTOSAR_Platform_BaseTypes_boolean 255.0 AUTOSAR_Platform_CompuMethods_boolean 0.0 255. FORMAT "%10.5"
 /begin ANNOTATION ANNOTATION_LABEL "Description (coming from AUTOSAR DESC field)" /begin ANNOTATION_TEXT "If true, Huybrid mode will be set to decouple\r\n" /end ANNOTATION_TEXT /end ANNOTATION
/end CHARACTERISTIC
/begin CHARACTERISTIC DST_CALIB.DST__LB63x_SailInR "" VALUE 0x806070F6 DefaultValueRecordLayout_AUTOSAR_Platform_BaseTypes_boolean 255.0 AUTOSAR_Platform_CompuMethods_boolean 0.0 255. FORMAT "%10.5"
 /begin ANNOTATION ANNOTATION_LABEL "Description (coming from AUTOSAR DESC field)"
  /begin ANNOTATION_TEXT "If true, Geared Neutral (gears selected but clutch open) when in Reverse\r\n" /end ANNOTATION_TEXT
 /end ANNOTATION
/end CHARACTERISTIC
/begin CHARACTERISTIC DST_CALIB.DST__LB63x_SailInREngineOff "" VALUE 0x806070F7 DefaultValueRecordLayout_AUTOSAR_Platform_BaseTypes_boolean 255.0 AUTOSAR_Platform_CompuMethods_boolean 0.0 255. FORMAT "%10.5"
 /begin ANNOTATION ANNOTATION_LABEL "Description (coming from AUTOSAR DESC field)"
  /begin ANNOTATION_TEXT "If true, if IOP_CluutchStateICE is 0 then geared neutral will be requested\r\n" /end ANNOTATION_TEXT
 /end ANNOTATION
/end CHARACTERISTIC
/begin CHARACTERISTIC DST_CALIB.DST_1TYREDIAMETER "" VALUE 0x80607050 DefaultValueRecordLayout_AUTOSAR_Platform_BaseTypes_uint16 20000.0 RB_PT_PCT_SWC_DST_CompuMethods_ident 0.0 20000. FORMAT "%10.5"
 /begin ANNOTATION ANNOTATION_LABEL "Description (coming from AUTOSAR DESC field)" /begin ANNOTATION_TEXT "Tyre diameter\r\n" /end ANNOTATION_TEXT /end ANNOTATION
/end CHARACTERISTIC
/begin CHARACTERISTIC DST_CALIB.DST_1TYREPROFILE "" VALUE 0x80607052 DefaultValueRecordLayout_AUTOSAR_Platform_BaseTypes_uint16 100.0 RB_PT_PCT_SWC_DST_CompuMethods_ident 0.0 100. FORMAT "%10.5"
 /begin ANNOTATION ANNOTATION_LABEL "Description (coming from AUTOSAR DESC field)" /begin ANNOTATION_TEXT "Tyre profile\r\n" /end ANNOTATION_TEXT /end ANNOTATION
/end CHARACTERISTIC
/begin CHARACTERISTIC DST_CALIB.DST_1TYREWIDTH "" VALUE 0x80607054 DefaultValueRecordLayout_AUTOSAR_Platform_BaseTypes_uint16 1000.0 RB_PT_PCT_SWC_DST_CompuMethods_ident 0.0 1000. FORMAT "%10.5"
 /begin ANNOTATION ANNOTATION_LABEL "Description (coming from AUTOSAR DESC field)" /begin ANNOTATION_TEXT "Tyre width\r\n" /end ANNOTATION_TEXT /end ANNOTATION
/end CHARACTERISTIC
/begin CHARACTERISTIC DST_CALIB.DST_4WD_ParallelALWAYSFOLLOWCluICE "" VALUE 0x806070B0 DefaultValueRecordLayout_AUTOSAR_Platform_BaseTypes_boolean 255.0 AUTOSAR_Platform_CompuMethods_boolean 0.0 255. FORMAT "%10.5"
 /begin ANNOTATION ANNOTATION_LABEL "Description (coming from AUTOSAR DESC field)"
  /begin ANNOTATION_TEXT "If true and IOP_ClutchStateOCE is 1 then Hybrid mode will be set to 4WD parallel not 4WD_Idle or 4WD_EDrive\r\n" /end ANNOTATION_TEXT
 /end ANNOTATION
/end CHARACTERISTIC
/begin CHARACTERISTIC DST_CALIB.DST_ALLOWHOLDGEARSFREEZEPSG "" VALUE 0x806070B1 DefaultValueRecordLayout_AUTOSAR_Platform_BaseTypes_uint8 255.0 DefaultIdenticalCompu 0.0 255. FORMAT "%10.5"
 /begin ANNOTATION ANNOTATION_LABEL "Description (coming from AUTOSAR DESC field)" /begin ANNOTATION_TEXT "If true, throttle increasing will freeze preselect\r\n" /end ANNOTATION_TEXT /end ANNOTATION
/end CHARACTERISTIC
/begin CHARACTERISTIC DST_CALIB.DST_ASGRequest.DST_ASGKICKDOWNS "" VALUE 0x8060714C DefaultValueRecordLayout_AUTOSAR_Platform_BaseTypes_boolean 255.0 AUTOSAR_Platform_CompuMethods_boolean 0.0 255. FORMAT "%10.5"
 /begin ANNOTATION ANNOTATION_LABEL "Description (coming from AUTOSAR DESC field)" /begin ANNOTATION_TEXT "If true kickdowns can be requested as ASG shifts\r\n" /end ANNOTATION_TEXT /end ANNOTATION
/end CHARACTERISTIC
/begin CHARACTERISTIC DST_CALIB.DST_ASGRequest.DST_ASGLOWTEMPRPMDEMANDTHRESH "" VALUE 0x80607142 DefaultValueRecordLayout_AUTOSAR_Platform_BaseTypes_sint16 20000.0 RB_PT_PCT_SWC_DST_CompuMethods_DST_Ident 0.0 20000. FORMAT "%10.5"
 /begin ANNOTATION ANNOTATION_LABEL "Description (coming from AUTOSAR DESC field)"
  /begin ANNOTATION_TEXT "Upper limit for downshift request to request ASG shift\r\n" /end ANNOTATION_TEXT
 /end ANNOTATION
/end CHARACTERISTIC
/begin CHARACTERISTIC DST_CALIB.DST_ASGRequest.DST_ASGLOWTEMPTHRESH "" VALUE 0x80607144 DefaultValueRecordLayout_AUTOSAR_Platform_BaseTypes_sint16 250.0 RB_PT_PCT_SWC_DST_CompuMethods_ident -50. 200. FORMAT "%10.5"
 /begin ANNOTATION ANNOTATION_LABEL "Description (coming from AUTOSAR DESC field)"
  /begin ANNOTATION_TEXT "Trans oil temperature below which down-shifts will be requested as ASG\r\n" /end ANNOTATION_TEXT
 /end ANNOTATION
/end CHARACTERISTIC
/begin CHARACTERISTIC DST_CALIB.DST_ASGRequest.DST_ASGLOWTEMPTHRESMAXTHROTTLE "" VALUE 0x8060714D DefaultValueRecordLayout_AUTOSAR_Platform_BaseTypes_uint8 102.0 RB_PT_PCT_SWC_DST_CompuMethods_ratio_0p4 0.0 102. FORMAT "%10.5"
 /begin ANNOTATION ANNOTATION_LABEL "Description (coming from AUTOSAR DESC field)"
  /begin ANNOTATION_TEXT "Throttle must be below this value to request an ASG auto roll-out downshift\r\n" /end ANNOTATION_TEXT
 /end ANNOTATION
/end CHARACTERISTIC
/begin CHARACTERISTIC DST_CALIB.DST_ASGRequest.DST_ASGSPECIFICKDs "" VAL_BLK 0x806070FA DefaultValueRecordLayout_AUTOSAR_Platform_BaseTypes_boolean 255.0 AUTOSAR_Platform_CompuMethods_boolean 0.0 255. FORMAT "%10.5"
 /begin ANNOTATION ANNOTATION_LABEL "Description (coming from AUTOSAR DESC field)"
  /begin ANNOTATION_TEXT "Defines current target gear and Demand gear to allow specific ASG kickdown requests\r\n" /end ANNOTATION_TEXT
 /end ANNOTATION
 MATRIX_DIM 8 9 1 /end CHARACTERISTIC
/begin CHARACTERISTIC DST_CALIB.DST_ASGRequest.DST_ASGSPECIFICKDsENABLE "" VALUE 0x8060714E DefaultValueRecordLayout_AUTOSAR_Platform_BaseTypes_boolean 255.0 AUTOSAR_Platform_CompuMethods_boolean 0.0 255. FORMAT "%10.5"
 /begin ANNOTATION ANNOTATION_LABEL "Description (coming from AUTOSAR DESC field)" /begin ANNOTATION_TEXT "If true, specific kickdowns can be ASG shifts\r\n" /end ANNOTATION_TEXT /end ANNOTATION
/end CHARACTERISTIC
/begin CHARACTERISTIC DST_CALIB.DST_ASGRequest.DST_IDIOTDETECTIONCONFIG "" VALUE 0x8060714F DefaultValueRecordLayout_AUTOSAR_Platform_BaseTypes_uint8 2.0 RB_PT_PCT_SWC_DST_CompuMethods_ident 0.0 2. FORMAT "%10.5"
 /begin ANNOTATION ANNOTATION_LABEL "Description (coming from AUTOSAR DESC field)"
  /begin ANNOTATION_TEXT "0 - Idiot off, 1 - Active only for downshifts, 2 - Active for up and downshifts\r\n" /end ANNOTATION_TEXT
 /end ANNOTATION
/end CHARACTERISTIC
/begin CHARACTERISTIC DST_CALIB.DST_ASGRequest.DST_IDIOTINCSTEP "" VALUE 0x80607146 DefaultValueRecordLayout_AUTOSAR_Platform_BaseTypes_uint16 655.35 RB_PT_PCT_SWC_DST_CompuMethods_DST_Time 0.0 655.35 FORMAT "%10.5" /end CHARACTERISTIC
/begin CHARACTERISTIC DST_CALIB.DST_ASGRequest.DST_IDIOTMAXASGTIME "" VALUE 0x80607148 DefaultValueRecordLayout_AUTOSAR_Platform_BaseTypes_uint16 655.35 RB_PT_PCT_SWC_DST_CompuMethods_DST_Time 0.0 655.35 FORMAT "%10.5"
 /begin ANNOTATION ANNOTATION_LABEL "Description (coming from AUTOSAR DESC field)" /begin ANNOTATION_TEXT "Maximum time ASG shifts can be latched\r\n" /end ANNOTATION_TEXT /end ANNOTATION
/end CHARACTERISTIC
/begin CHARACTERISTIC DST_CALIB.DST_ASGRequest.DST_IDIOTTRIGGER "" VALUE 0x8060714A DefaultValueRecordLayout_AUTOSAR_Platform_BaseTypes_uint16 655.35 RB_PT_PCT_SWC_DST_CompuMethods_DST_Time 0.0 655.35 FORMAT "%10.5" /end CHARACTERISTIC
/begin CHARACTERISTIC DST_CALIB.DST_BOB_DEMANDGEAR "" VALUE 0x806070C1 DefaultValueRecordLayout_AUTOSAR_Platform_BaseTypes_uint8 11.0 RB_PT_PCT_SWC_DST_CompuMethods_ident 0.0 11. FORMAT "%10.5"
 /begin ANNOTATION ANNOTATION_LABEL "Description (coming from AUTOSAR DESC field)" /begin ANNOTATION_TEXT "Demand gear BOB output\r\n" /end ANNOTATION_TEXT /end ANNOTATION
/end CHARACTERISTIC
/begin CHARACTERISTIC DST_CALIB.DST_BOB_DRIVINGMODE "" VALUE 0x806070C2 DefaultValueRecordLayout_AUTOSAR_Platform_BaseTypes_uint8 11.0 RB_PT_PCT_SWC_DST_CompuMethods_Enumerations_DST_Mode 0.0 11. FORMAT "%10.5"
 /begin ANNOTATION ANNOTATION_LABEL "Description (coming from AUTOSAR DESC field)" /begin ANNOTATION_TEXT "BOB override value for DST_DrivingMode\r\n" /end ANNOTATION_TEXT /end ANNOTATION
/end CHARACTERISTIC
/begin CHARACTERISTIC DST_CALIB.DST_BOB_DRIVINGMODEENABLE "" VALUE 0x806070C3 DefaultValueRecordLayout_AUTOSAR_Platform_BaseTypes_boolean 255.0 AUTOSAR_Platform_CompuMethods_boolean 0.0 255. FORMAT "%10.5"
 /begin ANNOTATION ANNOTATION_LABEL "Description (coming from AUTOSAR DESC field)" /begin ANNOTATION_TEXT "Flag to enble development BOB for DST Outputs\r\n" /end ANNOTATION_TEXT /end ANNOTATION
/end CHARACTERISTIC
/begin CHARACTERISTIC DST_CALIB.DST_BOB_GEARSENABLE "" VALUE 0x806070C4 DefaultValueRecordLayout_AUTOSAR_Platform_BaseTypes_boolean 255.0 AUTOSAR_Platform_CompuMethods_boolean 0.0 255. FORMAT "%10.5"
 /begin ANNOTATION ANNOTATION_LABEL "Description (coming from AUTOSAR DESC field)" /begin ANNOTATION_TEXT "Flag to enble development BOB for DST Outputs\r\n" /end ANNOTATION_TEXT /end ANNOTATION
/end CHARACTERISTIC
/begin CHARACTERISTIC DST_CALIB.DST_BOB_HYBRIDMODE "" VALUE 0x806070C5 DefaultValueRecordLayout_AUTOSAR_Platform_BaseTypes_uint8 14.0 RB_PT_PCT_SWC_DST_CompuMethods_Enumerations_DST_ModeHyb 0.0 14. FORMAT "%10.5"
 /begin ANNOTATION ANNOTATION_LABEL "Description (coming from AUTOSAR DESC field)" /begin ANNOTATION_TEXT "BOB override for DST_HybridModeInt\r\n" /end ANNOTATION_TEXT /end ANNOTATION
/end CHARACTERISTIC
/begin CHARACTERISTIC DST_CALIB.DST_BOB_HYBRIDMODEENABLE "" VALUE 0x806070C6 DefaultValueRecordLayout_AUTOSAR_Platform_BaseTypes_boolean 255.0 AUTOSAR_Platform_CompuMethods_boolean 0.0 255. FORMAT "%10.5"
 /begin ANNOTATION ANNOTATION_LABEL "Description (coming from AUTOSAR DESC field)" /begin ANNOTATION_TEXT "Flag to enble development BOB for DST Outputs\r\n" /end ANNOTATION_TEXT /end ANNOTATION
/end CHARACTERISTIC
/begin CHARACTERISTIC DST_CALIB.DST_BOB_PRESELECTGEAR "" VALUE 0x806070C7 DefaultValueRecordLayout_AUTOSAR_Platform_BaseTypes_uint8 11.0 RB_PT_PCT_SWC_DST_CompuMethods_ident 0.0 11. FORMAT "%10.5"
 /begin ANNOTATION ANNOTATION_LABEL "Description (coming from AUTOSAR DESC field)" /begin ANNOTATION_TEXT "Demand gear BOB output\r\n" /end ANNOTATION_TEXT /end ANNOTATION
/end CHARACTERISTIC
/begin CHARACTERISTIC DST_CALIB.DST_BOBIN_BRAKEPRESS "" VALUE 0x80607058 DefaultValueRecordLayout_AUTOSAR_Platform_BaseTypes_uint16 409.5 RB_PT_PCT_SWC_DST_CompuMethods_ratio_0p1 0.0 409.5 FORMAT "%10.5"
 /begin ANNOTATION ANNOTATION_LABEL "Description (coming from AUTOSAR DESC field)" /begin ANNOTATION_TEXT "DST BOB override for brake pressure\r\n" /end ANNOTATION_TEXT /end ANNOTATION
/end CHARACTERISTIC
/begin CHARACTERISTIC DST_CALIB.DST_BOBIN_BRAKESW "" VALUE 0x806070B2 DefaultValueRecordLayout_AUTOSAR_Platform_BaseTypes_boolean 255.0 AUTOSAR_Platform_CompuMethods_boolean 0.0 255. FORMAT "%10.5"
 /begin ANNOTATION ANNOTATION_LABEL "Description (coming from AUTOSAR DESC field)" /begin ANNOTATION_TEXT "DST BOB override for Brake switch\r\n" /end ANNOTATION_TEXT /end ANNOTATION
/end CHARACTERISTIC
/begin CHARACTERISTIC DST_CALIB.DST_BOBIN_DOWNSWITCHSTATUS "" VALUE 0x806070B3 DefaultValueRecordLayout_AUTOSAR_Platform_BaseTypes_boolean 255.0 AUTOSAR_Platform_CompuMethods_boolean 0.0 255. FORMAT "%10.5"
 /begin ANNOTATION ANNOTATION_LABEL "Description (coming from AUTOSAR DESC field)" /begin ANNOTATION_TEXT "DST BOB override for downshift status\r\n" /end ANNOTATION_TEXT /end ANNOTATION
/end CHARACTERISTIC
/begin CHARACTERISTIC DST_CALIB.DST_BOBIN_HYBMODE "" VALUE 0x806070B4 DefaultValueRecordLayout_AUTOSAR_Platform_BaseTypes_uint8 255.0 RB_PT_PCT_SWC_DST_CompuMethods_ident 0.0 255. FORMAT "%10.5"
 /begin ANNOTATION ANNOTATION_LABEL "Description (coming from AUTOSAR DESC field)" /begin ANNOTATION_TEXT "DST BOB override for hybrid mode request\r\n" /end ANNOTATION_TEXT /end ANNOTATION
/end CHARACTERISTIC
/begin CHARACTERISTIC DST_CALIB.DST_BOBIN_INIDONE "" VALUE 0x806070B5 DefaultValueRecordLayout_AUTOSAR_Platform_BaseTypes_boolean 255.0 AUTOSAR_Platform_CompuMethods_boolean 0.0 255. FORMAT "%10.5"
 /begin ANNOTATION ANNOTATION_LABEL "Description (coming from AUTOSAR DESC field)" /begin ANNOTATION_TEXT "DST BOB override for  INI done\r\n" /end ANNOTATION_TEXT /end ANNOTATION
/end CHARACTERISTIC
/begin CHARACTERISTIC DST_CALIB.DST_BOBIN_KL15 "" VALUE 0x806070B6 DefaultValueRecordLayout_AUTOSAR_Platform_BaseTypes_boolean 255.0 AUTOSAR_Platform_CompuMethods_boolean 0.0 255. FORMAT "%10.5"
 /begin ANNOTATION ANNOTATION_LABEL "Description (coming from AUTOSAR DESC field)" /begin ANNOTATION_TEXT "DST BOB override for KL15\r\n" /end ANNOTATION_TEXT /end ANNOTATION
/end CHARACTERISTIC
/begin CHARACTERISTIC DST_CALIB.DST_BOBIN_M "" VALUE 0x806070B7 DefaultValueRecordLayout_AUTOSAR_Platform_BaseTypes_boolean 255.0 AUTOSAR_Platform_CompuMethods_boolean 0.0 255. FORMAT "%10.5"
 /begin ANNOTATION ANNOTATION_LABEL "Description (coming from AUTOSAR DESC field)" /begin ANNOTATION_TEXT "DST BOB override for  M button\r\n" /end ANNOTATION_TEXT /end ANNOTATION
/end CHARACTERISTIC
/begin CHARACTERISTIC DST_CALIB.DST_BOBIN_P "" VALUE 0x806070B8 DefaultValueRecordLayout_AUTOSAR_Platform_BaseTypes_boolean 255.0 AUTOSAR_Platform_CompuMethods_boolean 0.0 255. FORMAT "%10.5"
 /begin ANNOTATION ANNOTATION_LABEL "Description (coming from AUTOSAR DESC field)" /begin ANNOTATION_TEXT "DST BOB override for P button\r\n" /end ANNOTATION_TEXT /end ANNOTATION
/end CHARACTERISTIC
/begin CHARACTERISTIC DST_CALIB.DST_BOBIN_PADDLEDOWN "" VALUE 0x806070B9 DefaultValueRecordLayout_AUTOSAR_Platform_BaseTypes_boolean 255.0 AUTOSAR_Platform_CompuMethods_boolean 0.0 255. FORMAT "%10.5"
 /begin ANNOTATION ANNOTATION_LABEL "Description (coming from AUTOSAR DESC field)" /begin ANNOTATION_TEXT "DST BOB override for down paddle input\r\n" /end ANNOTATION_TEXT /end ANNOTATION
/end CHARACTERISTIC
/begin CHARACTERISTIC DST_CALIB.DST_BOBIN_PADDLEUP "" VALUE 0x806070BA DefaultValueRecordLayout_AUTOSAR_Platform_BaseTypes_boolean 255.0 AUTOSAR_Platform_CompuMethods_boolean 0.0 255. FORMAT "%10.5"
 /begin ANNOTATION ANNOTATION_LABEL "Description (coming from AUTOSAR DESC field)" /begin ANNOTATION_TEXT "DST BOB override for up paddle\r\n" /end ANNOTATION_TEXT /end ANNOTATION
/end CHARACTERISTIC
/begin CHARACTERISTIC DST_CALIB.DST_BOBIN_PARKBUTTONSTATUS "" VALUE 0x806070BB DefaultValueRecordLayout_AUTOSAR_Platform_BaseTypes_boolean 255.0 AUTOSAR_Platform_CompuMethods_boolean 0.0 255. FORMAT "%10.5"
 /begin ANNOTATION ANNOTATION_LABEL "Description (coming from AUTOSAR DESC field)" /begin ANNOTATION_TEXT "DST BOB override for park button status\r\n" /end ANNOTATION_TEXT /end ANNOTATION
/end CHARACTERISTIC
/begin CHARACTERISTIC DST_CALIB.DST_BOBIN_R "" VALUE 0x806070BC DefaultValueRecordLayout_AUTOSAR_Platform_BaseTypes_boolean 255.0 AUTOSAR_Platform_CompuMethods_boolean 0.0 255. FORMAT "%10.5"
 /begin ANNOTATION ANNOTATION_LABEL "Description (coming from AUTOSAR DESC field)" /begin ANNOTATION_TEXT "DST BOB override for R button input\r\n" /end ANNOTATION_TEXT /end ANNOTATION
/end CHARACTERISTIC
/begin CHARACTERISTIC DST_CALIB.DST_BOBIN_REVERSESWITCHSTATUS "" VALUE 0x806070BD DefaultValueRecordLayout_AUTOSAR_Platform_BaseTypes_boolean 255.0 AUTOSAR_Platform_CompuMethods_boolean 0.0 255. FORMAT "%10.5"
 /begin ANNOTATION ANNOTATION_LABEL "Description (coming from AUTOSAR DESC field)" /begin ANNOTATION_TEXT "DST BOB override for reverse switch status\r\n" /end ANNOTATION_TEXT /end ANNOTATION
/end CHARACTERISTIC
/begin CHARACTERISTIC DST_CALIB.DST_BOBIN_THROTTLE "" VALUE 0x806070BE DefaultValueRecordLayout_AUTOSAR_Platform_BaseTypes_uint8 102.0 RB_PT_PCT_SWC_DST_CompuMethods_ratio_0p4 0.0 102. FORMAT "%10.5"
 /begin ANNOTATION ANNOTATION_LABEL "Description (coming from AUTOSAR DESC field)" /begin ANNOTATION_TEXT "DST BOB override for  throttle\r\n" /end ANNOTATION_TEXT /end ANNOTATION
/end CHARACTERISTIC
/begin CHARACTERISTIC DST_CALIB.DST_BOBIN_UPSWITCHSTATUS "" VALUE 0x806070BF DefaultValueRecordLayout_AUTOSAR_Platform_BaseTypes_boolean 255.0 AUTOSAR_Platform_CompuMethods_boolean 0.0 255. FORMAT "%10.5"
 /begin ANNOTATION ANNOTATION_LABEL "Description (coming from AUTOSAR DESC field)" /begin ANNOTATION_TEXT "DST BOB override for upshift status\r\n" /end ANNOTATION_TEXT /end ANNOTATION
/end CHARACTERISTIC
/begin CHARACTERISTIC DST_CALIB.DST_BOBINS "" VALUE 0x80607056 DefaultValueRecordLayout_AUTOSAR_Platform_BaseTypes_uint16 65535.0 RB_PT_PCT_SWC_DST_CompuMethods_ident 0.0 65535. FORMAT "%10.5"
 /begin ANNOTATION ANNOTATION_LABEL "Description (coming from AUTOSAR DESC field)" /begin ANNOTATION_TEXT "Set to 21930 to override some inputs to DST\r\n" /end ANNOTATION_TEXT /end ANNOTATION
/end CHARACTERISTIC
/begin CHARACTERISTIC DST_CALIB.DST_BOBSTATUSLONGACC "" VALUE 0x806070C0 DefaultValueRecordLayout_AUTOSAR_Platform_BaseTypes_boolean 255.0 AUTOSAR_Platform_CompuMethods_boolean 0.0 255. FORMAT "%10.5"
 /begin ANNOTATION ANNOTATION_LABEL "Description (coming from AUTOSAR DESC field)" /begin ANNOTATION_TEXT "DST BOB override for status of the long acc sensor\r\n" /end ANNOTATION_TEXT /end ANNOTATION
/end CHARACTERISTIC
/begin CHARACTERISTIC DST_CALIB.DST_BYPASSDWCSELFTEST "" VALUE 0x806070C8 DefaultValueRecordLayout_AUTOSAR_Platform_BaseTypes_uint8 255.0 DefaultIdenticalCompu 0.0 255. FORMAT "%10.5"
 /begin ANNOTATION ANNOTATION_LABEL "Description (coming from AUTOSAR DESC field)"
  /begin ANNOTATION_TEXT "If true then self test is not required to select gears\r\n" /end ANNOTATION_TEXT
 /end ANNOTATION
/end CHARACTERISTIC
/begin CHARACTERISTIC DST_CALIB.DST_CANCELLATCHEDMANUAL "" VAL_BLK 0x80606FED DefaultValueRecordLayout_AUTOSAR_Platform_BaseTypes_boolean 255.0 AUTOSAR_Platform_CompuMethods_boolean 0.0 255. FORMAT "%10.5"
 /begin ANNOTATION ANNOTATION_LABEL "Description (coming from AUTOSAR DESC field)"
  /begin ANNOTATION_TEXT "If true, this value of IOP_DriveModeTrans will force to manual mode\r\n" /end ANNOTATION_TEXT
 /end ANNOTATION
 MATRIX_DIM 16 1 1 /end CHARACTERISTIC
/begin CHARACTERISTIC DST_CALIB.DST_COUNTS4CHARGERATTACHEDWARN "" VALUE 0x8060705A DefaultValueRecordLayout_AUTOSAR_Platform_BaseTypes_uint16 65535.0 RB_PT_PCT_SWC_DST_CompuMethods_ident 0.0 65535. FORMAT "%10.5"
 /begin ANNOTATION ANNOTATION_LABEL "Description (coming from AUTOSAR DESC field)"
  /begin ANNOTATION_TEXT "Number of program loops the charger attached warning will be displayed for\r\n" /end ANNOTATION_TEXT
 /end ANNOTATION
/end CHARACTERISTIC
/begin CHARACTERISTIC DST_CALIB.DST_CRUISEACTIVE "" VAL_BLK 0x8060703D DefaultValueRecordLayout_AUTOSAR_Platform_BaseTypes_uint8 255.0 DefaultIdenticalCompu 0.0 255. FORMAT "%10.5" MATRIX_DIM 8 1 1 /end CHARACTERISTIC
/begin CHARACTERISTIC DST_CALIB.DST_CRUISESTATUS "" VALUE 0x806070C9 DefaultValueRecordLayout_AUTOSAR_Platform_BaseTypes_uint8 3.0 RB_PT_PCT_SWC_DST_CompuMethods_Enumerations_DST_CruiseStatus 0.0 3. FORMAT "%10.5"
 /begin ANNOTATION ANNOTATION_LABEL "Description (coming from AUTOSAR DESC field)"
  /begin ANNOTATION_TEXT "Gives ability to change the internal throttle pedal based on cruise control status\r\n" /end ANNOTATION_TEXT
 /end ANNOTATION
/end CHARACTERISTIC
/begin CHARACTERISTIC DST_CALIB.DST_DEFAULTNORMALMODE "" VALUE 0x806070CA DefaultValueRecordLayout_AUTOSAR_Platform_BaseTypes_uint8 15.0 RB_PT_PCT_SWC_DST_CompuMethods_ident 0.0 15. FORMAT "%10.5"
 /begin ANNOTATION ANNOTATION_LABEL "Description (coming from AUTOSAR DESC field)"
  /begin ANNOTATION_TEXT "If normal mode is forced (manual unavaialble etc) this is the shift map to use\r\n" /end ANNOTATION_TEXT
 /end ANNOTATION
/end CHARACTERISTIC
/begin CHARACTERISTIC DST_CALIB.DST_DetectInstability.DST_CHANGES2FREEZE "" VALUE 0x8060724C DefaultValueRecordLayout_AUTOSAR_Platform_BaseTypes_uint8 7.0 RB_PT_PCT_SWC_DST_CompuMethods_ident 1. 8. FORMAT "%10.5"
 /begin ANNOTATION ANNOTATION_LABEL "Description (coming from AUTOSAR DESC field)" /begin ANNOTATION_TEXT "Number of gear changes to freeze the output\r\n" /end ANNOTATION_TEXT /end ANNOTATION
/end CHARACTERISTIC
/begin CHARACTERISTIC DST_CALIB.DST_DetectInstability.DST_MINCOUNTSBETWEENCHNG "" VALUE 0x8060724D DefaultValueRecordLayout_AUTOSAR_Platform_BaseTypes_uint8 252.0 RB_PT_PCT_SWC_DST_CompuMethods_ident 3. 255. FORMAT "%10.5"
 /begin ANNOTATION ANNOTATION_LABEL "Description (coming from AUTOSAR DESC field)"
  /begin ANNOTATION_TEXT "Minimum program loops between gear changes before instability counter starts\r\n" /end ANNOTATION_TEXT
 /end ANNOTATION
/end CHARACTERISTIC
/begin CHARACTERISTIC DST_CALIB.DST_DetectInstability.DST_UNSTABLEHOLDCOUNT "" VALUE 0x8060724E DefaultValueRecordLayout_AUTOSAR_Platform_BaseTypes_uint8 155.0 RB_PT_PCT_SWC_DST_CompuMethods_ident 100. 255. FORMAT "%10.5"
 /begin ANNOTATION ANNOTATION_LABEL "Description (coming from AUTOSAR DESC field)"
  /begin ANNOTATION_TEXT "Loops to hold the preselect and demand gear after instability has been detected\r\n" /end ANNOTATION_TEXT
 /end ANNOTATION
/end CHARACTERISTIC
/begin CHARACTERISTIC DST_CALIB.DST_DG.DST_DGSelect.DST_MINRPMUPSHIFTALTITUDE "" MAP 0x80607186 RB_PT_PCT_SWC_DST_RecordLayouts_RL_Map_sint16_60_uint8_5_uint8_12 20000.0 RB_PT_PCT_SWC_DST_CompuMethods_DST_Ident 0.0 20000. FORMAT "%10.5"
 /begin AXIS_DESCR STD_AXIS NO_INPUT_QUANTITY RB_PT_PCT_SWC_DST_CompuMethods_ratio_0p4 5 0.0 102. FORMAT "%10.5" DEPOSIT ABSOLUTE /end AXIS_DESCR
 /begin AXIS_DESCR STD_AXIS NO_INPUT_QUANTITY RB_PT_PCT_SWC_DST_CompuMethods_ident 12 0.0 11. FORMAT "%10.5" DEPOSIT ABSOLUTE /end AXIS_DESCR
/end CHARACTERISTIC
/begin CHARACTERISTIC DST_CALIB.DST_DG.DST_DGSelect.DST_MODECHANGEDOWNCRUISEENABLE "" VALUE 0x8060717E DefaultValueRecordLayout_AUTOSAR_Platform_BaseTypes_uint8 255.0 DefaultIdenticalCompu 0.0 255. FORMAT "%10.5"
 /begin ANNOTATION ANNOTATION_LABEL "Description (coming from AUTOSAR DESC field)" /begin ANNOTATION_TEXT "Enable mode change downshift when in cruise\r\n" /end ANNOTATION_TEXT /end ANNOTATION
/end CHARACTERISTIC
/begin CHARACTERISTIC DST_CALIB.DST_DG.DST_DGSelect.DST_MODECHANGEDOWNGEARS "" VAL_BLK 0x80607160 DefaultValueRecordLayout_AUTOSAR_Platform_BaseTypes_uint8 11.0 RB_PT_PCT_SWC_DST_CompuMethods_ident 0.0 11. FORMAT "%10.5"
 /begin ANNOTATION ANNOTATION_LABEL "Description (coming from AUTOSAR DESC field)" /begin ANNOTATION_TEXT "Number of gears to downsift based on last gear\r\n" /end ANNOTATION_TEXT /end ANNOTATION
 MATRIX_DIM 12 1 1 /end CHARACTERISTIC
/begin CHARACTERISTIC DST_CALIB.DST_DG.DST_DGSelect.DST_MODECHANGEDOWNMANENABLE "" VALUE 0x8060717F DefaultValueRecordLayout_AUTOSAR_Platform_BaseTypes_uint8 255.0 DefaultIdenticalCompu 0.0 255. FORMAT "%10.5"
 /begin ANNOTATION ANNOTATION_LABEL "Description (coming from AUTOSAR DESC field)" /begin ANNOTATION_TEXT "Enable mode change downshift when in cruise\r\n" /end ANNOTATION_TEXT /end ANNOTATION
/end CHARACTERISTIC
/begin CHARACTERISTIC DST_CALIB.DST_DG.DST_DGSelect.DST_MODECHANGEDOWNMAXACCEL "" VALUE 0x8060716C DefaultValueRecordLayout_AUTOSAR_Platform_BaseTypes_sint16 4.0 RB_PT_PCT_SWC_DST_CompuMethods_ratio_0p01 -2. 2. FORMAT "%10.5"
 /begin ANNOTATION ANNOTATION_LABEL "Description (coming from AUTOSAR DESC field)" /begin ANNOTATION_TEXT "Maximum acceleration to enable mode change downshift\r\n" /end ANNOTATION_TEXT /end ANNOTATION
/end CHARACTERISTIC
/begin CHARACTERISTIC DST_CALIB.DST_DG.DST_DGSelect.DST_MODECHANGEDOWNMAXGRAD "" VALUE 0x8060716E DefaultValueRecordLayout_AUTOSAR_Platform_BaseTypes_sint16 65.4 RB_PT_PCT_SWC_DST_CompuMethods_ratio_0p001 -32.7 32.7 FORMAT "%10.5"
 /begin ANNOTATION ANNOTATION_LABEL "Description (coming from AUTOSAR DESC field)" /begin ANNOTATION_TEXT "Maximum gradient to allow mode change downshift\r\n" /end ANNOTATION_TEXT /end ANNOTATION
/end CHARACTERISTIC
/begin CHARACTERISTIC DST_CALIB.DST_DG.DST_DGSelect.DST_MODECHANGEDOWNMAXLATACC "" VALUE 0x80607180 DefaultValueRecordLayout_AUTOSAR_Platform_BaseTypes_uint8 1.27 RB_PT_PCT_SWC_DST_CompuMethods_ratio_0p01 0.0 1.27 FORMAT "%10.5"
 /begin ANNOTATION ANNOTATION_LABEL "Description (coming from AUTOSAR DESC field)"
  /begin ANNOTATION_TEXT "Maximum lateral acceleration to allow mode change downshifts\r\n" /end ANNOTATION_TEXT
 /end ANNOTATION
/end CHARACTERISTIC
/begin CHARACTERISTIC DST_CALIB.DST_DG.DST_DGSelect.DST_MODECHANGEDOWNMAXTHROTTLE "" VALUE 0x80607181 DefaultValueRecordLayout_AUTOSAR_Platform_BaseTypes_uint8 102.0 RB_PT_PCT_SWC_DST_CompuMethods_ratio_0p4 0.0 102. FORMAT "%10.5"
 /begin ANNOTATION ANNOTATION_LABEL "Description (coming from AUTOSAR DESC field)" /begin ANNOTATION_TEXT "Maximum throttle to trigger mode change downshifts\r\n" /end ANNOTATION_TEXT /end ANNOTATION
/end CHARACTERISTIC
/begin CHARACTERISTIC DST_CALIB.DST_DG.DST_DGSelect.DST_MODECHANGEDOWNMINACCEL "" VALUE 0x80607170 DefaultValueRecordLayout_AUTOSAR_Platform_BaseTypes_sint16 4.0 RB_PT_PCT_SWC_DST_CompuMethods_ratio_0p01 -2. 2. FORMAT "%10.5"
 /begin ANNOTATION ANNOTATION_LABEL "Description (coming from AUTOSAR DESC field)" /begin ANNOTATION_TEXT "Maximum acceleration to enable mode change downshift\r\n" /end ANNOTATION_TEXT /end ANNOTATION
/end CHARACTERISTIC
/begin CHARACTERISTIC DST_CALIB.DST_DG.DST_DGSelect.DST_MODECHANGEDOWNMINGRAD "" VALUE 0x80607172 DefaultValueRecordLayout_AUTOSAR_Platform_BaseTypes_sint16 65.4 RB_PT_PCT_SWC_DST_CompuMethods_ratio_0p001 -32.7 32.7 FORMAT "%10.5"
 /begin ANNOTATION ANNOTATION_LABEL "Description (coming from AUTOSAR DESC field)" /begin ANNOTATION_TEXT "Maximum gradient to allow mode change downshift\r\n" /end ANNOTATION_TEXT /end ANNOTATION
/end CHARACTERISTIC
/begin CHARACTERISTIC DST_CALIB.DST_DG.DST_DGSelect.DST_MODECHANGEDOWNMINKMH "" VALUE 0x80607174 DefaultValueRecordLayout_AUTOSAR_Platform_BaseTypes_uint16 500.0 RB_PT_PCT_SWC_DST_CompuMethods_kph_0p1 0.0 500. FORMAT "%10.5"
 /begin ANNOTATION ANNOTATION_LABEL "Description (coming from AUTOSAR DESC field)" /begin ANNOTATION_TEXT "Minimum speed for mode change downshift\r\n" /end ANNOTATION_TEXT /end ANNOTATION
/end CHARACTERISTIC
/begin CHARACTERISTIC DST_CALIB.DST_DG.DST_DGSelect.DST_MODECHANGEDOWNMODES "" VAL_BLK 0x80607150 DefaultValueRecordLayout_AUTOSAR_Platform_BaseTypes_uint8 255.0 DefaultIdenticalCompu 0.0 255. FORMAT "%10.5" MATRIX_DIM 16 1 1 /end CHARACTERISTIC
/begin CHARACTERISTIC DST_CALIB.DST_DG.DST_DGSelect.DST_MODECHANGEDOWNSHIFTMODELAST "" VALUE 0x80607182 DefaultValueRecordLayout_AUTOSAR_Platform_BaseTypes_uint8 16.0 RB_PT_PCT_SWC_DST_CompuMethods_ident 0.0 16. FORMAT "%10.5"
 /begin ANNOTATION ANNOTATION_LABEL "Description (coming from AUTOSAR DESC field)"
  /begin ANNOTATION_TEXT "Highest shift mode for mode change downshift to be active\r\n" /end ANNOTATION_TEXT
 /end ANNOTATION
/end CHARACTERISTIC
/begin CHARACTERISTIC DST_CALIB.DST_DG.DST_DGSelect.DST_MODECHANGEDOWNSHIFTMODELIM "" VALUE 0x80607183 DefaultValueRecordLayout_AUTOSAR_Platform_BaseTypes_uint8 16.0 RB_PT_PCT_SWC_DST_CompuMethods_ident 0.0 16. FORMAT "%10.5"
 /begin ANNOTATION ANNOTATION_LABEL "Description (coming from AUTOSAR DESC field)"
  /begin ANNOTATION_TEXT "Highest shift mode for mode change downshift to be active\r\n" /end ANNOTATION_TEXT
 /end ANNOTATION
/end CHARACTERISTIC
/begin CHARACTERISTIC DST_CALIB.DST_DG.DST_DGSelect.DST_MODECHANGEDOWNSHIFTMODEMIN "" VALUE 0x80607184 DefaultValueRecordLayout_AUTOSAR_Platform_BaseTypes_uint8 16.0 RB_PT_PCT_SWC_DST_CompuMethods_ident 0.0 16. FORMAT "%10.5"
 /begin ANNOTATION ANNOTATION_LABEL "Description (coming from AUTOSAR DESC field)"
  /begin ANNOTATION_TEXT "Highest shift mode for mode change downshift to be active\r\n" /end ANNOTATION_TEXT
 /end ANNOTATION
/end CHARACTERISTIC
/begin CHARACTERISTIC DST_CALIB.DST_DG.DST_DGSelect.DST_PRESSURENOTOK4LOWRPM "" VALUE 0x80607176 DefaultValueRecordLayout_AUTOSAR_Platform_BaseTypes_uint16 2.0 RB_PT_PCT_SWC_DST_CompuMethods_ratio_0p001 0.0 2. FORMAT "%10.5"
 /begin ANNOTATION ANNOTATION_LABEL "Description (coming from AUTOSAR DESC field)" /begin ANNOTATION_TEXT "Pressure above which normal shifting is restored\r\n" /end ANNOTATION_TEXT /end ANNOTATION
/end CHARACTERISTIC
/begin CHARACTERISTIC DST_CALIB.DST_DG.DST_DGSelect.DST_PRESSUREOK4LOWRPM "" VALUE 0x80607178 DefaultValueRecordLayout_AUTOSAR_Platform_BaseTypes_uint16 2.0 RB_PT_PCT_SWC_DST_CompuMethods_ratio_0p001 0.0 2. FORMAT "%10.5"
 /begin ANNOTATION ANNOTATION_LABEL "Description (coming from AUTOSAR DESC field)" /begin ANNOTATION_TEXT "Pressure above which normal shifting is restored\r\n" /end ANNOTATION_TEXT /end ANNOTATION
/end CHARACTERISTIC
/begin CHARACTERISTIC DST_CALIB.DST_DG.DST_DGSelect.DST_TIMEDOWNSHIFTHOLDINHIBITTME "" VALUE 0x8060717A DefaultValueRecordLayout_AUTOSAR_Platform_BaseTypes_uint16 655.35 RB_PT_PCT_SWC_DST_CompuMethods_DST_Time 0.0 655.35 FORMAT "%10.5" /end CHARACTERISTIC
/begin CHARACTERISTIC DST_CALIB.DST_DG.DST_DGSelect.DST_TIMEDOWNSHIFTHOLDLOWERGEAR "" VALUE 0x8060717C DefaultValueRecordLayout_AUTOSAR_Platform_BaseTypes_uint16 655.35 RB_PT_PCT_SWC_DST_CompuMethods_DST_Time 0.0 655.35 FORMAT "%10.5" /end CHARACTERISTIC
/begin CHARACTERISTIC DST_CALIB.DST_DG.DST_ShiftPointsAndComp.DST_CompensationManager.DST_CORNERHOLDTIMEROWSELECT "" VAL_BLK 0x80607214 DefaultValueRecordLayout_AUTOSAR_Platform_BaseTypes_uint8 1.0 RB_PT_PCT_SWC_DST_CompuMethods_ident 0.0 1. FORMAT "%10.5"
 /begin ANNOTATION ANNOTATION_LABEL "Description (coming from AUTOSAR DESC field)" /begin ANNOTATION_TEXT "Use to select row 0 or 1 of DST_CORNERHOLDTIME2D\r\n" /end ANNOTATION_TEXT /end ANNOTATION
 MATRIX_DIM 17 1 1 /end CHARACTERISTIC
/begin CHARACTERISTIC DST_CALIB.DST_DG.DST_ShiftPointsAndComp.DST_CompensationManager.DST_DECELHOLDTIMELIMIT_PEDAL "" CURVE 0x80607236 RB_PT_PCT_SWC_DST_RecordLayouts_RL_Curve_sint16_4_uint8_4 10.0 RB_PT_PCT_SWC_DST_CompuMethods_DST_Time 0.0 10. FORMAT "%10.5"
 /begin ANNOTATION ANNOTATION_LABEL "Description (coming from AUTOSAR DESC field)"
  /begin ANNOTATION_TEXT "Upper limit of Decel hold time based on Driver demand\r\n" /end ANNOTATION_TEXT
 /end ANNOTATION
 /begin AXIS_DESCR STD_AXIS NO_INPUT_QUANTITY RB_PT_PCT_SWC_DST_CompuMethods_ratio_0p4 4 0.0 102. FORMAT "%10.5" DEPOSIT ABSOLUTE /end AXIS_DESCR
/end CHARACTERISTIC
/begin CHARACTERISTIC DST_CALIB.DST_DG.DST_ShiftPointsAndComp.DST_CompensationManager.DST_DECELHOLDTIMEROWSELECT "" VAL_BLK 0x80607225 DefaultValueRecordLayout_AUTOSAR_Platform_BaseTypes_uint8 1.0 RB_PT_PCT_SWC_DST_CompuMethods_ident 0.0 1. FORMAT "%10.5"
 /begin ANNOTATION ANNOTATION_LABEL "Description (coming from AUTOSAR DESC field)" /begin ANNOTATION_TEXT "Select row 0 or 1 of DST_DECELHOLDTIME2D\r\n" /end ANNOTATION_TEXT /end ANNOTATION
 MATRIX_DIM 17 1 1 /end CHARACTERISTIC
/begin CHARACTERISTIC DST_CALIB.DST_DG.DST_ShiftPointsAndComp.DST_ShiftCompensation.DST_DECELUPPERLIMITCLAMP "" VALUE 0x80607244 DefaultValueRecordLayout_AUTOSAR_Platform_BaseTypes_uint16 20000.0 RB_PT_PCT_SWC_DST_CompuMethods_DST_Ident 0.0 20000. FORMAT "%10.5"
 /begin ANNOTATION ANNOTATION_LABEL "Description (coming from AUTOSAR DESC field)" /begin ANNOTATION_TEXT "Lower limit of DecelRpmUpperLimit\r\n" /end ANNOTATION_TEXT /end ANNOTATION
/end CHARACTERISTIC
/begin CHARACTERISTIC DST_CALIB.DST_DG.DST_ShiftPointsAndComp.DST_ShiftCompensation.DST_DOWNSHIFTIDLEUPPERLIMIT "" VALUE 0x80607246 DefaultValueRecordLayout_AUTOSAR_Platform_BaseTypes_uint16 20000.0 RB_PT_PCT_SWC_DST_CompuMethods_ident 0.0 20000. FORMAT "%10.5"
 /begin ANNOTATION ANNOTATION_LABEL "Description (coming from AUTOSAR DESC field)"
  /begin ANNOTATION_TEXT "Upper limit allowed to cause early downshifts due to idle speed\r\n" /end ANNOTATION_TEXT
 /end ANNOTATION
/end CHARACTERISTIC
/begin CHARACTERISTIC DST_CALIB.DST_DG.DST_ShiftPointsAndComp.DST_ShiftCompensation.DST_PULLAWAY2NDPREVENT1TO2STATIC "" VALUE 0x80607248 DefaultValueRecordLayout_AUTOSAR_Platform_BaseTypes_boolean 255.0 AUTOSAR_Platform_CompuMethods_boolean 0.0 255. FORMAT "%10.5"
 /begin ANNOTATION ANNOTATION_LABEL "Description (coming from AUTOSAR DESC field)"
  /begin ANNOTATION_TEXT "If true prevents a 1 to 2 shift when static or low speed when 2nd gear pullaway becomes availalbe\r\n" /end ANNOTATION_TEXT
 /end ANNOTATION
/end CHARACTERISTIC
/begin CHARACTERISTIC DST_CALIB.DST_DG.DST_ShiftPointsAndComp.DST_ShiftMaps.DST_ALWAYSUPSHIFTCATALYSTHOT "" VALUE 0x8060724A DefaultValueRecordLayout_AUTOSAR_Platform_BaseTypes_boolean 255.0 AUTOSAR_Platform_CompuMethods_boolean 0.0 255. FORMAT "%10.5"
 /begin ANNOTATION ANNOTATION_LABEL "Description (coming from AUTOSAR DESC field)"
  /begin ANNOTATION_TEXT "If true and IOP_CatalystOverHeat is true, it will not bounce off the rev limit\r\n" /end ANNOTATION_TEXT
 /end ANNOTATION
/end CHARACTERISTIC
/begin CHARACTERISTIC DST_CALIB.DST_DISABLEP3INNorP "" VALUE 0x806070CB DefaultValueRecordLayout_AUTOSAR_Platform_BaseTypes_boolean 255.0 AUTOSAR_Platform_CompuMethods_boolean 0.0 255. FORMAT "%10.5"
 /begin ANNOTATION ANNOTATION_LABEL "Description (coming from AUTOSAR DESC field)" /begin ANNOTATION_TEXT "If true, P3 mode should be disabled in N or P\r\n" /end ANNOTATION_TEXT /end ANNOTATION
/end CHARACTERISTIC
/begin CHARACTERISTIC DST_CALIB.DST_DriverInterface.DST_AUTO2NPADDLEFAILKMHENABLE "" VALUE 0x80607250 DefaultValueRecordLayout_AUTOSAR_Platform_BaseTypes_uint16 12.0 RB_PT_PCT_SWC_DST_CompuMethods_kph_0p1 0.0 12. FORMAT "%10.5"
 /begin ANNOTATION ANNOTATION_LABEL "Description (coming from AUTOSAR DESC field)"
  /begin ANNOTATION_TEXT "Cal above 12kmh will required L2 rule 40 enable code change.  Vehicle speed below which N will be selected if a paddle has failed and the speed has exceeded a threshold\r\n" /end ANNOTATION_TEXT
 /end ANNOTATION
/end CHARACTERISTIC
/begin CHARACTERISTIC DST_CALIB.DST_DriverInterface.DST_AUTO2NPADDLEFAILKMHTRIGGER "" VALUE 0x80607252 DefaultValueRecordLayout_AUTOSAR_Platform_BaseTypes_uint16 500.0 RB_PT_PCT_SWC_DST_CompuMethods_kph_0p1 0.0 500. FORMAT "%10.5"
 /begin ANNOTATION ANNOTATION_LABEL "Description (coming from AUTOSAR DESC field)"
  /begin ANNOTATION_TEXT "Vehicle speed below which N will be selected if a paddle has failed and the speed has exceeded a threshold\r\n" /end ANNOTATION_TEXT
 /end ANNOTATION
/end CHARACTERISTIC
/begin CHARACTERISTIC DST_CALIB.DST_DriverInterface.DST_FORCE2MANUALLATCHES "" VALUE 0x8060725C DefaultValueRecordLayout_AUTOSAR_Platform_BaseTypes_uint8 255.0 DefaultIdenticalCompu 0.0 255. FORMAT "%10.5"
 /begin ANNOTATION ANNOTATION_LABEL "Description (coming from AUTOSAR DESC field)"
  /begin ANNOTATION_TEXT "If true, request to go to manual mode latches if based on mode\r\n" /end ANNOTATION_TEXT
 /end ANNOTATION
/end CHARACTERISTIC
/begin CHARACTERISTIC DST_CALIB.DST_DriverInterface.DST_INPUTFAILTIME "" VALUE 0x80607254 DefaultValueRecordLayout_AUTOSAR_Platform_BaseTypes_uint16 655.35 RB_PT_PCT_SWC_DST_CompuMethods_DST_Time 0.0 655.35 FORMAT "%10.5"
 /begin ANNOTATION ANNOTATION_LABEL "Description (coming from AUTOSAR DESC field)" /begin ANNOTATION_TEXT "Time before backup strategy is active\r\n" /end ANNOTATION_TEXT /end ANNOTATION
/end CHARACTERISTIC
/begin CHARACTERISTIC DST_CALIB.DST_DriverInterface.DST_INPUTRECOVERTIME "" VALUE 0x80607256 DefaultValueRecordLayout_AUTOSAR_Platform_BaseTypes_uint16 655.35 RB_PT_PCT_SWC_DST_CompuMethods_DST_Time 0.0 655.35 FORMAT "%10.5"
 /begin ANNOTATION ANNOTATION_LABEL "Description (coming from AUTOSAR DESC field)"
  /begin ANNOTATION_TEXT "Time after driver input is OK before normal strategy resumes\r\n" /end ANNOTATION_TEXT
 /end ANNOTATION
/end CHARACTERISTIC
/begin CHARACTERISTIC DST_CALIB.DST_DriverInterface.DST_MBUTTONHOLD2DTIME "" VALUE 0x80607258 DefaultValueRecordLayout_AUTOSAR_Platform_BaseTypes_uint16 655.35 RB_PT_PCT_SWC_DST_CompuMethods_DST_Time 0.0 655.35 FORMAT "%10.5"
 /begin ANNOTATION ANNOTATION_LABEL "Description (coming from AUTOSAR DESC field)" /begin ANNOTATION_TEXT "Seconds to hold M to get D if paddles failed\r\n" /end ANNOTATION_TEXT /end ANNOTATION
/end CHARACTERISTIC
/begin CHARACTERISTIC DST_CALIB.DST_DriverInterface.DST_REFSPDCANISTERENMAN "" VALUE 0x8060725A DefaultValueRecordLayout_AUTOSAR_Platform_BaseTypes_uint16 500.0 RB_PT_PCT_SWC_DST_CompuMethods_kph_0p1 0.0 500. FORMAT "%10.5"
 /begin ANNOTATION ANNOTATION_LABEL "Description (coming from AUTOSAR DESC field)"
  /begin ANNOTATION_TEXT "Disable canister full strategy if reference speed below this value and strategy no longer being requested\r\n" /end ANNOTATION_TEXT
 /end ANNOTATION
/end CHARACTERISTIC
/begin CHARACTERISTIC DST_CALIB.DST_ENABLE2NDPULLAWAY "" VALUE 0x806070CC DefaultValueRecordLayout_AUTOSAR_Platform_BaseTypes_uint8 255.0 DefaultIdenticalCompu 0.0 255. FORMAT "%10.5"
 /begin ANNOTATION ANNOTATION_LABEL "Description (coming from AUTOSAR DESC field)" /begin ANNOTATION_TEXT "If true, 2nd gear pullaway logic is enabled\r\n" /end ANNOTATION_TEXT /end ANNOTATION
/end CHARACTERISTIC
/begin CHARACTERISTIC DST_CALIB.DST_ENABLEADAPTIONGAC "" VALUE 0x806070CD DefaultValueRecordLayout_AUTOSAR_Platform_BaseTypes_boolean 255.0 AUTOSAR_Platform_CompuMethods_boolean 0.0 255. FORMAT "%10.5"
 /begin ANNOTATION ANNOTATION_LABEL "Description (coming from AUTOSAR DESC field)" /begin ANNOTATION_TEXT "If true, GAC_FlgEOLRq is listened to\r\n" /end ANNOTATION_TEXT /end ANNOTATION
/end CHARACTERISTIC
/begin CHARACTERISTIC DST_CALIB.DST_ENABLEADAPTIONPCL "" VALUE 0x806070CE DefaultValueRecordLayout_AUTOSAR_Platform_BaseTypes_boolean 255.0 AUTOSAR_Platform_CompuMethods_boolean 0.0 255. FORMAT "%10.5"
 /begin ANNOTATION ANNOTATION_LABEL "Description (coming from AUTOSAR DESC field)" /begin ANNOTATION_TEXT "If true, PCL_FlgDecoupleRequest is listened to\r\n" /end ANNOTATION_TEXT /end ANNOTATION
/end CHARACTERISTIC
/begin CHARACTERISTIC DST_CALIB.DST_ENABLEVSS1CLEANDWC "" VALUE 0x806070CF DefaultValueRecordLayout_AUTOSAR_Platform_BaseTypes_boolean 255.0 AUTOSAR_Platform_CompuMethods_boolean 0.0 255. FORMAT "%10.5"
 /begin ANNOTATION ANNOTATION_LABEL "Description (coming from AUTOSAR DESC field)" /begin ANNOTATION_TEXT "If true, DWC_FlgDecoupleRequest is listen to\r\n" /end ANNOTATION_TEXT /end ANNOTATION
/end CHARACTERISTIC
/begin CHARACTERISTIC DST_CALIB.DST_ENGAGERMAXKMH "" VALUE 0x8060705C DefaultValueRecordLayout_AUTOSAR_Platform_BaseTypes_uint16 500.0 RB_PT_PCT_SWC_DST_CompuMethods_kph_0p1 0.0 500. FORMAT "%10.5"
 /begin ANNOTATION ANNOTATION_LABEL "Description (coming from AUTOSAR DESC field)"
  /begin ANNOTATION_TEXT "Vehicle speed above which mechanical reverse will not be engaged\r\n" /end ANNOTATION_TEXT
 /end ANNOTATION
/end CHARACTERISTIC
/begin CHARACTERISTIC DST_CALIB.DST_ENGAGERMINENGSPD "" VALUE 0x8060705E DefaultValueRecordLayout_AUTOSAR_Platform_BaseTypes_uint16 20000.0 RB_PT_PCT_SWC_DST_CompuMethods_ident 0.0 20000. FORMAT "%10.5"
 /begin ANNOTATION ANNOTATION_LABEL "Description (coming from AUTOSAR DESC field)"
  /begin ANNOTATION_TEXT "Minimum engine speed before Reverse will be mechanically selected\r\n" /end ANNOTATION_TEXT
 /end ANNOTATION
/end CHARACTERISTIC
/begin CHARACTERISTIC DST_CALIB.DST_ENGAGERMINENGSPDto1st "" VALUE 0x80607060 DefaultValueRecordLayout_AUTOSAR_Platform_BaseTypes_uint16 20000.0 RB_PT_PCT_SWC_DST_CompuMethods_ident 0.0 20000. FORMAT "%10.5"
 /begin ANNOTATION ANNOTATION_LABEL "Description (coming from AUTOSAR DESC field)"
  /begin ANNOTATION_TEXT "Minimum engine speed before Reverse will be mechanically selected\r\n" /end ANNOTATION_TEXT
 /end ANNOTATION
/end CHARACTERISTIC
/begin CHARACTERISTIC DST_CALIB.DST_ENGAGERWHILSTRMAXKMHOFF "" VALUE 0x80607062 DefaultValueRecordLayout_AUTOSAR_Platform_BaseTypes_uint16 500.0 RB_PT_PCT_SWC_DST_CompuMethods_kph_0p1 0.0 500. FORMAT "%10.5"
 /begin ANNOTATION ANNOTATION_LABEL "Description (coming from AUTOSAR DESC field)"
  /begin ANNOTATION_TEXT "Vehicle speed above which mechanical reverse will not be engaged\r\n" /end ANNOTATION_TEXT
 /end ANNOTATION
/end CHARACTERISTIC
/begin CHARACTERISTIC DST_CALIB.DST_ENGAGERWHILSTRMAXKMHON "" VALUE 0x80607064 DefaultValueRecordLayout_AUTOSAR_Platform_BaseTypes_uint16 500.0 RB_PT_PCT_SWC_DST_CompuMethods_kph_0p1 0.0 500. FORMAT "%10.5"
 /begin ANNOTATION ANNOTATION_LABEL "Description (coming from AUTOSAR DESC field)"
  /begin ANNOTATION_TEXT "Vehicle speed above which mechanical reverse will not be engaged\r\n" /end ANNOTATION_TEXT
 /end ANNOTATION
/end CHARACTERISTIC
/begin CHARACTERISTIC DST_CALIB.DST_ENGREVLIMITMAX "" VALUE 0x80607066 DefaultValueRecordLayout_AUTOSAR_Platform_BaseTypes_uint16 20000.0 RB_PT_PCT_SWC_DST_CompuMethods_ident 0.0 20000. FORMAT "%10.5"
 /begin ANNOTATION ANNOTATION_LABEL "Description (coming from AUTOSAR DESC field)" /begin ANNOTATION_TEXT "Upper limit applied to IOP_EngRevLimit\r\n" /end ANNOTATION_TEXT /end ANNOTATION
/end CHARACTERISTIC
/begin CHARACTERISTIC DST_CALIB.DST_ENGRPMKEEPGEARSINNEUTRAL "" VALUE 0x80607068 DefaultValueRecordLayout_AUTOSAR_Platform_BaseTypes_uint16 20000.0 RB_PT_PCT_SWC_DST_CompuMethods_ident 0.0 20000. FORMAT "%10.5"
 /begin ANNOTATION ANNOTATION_LABEL "Description (coming from AUTOSAR DESC field)"
  /begin ANNOTATION_TEXT "engine speed below whch demand and preselect gears will be set to zero\r\n" /end ANNOTATION_TEXT
 /end ANNOTATION
/end CHARACTERISTIC
/begin CHARACTERISTIC DST_CALIB.DST_ENGSPEEDMINLIMIT "" VALUE 0x8060706A DefaultValueRecordLayout_AUTOSAR_Platform_BaseTypes_uint16 20000.0 RB_PT_PCT_SWC_DST_CompuMethods_ident 0.0 20000. FORMAT "%10.5"
 /begin ANNOTATION ANNOTATION_LABEL "Description (coming from AUTOSAR DESC field)"
  /begin ANNOTATION_TEXT "Lowest value to use of Engine speed limit from engine\r\n" /end ANNOTATION_TEXT
 /end ANNOTATION
/end CHARACTERISTIC
/begin CHARACTERISTIC DST_CALIB.DST_EPBPARKREQUESTS "" VALUE 0x806070D0 DefaultValueRecordLayout_AUTOSAR_Platform_BaseTypes_boolean 255.0 AUTOSAR_Platform_CompuMethods_boolean 0.0 255. FORMAT "%10.5"
 /begin ANNOTATION ANNOTATION_LABEL "Description (coming from AUTOSAR DESC field)"
  /begin ANNOTATION_TEXT "If true, supports EPB requesting the Park brake to engage\r\n" /end ANNOTATION_TEXT
 /end ANNOTATION
/end CHARACTERISTIC
/begin CHARACTERISTIC DST_CALIB.DST_EVPRESELECTSTRATEGYBASEDONSHIFTMODE "" VAL_BLK 0x80606FDC DefaultValueRecordLayout_AUTOSAR_Platform_BaseTypes_uint8 255.0 DefaultIdenticalCompu 0.0 255. FORMAT "%10.5"
 /begin ANNOTATION ANNOTATION_LABEL "Description (coming from AUTOSAR DESC field)"
  /begin ANNOTATION_TEXT "Depending on shift mode, preselect strategy can be enabled\r\n" /end ANNOTATION_TEXT
 /end ANNOTATION
 MATRIX_DIM 17 1 1 /end CHARACTERISTIC
/begin CHARACTERISTIC DST_CALIB.DST_EVStart.DST_BYPASSSTOPSTARTFLAG "" VALUE 0x8060728A DefaultValueRecordLayout_AUTOSAR_Platform_BaseTypes_uint8 255.0 DefaultIdenticalCompu 0.0 255. FORMAT "%10.5" /end CHARACTERISTIC
/begin CHARACTERISTIC DST_CALIB.DST_EVStart.DST_CLUICE0BYPASSSUPPORTGEAR "" VALUE 0x8060728B DefaultValueRecordLayout_AUTOSAR_Platform_BaseTypes_boolean 255.0 AUTOSAR_Platform_CompuMethods_boolean 0.0 255. FORMAT "%10.5" /end CHARACTERISTIC
/begin CHARACTERISTIC DST_CALIB.DST_EVStart.DST_CLUICE0BYPASSTORQUEONFROZXEN "" VALUE 0x8060728C DefaultValueRecordLayout_AUTOSAR_Platform_BaseTypes_boolean 255.0 AUTOSAR_Platform_CompuMethods_boolean 0.0 255. FORMAT "%10.5" /end CHARACTERISTIC
/begin CHARACTERISTIC DST_CALIB.DST_EVStart.DST_DISABLEEV3RD "" VALUE 0x8060728D DefaultValueRecordLayout_AUTOSAR_Platform_BaseTypes_uint8 255.0 DefaultIdenticalCompu 0.0 255. FORMAT "%10.5" /end CHARACTERISTIC
/begin CHARACTERISTIC DST_CALIB.DST_EVStart.DST_DISABLEEVSTART2ND "" VALUE 0x8060728E DefaultValueRecordLayout_AUTOSAR_Platform_BaseTypes_uint8 255.0 DefaultIdenticalCompu 0.0 255. FORMAT "%10.5"
 /begin ANNOTATION ANNOTATION_LABEL "Description (coming from AUTOSAR DESC field)"
  /begin ANNOTATION_TEXT "If true, 2nd gear will not be used for the EV start, only 5th and 6th\r\n" /end ANNOTATION_TEXT
 /end ANNOTATION
/end CHARACTERISTIC
/begin CHARACTERISTIC DST_CALIB.DST_EVStart.DST_EVSTART_NODGTEMP "" VALUE 0x8060727E DefaultValueRecordLayout_AUTOSAR_Platform_BaseTypes_sint16 250.0 RB_PT_PCT_SWC_DST_CompuMethods_ident -50. 200. FORMAT "%10.5"
 /begin ANNOTATION ANNOTATION_LABEL "Description (coming from AUTOSAR DESC field)"
  /begin ANNOTATION_TEXT "Temperature below which no demand gear is required during EV start\r\n" /end ANNOTATION_TEXT
 /end ANNOTATION
/end CHARACTERISTIC
/begin CHARACTERISTIC DST_CALIB.DST_EVStart.DST_EVSTART_NOGEARSRPM "" VALUE 0x80607280 DefaultValueRecordLayout_AUTOSAR_Platform_BaseTypes_uint16 20000.0 RB_PT_PCT_SWC_DST_CompuMethods_ident 0.0 20000. FORMAT "%10.5"
 /begin ANNOTATION ANNOTATION_LABEL "Description (coming from AUTOSAR DESC field)" /begin ANNOTATION_TEXT "Engine speed when cold gears will be set to 0\r\n" /end ANNOTATION_TEXT /end ANNOTATION
/end CHARACTERISTIC
/begin CHARACTERISTIC DST_CALIB.DST_EVStart.DST_EVSTART_NOPSGTEMP "" VALUE 0x80607282 DefaultValueRecordLayout_AUTOSAR_Platform_BaseTypes_sint16 250.0 RB_PT_PCT_SWC_DST_CompuMethods_ident -50. 200. FORMAT "%10.5"
 /begin ANNOTATION ANNOTATION_LABEL "Description (coming from AUTOSAR DESC field)"
  /begin ANNOTATION_TEXT "Temperature below which no preselect gear is required during EV start\r\n" /end ANNOTATION_TEXT
 /end ANNOTATION
/end CHARACTERISTIC
/begin CHARACTERISTIC DST_CALIB.DST_EVStart.DST_EVSTART_REFSPDTO8th "" VALUE 0x80607284 DefaultValueRecordLayout_AUTOSAR_Platform_BaseTypes_uint16 500.0 RB_PT_PCT_SWC_DST_CompuMethods_kph_0p1 0.0 500. FORMAT "%10.5"
 /begin ANNOTATION ANNOTATION_LABEL "Description (coming from AUTOSAR DESC field)"
  /begin ANNOTATION_TEXT "Vehicle speed above which the start gear for EV start will be 8th\r\n" /end ANNOTATION_TEXT
 /end ANNOTATION
/end CHARACTERISTIC
/begin CHARACTERISTIC DST_CALIB.DST_EVStart.DST_EVSTART1_WAITFORPEDAL "" VALUE 0x80607276 DefaultValueRecordLayout_AUTOSAR_Platform_BaseTypes_uint16 655.35 RB_PT_PCT_SWC_DST_CompuMethods_DST_Time 0.0 655.35 FORMAT "%10.5"
 /begin ANNOTATION ANNOTATION_LABEL "Description (coming from AUTOSAR DESC field)" /begin ANNOTATION_TEXT "Wait for a short time for the driver pedal to settle\r\n" /end ANNOTATION_TEXT /end ANNOTATION
/end CHARACTERISTIC
/begin CHARACTERISTIC DST_CALIB.DST_EVStart.DST_EVSTART2_TIMEFORTORQUEONSUPPORT "" VALUE 0x80607278 DefaultValueRecordLayout_AUTOSAR_Platform_BaseTypes_uint16 655.35 RB_PT_PCT_SWC_DST_CompuMethods_DST_Time 0.0 655.35 FORMAT "%10.5"
 /begin ANNOTATION ANNOTATION_LABEL "Description (coming from AUTOSAR DESC field)"
  /begin ANNOTATION_TEXT "Maximum time allowed to get torque onto the support gear\r\n" /end ANNOTATION_TEXT
 /end ANNOTATION
/end CHARACTERISTIC
/begin CHARACTERISTIC DST_CALIB.DST_EVStart.DST_EVSTART3_TIMEFORTORQUEONFROZEN "" VALUE 0x8060727A DefaultValueRecordLayout_AUTOSAR_Platform_BaseTypes_uint16 655.35 RB_PT_PCT_SWC_DST_CompuMethods_DST_Time 0.0 655.35 FORMAT "%10.5"
 /begin ANNOTATION ANNOTATION_LABEL "Description (coming from AUTOSAR DESC field)"
  /begin ANNOTATION_TEXT "Maximum time allowed to get torque onto the support gear\r\n" /end ANNOTATION_TEXT
 /end ANNOTATION
/end CHARACTERISTIC
/begin CHARACTERISTIC DST_CALIB.DST_EVStart.DST_EVSTART4_WAITONFROZENGEAR "" VALUE 0x8060727C DefaultValueRecordLayout_AUTOSAR_Platform_BaseTypes_uint16 655.35 RB_PT_PCT_SWC_DST_CompuMethods_DST_Time 0.0 655.35 FORMAT "%10.5"
 /begin ANNOTATION ANNOTATION_LABEL "Description (coming from AUTOSAR DESC field)"
  /begin ANNOTATION_TEXT "Time to wait on frozen gear before going to shift maps\r\n" /end ANNOTATION_TEXT
 /end ANNOTATION
/end CHARACTERISTIC
/begin CHARACTERISTIC DST_CALIB.DST_EVStart.DST_EVSTARTPSGOUTPUT "" VAL_BLK 0x8060725E DefaultValueRecordLayout_AUTOSAR_Platform_BaseTypes_uint8 11.0 RB_PT_PCT_SWC_DST_CompuMethods_ident 0.0 11. FORMAT "%10.5"
 /begin ANNOTATION ANNOTATION_LABEL "Description (coming from AUTOSAR DESC field)" /begin ANNOTATION_TEXT "Preselect depending on EVDemandOutput\r\n" /end ANNOTATION_TEXT /end ANNOTATION
 MATRIX_DIM 12 1 1 /end CHARACTERISTIC
/begin CHARACTERISTIC DST_CALIB.DST_EVStart.DST_FROZENGEARTOEVOUTPUT "" VAL_BLK 0x8060726A DefaultValueRecordLayout_AUTOSAR_Platform_BaseTypes_uint8 11.0 RB_PT_PCT_SWC_DST_CompuMethods_ident 0.0 11. FORMAT "%10.5"
 /begin ANNOTATION ANNOTATION_LABEL "Description (coming from AUTOSAR DESC field)" /begin ANNOTATION_TEXT "If True the EV Demand Output will be set to 6\r\n" /end ANNOTATION_TEXT /end ANNOTATION
 MATRIX_DIM 12 1 1 /end CHARACTERISTIC
/begin CHARACTERISTIC DST_CALIB.DST_EVStart.DST_KMHMINFOREVSTART "" VALUE 0x80607286 DefaultValueRecordLayout_AUTOSAR_Platform_BaseTypes_uint16 500.0 RB_PT_PCT_SWC_DST_CompuMethods_kph_0p1 0.0 500. FORMAT "%10.5"
 /begin ANNOTATION ANNOTATION_LABEL "Description (coming from AUTOSAR DESC field)" /begin ANNOTATION_TEXT "Minimum vehicle speed to perfrom EV start\r\n" /end ANNOTATION_TEXT /end ANNOTATION
/end CHARACTERISTIC
/begin CHARACTERISTIC DST_CALIB.DST_EVStart.DST_LOWESTGEARPOSEVSTART "" VALUE 0x8060728F DefaultValueRecordLayout_AUTOSAR_Platform_BaseTypes_uint8 11.0 RB_PT_PCT_SWC_DST_CompuMethods_ident 0.0 11. FORMAT "%10.5"
 /begin ANNOTATION ANNOTATION_LABEL "Description (coming from AUTOSAR DESC field)" /begin ANNOTATION_TEXT "Lowest gear to enter into DemandGearFrozen\r\n" /end ANNOTATION_TEXT /end ANNOTATION
/end CHARACTERISTIC
/begin CHARACTERISTIC DST_CALIB.DST_EVStart.DST_MAXTIMEFOREVSTART "" VALUE 0x80607288 DefaultValueRecordLayout_AUTOSAR_Platform_BaseTypes_uint16 655.35 RB_PT_PCT_SWC_DST_CompuMethods_DST_Time 0.0 655.35 FORMAT "%10.5" /end CHARACTERISTIC
/begin CHARACTERISTIC DST_CALIB.DST_EVStart.DST_REVERSECANBEEV "" VALUE 0x80607290 DefaultValueRecordLayout_AUTOSAR_Platform_BaseTypes_uint8 255.0 DefaultIdenticalCompu 0.0 255. FORMAT "%10.5"
 /begin ANNOTATION ANNOTATION_LABEL "Description (coming from AUTOSAR DESC field)" /begin ANNOTATION_TEXT "enable to allow reverse to be an EV mode\r\n" /end ANNOTATION_TEXT /end ANNOTATION
/end CHARACTERISTIC
/begin CHARACTERISTIC DST_CALIB.DST_FLGSAILWHILECOASTTOD "" VALUE 0x806070D1 DefaultValueRecordLayout_AUTOSAR_Platform_BaseTypes_uint8 255.0 DefaultIdenticalCompu 0.0 255. FORMAT "%10.5"
 /begin ANNOTATION ANNOTATION_LABEL "Description (coming from AUTOSAR DESC field)"
  /begin ANNOTATION_TEXT "flag to enable the abort of shuttling gear selection strategy on park or neutral modes\r\n" /end ANNOTATION_TEXT
 /end ANNOTATION
/end CHARACTERISTIC
/begin CHARACTERISTIC DST_CALIB.DST_GACEOLDoneOverride "" VALUE 0x806070D2 DefaultValueRecordLayout_AUTOSAR_Platform_BaseTypes_boolean 255.0 AUTOSAR_Platform_CompuMethods_boolean 0.0 255. FORMAT "%10.5"
 /begin ANNOTATION ANNOTATION_LABEL "Description (coming from AUTOSAR DESC field)"
  /begin ANNOTATION_TEXT "If true GAC_FlgEOL done flag is ignored for pressure available to be set true\r\n" /end ANNOTATION_TEXT
 /end ANNOTATION
/end CHARACTERISTIC
/begin CHARACTERISTIC DST_CALIB.DST_GearShiftIndicator.DST_GSIDOWNSHIFTABOVEIDLE "" VALUE 0x80607292 DefaultValueRecordLayout_AUTOSAR_Platform_BaseTypes_uint16 20000.0 RB_PT_PCT_SWC_DST_CompuMethods_ident 0.0 20000. FORMAT "%10.5"
 /begin ANNOTATION ANNOTATION_LABEL "Description (coming from AUTOSAR DESC field)" /begin ANNOTATION_TEXT "Rpm above idle speed to recommend a downshift\r\n" /end ANNOTATION_TEXT /end ANNOTATION
/end CHARACTERISTIC
/begin CHARACTERISTIC DST_CALIB.DST_GearShiftIndicator.DST_GSIMINRPMDOWN "" CURVE 0x80607294 RB_PT_PCT_SWC_DST_RecordLayouts_RL_Curve_sint16_6_uint8_6 20000.0 RB_PT_PCT_SWC_DST_CompuMethods_DST_Ident 0.0 20000. FORMAT "%10.5"
 /begin ANNOTATION ANNOTATION_LABEL "Description (coming from AUTOSAR DESC field)" /begin ANNOTATION_TEXT "Minimum recommended gear\r\n" /end ANNOTATION_TEXT /end ANNOTATION
 /begin AXIS_DESCR STD_AXIS NO_INPUT_QUANTITY RB_PT_PCT_SWC_DST_CompuMethods_ratio_0p4 6 0.0 102. FORMAT "%10.5" DEPOSIT ABSOLUTE /end AXIS_DESCR
/end CHARACTERISTIC
/begin CHARACTERISTIC DST_CALIB.DST_GearShiftIndicator.DST_GSIRPMHYST "" CURVE 0x806072A8 RB_PT_PCT_SWC_DST_RecordLayouts_RL_Curve_sint16_6_uint8_6 20000.0 RB_PT_PCT_SWC_DST_CompuMethods_DST_Ident 0.0 20000. FORMAT "%10.5"
 /begin ANNOTATION ANNOTATION_LABEL "Description (coming from AUTOSAR DESC field)" /begin ANNOTATION_TEXT "Gear hystereesis for gear recomendation\r\n" /end ANNOTATION_TEXT /end ANNOTATION
 /begin AXIS_DESCR STD_AXIS NO_INPUT_QUANTITY RB_PT_PCT_SWC_DST_CompuMethods_ratio_0p4 6 0.0 102. FORMAT "%10.5" DEPOSIT ABSOLUTE /end AXIS_DESCR
/end CHARACTERISTIC
/begin CHARACTERISTIC DST_CALIB.DST_In_DriverDemand.DST_MODEPEDALKDOVERRIDE "" VALUE 0x806072DC DefaultValueRecordLayout_AUTOSAR_Platform_BaseTypes_boolean 255.0 AUTOSAR_Platform_CompuMethods_boolean 0.0 255. FORMAT "%10.5"
 /begin ANNOTATION ANNOTATION_LABEL "Description (coming from AUTOSAR DESC field)"
  /begin ANNOTATION_TEXT "If false, the KD input is not used to limit the pedal angle\r\n" /end ANNOTATION_TEXT
 /end ANNOTATION
/end CHARACTERISTIC
/begin CHARACTERISTIC DST_CALIB.DST_In_DriverDemand.DST_MODEPEDALLIMITcal "" VAL_BLK 0x806072BC DefaultValueRecordLayout_AUTOSAR_Platform_BaseTypes_uint16 110.0 RB_PT_PCT_SWC_DST_CompuMethods_ratio_0p1 0.0 110. FORMAT "%10.5"
 /begin ANNOTATION ANNOTATION_LABEL "Description (coming from AUTOSAR DESC field)" /begin ANNOTATION_TEXT "Pedal limit bases on hybrid mode\r\n" /end ANNOTATION_TEXT /end ANNOTATION
 MATRIX_DIM 15 1 1 /end CHARACTERISTIC
/begin CHARACTERISTIC DST_CALIB.DST_In_DriverDemand.DST_MODEPEDALRAMPDELAY "" VALUE 0x806072DD DefaultValueRecordLayout_AUTOSAR_Platform_BaseTypes_uint8 2.55 RB_PT_PCT_SWC_DST_CompuMethods_time_0p01 0.0 2.55 FORMAT "%10.5"
 /begin ANNOTATION ANNOTATION_LABEL "Description (coming from AUTOSAR DESC field)"
  /begin ANNOTATION_TEXT "After a changing in hybrid mode, time before the pedal limit starts to change\r\n" /end ANNOTATION_TEXT
 /end ANNOTATION
/end CHARACTERISTIC
/begin CHARACTERISTIC DST_CALIB.DST_In_DriverDemand.DST_MODEPEDALRAMPUP "" VALUE 0x806072DA DefaultValueRecordLayout_AUTOSAR_Platform_BaseTypes_uint16 110.0 RB_PT_PCT_SWC_DST_CompuMethods_ratio_0p1 0.0 110. FORMAT "%10.5"
 /begin ANNOTATION ANNOTATION_LABEL "Description (coming from AUTOSAR DESC field)" /begin ANNOTATION_TEXT "Increase in pedal limit\r\n" /end ANNOTATION_TEXT /end ANNOTATION
/end CHARACTERISTIC
/begin CHARACTERISTIC DST_CALIB.DST_In_DriverDemand.DST_THROTTLEdTLOOPS "" VALUE 0x806072E0 DefaultValueRecordLayout_AUTOSAR_Platform_BaseTypes_uint8 255.0 RB_PT_PCT_SWC_DST_CompuMethods_ident 0.0 255. FORMAT "%10.5"
 /begin ANNOTATION ANNOTATION_LABEL "Description (coming from AUTOSAR DESC field)" /begin ANNOTATION_TEXT "10 would give pedal dT over 100ms\r\n" /end ANNOTATION_TEXT /end ANNOTATION
/end CHARACTERISTIC
/begin CHARACTERISTIC DST_CALIB.DST_In_DriverDemand.DST_THROTTLEdTONESAMPE "" VALUE 0x806072E1 DefaultValueRecordLayout_AUTOSAR_Platform_BaseTypes_uint8 102.0 RB_PT_PCT_SWC_DST_CompuMethods_ratio_0p4 0.0 102. FORMAT "%10.5"
 /begin ANNOTATION ANNOTATION_LABEL "Description (coming from AUTOSAR DESC field)" /begin ANNOTATION_TEXT "Rapid pedal increase percent\r\n" /end ANNOTATION_TEXT /end ANNOTATION
/end CHARACTERISTIC
/begin CHARACTERISTIC DST_CALIB.DST_In_DriverDemand.DST_THROTTLEdTPCNT "" VALUE 0x806072E2 DefaultValueRecordLayout_AUTOSAR_Platform_BaseTypes_uint8 102.0 RB_PT_PCT_SWC_DST_CompuMethods_ratio_0p4 0.0 102. FORMAT "%10.5"
 /begin ANNOTATION ANNOTATION_LABEL "Description (coming from AUTOSAR DESC field)" /begin ANNOTATION_TEXT "Rapid pedal increase percent\r\n" /end ANNOTATION_TEXT /end ANNOTATION
/end CHARACTERISTIC
/begin CHARACTERISTIC DST_CALIB.DST_In_DriverDemand.DST_THROTTLEMAX2STEADY "" VALUE 0x806072DE DefaultValueRecordLayout_AUTOSAR_Platform_BaseTypes_uint8 102.0 RB_PT_PCT_SWC_DST_CompuMethods_ratio_0p4 0.0 102. FORMAT "%10.5" /end CHARACTERISTIC
/begin CHARACTERISTIC DST_CALIB.DST_In_DriverDemand.DST_THROTTLESTEADYDELAY "" VALUE 0x806072DF DefaultValueRecordLayout_AUTOSAR_Platform_BaseTypes_uint8 255.0 RB_PT_PCT_SWC_DST_CompuMethods_ident 0.0 255. FORMAT "%10.5"
 /begin ANNOTATION ANNOTATION_LABEL "Description (coming from AUTOSAR DESC field)" /begin ANNOTATION_TEXT "Delay after steady\r\n" /end ANNOTATION_TEXT /end ANNOTATION
/end CHARACTERISTIC
/begin CHARACTERISTIC DST_CALIB.DST_In_OpShftGrad.DST_ALTITUDEDRIFT "" VALUE 0x806072E4 DefaultValueRecordLayout_AUTOSAR_Platform_BaseTypes_uint16 0.1 RB_PT_PCT_SWC_DST_CompuMethods_ratio_0p00001 0.0 0.1 FORMAT "%10.5"
 /begin ANNOTATION ANNOTATION_LABEL "Description (coming from AUTOSAR DESC field)"
  /begin ANNOTATION_TEXT "Rate at which the calculated altitude can move towards the altitude from ambient air pressure\r\n" /end ANNOTATION_TEXT
 /end ANNOTATION
/end CHARACTERISTIC
/begin CHARACTERISTIC DST_CALIB.DST_In_OpShftGrad.DST_ALTITUDEDRIFTENABLE "" VALUE 0x806072FC DefaultValueRecordLayout_AUTOSAR_Platform_BaseTypes_boolean 255.0 AUTOSAR_Platform_CompuMethods_boolean 0.0 255. FORMAT "%10.5"
 /begin ANNOTATION ANNOTATION_LABEL "Description (coming from AUTOSAR DESC field)"
  /begin ANNOTATION_TEXT "If true, calculated altitude can drift towards the altitude from ambient air pressure\r\n" /end ANNOTATION_TEXT
 /end ANNOTATION
/end CHARACTERISTIC
/begin CHARACTERISTIC DST_CALIB.DST_In_OpShftGrad.DST_ALTITUDEERRGRADDISABLE "" VALUE 0x806072E6 DefaultValueRecordLayout_AUTOSAR_Platform_BaseTypes_uint16 7000.0 RB_PT_PCT_SWC_DST_CompuMethods_ident 0.0 7000. FORMAT "%10.5"
 /begin ANNOTATION ANNOTATION_LABEL "Description (coming from AUTOSAR DESC field)"
  /begin ANNOTATION_TEXT "Difference in calculated gradient and gradient from ambient air pressure to disable the gradient signal\r\n" /end ANNOTATION_TEXT
 /end ANNOTATION
/end CHARACTERISTIC
/begin CHARACTERISTIC DST_CALIB.DST_In_OpShftGrad.DST_GRADFAILEDLATCH "" VALUE 0x806072FD DefaultValueRecordLayout_AUTOSAR_Platform_BaseTypes_boolean 255.0 AUTOSAR_Platform_CompuMethods_boolean 0.0 255. FORMAT "%10.5" /end CHARACTERISTIC
/begin CHARACTERISTIC DST_CALIB.DST_In_OpShftGrad.DST_GRADFORCEUPDATE "" VALUE 0x806072FE DefaultValueRecordLayout_AUTOSAR_Platform_BaseTypes_boolean 255.0 AUTOSAR_Platform_CompuMethods_boolean 0.0 255. FORMAT "%10.5"
 /begin ANNOTATION ANNOTATION_LABEL "Description (coming from AUTOSAR DESC field)" /begin ANNOTATION_TEXT "Forces the gradient to be calculated\r\n" /end ANNOTATION_TEXT /end ANNOTATION
/end CHARACTERISTIC
/begin CHARACTERISTIC DST_CALIB.DST_In_OpShftGrad.DST_GRADIENTROCINCRAMP "" VALUE 0x806072E8 DefaultValueRecordLayout_AUTOSAR_Platform_BaseTypes_uint16 1.0 RB_PT_PCT_SWC_DST_CompuMethods_ratio_0p001 0.0 1. FORMAT "%10.5"
 /begin ANNOTATION ANNOTATION_LABEL "Description (coming from AUTOSAR DESC field)"
  /begin ANNOTATION_TEXT "Maximum increase rate of gradient ROC (instant decrease from noise, gradual increase).  Up-side-down peak hold and decay\r\n" /end ANNOTATION_TEXT
 /end ANNOTATION
/end CHARACTERISTIC
/begin CHARACTERISTIC DST_CALIB.DST_In_OpShftGrad.DST_GRADINTEGRATORGAIN "" CURVE 0x80607304 RB_PT_PCT_SWC_DST_RecordLayouts_RL_Curve_uint16_7_sint16_7 32.0 RB_PT_PCT_SWC_DST_CompuMethods_ratio_0p001 0.0 32. FORMAT "%10.5"
 /begin ANNOTATION ANNOTATION_LABEL "Description (coming from AUTOSAR DESC field)"
  /begin ANNOTATION_TEXT "Inrease rate of Gradient ROC integrator based on gradient error\r\n" /end ANNOTATION_TEXT
 /end ANNOTATION
 /begin AXIS_DESCR STD_AXIS NO_INPUT_QUANTITY RB_PT_PCT_SWC_DST_CompuMethods_ratio_0p001 7 0.0 32.7 FORMAT "%10.5" DEPOSIT ABSOLUTE /end AXIS_DESCR
/end CHARACTERISTIC
/begin CHARACTERISTIC DST_CALIB.DST_In_OpShftGrad.DST_GRADINTEGRATORLIMIT "" CURVE 0x80607322 RB_PT_PCT_SWC_DST_RecordLayouts_RL_Curve_uint16_7_sint16_7 32.0 RB_PT_PCT_SWC_DST_CompuMethods_ratio_0p001 0.0 32. FORMAT "%10.5"
 /begin ANNOTATION ANNOTATION_LABEL "Description (coming from AUTOSAR DESC field)"
  /begin ANNOTATION_TEXT "Maximum rate of change of gradient integrator based on Gradient error\r\n" /end ANNOTATION_TEXT
 /end ANNOTATION
 /begin AXIS_DESCR STD_AXIS NO_INPUT_QUANTITY RB_PT_PCT_SWC_DST_CompuMethods_ratio_0p001 7 0.0 32.7 FORMAT "%10.5" DEPOSIT ABSOLUTE /end AXIS_DESCR
/end CHARACTERISTIC
/begin CHARACTERISTIC DST_CALIB.DST_In_OpShftGrad.DST_GRADINTEGRATORMIN "" VALUE 0x806072EA DefaultValueRecordLayout_AUTOSAR_Platform_BaseTypes_uint16 32.0 RB_PT_PCT_SWC_DST_CompuMethods_ratio_0p001 0.0 32. FORMAT "%10.5"
 /begin ANNOTATION ANNOTATION_LABEL "Description (coming from AUTOSAR DESC field)" /begin ANNOTATION_TEXT "Minimum value for gradient integrator\r\n" /end ANNOTATION_TEXT /end ANNOTATION
/end CHARACTERISTIC
/begin CHARACTERISTIC DST_CALIB.DST_In_OpShftGrad.DST_GRADOFFSETLEARN "" VALUE 0x806072FF DefaultValueRecordLayout_AUTOSAR_Platform_BaseTypes_boolean 255.0 AUTOSAR_Platform_CompuMethods_boolean 0.0 255. FORMAT "%10.5"
 /begin ANNOTATION ANNOTATION_LABEL "Description (coming from AUTOSAR DESC field)" /begin ANNOTATION_TEXT "Rising edge sets gradient offset\r\n" /end ANNOTATION_TEXT /end ANNOTATION
/end CHARACTERISTIC
/begin CHARACTERISTIC DST_CALIB.DST_In_OpShftGrad.DST_GRADPWRCOUNTHOLDZERO "" VALUE 0x806072EC DefaultValueRecordLayout_AUTOSAR_Platform_BaseTypes_uint16 65535.0 RB_PT_PCT_SWC_DST_CompuMethods_ident 0.0 65535. FORMAT "%10.5"
 /begin ANNOTATION ANNOTATION_LABEL "Description (coming from AUTOSAR DESC field)" /begin ANNOTATION_TEXT "Counts until the gradient is updated\r\n" /end ANNOTATION_TEXT /end ANNOTATION
/end CHARACTERISTIC
/begin CHARACTERISTIC DST_CALIB.DST_In_OpShftGrad.DST_GRADPWRCOUNTSENSORONLY "" VALUE 0x806072EE DefaultValueRecordLayout_AUTOSAR_Platform_BaseTypes_uint16 65535.0 RB_PT_PCT_SWC_DST_CompuMethods_ident 0.0 65535. FORMAT "%10.5"
 /begin ANNOTATION ANNOTATION_LABEL "Description (coming from AUTOSAR DESC field)" /begin ANNOTATION_TEXT "Counts until the gradient is updated\r\n" /end ANNOTATION_TEXT /end ANNOTATION
/end CHARACTERISTIC
/begin CHARACTERISTIC DST_CALIB.DST_In_OpShftGrad.DST_GRADRAMPJERKSENSOR "" CURVE 0x80607340 RB_PT_PCT_SWC_DST_RecordLayouts_RL_Curve_uint16_5_sint16_5 32.0 RB_PT_PCT_SWC_DST_CompuMethods_ratio_0p001 0.0 32. FORMAT "%10.5"
 /begin ANNOTATION ANNOTATION_LABEL "Description (coming from AUTOSAR DESC field)"
  /begin ANNOTATION_TEXT "Rate of change of gradient based on vehicle acceleration\r\n" /end ANNOTATION_TEXT
 /end ANNOTATION
 /begin AXIS_DESCR STD_AXIS NO_INPUT_QUANTITY RB_PT_PCT_SWC_DST_CompuMethods_ratio_0p01 5 0.0 320. FORMAT "%10.5" DEPOSIT ABSOLUTE /end AXIS_DESCR
/end CHARACTERISTIC
/begin CHARACTERISTIC DST_CALIB.DST_In_OpShftGrad.DST_GRADRAMPJERKWHEELS "" CURVE 0x80607356 RB_PT_PCT_SWC_DST_RecordLayouts_RL_Curve_uint16_5_sint16_5 32.0 RB_PT_PCT_SWC_DST_CompuMethods_ratio_0p001 0.0 32. FORMAT "%10.5"
 /begin ANNOTATION ANNOTATION_LABEL "Description (coming from AUTOSAR DESC field)"
  /begin ANNOTATION_TEXT "Rate of change of gradient based on vehicle acceleration\r\n" /end ANNOTATION_TEXT
 /end ANNOTATION
 /begin AXIS_DESCR STD_AXIS NO_INPUT_QUANTITY RB_PT_PCT_SWC_DST_CompuMethods_ratio_0p01 5 0.0 320. FORMAT "%10.5" DEPOSIT ABSOLUTE /end AXIS_DESCR
/end CHARACTERISTIC
/begin CHARACTERISTIC DST_CALIB.DST_In_OpShftGrad.DST_GRADRAMPWHEELACCEL "" CURVE 0x8060736C RB_PT_PCT_SWC_DST_RecordLayouts_RL_Curve_uint16_5_sint16_5 32.0 RB_PT_PCT_SWC_DST_CompuMethods_ratio_0p001 0.0 32. FORMAT "%10.5"
 /begin ANNOTATION ANNOTATION_LABEL "Description (coming from AUTOSAR DESC field)"
  /begin ANNOTATION_TEXT "Rate of change of gradient based on vehicle acceleration\r\n" /end ANNOTATION_TEXT
 /end ANNOTATION
 /begin AXIS_DESCR STD_AXIS NO_INPUT_QUANTITY RB_PT_PCT_SWC_DST_CompuMethods_ratio_0p0001 5 -2. 2. FORMAT "%10.5" DEPOSIT ABSOLUTE /end AXIS_DESCR
/end CHARACTERISTIC
/begin CHARACTERISTIC DST_CALIB.DST_In_OpShftGrad.DST_GRADRAMPWHEELDIFF "" MAP 0x80607382 RB_PT_PCT_SWC_DST_RecordLayouts_RL_Map_uint16_25_uint16_5_uint16_5 32.0 RB_PT_PCT_SWC_DST_CompuMethods_ratio_0p001 0.0 32. FORMAT "%10.5"
 /begin ANNOTATION ANNOTATION_LABEL "Description (coming from AUTOSAR DESC field)"
  /begin ANNOTATION_TEXT "Difference in left and right wheel speeds, especially at low speeds\r\n" /end ANNOTATION_TEXT
 /end ANNOTATION
 /begin AXIS_DESCR STD_AXIS NO_INPUT_QUANTITY RB_PT_PCT_SWC_DST_CompuMethods_kph_0p1 5 0.0 10. FORMAT "%10.5" DEPOSIT ABSOLUTE /end AXIS_DESCR
 /begin AXIS_DESCR STD_AXIS NO_INPUT_QUANTITY RB_PT_PCT_SWC_DST_CompuMethods_kph_0p1 5 0.0 500. FORMAT "%10.5" DEPOSIT ABSOLUTE /end AXIS_DESCR
/end CHARACTERISTIC
/begin CHARACTERISTIC DST_CALIB.DST_In_OpShftGrad.DST_GRADVSPRESSUREFAILTIME "" VALUE 0x806072F0 DefaultValueRecordLayout_AUTOSAR_Platform_BaseTypes_uint16 655.35 RB_PT_PCT_SWC_DST_CompuMethods_DST_Time 0.0 655.35 FORMAT "%10.5"
 /begin ANNOTATION ANNOTATION_LABEL "Description (coming from AUTOSAR DESC field)"
  /begin ANNOTATION_TEXT "Debounce counter when altitude calculation makes gradient implausible\r\n" /end ANNOTATION_TEXT
 /end ANNOTATION
/end CHARACTERISTIC
/begin CHARACTERISTIC DST_CALIB.DST_In_OpShftGrad.DST_GRADWHEELSUNSIGNED "" VALUE 0x80607300 DefaultValueRecordLayout_AUTOSAR_Platform_BaseTypes_boolean 255.0 AUTOSAR_Platform_CompuMethods_boolean 0.0 255. FORMAT "%10.5"
 /begin ANNOTATION ANNOTATION_LABEL "Description (coming from AUTOSAR DESC field)" /begin ANNOTATION_TEXT "True if reference speed is unsigned\r\n" /end ANNOTATION_TEXT /end ANNOTATION
/end CHARACTERISTIC
/begin CHARACTERISTIC DST_CALIB.DST_In_OpShftGrad.DST_GSENSORLOWACTIVITY "" VALUE 0x806072F2 DefaultValueRecordLayout_AUTOSAR_Platform_BaseTypes_sint16 4.0 RB_PT_PCT_SWC_DST_CompuMethods_ratio_0p0001 -2. 2. FORMAT "%10.5"
 /begin ANNOTATION ANNOTATION_LABEL "Description (coming from AUTOSAR DESC field)"
  /begin ANNOTATION_TEXT "Threshold to see if the long acc sensor reading has frozen\r\n" /end ANNOTATION_TEXT
 /end ANNOTATION
/end CHARACTERISTIC
/begin CHARACTERISTIC DST_CALIB.DST_In_OpShftGrad.DST_GWHEELSHIGHACTIVITY "" VALUE 0x806072F4 DefaultValueRecordLayout_AUTOSAR_Platform_BaseTypes_sint16 4.0 RB_PT_PCT_SWC_DST_CompuMethods_ratio_0p0001 -2. 2. FORMAT "%10.5"
 /begin ANNOTATION ANNOTATION_LABEL "Description (coming from AUTOSAR DESC field)"
  /begin ANNOTATION_TEXT "Threshold above which wheels appear to be changing speed and can be used for calculation of gradient\r\n" /end ANNOTATION_TEXT
 /end ANNOTATION
/end CHARACTERISTIC
/begin CHARACTERISTIC DST_CALIB.DST_In_OpShftGrad.DST_LATACCSTATUSDISABLEGRAD "" VALUE 0x80607301 DefaultValueRecordLayout_AUTOSAR_Platform_BaseTypes_uint8 255.0 DefaultIdenticalCompu 0.0 255. FORMAT "%10.5" /end CHARACTERISTIC
/begin CHARACTERISTIC DST_CALIB.DST_In_OpShftGrad.DST_LONGACCSENSORMAX "" VALUE 0x806072F6 DefaultValueRecordLayout_AUTOSAR_Platform_BaseTypes_sint16 4.0 RB_PT_PCT_SWC_DST_CompuMethods_ratio_0p01 -2. 2. FORMAT "%10.5"
 /begin ANNOTATION ANNOTATION_LABEL "Description (coming from AUTOSAR DESC field)" /begin ANNOTATION_TEXT "Maximum expected value\r\n" /end ANNOTATION_TEXT /end ANNOTATION
/end CHARACTERISTIC
/begin CHARACTERISTIC DST_CALIB.DST_In_OpShftGrad.DST_LONGACCSENSORMIN "" VALUE 0x806072F8 DefaultValueRecordLayout_AUTOSAR_Platform_BaseTypes_sint16 4.0 RB_PT_PCT_SWC_DST_CompuMethods_ratio_0p01 -2. 2. FORMAT "%10.5"
 /begin ANNOTATION ANNOTATION_LABEL "Description (coming from AUTOSAR DESC field)" /begin ANNOTATION_TEXT "Minimum expected value\r\n" /end ANNOTATION_TEXT /end ANNOTATION
/end CHARACTERISTIC
/begin CHARACTERISTIC DST_CALIB.DST_In_OpShftGrad.DST_PressureToAltitude "" CURVE 0x806073CC RB_PT_PCT_SWC_DST_RecordLayouts_RL_Curve_sint16_9_uint16_9 8000.0 RB_PT_PCT_SWC_DST_CompuMethods_ident -1000. 7000. FORMAT "%10.5"
 /begin ANNOTATION ANNOTATION_LABEL "Description (coming from AUTOSAR DESC field)" /begin ANNOTATION_TEXT "Conversion from mBar to m altitde\r\n" /end ANNOTATION_TEXT /end ANNOTATION
 /begin AXIS_DESCR STD_AXIS NO_INPUT_QUANTITY RB_PT_PCT_SWC_DST_CompuMethods_ratio_0p001 9 0.0 2. FORMAT "%10.5" DEPOSIT ABSOLUTE /end AXIS_DESCR
/end CHARACTERISTIC
/begin CHARACTERISTIC DST_CALIB.DST_In_OpShftGrad.DST_PWRUPCNT2GRADCALC "" VALUE 0x806072FA DefaultValueRecordLayout_AUTOSAR_Platform_BaseTypes_uint16 65535.0 RB_PT_PCT_SWC_DST_CompuMethods_ident 0.0 65535. FORMAT "%10.5"
 /begin ANNOTATION ANNOTATION_LABEL "Description (coming from AUTOSAR DESC field)"
  /begin ANNOTATION_TEXT "Count values before the gradient calculation is enabled\r\n" /end ANNOTATION_TEXT
 /end ANNOTATION
/end CHARACTERISTIC
/begin CHARACTERISTIC DST_CALIB.DST_In_OpShftGrad.DST_USEWHEELACCUNTILGRADOK "" VALUE 0x80607302 DefaultValueRecordLayout_AUTOSAR_Platform_BaseTypes_uint8 255.0 DefaultIdenticalCompu 0.0 255. FORMAT "%10.5"
 /begin ANNOTATION ANNOTATION_LABEL "Description (coming from AUTOSAR DESC field)"
  /begin ANNOTATION_TEXT "If true, the wheel acceleration will be used until the gradient calculation is OK\r\n" /end ANNOTATION_TEXT
 /end ANNOTATION
/end CHARACTERISTIC
/begin CHARACTERISTIC DST_CALIB.DST_Ini.DST_HIGHRPMCONTINUOUSRPM "" VALUE 0x806073F2 DefaultValueRecordLayout_AUTOSAR_Platform_BaseTypes_sint16 20000.0 RB_PT_PCT_SWC_DST_CompuMethods_ident 0.0 20000. FORMAT "%10.5"
 /begin ANNOTATION ANNOTATION_LABEL "Description (coming from AUTOSAR DESC field)"
  /begin ANNOTATION_TEXT "RPm the transmission can only sustain for a certain time\r\n" /end ANNOTATION_TEXT
 /end ANNOTATION
/end CHARACTERISTIC
/begin CHARACTERISTIC DST_CALIB.DST_Ini.DST_HIGHRPMCONTINUOUSTIME "" VALUE 0x806073F4 DefaultValueRecordLayout_AUTOSAR_Platform_BaseTypes_uint16 655.35 RB_PT_PCT_SWC_DST_CompuMethods_DST_Time 0.0 655.35 FORMAT "%10.5"
 /begin ANNOTATION ANNOTATION_LABEL "Description (coming from AUTOSAR DESC field)" /begin ANNOTATION_TEXT "Time the transmission can sustain high rpm\r\n" /end ANNOTATION_TEXT /end ANNOTATION
/end CHARACTERISTIC
/begin CHARACTERISTIC DST_CALIB.DST_Ini.DST_HIGHRPMMAXTIME "" VALUE 0x806073F6 DefaultValueRecordLayout_AUTOSAR_Platform_BaseTypes_uint16 655.35 RB_PT_PCT_SWC_DST_CompuMethods_DST_Time 0.0 655.35 FORMAT "%10.5"
 /begin ANNOTATION ANNOTATION_LABEL "Description (coming from AUTOSAR DESC field)"
  /begin ANNOTATION_TEXT "The rpm the upper limit will be reduced by after the high rpm time has been exceeded\r\n" /end ANNOTATION_TEXT
 /end ANNOTATION
/end CHARACTERISTIC
/begin CHARACTERISTIC DST_CALIB.DST_Ini.DST_HIGHRPMRECOVERY "" CURVE 0x80607400 RB_PT_PCT_SWC_DST_RecordLayouts_RL_Curve_sint16_8_uint16_8 20000.0 RB_PT_PCT_SWC_DST_CompuMethods_ident 0.0 20000. FORMAT "%10.5"
 /begin ANNOTATION ANNOTATION_LABEL "Description (coming from AUTOSAR DESC field)"
  /begin ANNOTATION_TEXT "After the max rpm has been reduced, this increases the limit as DST_HighRpmRecoveryTimer increases\r\n" /end ANNOTATION_TEXT
 /end ANNOTATION
 /begin AXIS_DESCR STD_AXIS NO_INPUT_QUANTITY RB_PT_PCT_SWC_DST_CompuMethods_DST_Time 8 0.0 655.35 FORMAT "%10.5" DEPOSIT ABSOLUTE /end AXIS_DESCR
/end CHARACTERISTIC
/begin CHARACTERISTIC DST_CALIB.DST_Ini.DST_INHIBITUPDECRATE "" VALUE 0x806073FE DefaultValueRecordLayout_AUTOSAR_Platform_BaseTypes_uint8 255.0 RB_PT_PCT_SWC_DST_CompuMethods_ident 0.0 255. FORMAT "%10.5"
 /begin ANNOTATION ANNOTATION_LABEL "Description (coming from AUTOSAR DESC field)"
  /begin ANNOTATION_TEXT "Rate of decrease of rpm to inhibit unshifts if reduced.\r\n" /end ANNOTATION_TEXT
 /end ANNOTATION
/end CHARACTERISTIC
/begin CHARACTERISTIC DST_CALIB.DST_Ini.DST_OP2KMHMAX "" VALUE 0x806073F8 DefaultValueRecordLayout_AUTOSAR_Platform_BaseTypes_uint16 0.99 RB_PT_PCT_SWC_DST_CompuMethods_ratio_0p001 0.01 1. FORMAT "%10.5"
 /begin ANNOTATION ANNOTATION_LABEL "Description (coming from AUTOSAR DESC field)" /begin ANNOTATION_TEXT "Maximum adaption value of output to kmh\r\n" /end ANNOTATION_TEXT /end ANNOTATION
/end CHARACTERISTIC
/begin CHARACTERISTIC DST_CALIB.DST_Ini.DST_OP2KMHMIN "" VALUE 0x806073FA DefaultValueRecordLayout_AUTOSAR_Platform_BaseTypes_uint16 0.99 RB_PT_PCT_SWC_DST_CompuMethods_ratio_0p001 0.01 1. FORMAT "%10.5"
 /begin ANNOTATION ANNOTATION_LABEL "Description (coming from AUTOSAR DESC field)" /begin ANNOTATION_TEXT "Minimum adaption value of output to kmh\r\n" /end ANNOTATION_TEXT /end ANNOTATION
/end CHARACTERISTIC
/begin CHARACTERISTIC DST_CALIB.DST_Ini.DST_REDUCEOP2KMH "" VALUE 0x806073FC DefaultValueRecordLayout_AUTOSAR_Platform_BaseTypes_uint16 0.7999999999999999 RB_PT_PCT_SWC_DST_CompuMethods_ratio_0p001 0.6 1.4 FORMAT "%10.5"
 /begin ANNOTATION ANNOTATION_LABEL "Description (coming from AUTOSAR DESC field)"
  /begin ANNOTATION_TEXT "Factor to reduce OP2 KMH.  Result is vehicle speed is less reliant\r\n" /end ANNOTATION_TEXT
 /end ANNOTATION
/end CHARACTERISTIC
/begin CHARACTERISTIC DST_CALIB.DST_LATACCMAXSHIFT "" VALUE 0x806070D3 DefaultValueRecordLayout_AUTOSAR_Platform_BaseTypes_uint8 1.27 RB_PT_PCT_SWC_DST_CompuMethods_ratio_0p01 0.0 1.27 FORMAT "%10.5"
 /begin ANNOTATION ANNOTATION_LABEL "Description (coming from AUTOSAR DESC field)" /begin ANNOTATION_TEXT "Lateral acceleration above which shifts are disabled\r\n" /end ANNOTATION_TEXT /end ANNOTATION
/end CHARACTERISTIC
/begin CHARACTERISTIC DST_CALIB.DST_LatAccWheels.DST_LATACCBACKUPFROMWHEELS "" VALUE 0x80607430 DefaultValueRecordLayout_AUTOSAR_Platform_BaseTypes_boolean 255.0 AUTOSAR_Platform_CompuMethods_boolean 0.0 255. FORMAT "%10.5"
 /begin ANNOTATION ANNOTATION_LABEL "Description (coming from AUTOSAR DESC field)" /begin ANNOTATION_TEXT "If true, lateral acceleration is from the wheels\r\n" /end ANNOTATION_TEXT /end ANNOTATION
/end CHARACTERISTIC
/begin CHARACTERISTIC DST_CALIB.DST_LatAccWheels.DST_LATACCDELTAFAIL1D "" CURVE 0x8060743C RB_PT_PCT_SWC_DST_RecordLayouts_RL_Curve_uint8_6_uint16_6 1.27 RB_PT_PCT_SWC_DST_CompuMethods_ratio_0p01 0.0 1.27 FORMAT "%10.5"
 /begin ANNOTATION ANNOTATION_LABEL "Description (coming from AUTOSAR DESC field)"
  /begin ANNOTATION_TEXT "m/s speed input.  Lateral acceleration difference output\r\n" /end ANNOTATION_TEXT
 /end ANNOTATION
 /begin AXIS_DESCR STD_AXIS NO_INPUT_QUANTITY RB_PT_PCT_SWC_DST_CompuMethods_ratio_0p002 6 0.0 131.07 FORMAT "%10.5" DEPOSIT ABSOLUTE /end AXIS_DESCR
/end CHARACTERISTIC
/begin CHARACTERISTIC DST_CALIB.DST_LatAccWheels.DST_LATACCDELTAHEALENABLE "" VALUE 0x80607431 DefaultValueRecordLayout_AUTOSAR_Platform_BaseTypes_uint8 1.27 RB_PT_PCT_SWC_DST_CompuMethods_ratio_0p01 0.0 1.27 FORMAT "%10.5"
 /begin ANNOTATION ANNOTATION_LABEL "Description (coming from AUTOSAR DESC field)"
  /begin ANNOTATION_TEXT "Low lat acc threshold to compare to high threshold to check for error\r\n" /end ANNOTATION_TEXT
 /end ANNOTATION
/end CHARACTERISTIC
/begin CHARACTERISTIC DST_CALIB.DST_LatAccWheels.DST_LATACCDELTAOK "" VALUE 0x80607432 DefaultValueRecordLayout_AUTOSAR_Platform_BaseTypes_uint8 1.27 RB_PT_PCT_SWC_DST_CompuMethods_ratio_0p01 0.0 1.27 FORMAT "%10.5"
 /begin ANNOTATION ANNOTATION_LABEL "Description (coming from AUTOSAR DESC field)"
  /begin ANNOTATION_TEXT "Low lat acc threshold to compare to high threshold to check for error\r\n" /end ANNOTATION_TEXT
 /end ANNOTATION
/end CHARACTERISTIC
/begin CHARACTERISTIC DST_CALIB.DST_LatAccWheels.DST_LATACCFILTGAIN "" VALUE 0x80607433 DefaultValueRecordLayout_AUTOSAR_Platform_BaseTypes_uint8 1.0 RB_PT_PCT_SWC_DST_CompuMethods_ratio_0p01 0.0 1. FORMAT "%10.5"
 /begin ANNOTATION ANNOTATION_LABEL "Description (coming from AUTOSAR DESC field)"
  /begin ANNOTATION_TEXT "Filter gain calculating lateral acceleration from the wheels\r\n" /end ANNOTATION_TEXT
 /end ANNOTATION
/end CHARACTERISTIC
/begin CHARACTERISTIC DST_CALIB.DST_LatAccWheels.DST_LATACCFROMWHEELS "" VALUE 0x80607434 DefaultValueRecordLayout_AUTOSAR_Platform_BaseTypes_boolean 255.0 AUTOSAR_Platform_CompuMethods_boolean 0.0 255. FORMAT "%10.5"
 /begin ANNOTATION ANNOTATION_LABEL "Description (coming from AUTOSAR DESC field)" /begin ANNOTATION_TEXT "If true, lateral acceleration is from the wheels\r\n" /end ANNOTATION_TEXT /end ANNOTATION
/end CHARACTERISTIC
/begin CHARACTERISTIC DST_CALIB.DST_LatAccWheels.DST_LATACCPLAUSCOUNTDOWN "" VALUE 0x80607435 DefaultValueRecordLayout_AUTOSAR_Platform_BaseTypes_uint8 255.0 RB_PT_PCT_SWC_DST_CompuMethods_ident 0.0 255. FORMAT "%10.5"
 /begin ANNOTATION ANNOTATION_LABEL "Description (coming from AUTOSAR DESC field)" /begin ANNOTATION_TEXT "Rate at which plausibility timer counts down\r\n" /end ANNOTATION_TEXT /end ANNOTATION
/end CHARACTERISTIC
/begin CHARACTERISTIC DST_CALIB.DST_LatAccWheels.DST_LATACCPLAUSCOUNTER2FAILED "" VALUE 0x80607422 DefaultValueRecordLayout_AUTOSAR_Platform_BaseTypes_uint16 65535.0 RB_PT_PCT_SWC_DST_CompuMethods_ident 0.0 65535. FORMAT "%10.5"
 /begin ANNOTATION ANNOTATION_LABEL "Description (coming from AUTOSAR DESC field)"
  /begin ANNOTATION_TEXT "Counter above which lateral acceleration plausibility has failed\r\n" /end ANNOTATION_TEXT
 /end ANNOTATION
/end CHARACTERISTIC
/begin CHARACTERISTIC DST_CALIB.DST_LatAccWheels.DST_LATACCPLAUSCOUNTERMAX "" VALUE 0x80607424 DefaultValueRecordLayout_AUTOSAR_Platform_BaseTypes_uint16 65535.0 RB_PT_PCT_SWC_DST_CompuMethods_ident 0.0 65535. FORMAT "%10.5"
 /begin ANNOTATION ANNOTATION_LABEL "Description (coming from AUTOSAR DESC field)" /begin ANNOTATION_TEXT "Maximum counter value of plausibility timer\r\n" /end ANNOTATION_TEXT /end ANNOTATION
/end CHARACTERISTIC
/begin CHARACTERISTIC DST_CALIB.DST_LatAccWheels.DST_LATACCPLAUSCOUNTUP "" VALUE 0x80607436 DefaultValueRecordLayout_AUTOSAR_Platform_BaseTypes_uint8 255.0 RB_PT_PCT_SWC_DST_CompuMethods_ident 0.0 255. FORMAT "%10.5"
 /begin ANNOTATION ANNOTATION_LABEL "Description (coming from AUTOSAR DESC field)" /begin ANNOTATION_TEXT "Rate at which plausibility timer counts down\r\n" /end ANNOTATION_TEXT /end ANNOTATION
/end CHARACTERISTIC
/begin CHARACTERISTIC DST_CALIB.DST_LatAccWheels.DST_LATACCPLAUSDISABLESPEED "" VALUE 0x80607426 DefaultValueRecordLayout_AUTOSAR_Platform_BaseTypes_uint16 131.07 RB_PT_PCT_SWC_DST_CompuMethods_ratio_0p002 0.0 131.07 FORMAT "%10.5"
 /begin ANNOTATION ANNOTATION_LABEL "Description (coming from AUTOSAR DESC field)"
  /begin ANNOTATION_TEXT "Vehicle speed (in m/s) above which lateral acceleration plausibility is disabled\r\n" /end ANNOTATION_TEXT
 /end ANNOTATION
/end CHARACTERISTIC
/begin CHARACTERISTIC DST_CALIB.DST_LatAccWheels.DST_LATACCREJECTDELTA_AXLE "" VALUE 0x80607428 DefaultValueRecordLayout_AUTOSAR_Platform_BaseTypes_uint16 500.0 RB_PT_PCT_SWC_DST_CompuMethods_ratio_0p01 0.0 500. FORMAT "%10.5"
 /begin ANNOTATION ANNOTATION_LABEL "Description (coming from AUTOSAR DESC field)" /begin ANNOTATION_TEXT "Reject wheels due to cross axle speed difference\r\n" /end ANNOTATION_TEXT /end ANNOTATION
/end CHARACTERISTIC
/begin CHARACTERISTIC DST_CALIB.DST_LatAccWheels.DST_LATACCREJECTDELTA_ROC "" VALUE 0x8060742A DefaultValueRecordLayout_AUTOSAR_Platform_BaseTypes_uint16 500.0 RB_PT_PCT_SWC_DST_CompuMethods_ratio_0p01 0.0 500. FORMAT "%10.5"
 /begin ANNOTATION ANNOTATION_LABEL "Description (coming from AUTOSAR DESC field)" /begin ANNOTATION_TEXT "Reject wheels due to cross axle speed difference\r\n" /end ANNOTATION_TEXT /end ANNOTATION
/end CHARACTERISTIC
/begin CHARACTERISTIC DST_CALIB.DST_LatAccWheels.DST_LATACCREJECTDELTA_SIDE "" VALUE 0x8060742C DefaultValueRecordLayout_AUTOSAR_Platform_BaseTypes_uint16 500.0 RB_PT_PCT_SWC_DST_CompuMethods_ratio_0p01 0.0 500. FORMAT "%10.5"
 /begin ANNOTATION ANNOTATION_LABEL "Description (coming from AUTOSAR DESC field)" /begin ANNOTATION_TEXT "Reject wheels due to cross axle speed difference\r\n" /end ANNOTATION_TEXT /end ANNOTATION
/end CHARACTERISTIC
/begin CHARACTERISTIC DST_CALIB.DST_LatAccWheels.DST_LATACCREJECTPAUSETIME "" VALUE 0x80607437 DefaultValueRecordLayout_AUTOSAR_Platform_BaseTypes_uint8 2.55 RB_PT_PCT_SWC_DST_CompuMethods_DST_Time 0.0 2.55 FORMAT "%10.5"
 /begin ANNOTATION ANNOTATION_LABEL "Description (coming from AUTOSAR DESC field)"
  /begin ANNOTATION_TEXT "If there is a reason to reject the lat acc this is the time the calculated lat acc will be paused\r\n" /end ANNOTATION_TEXT
 /end ANNOTATION
/end CHARACTERISTIC
/begin CHARACTERISTIC DST_CALIB.DST_LatAccWheels.DST_LATACCREJECTRESETTIME "" VALUE 0x8060742E DefaultValueRecordLayout_AUTOSAR_Platform_BaseTypes_uint16 655.35 RB_PT_PCT_SWC_DST_CompuMethods_DST_Time 0.0 655.35 FORMAT "%10.5"
 /begin ANNOTATION ANNOTATION_LABEL "Description (coming from AUTOSAR DESC field)" /begin ANNOTATION_TEXT "If no update in this time then reset Lat Acc\r\n" /end ANNOTATION_TEXT /end ANNOTATION
/end CHARACTERISTIC
/begin CHARACTERISTIC DST_CALIB.DST_LatAccWheels.DST_LATACCREJECTSTATUS "" VALUE 0x80607438 DefaultValueRecordLayout_AUTOSAR_Platform_BaseTypes_boolean 255.0 AUTOSAR_Platform_CompuMethods_boolean 0.0 255. FORMAT "%10.5"
 /begin ANNOTATION ANNOTATION_LABEL "Description (coming from AUTOSAR DESC field)" /begin ANNOTATION_TEXT "Reset Lat acc if any wheel is failed\r\n" /end ANNOTATION_TEXT /end ANNOTATION
/end CHARACTERISTIC
/begin CHARACTERISTIC DST_CALIB.DST_LatAccWheels.DST_PAUSELATACCPLAUSABS "" VALUE 0x80607439 DefaultValueRecordLayout_AUTOSAR_Platform_BaseTypes_uint8 255.0 DefaultIdenticalCompu 0.0 255. FORMAT "%10.5"
 /begin ANNOTATION ANNOTATION_LABEL "Description (coming from AUTOSAR DESC field)"
  /begin ANNOTATION_TEXT "If true, lat acc plausibility will be reset if ABS / ESP intervention\r\n" /end ANNOTATION_TEXT
 /end ANNOTATION
/end CHARACTERISTIC
/begin CHARACTERISTIC DST_CALIB.DST_LatAccWheels.DST_RESETLATACCPLAUSABS "" VALUE 0x8060743A DefaultValueRecordLayout_AUTOSAR_Platform_BaseTypes_uint8 255.0 DefaultIdenticalCompu 0.0 255. FORMAT "%10.5"
 /begin ANNOTATION ANNOTATION_LABEL "Description (coming from AUTOSAR DESC field)"
  /begin ANNOTATION_TEXT "If true, lat acc plausibility will be reset if ABS / ESP intervention\r\n" /end ANNOTATION_TEXT
 /end ANNOTATION
/end CHARACTERISTIC
/begin CHARACTERISTIC DST_CALIB.DST_LATCHDIRECTIONMAKEFALSE "" VALUE 0x806070D4 DefaultValueRecordLayout_AUTOSAR_Platform_BaseTypes_uint8 255.0 DefaultIdenticalCompu 0.0 255. FORMAT "%10.5" /end CHARACTERISTIC
/begin CHARACTERISTIC DST_CALIB.DST_LATINALAUNCHSHIFTMODE "" VALUE 0x806070D5 DefaultValueRecordLayout_AUTOSAR_Platform_BaseTypes_uint8 16.0 RB_PT_PCT_SWC_DST_CompuMethods_ident 0.0 16. FORMAT "%10.5"
 /begin ANNOTATION ANNOTATION_LABEL "Description (coming from AUTOSAR DESC field)"
  /begin ANNOTATION_TEXT "The shift mode (maps) to use when performing a launch\r\n" /end ANNOTATION_TEXT
 /end ANNOTATION
/end CHARACTERISTIC
/begin CHARACTERISTIC DST_CALIB.DST_LAUNCHABORTSTOPSHIFTMODE "" VALUE 0x806070D6 DefaultValueRecordLayout_AUTOSAR_Platform_BaseTypes_boolean 255.0 AUTOSAR_Platform_CompuMethods_boolean 0.0 255. FORMAT "%10.5"
 /begin ANNOTATION ANNOTATION_LABEL "Description (coming from AUTOSAR DESC field)"
  /begin ANNOTATION_TEXT "If launch goes to abort then stop special launch shift mode\r\n" /end ANNOTATION_TEXT
 /end ANNOTATION
/end CHARACTERISTIC
/begin CHARACTERISTIC DST_CALIB.DST_LAUNCHDISPLAYMANAUTOMAPS "" VALUE 0x806070D7 DefaultValueRecordLayout_AUTOSAR_Platform_BaseTypes_boolean 255.0 AUTOSAR_Platform_CompuMethods_boolean 0.0 255. FORMAT "%10.5"
 /begin ANNOTATION ANNOTATION_LABEL "Description (coming from AUTOSAR DESC field)"
  /begin ANNOTATION_TEXT "If true in auto shift maps Manual will be displayed if lauch active\r\n" /end ANNOTATION_TEXT
 /end ANNOTATION
/end CHARACTERISTIC
/begin CHARACTERISTIC DST_CALIB.DST_LAUNCHDISPLAYMANMANMAPS "" VALUE 0x806070D8 DefaultValueRecordLayout_AUTOSAR_Platform_BaseTypes_boolean 255.0 AUTOSAR_Platform_CompuMethods_boolean 0.0 255. FORMAT "%10.5"
 /begin ANNOTATION ANNOTATION_LABEL "Description (coming from AUTOSAR DESC field)"
  /begin ANNOTATION_TEXT "If true and in launch mode manual will be displayed when shift mode is greater than 10\r\n" /end ANNOTATION_TEXT
 /end ANNOTATION
/end CHARACTERISTIC
/begin CHARACTERISTIC DST_CALIB.DST_LAUNCHINACTIVESTOPSHIFTMODE "" VALUE 0x806070D9 DefaultValueRecordLayout_AUTOSAR_Platform_BaseTypes_boolean 255.0 AUTOSAR_Platform_CompuMethods_boolean 0.0 255. FORMAT "%10.5"
 /begin ANNOTATION ANNOTATION_LABEL "Description (coming from AUTOSAR DESC field)"
  /begin ANNOTATION_TEXT "If true, if the launch mode goes to inactive the DST will not longer request the special launch shift mode\r\n" /end ANNOTATION_TEXT
 /end ANNOTATION
/end CHARACTERISTIC
/begin CHARACTERISTIC DST_CALIB.DST_LAUNCHMODECHANGEDISPLAY "" VALUE 0x806070DA DefaultValueRecordLayout_AUTOSAR_Platform_BaseTypes_boolean 255.0 AUTOSAR_Platform_CompuMethods_boolean 0.0 255. FORMAT "%10.5"
 /begin ANNOTATION ANNOTATION_LABEL "Description (coming from AUTOSAR DESC field)"
  /begin ANNOTATION_TEXT "If true and in launch mode, this display will change between manual and auto\r\n" /end ANNOTATION_TEXT
 /end ANNOTATION
/end CHARACTERISTIC
/begin CHARACTERISTIC DST_CALIB.DST_LAUNCHSHIFTPOINTSREQUEST "" VALUE 0x806070DB DefaultValueRecordLayout_AUTOSAR_Platform_BaseTypes_boolean 255.0 AUTOSAR_Platform_CompuMethods_boolean 0.0 255. FORMAT "%10.5"
 /begin ANNOTATION ANNOTATION_LABEL "Description (coming from AUTOSAR DESC field)"
  /begin ANNOTATION_TEXT "If true, the shift maps to be used will be special for a launch mode\r\n" /end ANNOTATION_TEXT
 /end ANNOTATION
/end CHARACTERISTIC
/begin CHARACTERISTIC DST_CALIB.DST_LAUNCHTHROTTLECANCEL "" VALUE 0x806070DC DefaultValueRecordLayout_AUTOSAR_Platform_BaseTypes_uint8 102.0 RB_PT_PCT_SWC_DST_CompuMethods_ratio_0p4 0.0 102. FORMAT "%10.5"
 /begin ANNOTATION ANNOTATION_LABEL "Description (coming from AUTOSAR DESC field)"
  /begin ANNOTATION_TEXT "Throttle angle below which launch mode shift map is cancelled\r\n" /end ANNOTATION_TEXT
 /end ANNOTATION
/end CHARACTERISTIC
/begin CHARACTERISTIC DST_CALIB.DST_LodiParkInterface.DST_ALLOWPARKDISENGAGE "" VALUE 0x80607480 DefaultValueRecordLayout_AUTOSAR_Platform_BaseTypes_boolean 255.0 AUTOSAR_Platform_CompuMethods_boolean 0.0 255. FORMAT "%10.5"
 /begin ANNOTATION ANNOTATION_LABEL "Description (coming from AUTOSAR DESC field)"
  /begin ANNOTATION_TEXT "For testing.  If false the state machine will think the pawl has not disengaged\r\n" /end ANNOTATION_TEXT
 /end ANNOTATION
/end CHARACTERISTIC
/begin CHARACTERISTIC DST_CALIB.DST_LodiParkInterface.DST_BOB_PARK "" VALUE 0x80607481 DefaultValueRecordLayout_AUTOSAR_Platform_BaseTypes_boolean 255.0 AUTOSAR_Platform_CompuMethods_boolean 0.0 255. FORMAT "%10.5"
 /begin ANNOTATION ANNOTATION_LABEL "Description (coming from AUTOSAR DESC field)"
  /begin ANNOTATION_TEXT "If true DST_BOB_PARKENGAGE used to change between Park and Not Park\r\n" /end ANNOTATION_TEXT
 /end ANNOTATION
/end CHARACTERISTIC
/begin CHARACTERISTIC DST_CALIB.DST_LodiParkInterface.DST_BOB_PARKENGAGE "" VALUE 0x80607482 DefaultValueRecordLayout_AUTOSAR_Platform_BaseTypes_boolean 255.0 AUTOSAR_Platform_CompuMethods_boolean 0.0 255. FORMAT "%10.5"
 /begin ANNOTATION ANNOTATION_LABEL "Description (coming from AUTOSAR DESC field)" /begin ANNOTATION_TEXT "If true and BOB enabled then Park will be requested\r\n" /end ANNOTATION_TEXT /end ANNOTATION
/end CHARACTERISTIC
/begin CHARACTERISTIC DST_CALIB.DST_LodiParkInterface.DST_DISENGAGEDT1_FLOWOFF "" VALUE 0x80607450 DefaultValueRecordLayout_AUTOSAR_Platform_BaseTypes_uint16 655.35 RB_PT_PCT_SWC_DST_CompuMethods_DST_Time 0.0 655.35 FORMAT "%10.5" /end CHARACTERISTIC
/begin CHARACTERISTIC DST_CALIB.DST_LodiParkInterface.DST_DISENGAGEDT2_PRESSOFF "" VALUE 0x80607452 DefaultValueRecordLayout_AUTOSAR_Platform_BaseTypes_uint16 655.35 RB_PT_PCT_SWC_DST_CompuMethods_DST_Time 0.0 655.35 FORMAT "%10.5" /end CHARACTERISTIC
/begin CHARACTERISTIC DST_CALIB.DST_LodiParkInterface.DST_DISENGAGEDT3_ADAPTDIS "" VALUE 0x80607454 DefaultValueRecordLayout_AUTOSAR_Platform_BaseTypes_uint16 655.35 RB_PT_PCT_SWC_DST_CompuMethods_DST_Time 0.0 655.35 FORMAT "%10.5" /end CHARACTERISTIC
/begin CHARACTERISTIC DST_CALIB.DST_LodiParkInterface.DST_ENGAGEDT1_FLOWOFF "" VALUE 0x80607456 DefaultValueRecordLayout_AUTOSAR_Platform_BaseTypes_uint16 655.35 RB_PT_PCT_SWC_DST_CompuMethods_DST_Time 0.0 655.35 FORMAT "%10.5" /end CHARACTERISTIC
/begin CHARACTERISTIC DST_CALIB.DST_LodiParkInterface.DST_ENGAGEDT2_PRESSOFF "" VALUE 0x80607458 DefaultValueRecordLayout_AUTOSAR_Platform_BaseTypes_uint16 655.35 RB_PT_PCT_SWC_DST_CompuMethods_DST_Time 0.0 655.35 FORMAT "%10.5" /end CHARACTERISTIC
/begin CHARACTERISTIC DST_CALIB.DST_LodiParkInterface.DST_ENGAGEDT3_ADAPTENG "" VALUE 0x8060745A DefaultValueRecordLayout_AUTOSAR_Platform_BaseTypes_uint16 655.35 RB_PT_PCT_SWC_DST_CompuMethods_DST_Time 0.0 655.35 FORMAT "%10.5" /end CHARACTERISTIC
/begin CHARACTERISTIC DST_CALIB.DST_LodiParkInterface.DST_EPBFAILCOUNTS "" VALUE 0x80607483 DefaultValueRecordLayout_AUTOSAR_Platform_BaseTypes_uint8 255.0 RB_PT_PCT_SWC_DST_CompuMethods_ident 0.0 255. FORMAT "%10.5"
 /begin ANNOTATION ANNOTATION_LABEL "Description (coming from AUTOSAR DESC field)"
  /begin ANNOTATION_TEXT "Counts to allow the EPB to report engaged from requesting it to engage\r\n" /end ANNOTATION_TEXT
 /end ANNOTATION
/end CHARACTERISTIC
/begin CHARACTERISTIC DST_CALIB.DST_LodiParkInterface.DST_EPBINPARKALWAYS "" VALUE 0x80607484 DefaultValueRecordLayout_AUTOSAR_Platform_BaseTypes_boolean 255.0 AUTOSAR_Platform_CompuMethods_boolean 0.0 255. FORMAT "%10.5"
 /begin ANNOTATION ANNOTATION_LABEL "Description (coming from AUTOSAR DESC field)" /begin ANNOTATION_TEXT "If true, the EPB will always be requested in Park\r\n" /end ANNOTATION_TEXT /end ANNOTATION
/end CHARACTERISTIC
/begin CHARACTERISTIC DST_CALIB.DST_LodiParkInterface.DST_PARKDISENGAGEMAXTIME "" VALUE 0x8060745C DefaultValueRecordLayout_AUTOSAR_Platform_BaseTypes_uint16 655.35 RB_PT_PCT_SWC_DST_CompuMethods_DST_Time 0.0 655.35 FORMAT "%10.5"
 /begin ANNOTATION ANNOTATION_LABEL "Description (coming from AUTOSAR DESC field)" /begin ANNOTATION_TEXT "Maximum time allowed to disengage Park\r\n" /end ANNOTATION_TEXT /end ANNOTATION
/end CHARACTERISTIC
/begin CHARACTERISTIC DST_CALIB.DST_LodiParkInterface.DST_PARKDISENGAGEWARNTIME "" VALUE 0x8060745E DefaultValueRecordLayout_AUTOSAR_Platform_BaseTypes_uint16 655.35 RB_PT_PCT_SWC_DST_CompuMethods_DST_Time 0.0 655.35 FORMAT "%10.5"
 /begin ANNOTATION ANNOTATION_LABEL "Description (coming from AUTOSAR DESC field)" /begin ANNOTATION_TEXT "Maximum time allowed to disengage Park\r\n" /end ANNOTATION_TEXT /end ANNOTATION
/end CHARACTERISTIC
/begin CHARACTERISTIC DST_CALIB.DST_LodiParkInterface.DST_PARKENGAGEMAXTIME "" VALUE 0x80607460 DefaultValueRecordLayout_AUTOSAR_Platform_BaseTypes_uint16 655.35 RB_PT_PCT_SWC_DST_CompuMethods_DST_Time 0.0 655.35 FORMAT "%10.5"
 /begin ANNOTATION ANNOTATION_LABEL "Description (coming from AUTOSAR DESC field)" /begin ANNOTATION_TEXT "Maximum time allowed to engage Park\r\n" /end ANNOTATION_TEXT /end ANNOTATION
/end CHARACTERISTIC
/begin CHARACTERISTIC DST_CALIB.DST_LodiParkInterface.DST_PARKENGAGEMAXTIMEB4EPB "" VALUE 0x80607462 DefaultValueRecordLayout_AUTOSAR_Platform_BaseTypes_uint16 655.35 RB_PT_PCT_SWC_DST_CompuMethods_DST_Time 0.0 655.35 FORMAT "%10.5"
 /begin ANNOTATION ANNOTATION_LABEL "Description (coming from AUTOSAR DESC field)" /begin ANNOTATION_TEXT "Maximum time allowed to engage Park\r\n" /end ANNOTATION_TEXT /end ANNOTATION
/end CHARACTERISTIC
/begin CHARACTERISTIC DST_CALIB.DST_LodiParkInterface.DST_PARKFAILENGAGEDBNCE "" VALUE 0x80607485 DefaultValueRecordLayout_AUTOSAR_Platform_BaseTypes_uint8 255.0 RB_PT_PCT_SWC_DST_CompuMethods_ident 0.0 255. FORMAT "%10.5"
 /begin ANNOTATION ANNOTATION_LABEL "Description (coming from AUTOSAR DESC field)" /begin ANNOTATION_TEXT "Loops Park needs to be not engaged\r\n" /end ANNOTATION_TEXT /end ANNOTATION
/end CHARACTERISTIC
/begin CHARACTERISTIC DST_CALIB.DST_LodiParkInterface.DST_PARKFLOWDISENGAGE "" VALUE 0x80607464 DefaultValueRecordLayout_AUTOSAR_Platform_BaseTypes_sint16 64.0 RB_PT_PCT_SWC_DST_CompuMethods_ratio_0p001 -32. 32. FORMAT "%10.5"
 /begin ANNOTATION ANNOTATION_LABEL "Description (coming from AUTOSAR DESC field)" /begin ANNOTATION_TEXT "Requested flow rate to disengage\r\n" /end ANNOTATION_TEXT /end ANNOTATION
/end CHARACTERISTIC
/begin CHARACTERISTIC DST_CALIB.DST_LodiParkInterface.DST_PARKFLOWENGAGE "" VALUE 0x80607466 DefaultValueRecordLayout_AUTOSAR_Platform_BaseTypes_sint16 64.0 RB_PT_PCT_SWC_DST_CompuMethods_ratio_0p001 -32. 32. FORMAT "%10.5"
 /begin ANNOTATION ANNOTATION_LABEL "Description (coming from AUTOSAR DESC field)" /begin ANNOTATION_TEXT "Requested flow rate to engage park\r\n" /end ANNOTATION_TEXT /end ANNOTATION
/end CHARACTERISTIC
/begin CHARACTERISTIC DST_CALIB.DST_LodiParkInterface.DST_PARKFLOWENGAGED "" VALUE 0x80607468 DefaultValueRecordLayout_AUTOSAR_Platform_BaseTypes_sint16 64.0 RB_PT_PCT_SWC_DST_CompuMethods_ratio_0p001 -32. 32. FORMAT "%10.5"
 /begin ANNOTATION ANNOTATION_LABEL "Description (coming from AUTOSAR DESC field)" /begin ANNOTATION_TEXT "Flow request for park when Park is engaged\r\n" /end ANNOTATION_TEXT /end ANNOTATION
/end CHARACTERISTIC
/begin CHARACTERISTIC DST_CALIB.DST_LodiParkInterface.DST_PARKFLOWENGAGEPROF "" CURVE 0x80607488 RB_PT_PCT_SWC_DST_RecordLayouts_RL_Curve_sint16_10_uint16_10 64.0 RB_PT_PCT_SWC_DST_CompuMethods_ratio_0p001 -32. 32. FORMAT "%10.5"
 /begin ANNOTATION ANNOTATION_LABEL "Description (coming from AUTOSAR DESC field)"
  /begin ANNOTATION_TEXT "Calibrate to allow mini minse of valve or soften engagement\r\n" /end ANNOTATION_TEXT
 /end ANNOTATION
 /begin AXIS_DESCR STD_AXIS NO_INPUT_QUANTITY RB_PT_PCT_SWC_DST_CompuMethods_DST_Time 10 0.0 655.35 FORMAT "%10.5" DEPOSIT ABSOLUTE /end AXIS_DESCR
/end CHARACTERISTIC
/begin CHARACTERISTIC DST_CALIB.DST_LodiParkInterface.DST_PARKLEARNGAIN "" VALUE 0x80607486 DefaultValueRecordLayout_AUTOSAR_Platform_BaseTypes_uint8 1.0 RB_PT_PCT_SWC_DST_CompuMethods_ratio_0p01 0.0 1. FORMAT "%10.5"
 /begin ANNOTATION ANNOTATION_LABEL "Description (coming from AUTOSAR DESC field)" /begin ANNOTATION_TEXT "Fraction of new position to apply to learnt position\r\n" /end ANNOTATION_TEXT /end ANNOTATION
/end CHARACTERISTIC
/begin CHARACTERISTIC DST_CALIB.DST_LodiParkInterface.DST_PARKMAXENGAGESPEED "" VALUE 0x8060746A DefaultValueRecordLayout_AUTOSAR_Platform_BaseTypes_uint16 500.0 RB_PT_PCT_SWC_DST_CompuMethods_kph_0p1 0.0 500. FORMAT "%10.5"
 /begin ANNOTATION ANNOTATION_LABEL "Description (coming from AUTOSAR DESC field)" /begin ANNOTATION_TEXT "Maximum speed to allow park to engage\r\n" /end ANNOTATION_TEXT /end ANNOTATION
/end CHARACTERISTIC
/begin CHARACTERISTIC DST_CALIB.DST_LodiParkInterface.DST_PARKWARNHOLDTIME "" VALUE 0x8060746C DefaultValueRecordLayout_AUTOSAR_Platform_BaseTypes_uint16 655.35 RB_PT_PCT_SWC_DST_CompuMethods_DST_Time 0.0 655.35 FORMAT "%10.5"
 /begin ANNOTATION ANNOTATION_LABEL "Description (coming from AUTOSAR DESC field)" /begin ANNOTATION_TEXT "Time to maintain the park warning flag\r\n" /end ANNOTATION_TEXT /end ANNOTATION
/end CHARACTERISTIC
/begin CHARACTERISTIC DST_CALIB.DST_LodiParkInterface.DST_POSPARKDISENGAGEDDefault "" VALUE 0x8060746E DefaultValueRecordLayout_AUTOSAR_Platform_BaseTypes_sint16 40.0 RB_PT_PCT_SWC_DST_CompuMethods_ratio_0p001 -20. 20. FORMAT "%10.5"
 /begin ANNOTATION ANNOTATION_LABEL "Description (coming from AUTOSAR DESC field)" /begin ANNOTATION_TEXT "Reset value of the disengaged position\r\n" /end ANNOTATION_TEXT /end ANNOTATION
/end CHARACTERISTIC
/begin CHARACTERISTIC DST_CALIB.DST_LodiParkInterface.DST_POSPARKDISENGAGEDHIGH "" VALUE 0x80607470 DefaultValueRecordLayout_AUTOSAR_Platform_BaseTypes_sint16 40.0 RB_PT_PCT_SWC_DST_CompuMethods_ratio_0p001 -20. 20. FORMAT "%10.5"
 /begin ANNOTATION ANNOTATION_LABEL "Description (coming from AUTOSAR DESC field)"
  /begin ANNOTATION_TEXT "Adapted engaged position of park brake that is higher than expected.\r\n" /end ANNOTATION_TEXT
 /end ANNOTATION
/end CHARACTERISTIC
/begin CHARACTERISTIC DST_CALIB.DST_LodiParkInterface.DST_POSPARKDISENGAGEDLOW "" VALUE 0x80607472 DefaultValueRecordLayout_AUTOSAR_Platform_BaseTypes_sint16 40.0 RB_PT_PCT_SWC_DST_CompuMethods_ratio_0p001 -20. 20. FORMAT "%10.5"
 /begin ANNOTATION ANNOTATION_LABEL "Description (coming from AUTOSAR DESC field)"
  /begin ANNOTATION_TEXT "Adapted engaged position of park brake that is higher than expected.\r\n" /end ANNOTATION_TEXT
 /end ANNOTATION
/end CHARACTERISTIC
/begin CHARACTERISTIC DST_CALIB.DST_LodiParkInterface.DST_POSPARKENGAGEDDefault "" VALUE 0x80607474 DefaultValueRecordLayout_AUTOSAR_Platform_BaseTypes_sint16 40.0 RB_PT_PCT_SWC_DST_CompuMethods_ratio_0p001 -20. 20. FORMAT "%10.5"
 /begin ANNOTATION ANNOTATION_LABEL "Description (coming from AUTOSAR DESC field)" /begin ANNOTATION_TEXT "Reset value of the engaged position\r\n" /end ANNOTATION_TEXT /end ANNOTATION
/end CHARACTERISTIC
/begin CHARACTERISTIC DST_CALIB.DST_LodiParkInterface.DST_POSPARKENGAGEDHIGH "" VALUE 0x80607476 DefaultValueRecordLayout_AUTOSAR_Platform_BaseTypes_sint16 40.0 RB_PT_PCT_SWC_DST_CompuMethods_ratio_0p001 -20. 20. FORMAT "%10.5"
 /begin ANNOTATION ANNOTATION_LABEL "Description (coming from AUTOSAR DESC field)"
  /begin ANNOTATION_TEXT "Adapted engaged position of park brake that is higher than expected.\r\n" /end ANNOTATION_TEXT
 /end ANNOTATION
/end CHARACTERISTIC
/begin CHARACTERISTIC DST_CALIB.DST_LodiParkInterface.DST_POSPARKENGAGEDLOW "" VALUE 0x80607478 DefaultValueRecordLayout_AUTOSAR_Platform_BaseTypes_sint16 40.0 RB_PT_PCT_SWC_DST_CompuMethods_ratio_0p001 -20. 20. FORMAT "%10.5"
 /begin ANNOTATION ANNOTATION_LABEL "Description (coming from AUTOSAR DESC field)"
  /begin ANNOTATION_TEXT "Adapted engaged position of park brake that is higher than expected.\r\n" /end ANNOTATION_TEXT
 /end ANNOTATION
/end CHARACTERISTIC
/begin CHARACTERISTIC DST_CALIB.DST_LodiParkInterface.DST_POSPARKLEARNOFFSET "" VALUE 0x8060747A DefaultValueRecordLayout_AUTOSAR_Platform_BaseTypes_sint16 40.0 RB_PT_PCT_SWC_DST_CompuMethods_ratio_0p001 -20. 20. FORMAT "%10.5"
 /begin ANNOTATION ANNOTATION_LABEL "Description (coming from AUTOSAR DESC field)"
  /begin ANNOTATION_TEXT "Position to subtract / add to the min/max limits when adapting\r\n" /end ANNOTATION_TEXT
 /end ANNOTATION
/end CHARACTERISTIC
/begin CHARACTERISTIC DST_CALIB.DST_LodiParkInterface.DST_POSPARKMAXTRIGADAPTDISENGAGE "" VALUE 0x8060747C DefaultValueRecordLayout_AUTOSAR_Platform_BaseTypes_sint16 40.0 RB_PT_PCT_SWC_DST_CompuMethods_ratio_0p001 -20. 20. FORMAT "%10.5"
 /begin ANNOTATION ANNOTATION_LABEL "Description (coming from AUTOSAR DESC field)" /begin ANNOTATION_TEXT "Lower limit to allow park to adat\r\n" /end ANNOTATION_TEXT /end ANNOTATION
/end CHARACTERISTIC
/begin CHARACTERISTIC DST_CALIB.DST_LodiParkInterface.DST_POSPARKMAXTRIGADAPTENGAGED "" VALUE 0x8060747E DefaultValueRecordLayout_AUTOSAR_Platform_BaseTypes_sint16 40.0 RB_PT_PCT_SWC_DST_CompuMethods_ratio_0p001 -20. 20. FORMAT "%10.5"
 /begin ANNOTATION ANNOTATION_LABEL "Description (coming from AUTOSAR DESC field)" /begin ANNOTATION_TEXT "Upper limit to allow park to adapt\r\n" /end ANNOTATION_TEXT /end ANNOTATION
/end CHARACTERISTIC
/begin CHARACTERISTIC DST_CALIB.DST_LodiParkInterface.DST_PRESSUREDISENGAGEOil "" CURVE 0x806074B2 RB_PT_PCT_SWC_DST_RecordLayouts_RL_Curve_uint16_6_sint16_6 32.0 RB_PT_PCT_SWC_DST_CompuMethods_ratio_0p001 0.0 32. FORMAT "%10.5"
 /begin ANNOTATION ANNOTATION_LABEL "Description (coming from AUTOSAR DESC field)"
  /begin ANNOTATION_TEXT "Requestee actuation pressure based on transs oil temperature\r\n" /end ANNOTATION_TEXT
 /end ANNOTATION
 /begin AXIS_DESCR STD_AXIS NO_INPUT_QUANTITY RB_PT_PCT_SWC_DST_CompuMethods_ident 6 -50. 200. FORMAT "%10.5" DEPOSIT ABSOLUTE /end AXIS_DESCR
/end CHARACTERISTIC
/begin CHARACTERISTIC DST_CALIB.DST_LodiParkInterface.DST_PRESSUREDISENGAGETime "" CURVE 0x806074CC RB_PT_PCT_SWC_DST_RecordLayouts_RL_Curve_uint16_5_uint16_5 32.0 RB_PT_PCT_SWC_DST_CompuMethods_ratio_0p001 0.0 32. FORMAT "%10.5"
 /begin ANNOTATION ANNOTATION_LABEL "Description (coming from AUTOSAR DESC field)" /begin ANNOTATION_TEXT "Pressure based on time engaging\r\n" /end ANNOTATION_TEXT /end ANNOTATION
 /begin AXIS_DESCR STD_AXIS NO_INPUT_QUANTITY RB_PT_PCT_SWC_DST_CompuMethods_DST_Time 5 0.0 655.35 FORMAT "%10.5" DEPOSIT ABSOLUTE /end AXIS_DESCR
/end CHARACTERISTIC
/begin CHARACTERISTIC DST_CALIB.DST_LodiParkInterface.DST_PRESSUREENGAGEOil "" CURVE 0x806074E2 RB_PT_PCT_SWC_DST_RecordLayouts_RL_Curve_uint16_6_sint16_6 32.0 RB_PT_PCT_SWC_DST_CompuMethods_ratio_0p001 0.0 32. FORMAT "%10.5"
 /begin ANNOTATION ANNOTATION_LABEL "Description (coming from AUTOSAR DESC field)"
  /begin ANNOTATION_TEXT "Requestee actuation pressure based on transs oil temperature\r\n" /end ANNOTATION_TEXT
 /end ANNOTATION
 /begin AXIS_DESCR STD_AXIS NO_INPUT_QUANTITY RB_PT_PCT_SWC_DST_CompuMethods_ident 6 -50. 200. FORMAT "%10.5" DEPOSIT ABSOLUTE /end AXIS_DESCR
/end CHARACTERISTIC
/begin CHARACTERISTIC DST_CALIB.DST_LodiParkInterface.DST_PRESSUREENGAGETime "" CURVE 0x806074FC RB_PT_PCT_SWC_DST_RecordLayouts_RL_Curve_uint16_5_uint16_5 32.0 RB_PT_PCT_SWC_DST_CompuMethods_ratio_0p001 0.0 32. FORMAT "%10.5"
 /begin ANNOTATION ANNOTATION_LABEL "Description (coming from AUTOSAR DESC field)" /begin ANNOTATION_TEXT "Engagement pressre based on time to engage\r\n" /end ANNOTATION_TEXT /end ANNOTATION
 /begin AXIS_DESCR STD_AXIS NO_INPUT_QUANTITY RB_PT_PCT_SWC_DST_CompuMethods_DST_Time 5 0.0 655.35 FORMAT "%10.5" DEPOSIT ABSOLUTE /end AXIS_DESCR
/end CHARACTERISTIC
/begin CHARACTERISTIC DST_CALIB.DST_LodiParkInterface.DST_RESETPARKPOSITIONS "" VALUE 0x80607487 DefaultValueRecordLayout_AUTOSAR_Platform_BaseTypes_boolean 255.0 AUTOSAR_Platform_CompuMethods_boolean 0.0 255. FORMAT "%10.5"
 /begin ANNOTATION ANNOTATION_LABEL "Description (coming from AUTOSAR DESC field)"
  /begin ANNOTATION_TEXT "If true the park adapted positions will be reset to the default values\r\n" /end ANNOTATION_TEXT
 /end ANNOTATION
/end CHARACTERISTIC
/begin CHARACTERISTIC DST_CALIB.DST_LONACCMAXSHIFT "" VALUE 0x8060706C DefaultValueRecordLayout_AUTOSAR_Platform_BaseTypes_sint16 4.0 RB_PT_PCT_SWC_DST_CompuMethods_ratio_0p01 -2. 2. FORMAT "%10.5"
 /begin ANNOTATION ANNOTATION_LABEL "Description (coming from AUTOSAR DESC field)"
  /begin ANNOTATION_TEXT "Longitudinal acceleration above which shifting will be disabled\r\n" /end ANNOTATION_TEXT
 /end ANNOTATION
/end CHARACTERISTIC
/begin CHARACTERISTIC DST_CALIB.DST_LONGACCFAULTIGNOREMONITOR "" VALUE 0x806070DD DefaultValueRecordLayout_AUTOSAR_Platform_BaseTypes_uint8 255.0 DefaultIdenticalCompu 0.0 255. FORMAT "%10.5" /end CHARACTERISTIC
/begin CHARACTERISTIC DST_CALIB.DST_LONGACCMINSHIFT "" VALUE 0x8060706E DefaultValueRecordLayout_AUTOSAR_Platform_BaseTypes_sint16 4.0 RB_PT_PCT_SWC_DST_CompuMethods_ratio_0p01 -2. 2. FORMAT "%10.5"
 /begin ANNOTATION ANNOTATION_LABEL "Description (coming from AUTOSAR DESC field)"
  /begin ANNOTATION_TEXT "Minimum longitudinal acceleration below which shifting will be disabled\r\n" /end ANNOTATION_TEXT
 /end ANNOTATION
/end CHARACTERISTIC
/begin CHARACTERISTIC DST_CALIB.DST_MANDISABLEDRIVEMODE "" VAL_BLK 0x80606FFD DefaultValueRecordLayout_AUTOSAR_Platform_BaseTypes_boolean 255.0 AUTOSAR_Platform_CompuMethods_boolean 0.0 255. FORMAT "%10.5"
 /begin ANNOTATION ANNOTATION_LABEL "Description (coming from AUTOSAR DESC field)"
  /begin ANNOTATION_TEXT "Depending on IOP_DriveModeTrans, can be used to disable manual shifting modes\r\n" /end ANNOTATION_TEXT
 /end ANNOTATION
 MATRIX_DIM 16 1 1 /end CHARACTERISTIC
/begin CHARACTERISTIC DST_CALIB.DST_MANSHIFTINGPADDLESOFF "" VALUE 0x806070DE DefaultValueRecordLayout_AUTOSAR_Platform_BaseTypes_boolean 255.0 AUTOSAR_Platform_CompuMethods_boolean 0.0 255. FORMAT "%10.5"
 /begin ANNOTATION ANNOTATION_LABEL "Description (coming from AUTOSAR DESC field)"
  /begin ANNOTATION_TEXT "If true and DST_ManShiftingDisable is True, the shift paddles will be ignored\r\n" /end ANNOTATION_TEXT
 /end ANNOTATION
/end CHARACTERISTIC
/begin CHARACTERISTIC DST_CALIB.DST_MANUALMODEONLY "" VAL_BLK 0x8060700D DefaultValueRecordLayout_AUTOSAR_Platform_BaseTypes_boolean 255.0 AUTOSAR_Platform_CompuMethods_boolean 0.0 255. FORMAT "%10.5"
 /begin ANNOTATION ANNOTATION_LABEL "Description (coming from AUTOSAR DESC field)"
  /begin ANNOTATION_TEXT "If true, this value of IOP_DriveModeTrans will force to manual mode\r\n" /end ANNOTATION_TEXT
 /end ANNOTATION
 MATRIX_DIM 16 1 1 /end CHARACTERISTIC
/begin CHARACTERISTIC DST_CALIB.DST_MINENGSPDFORMANUAL "" VALUE 0x80607070 DefaultValueRecordLayout_AUTOSAR_Platform_BaseTypes_uint16 20000.0 RB_PT_PCT_SWC_DST_CompuMethods_ident 0.0 20000. FORMAT "%10.5" /end CHARACTERISTIC
/begin CHARACTERISTIC DST_CALIB.DST_MODEFAULT2NEUTRAL "" VALUE 0x806070DF DefaultValueRecordLayout_AUTOSAR_Platform_BaseTypes_uint8 255.0 RB_PT_PCT_SWC_DST_CompuMethods_ident 0.0 255. FORMAT "%10.5"
 /begin ANNOTATION ANNOTATION_LABEL "Description (coming from AUTOSAR DESC field)"
  /begin ANNOTATION_TEXT "Number of program loops before an L2 request for Neutral is performed (debounce)\r\n" /end ANNOTATION_TEXT
 /end ANNOTATION
/end CHARACTERISTIC
/begin CHARACTERISTIC DST_CALIB.DST_ModeSelectGeneric.DST_AGGRESSIONSPORTINDEX "" MAP 0x80607646 RB_PT_PCT_SWC_DST_RecordLayouts_RL_Map_uint8_16_uint8_8_uint8_2 2.0 RB_PT_PCT_SWC_DST_CompuMethods_ident 1. 3. FORMAT "%10.5"
 /begin ANNOTATION ANNOTATION_LABEL "Description (coming from AUTOSAR DESC field)"
  /begin ANNOTATION_TEXT "Convert aggression to upper and lower valuve of sport index (hyst)\r\n" /end ANNOTATION_TEXT
 /end ANNOTATION
 /begin AXIS_DESCR STD_AXIS NO_INPUT_QUANTITY RB_PT_PCT_SWC_DST_CompuMethods_percent_0p5 8 0.0 100. FORMAT "%10.5" DEPOSIT ABSOLUTE /end AXIS_DESCR
 /begin AXIS_DESCR STD_AXIS NO_INPUT_QUANTITY RB_PT_PCT_SWC_DST_CompuMethods_ident 2 0.0 1. FORMAT "%10.5" DEPOSIT ABSOLUTE /end AXIS_DESCR
/end CHARACTERISTIC
/begin CHARACTERISTIC DST_CALIB.DST_ModeSelectGeneric.DST_GRADPEAKHOLDDECAYNEG "" VALUE 0x8060755C DefaultValueRecordLayout_AUTOSAR_Platform_BaseTypes_uint16 32.7 RB_PT_PCT_SWC_DST_CompuMethods_ratio_0p001 0.0 32.7 FORMAT "%10.5"
 /begin ANNOTATION ANNOTATION_LABEL "Description (coming from AUTOSAR DESC field)" /begin ANNOTATION_TEXT "Decay rate of peak held negative gradient\r\n" /end ANNOTATION_TEXT /end ANNOTATION
/end CHARACTERISTIC
/begin CHARACTERISTIC DST_CALIB.DST_ModeSelectGeneric.DST_GRADPEAKHOLDDECAYPOS "" VALUE 0x8060755E DefaultValueRecordLayout_AUTOSAR_Platform_BaseTypes_uint16 32.7 RB_PT_PCT_SWC_DST_CompuMethods_ratio_0p001 0.0 32.7 FORMAT "%10.5"
 /begin ANNOTATION ANNOTATION_LABEL "Description (coming from AUTOSAR DESC field)" /begin ANNOTATION_TEXT "Decay rate of peak held negative gradient\r\n" /end ANNOTATION_TEXT /end ANNOTATION
/end CHARACTERISTIC
/begin CHARACTERISTIC DST_CALIB.DST_ModeSelectGeneric.DST_GRADPEAKHOLDTIMENEG "" VALUE 0x80607560 DefaultValueRecordLayout_AUTOSAR_Platform_BaseTypes_uint16 655.35 RB_PT_PCT_SWC_DST_CompuMethods_DST_Time 0.0 655.35 FORMAT "%10.5"
 /begin ANNOTATION ANNOTATION_LABEL "Description (coming from AUTOSAR DESC field)" /begin ANNOTATION_TEXT "Time the negative peak held gradient will be held\r\n" /end ANNOTATION_TEXT /end ANNOTATION
/end CHARACTERISTIC
/begin CHARACTERISTIC DST_CALIB.DST_ModeSelectGeneric.DST_GRADPEAKHOLDTIMEPOS "" VALUE 0x80607562 DefaultValueRecordLayout_AUTOSAR_Platform_BaseTypes_uint16 655.35 RB_PT_PCT_SWC_DST_CompuMethods_DST_Time 0.0 655.35 FORMAT "%10.5"
 /begin ANNOTATION ANNOTATION_LABEL "Description (coming from AUTOSAR DESC field)" /begin ANNOTATION_TEXT "Time the negative peak held gradient will be held\r\n" /end ANNOTATION_TEXT /end ANNOTATION
/end CHARACTERISTIC
/begin CHARACTERISTIC DST_CALIB.DST_ModeSelectGeneric.DST_INI2PIFSTOPPED "" VALUE 0x80607572 DefaultValueRecordLayout_AUTOSAR_Platform_BaseTypes_boolean 255.0 AUTOSAR_Platform_CompuMethods_boolean 0.0 255. FORMAT "%10.5"
 /begin ANNOTATION ANNOTATION_LABEL "Description (coming from AUTOSAR DESC field)"
  /begin ANNOTATION_TEXT "If true, regardless of the park brake state, on power up and vehicle stationary, Park will be engaged\r\n" /end ANNOTATION_TEXT
 /end ANNOTATION
/end CHARACTERISTIC
/begin CHARACTERISTIC DST_CALIB.DST_ModeSelectGeneric.DST_MANUALMODEPTRAINMODE "" VAL_BLK 0x80607534 DefaultValueRecordLayout_AUTOSAR_Platform_BaseTypes_boolean 255.0 AUTOSAR_Platform_CompuMethods_boolean 0.0 255. FORMAT "%10.5"
 /begin ANNOTATION ANNOTATION_LABEL "Description (coming from AUTOSAR DESC field)"
  /begin ANNOTATION_TEXT "Allows or prevents manual mode depending on powertrain mode\r\n" /end ANNOTATION_TEXT
 /end ANNOTATION
 MATRIX_DIM 16 1 1 /end CHARACTERISTIC
/begin CHARACTERISTIC DST_CALIB.DST_ModeSelectGeneric.DST_PARKMAXENGAGESPEED "" VALUE 0x80607564 DefaultValueRecordLayout_AUTOSAR_Platform_BaseTypes_uint16 500.0 RB_PT_PCT_SWC_DST_CompuMethods_kph_0p1 0.0 500. FORMAT "%10.5"
 /begin ANNOTATION ANNOTATION_LABEL "Description (coming from AUTOSAR DESC field)" /begin ANNOTATION_TEXT "Maximum speed allowed to select Park\r\n" /end ANNOTATION_TEXT /end ANNOTATION
/end CHARACTERISTIC
/begin CHARACTERISTIC DST_CALIB.DST_ModeSelectGeneric.DST_PARKWITHKL5OFF "" VALUE 0x80607573 DefaultValueRecordLayout_AUTOSAR_Platform_BaseTypes_boolean 255.0 AUTOSAR_Platform_CompuMethods_boolean 0.0 255. FORMAT "%10.5"
 /begin ANNOTATION ANNOTATION_LABEL "Description (coming from AUTOSAR DESC field)"
  /begin ANNOTATION_TEXT "If true, park will always be engaged when KL15 is switch off\r\n" /end ANNOTATION_TEXT
 /end ANNOTATION
/end CHARACTERISTIC
/begin CHARACTERISTIC DST_CALIB.DST_ModeSelectGeneric.DST_POWERTRAIN2MODE "" VAL_BLK 0x80607544 DefaultValueRecordLayout_AUTOSAR_Platform_BaseTypes_uint8 11.0 RB_PT_PCT_SWC_DST_CompuMethods_Enumerations_DST_Mode 0.0 11. FORMAT "%10.5"
 /begin ANNOTATION ANNOTATION_LABEL "Description (coming from AUTOSAR DESC field)" /begin ANNOTATION_TEXT "Conversion from powertrain mode to transmission mode\r\n" /end ANNOTATION_TEXT /end ANNOTATION
 MATRIX_DIM 16 1 1 /end CHARACTERISTIC
/begin CHARACTERISTIC DST_CALIB.DST_ModeSelectGeneric.DST_POWERUPTIME "" VALUE 0x80607566 DefaultValueRecordLayout_AUTOSAR_Platform_BaseTypes_uint16 655.35 RB_PT_PCT_SWC_DST_CompuMethods_DST_Time 0.0 655.35 FORMAT "%10.5"
 /begin ANNOTATION ANNOTATION_LABEL "Description (coming from AUTOSAR DESC field)"
  /begin ANNOTATION_TEXT "Time the vehicle has been powered up before allowing normal operation\r\n" /end ANNOTATION_TEXT
 /end ANNOTATION
/end CHARACTERISTIC
/begin CHARACTERISTIC DST_CALIB.DST_ModeSelectGeneric.DST_RoadDetect.DST_CITYEXITTIME "" MAP 0x8060757C RB_PT_PCT_SWC_DST_RecordLayouts_RL_Map_uint16_85_uint16_5_uint8_17 655.35 RB_PT_PCT_SWC_DST_CompuMethods_DST_Time 0.0 655.35 FORMAT "%10.5"
 /begin ANNOTATION ANNOTATION_LABEL "Description (coming from AUTOSAR DESC field)"
  /begin ANNOTATION_TEXT "Time to exit City based on shift mode and reference speed\r\n" /end ANNOTATION_TEXT
 /end ANNOTATION
 /begin AXIS_DESCR STD_AXIS NO_INPUT_QUANTITY RB_PT_PCT_SWC_DST_CompuMethods_kph_0p1 5 0.0 500. FORMAT "%10.5" DEPOSIT ABSOLUTE /end AXIS_DESCR
 /begin AXIS_DESCR STD_AXIS NO_INPUT_QUANTITY RB_PT_PCT_SWC_DST_CompuMethods_ident 17 0.0 16. FORMAT "%10.5" DEPOSIT ABSOLUTE /end AXIS_DESCR
/end CHARACTERISTIC
/begin CHARACTERISTIC DST_CALIB.DST_ModeSelectGeneric.DST_RoadDetect.DST_STOPGOCANCEL "" VALUE 0x80607578 DefaultValueRecordLayout_AUTOSAR_Platform_BaseTypes_uint16 500.0 RB_PT_PCT_SWC_DST_CompuMethods_kph_0p1 0.0 500. FORMAT "%10.5"
 /begin ANNOTATION ANNOTATION_LABEL "Description (coming from AUTOSAR DESC field)" /begin ANNOTATION_TEXT "Vehicle speed above which stop go counter is reset\r\n" /end ANNOTATION_TEXT /end ANNOTATION
/end CHARACTERISTIC
/begin CHARACTERISTIC DST_CALIB.DST_ModeSelectGeneric.DST_RoadDetect.DST_STOPGOINCREASEHI "" VALUE 0x8060757A DefaultValueRecordLayout_AUTOSAR_Platform_BaseTypes_uint16 500.0 RB_PT_PCT_SWC_DST_CompuMethods_kph_0p1 0.0 500. FORMAT "%10.5"
 /begin ANNOTATION ANNOTATION_LABEL "Description (coming from AUTOSAR DESC field)" /begin ANNOTATION_TEXT "Vehicle speed above which counter will be increased\r\n" /end ANNOTATION_TEXT /end ANNOTATION
/end CHARACTERISTIC
/begin CHARACTERISTIC DST_CALIB.DST_ModeSelectGeneric.DST_SLOWDOWNFORMODECHANGEDISPLAYTIME "" VALUE 0x80607568 DefaultValueRecordLayout_AUTOSAR_Platform_BaseTypes_uint16 65535.0 RB_PT_PCT_SWC_DST_CompuMethods_ident 0.0 65535. FORMAT "%10.5"
 /begin ANNOTATION ANNOTATION_LABEL "Description (coming from AUTOSAR DESC field)" /begin ANNOTATION_TEXT "Counts\r\n" /end ANNOTATION_TEXT /end ANNOTATION
/end CHARACTERISTIC
/begin CHARACTERISTIC DST_CALIB.DST_ModeSelectGeneric.DST_SPORTINCMODECHNG "" VAL_BLK 0x80607554 DefaultValueRecordLayout_AUTOSAR_Platform_BaseTypes_sint16 102.0 RB_PT_PCT_SWC_DST_CompuMethods_ratio_0p005 0.0 102. FORMAT "%10.5"
 /begin ANNOTATION ANNOTATION_LABEL "Description (coming from AUTOSAR DESC field)"
  /begin ANNOTATION_TEXT "Increaser in Throttle Peak held due to change to Sport\r\n" /end ANNOTATION_TEXT
 /end ANNOTATION
 MATRIX_DIM 4 1 1 /end CHARACTERISTIC
/begin CHARACTERISTIC DST_CALIB.DST_ModeSelectGeneric.DST_SPORTINDEX_KMH "" CURVE 0x80607664 RB_PT_PCT_SWC_DST_RecordLayouts_RL_Curve_uint8_6_uint16_6 100.0 RB_PT_PCT_SWC_DST_CompuMethods_percent_0p5 0.0 100. FORMAT "%10.5"
 /begin ANNOTATION ANNOTATION_LABEL "Description (coming from AUTOSAR DESC field)" /begin ANNOTATION_TEXT "Impact on sport index from vehicle speed\r\n" /end ANNOTATION_TEXT /end ANNOTATION
 /begin AXIS_DESCR STD_AXIS NO_INPUT_QUANTITY RB_PT_PCT_SWC_DST_CompuMethods_kph_0p1 6 0.0 500. FORMAT "%10.5" DEPOSIT ABSOLUTE /end AXIS_DESCR
/end CHARACTERISTIC
/begin CHARACTERISTIC DST_CALIB.DST_ModeSelectGeneric.DST_SPORTINDEX_KMHDECAY "" VALUE 0x80607577 DefaultValueRecordLayout_AUTOSAR_Platform_BaseTypes_uint8 25.5 RB_PT_PCT_SWC_DST_CompuMethods_kph_0p1 0.0 25.5 FORMAT "%10.5"
 /begin ANNOTATION ANNOTATION_LABEL "Description (coming from AUTOSAR DESC field)" /begin ANNOTATION_TEXT "Rate of decrease in peak speed used in sport index\r\n" /end ANNOTATION_TEXT /end ANNOTATION
/end CHARACTERISTIC
/begin CHARACTERISTIC DST_CALIB.DST_ModeSelectGeneric.DST_SPORTINDEX_THROTTLE "" CURVE 0x80607678 RB_PT_PCT_SWC_DST_RecordLayouts_RL_Curve_uint8_6_sint16_6 100.0 RB_PT_PCT_SWC_DST_CompuMethods_percent_0p5 0.0 100. FORMAT "%10.5"
 /begin ANNOTATION ANNOTATION_LABEL "Description (coming from AUTOSAR DESC field)" /begin ANNOTATION_TEXT "Impact on sport index from driver demand\r\n" /end ANNOTATION_TEXT /end ANNOTATION
 /begin AXIS_DESCR STD_AXIS NO_INPUT_QUANTITY RB_PT_PCT_SWC_DST_CompuMethods_ratio_0p005 6 0.0 102. FORMAT "%10.5" DEPOSIT ABSOLUTE /end AXIS_DESCR
/end CHARACTERISTIC
/begin CHARACTERISTIC DST_CALIB.DST_ModeSelectGeneric.DST_SPORTINDEXPAUSEMAXTHROTTLE "" VALUE 0x80607574 DefaultValueRecordLayout_AUTOSAR_Platform_BaseTypes_uint8 102.0 RB_PT_PCT_SWC_DST_CompuMethods_ratio_0p4 0.0 102. FORMAT "%10.5"
 /begin ANNOTATION ANNOTATION_LABEL "Description (coming from AUTOSAR DESC field)"
  /begin ANNOTATION_TEXT "Sport index will be pause after a shift if the throttle is between DST_SPORTINDEXPAUSEMINTHROTTLE and MAXTHROTTLE\r\n" /end ANNOTATION_TEXT
 /end ANNOTATION
/end CHARACTERISTIC
/begin CHARACTERISTIC DST_CALIB.DST_ModeSelectGeneric.DST_SPORTINDEXPAUSEMINTHROTTLE "" VALUE 0x80607575 DefaultValueRecordLayout_AUTOSAR_Platform_BaseTypes_uint8 102.0 RB_PT_PCT_SWC_DST_CompuMethods_ratio_0p4 0.0 102. FORMAT "%10.5"
 /begin ANNOTATION ANNOTATION_LABEL "Description (coming from AUTOSAR DESC field)"
  /begin ANNOTATION_TEXT "Sport index will be pause after a shift if the throttle is between DST_SPORTINDEXPAUSEMINTHROTTLE and MAXTHROTTLE\r\n" /end ANNOTATION_TEXT
 /end ANNOTATION
/end CHARACTERISTIC
/begin CHARACTERISTIC DST_CALIB.DST_ModeSelectGeneric.DST_SPORTINDEXRESETSPEED "" VALUE 0x8060756A DefaultValueRecordLayout_AUTOSAR_Platform_BaseTypes_uint16 500.0 RB_PT_PCT_SWC_DST_CompuMethods_kph_0p1 0.0 500. FORMAT "%10.5"
 /begin ANNOTATION ANNOTATION_LABEL "Description (coming from AUTOSAR DESC field)"
  /begin ANNOTATION_TEXT "When the reference speed is below this speed a timer will increase.  When the timer exceeds DST_SPORTINDEXRESETTIME the sport index will be set to 0\r\n" /end ANNOTATION_TEXT
 /end ANNOTATION
/end CHARACTERISTIC
/begin CHARACTERISTIC DST_CALIB.DST_ModeSelectGeneric.DST_SPORTINDEXRESETTIME "" VALUE 0x8060756C DefaultValueRecordLayout_AUTOSAR_Platform_BaseTypes_uint16 655.35 RB_PT_PCT_SWC_DST_CompuMethods_DST_Time 0.0 655.35 FORMAT "%10.5"
 /begin ANNOTATION ANNOTATION_LABEL "Description (coming from AUTOSAR DESC field)"
  /begin ANNOTATION_TEXT "Time below DST_SPORTINDEXRESETSPEED to reset the sport index to 1\r\n" /end ANNOTATION_TEXT
 /end ANNOTATION
/end CHARACTERISTIC
/begin CHARACTERISTIC DST_CALIB.DST_ModeSelectGeneric.DST_SPORTINDEXTHROTTLEALWAYSUPDATE "" VALUE 0x80607576 DefaultValueRecordLayout_AUTOSAR_Platform_BaseTypes_uint8 102.0 RB_PT_PCT_SWC_DST_CompuMethods_ratio_0p4 0.0 102. FORMAT "%10.5"
 /begin ANNOTATION ANNOTATION_LABEL "Description (coming from AUTOSAR DESC field)"
  /begin ANNOTATION_TEXT "Throttle angle above which sport index will always be updated\r\n" /end ANNOTATION_TEXT
 /end ANNOTATION
/end CHARACTERISTIC
/begin CHARACTERISTIC DST_CALIB.DST_ModeSelectGeneric.DST_TIME2BRAKEDECAYRESETGa "" VAL_BLK 0x80607512 DefaultValueRecordLayout_AUTOSAR_Platform_BaseTypes_uint8 2.0 RB_PT_PCT_SWC_DST_CompuMethods_ratio_0p01 0.0 2. FORMAT "%10.5"
 /begin ANNOTATION ANNOTATION_LABEL "Description (coming from AUTOSAR DESC field)"
  /begin ANNOTATION_TEXT "Braking G above which DST_Tome2BrakeDecay is set high\r\n" /end ANNOTATION_TEXT
 /end ANNOTATION
 MATRIX_DIM 17 1 1 /end CHARACTERISTIC
/begin CHARACTERISTIC DST_CALIB.DST_ModeSelectGeneric.DST_TIME2CORNERRESETG "" VAL_BLK 0x80607523 DefaultValueRecordLayout_AUTOSAR_Platform_BaseTypes_uint8 1.27 RB_PT_PCT_SWC_DST_CompuMethods_ratio_0p01 0.0 1.27 FORMAT "%10.5"
 /begin ANNOTATION ANNOTATION_LABEL "Description (coming from AUTOSAR DESC field)"
  /begin ANNOTATION_TEXT "Depending on shift mode, lateral acceleration that will cause the peak held  to be updated and high timer reset\r\n" /end ANNOTATION_TEXT
 /end ANNOTATION
 MATRIX_DIM 17 1 1 /end CHARACTERISTIC
/begin CHARACTERISTIC DST_CALIB.DST_ModeSelectGeneric.DST_TIMEPOSTENGRUNKEEPENGOFFMAPS "" VALUE 0x8060756E DefaultValueRecordLayout_AUTOSAR_Platform_BaseTypes_uint16 655.35 RB_PT_PCT_SWC_DST_CompuMethods_DST_Time 0.0 655.35 FORMAT "%10.5"
 /begin ANNOTATION ANNOTATION_LABEL "Description (coming from AUTOSAR DESC field)"
  /begin ANNOTATION_TEXT "If the engine has been running for less than this time, maintain the engine off shift maps\r\n" /end ANNOTATION_TEXT
 /end ANNOTATION
/end CHARACTERISTIC
/begin CHARACTERISTIC DST_CALIB.DST_ModeSelectGeneric.DST_TIMEPOSTSHIFTSPORTINDEXRUN "" VALUE 0x80607570 DefaultValueRecordLayout_AUTOSAR_Platform_BaseTypes_uint16 655.35 RB_PT_PCT_SWC_DST_CompuMethods_DST_Time 0.0 655.35 FORMAT "%10.5"
 /begin ANNOTATION ANNOTATION_LABEL "Description (coming from AUTOSAR DESC field)"
  /begin ANNOTATION_TEXT "Sport index is not updated after a shift for this time\r\n" /end ANNOTATION_TEXT
 /end ANNOTATION
/end CHARACTERISTIC
/begin CHARACTERISTIC DST_CALIB.DST_P3BACKUP_KMHDis "" VALUE 0x80607072 DefaultValueRecordLayout_AUTOSAR_Platform_BaseTypes_uint16 500.0 RB_PT_PCT_SWC_DST_CompuMethods_kph_0p1 0.0 500. FORMAT "%10.5"
 /begin ANNOTATION ANNOTATION_LABEL "Description (coming from AUTOSAR DESC field)"
  /begin ANNOTATION_TEXT "Above this speed do not request P3 as it will be in a backup mode that causes much higher EM1 speeds\r\n" /end ANNOTATION_TEXT
 /end ANNOTATION
/end CHARACTERISTIC
/begin CHARACTERISTIC DST_CALIB.DST_P3BACKUP_KMHEn "" VALUE 0x80607074 DefaultValueRecordLayout_AUTOSAR_Platform_BaseTypes_uint16 500.0 RB_PT_PCT_SWC_DST_CompuMethods_kph_0p1 0.0 500. FORMAT "%10.5"
 /begin ANNOTATION ANNOTATION_LABEL "Description (coming from AUTOSAR DESC field)"
  /begin ANNOTATION_TEXT "Above this speed do not request P3 as it will be in a backup mode that causes much higher EM1 speeds\r\n" /end ANNOTATION_TEXT
 /end ANNOTATION
/end CHARACTERISTIC
/begin CHARACTERISTIC DST_CALIB.DST_PARKMAXENGAGESPEED "" VALUE 0x80607076 DefaultValueRecordLayout_AUTOSAR_Platform_BaseTypes_uint16 500.0 RB_PT_PCT_SWC_DST_CompuMethods_kph_0p1 0.0 500. FORMAT "%10.5"
 /begin ANNOTATION ANNOTATION_LABEL "Description (coming from AUTOSAR DESC field)" /begin ANNOTATION_TEXT "Maximum speed to engage park\r\n" /end ANNOTATION_TEXT /end ANNOTATION
/end CHARACTERISTIC
/begin CHARACTERISTIC DST_CALIB.DST_PARKSLOWCOUNT "" VALUE 0x806070E0 DefaultValueRecordLayout_AUTOSAR_Platform_BaseTypes_uint8 255.0 RB_PT_PCT_SWC_DST_CompuMethods_ident 0.0 255. FORMAT "%10.5"
 /begin ANNOTATION ANNOTATION_LABEL "Description (coming from AUTOSAR DESC field)" /begin ANNOTATION_TEXT "Too slow to engage park so display Park\r\n" /end ANNOTATION_TEXT /end ANNOTATION
/end CHARACTERISTIC
/begin CHARACTERISTIC DST_CALIB.DST_POWERDOWNCOUNTS_N "" VALUE 0x80607048 DefaultValueRecordLayout_AUTOSAR_Platform_BaseTypes_uint32 400000.0 RB_PT_PCT_SWC_DST_CompuMethods_ident 0.0 400000. FORMAT "%10.5"
 /begin ANNOTATION ANNOTATION_LABEL "Description (coming from AUTOSAR DESC field)" /begin ANNOTATION_TEXT "Program loops DST will hold the power up\r\n" /end ANNOTATION_TEXT /end ANNOTATION
/end CHARACTERISTIC
/begin CHARACTERISTIC DST_CALIB.DST_POWERDOWNCOUNTS_P "" VALUE 0x8060704C DefaultValueRecordLayout_AUTOSAR_Platform_BaseTypes_uint32 400000.0 RB_PT_PCT_SWC_DST_CompuMethods_ident 0.0 400000. FORMAT "%10.5"
 /begin ANNOTATION ANNOTATION_LABEL "Description (coming from AUTOSAR DESC field)" /begin ANNOTATION_TEXT "Program loops DST will hold the power up\r\n" /end ANNOTATION_TEXT /end ANNOTATION
/end CHARACTERISTIC
/begin CHARACTERISTIC DST_CALIB.DST_POWERDOWNDONTCHECKPAWL "" VALUE 0x806070E1 DefaultValueRecordLayout_AUTOSAR_Platform_BaseTypes_uint8 255.0 DefaultIdenticalCompu 0.0 255. FORMAT "%10.5"
 /begin ANNOTATION ANNOTATION_LABEL "Description (coming from AUTOSAR DESC field)"
  /begin ANNOTATION_TEXT "If true, provided the car is in Park it will power down\r\n" /end ANNOTATION_TEXT
 /end ANNOTATION
/end CHARACTERISTIC
/begin CHARACTERISTIC DST_CALIB.DST_POWERDOWNPARKVALVEOFF "" VALUE 0x806070E2 DefaultValueRecordLayout_AUTOSAR_Platform_BaseTypes_boolean 255.0 AUTOSAR_Platform_CompuMethods_boolean 0.0 255. FORMAT "%10.5"
 /begin ANNOTATION ANNOTATION_LABEL "Description (coming from AUTOSAR DESC field)"
  /begin ANNOTATION_TEXT "Option to disable the park control valve when DST power down is ok\r\n" /end ANNOTATION_TEXT
 /end ANNOTATION
/end CHARACTERISTIC
/begin CHARACTERISTIC DST_CALIB.DST_POWERTRAIN2CHRISMA "" VAL_BLK 0x8060701D DefaultValueRecordLayout_AUTOSAR_Platform_BaseTypes_uint8 8.0 RB_PT_PCT_SWC_DST_CompuMethods_Enumerations_IOP_CANDriveStrategy 0.0 8. FORMAT "%10.5"
 /begin ANNOTATION ANNOTATION_LABEL "Description (coming from AUTOSAR DESC field)" /begin ANNOTATION_TEXT "Conversion for mode display\r\n" /end ANNOTATION_TEXT /end ANNOTATION
 MATRIX_DIM 16 1 1 /end CHARACTERISTIC
/begin CHARACTERISTIC DST_CALIB.DST_POWERTRAIN2FAHPROGRAMM "" VAL_BLK 0x8060702D DefaultValueRecordLayout_AUTOSAR_Platform_BaseTypes_uint8 13.0 RB_PT_PCT_SWC_DST_CompuMethods_Enumerations_IOP_CANShiftMode 0.0 13. FORMAT "%10.5"
 /begin ANNOTATION ANNOTATION_LABEL "Description (coming from AUTOSAR DESC field)" /begin ANNOTATION_TEXT "Conversion for mode display\r\n" /end ANNOTATION_TEXT /end ANNOTATION
 MATRIX_DIM 16 1 1 /end CHARACTERISTIC
/begin CHARACTERISTIC DST_CALIB.DST_PSG.DST_PRESELECTTEMPDISABLE "" VALUE 0x806076DE DefaultValueRecordLayout_AUTOSAR_Platform_BaseTypes_sint16 250.0 RB_PT_PCT_SWC_DST_CompuMethods_ident -50. 200. FORMAT "%10.5"
 /begin ANNOTATION ANNOTATION_LABEL "Description (coming from AUTOSAR DESC field)" /begin ANNOTATION_TEXT "Temperature below which preselect is disabled\r\n" /end ANNOTATION_TEXT /end ANNOTATION
/end CHARACTERISTIC
/begin CHARACTERISTIC DST_CALIB.DST_PSG.DST_PRESELECTZEROLATCHTIME "" VALUE 0x806076E0 DefaultValueRecordLayout_AUTOSAR_Platform_BaseTypes_uint16 655.35 RB_PT_PCT_SWC_DST_CompuMethods_DST_Time 0.0 655.35 FORMAT "%10.5"
 /begin ANNOTATION ANNOTATION_LABEL "Description (coming from AUTOSAR DESC field)" /begin ANNOTATION_TEXT "TIme to latch a preselect zero request\r\n" /end ANNOTATION_TEXT /end ANNOTATION
/end CHARACTERISTIC
/begin CHARACTERISTIC DST_CALIB.DST_PSG.DST_PSGUPCANCELBELOWIDLE "" VALUE 0x806076E2 DefaultValueRecordLayout_AUTOSAR_Platform_BaseTypes_uint16 20000.0 RB_PT_PCT_SWC_DST_CompuMethods_ident 0.0 20000. FORMAT "%10.5"
 /begin ANNOTATION ANNOTATION_LABEL "Description (coming from AUTOSAR DESC field)" /begin ANNOTATION_TEXT "Disable preselect up below idle speed threshold\r\n" /end ANNOTATION_TEXT /end ANNOTATION
/end CHARACTERISTIC
/begin CHARACTERISTIC DST_CALIB.DST_PSG.DST_PSGUPENABLEABOVEIDLE "" VALUE 0x806076E4 DefaultValueRecordLayout_AUTOSAR_Platform_BaseTypes_uint16 20000.0 RB_PT_PCT_SWC_DST_CompuMethods_ident 0.0 20000. FORMAT "%10.5"
 /begin ANNOTATION ANNOTATION_LABEL "Description (coming from AUTOSAR DESC field)" /begin ANNOTATION_TEXT "Enable preselect up above idle speed\r\n" /end ANNOTATION_TEXT /end ANNOTATION
/end CHARACTERISTIC
/begin CHARACTERISTIC DST_CALIB.DST_PSG.DST_PSGZEROMAXTIMEPOSTSHIFT "" VALUE 0x806076E6 DefaultValueRecordLayout_AUTOSAR_Platform_BaseTypes_uint16 655.35 RB_PT_PCT_SWC_DST_CompuMethods_DST_Time 0.0 655.35 FORMAT "%10.5"
 /begin ANNOTATION ANNOTATION_LABEL "Description (coming from AUTOSAR DESC field)" /begin ANNOTATION_TEXT "TIme to latch a preselect zero request\r\n" /end ANNOTATION_TEXT /end ANNOTATION
/end CHARACTERISTIC
/begin CHARACTERISTIC DST_CALIB.DST_PSG.DST_REFSPDWHEELSLIPMARGIN "" VALUE 0x806076EC DefaultValueRecordLayout_AUTOSAR_Platform_BaseTypes_uint8 1.0 RB_PT_PCT_SWC_DST_CompuMethods_ratio_0p01 1. 2. FORMAT "%10.5"
 /begin ANNOTATION ANNOTATION_LABEL "Description (coming from AUTOSAR DESC field)"
  /begin ANNOTATION_TEXT "Fraction above reference speed that wheels are considered to be slipping\r\n" /end ANNOTATION_TEXT
 /end ANNOTATION
/end CHARACTERISTIC
/begin CHARACTERISTIC DST_CALIB.DST_PSG.DST_REFSPDWHEELSLIPMIN "" VALUE 0x806076E8 DefaultValueRecordLayout_AUTOSAR_Platform_BaseTypes_uint16 500.0 RB_PT_PCT_SWC_DST_CompuMethods_kph_0p1 0.0 500. FORMAT "%10.5"
 /begin ANNOTATION ANNOTATION_LABEL "Description (coming from AUTOSAR DESC field)"
  /begin ANNOTATION_TEXT "Minimum wheel speed above reference speed to consider wheels are spinning\r\n" /end ANNOTATION_TEXT
 /end ANNOTATION
/end CHARACTERISTIC
/begin CHARACTERISTIC DST_CALIB.DST_PSG.DST_SPECIALPRESELECT "" VAL_BLK 0x8060768C DefaultValueRecordLayout_AUTOSAR_Platform_BaseTypes_uint8 255.0 RB_PT_PCT_SWC_DST_CompuMethods_ident 0.0 255. FORMAT "%10.5"
 /begin ANNOTATION ANNOTATION_LABEL "Description (coming from AUTOSAR DESC field)" /begin ANNOTATION_TEXT "Special preselect gear request during some shifts\r\n" /end ANNOTATION_TEXT /end ANNOTATION
 MATRIX_DIM 9 9 1 /end CHARACTERISTIC
/begin CHARACTERISTIC DST_CALIB.DST_PSG.DST_SPECIALPSGTIMOUT "" VALUE 0x806076ED DefaultValueRecordLayout_AUTOSAR_Platform_BaseTypes_uint8 2.55 RB_PT_PCT_SWC_DST_CompuMethods_ratio_0p01 0.0 2.55 FORMAT "%10.5"
 /begin ANNOTATION ANNOTATION_LABEL "Description (coming from AUTOSAR DESC field)" /begin ANNOTATION_TEXT "Max time special PSG can be requested\r\n" /end ANNOTATION_TEXT /end ANNOTATION
/end CHARACTERISTIC
/begin CHARACTERISTIC DST_CALIB.DST_PSG.DST_WHEELSDRIVEN_FRONT "" VALUE 0x806076EE DefaultValueRecordLayout_AUTOSAR_Platform_BaseTypes_boolean 255.0 AUTOSAR_Platform_CompuMethods_boolean 0.0 255. FORMAT "%10.5"
 /begin ANNOTATION ANNOTATION_LABEL "Description (coming from AUTOSAR DESC field)" /begin ANNOTATION_TEXT "Set true if frony wheels are driven\r\n" /end ANNOTATION_TEXT /end ANNOTATION
/end CHARACTERISTIC
/begin CHARACTERISTIC DST_CALIB.DST_PSG.DST_WHEELSDRIVEN_REAR "" VALUE 0x806076EF DefaultValueRecordLayout_AUTOSAR_Platform_BaseTypes_boolean 255.0 AUTOSAR_Platform_CompuMethods_boolean 0.0 255. FORMAT "%10.5"
 /begin ANNOTATION ANNOTATION_LABEL "Description (coming from AUTOSAR DESC field)" /begin ANNOTATION_TEXT "Set true if rear wheels are driven\r\n" /end ANNOTATION_TEXT /end ANNOTATION
/end CHARACTERISTIC
/begin CHARACTERISTIC DST_CALIB.DST_PSG.DST_WHEELSLIPDISABLLEPRESELECTCOUNT "" VALUE 0x806076EA DefaultValueRecordLayout_AUTOSAR_Platform_BaseTypes_uint16 65535.0 RB_PT_PCT_SWC_DST_CompuMethods_ident 0.0 65535. FORMAT "%10.5"
 /begin ANNOTATION ANNOTATION_LABEL "Description (coming from AUTOSAR DESC field)"
  /begin ANNOTATION_TEXT "Threshold to disable preselect after wheels have been slipping for a time\r\n" /end ANNOTATION_TEXT
 /end ANNOTATION
/end CHARACTERISTIC
/begin CHARACTERISTIC DST_CALIB.DST_RefSpdCalc.DST_PCNTSLIPUSETRANSSENSORS "" VALUE 0x806076F4 DefaultValueRecordLayout_AUTOSAR_Platform_BaseTypes_uint8 255.0 DefaultIdenticalCompu 0.0 255. FORMAT "%10.5"
 /begin ANNOTATION ANNOTATION_LABEL "Description (coming from AUTOSAR DESC field)"
  /begin ANNOTATION_TEXT "If true, the transmission sensors will be used to calculate wheel slip\r\n" /end ANNOTATION_TEXT
 /end ANNOTATION
/end CHARACTERISTIC
/begin CHARACTERISTIC DST_CALIB.DST_RefSpdCalc.DST_REFSPDLIMIT2NONDRIVENWHEELS "" VALUE 0x806076F0 DefaultValueRecordLayout_AUTOSAR_Platform_BaseTypes_uint16 500.0 RB_PT_PCT_SWC_DST_CompuMethods_ratio_0p01 0.0 500. FORMAT "%10.5"
 /begin ANNOTATION ANNOTATION_LABEL "Description (coming from AUTOSAR DESC field)"
  /begin ANNOTATION_TEXT "Speed below which non driven wheels will control rate of increase of reference speed\r\n" /end ANNOTATION_TEXT
 /end ANNOTATION
/end CHARACTERISTIC
/begin CHARACTERISTIC DST_CALIB.DST_RefSpdCalc.DST_REFSPDNODECELLIMIT_N_R "" VALUE 0x806076F2 DefaultValueRecordLayout_AUTOSAR_Platform_BaseTypes_uint16 500.0 RB_PT_PCT_SWC_DST_CompuMethods_ratio_0p01 0.0 500. FORMAT "%10.5"
 /begin ANNOTATION ANNOTATION_LABEL "Description (coming from AUTOSAR DESC field)"
  /begin ANNOTATION_TEXT "Below this vehicle speed in Reverse or Neutral, dont limit rate of change of ref speed\r\n" /end ANNOTATION_TEXT
 /end ANNOTATION
/end CHARACTERISTIC
/begin CHARACTERISTIC DST_CALIB.DST_REVERSEDEMAND "" VALUE 0x806070E3 DefaultValueRecordLayout_AUTOSAR_Platform_BaseTypes_uint8 11.0 RB_PT_PCT_SWC_DST_CompuMethods_ident 0.0 11. FORMAT "%10.5"
 /begin ANNOTATION ANNOTATION_LABEL "Description (coming from AUTOSAR DESC field)" /begin ANNOTATION_TEXT "Demand gear to request when in Reverse\r\n" /end ANNOTATION_TEXT /end ANNOTATION
/end CHARACTERISTIC
/begin CHARACTERISTIC DST_CALIB.DST_REVERSEDEMANDENG "" VALUE 0x806070E4 DefaultValueRecordLayout_AUTOSAR_Platform_BaseTypes_uint8 11.0 RB_PT_PCT_SWC_DST_CompuMethods_ident 0.0 11. FORMAT "%10.5" /end CHARACTERISTIC
/begin CHARACTERISTIC DST_CALIB.DST_REVERSEDEMANDEV "" VALUE 0x806070E5 DefaultValueRecordLayout_AUTOSAR_Platform_BaseTypes_uint8 11.0 RB_PT_PCT_SWC_DST_CompuMethods_ident 0.0 11. FORMAT "%10.5" /end CHARACTERISTIC
/begin CHARACTERISTIC DST_CALIB.DST_REVERSEDEMANDTOOFAST "" VALUE 0x806070E6 DefaultValueRecordLayout_AUTOSAR_Platform_BaseTypes_uint8 11.0 RB_PT_PCT_SWC_DST_CompuMethods_ident 0.0 11. FORMAT "%10.5"
 /begin ANNOTATION ANNOTATION_LABEL "Description (coming from AUTOSAR DESC field)" /begin ANNOTATION_TEXT "Demand gear to request when in Reverse\r\n" /end ANNOTATION_TEXT /end ANNOTATION
/end CHARACTERISTIC
/begin CHARACTERISTIC DST_CALIB.DST_REVERSEPRESELECT "" VALUE 0x806070E7 DefaultValueRecordLayout_AUTOSAR_Platform_BaseTypes_uint8 11.0 RB_PT_PCT_SWC_DST_CompuMethods_ident 0.0 11. FORMAT "%10.5"
 /begin ANNOTATION ANNOTATION_LABEL "Description (coming from AUTOSAR DESC field)" /begin ANNOTATION_TEXT "preselect gear to request when in reverse\r\n" /end ANNOTATION_TEXT /end ANNOTATION
/end CHARACTERISTIC
/begin CHARACTERISTIC DST_CALIB.DST_ROLLINGROAD "" VALUE 0x806070E8 DefaultValueRecordLayout_AUTOSAR_Platform_BaseTypes_boolean 255.0 AUTOSAR_Platform_CompuMethods_boolean 0.0 255. FORMAT "%10.5"
 /begin ANNOTATION ANNOTATION_LABEL "Description (coming from AUTOSAR DESC field)" /begin ANNOTATION_TEXT "Set true if the vehicle is being used on rollers\r\n" /end ANNOTATION_TEXT /end ANNOTATION
/end CHARACTERISTIC
/begin CHARACTERISTIC DST_CALIB.DST_SailingLogic.DST_SAILOFFTHROTTLE "" VALUE 0x806076F8 DefaultValueRecordLayout_AUTOSAR_Platform_BaseTypes_boolean 255.0 AUTOSAR_Platform_CompuMethods_boolean 0.0 255. FORMAT "%10.5"
 /begin ANNOTATION ANNOTATION_LABEL "Description (coming from AUTOSAR DESC field)" /begin ANNOTATION_TEXT "If true, allow sailing off throttle\r\n" /end ANNOTATION_TEXT /end ANNOTATION
/end CHARACTERISTIC
/begin CHARACTERISTIC DST_CALIB.DST_SailingLogic.DST_SAILONBRAKES "" VALUE 0x806076F9 DefaultValueRecordLayout_AUTOSAR_Platform_BaseTypes_boolean 255.0 AUTOSAR_Platform_CompuMethods_boolean 0.0 255. FORMAT "%10.5"
 /begin ANNOTATION ANNOTATION_LABEL "Description (coming from AUTOSAR DESC field)" /begin ANNOTATION_TEXT "If true, allow sailing when the brakes are applied\r\n" /end ANNOTATION_TEXT /end ANNOTATION
/end CHARACTERISTIC
/begin CHARACTERISTIC DST_CALIB.DST_SailingLogic.DST_SAILTRIGGERENGSPD "" VALUE 0x806076F6 DefaultValueRecordLayout_AUTOSAR_Platform_BaseTypes_uint16 20000.0 RB_PT_PCT_SWC_DST_CompuMethods_ident 0.0 20000. FORMAT "%10.5"
 /begin ANNOTATION ANNOTATION_LABEL "Description (coming from AUTOSAR DESC field)" /begin ANNOTATION_TEXT "Allow sailing below this engine speed\r\n" /end ANNOTATION_TEXT /end ANNOTATION
/end CHARACTERISTIC
/begin CHARACTERISTIC DST_CALIB.DST_SHIFTINHIBITACCELERATION_KMH_EN "" VALUE 0x80607078 DefaultValueRecordLayout_AUTOSAR_Platform_BaseTypes_uint16 500.0 RB_PT_PCT_SWC_DST_CompuMethods_kph_0p1 0.0 500. FORMAT "%10.5"
 /begin ANNOTATION ANNOTATION_LABEL "Description (coming from AUTOSAR DESC field)"
  /begin ANNOTATION_TEXT "Vehicle speed above which shifting at high lateral acceleration is enabled\r\n" /end ANNOTATION_TEXT
 /end ANNOTATION
/end CHARACTERISTIC
/begin CHARACTERISTIC DST_CALIB.DST_SPECIALPSGMINTEMP "" VALUE 0x8060707A DefaultValueRecordLayout_AUTOSAR_Platform_BaseTypes_sint16 250.0 RB_PT_PCT_SWC_DST_CompuMethods_ident -50. 200. FORMAT "%10.5" /end CHARACTERISTIC
/begin CHARACTERISTIC DST_CALIB.DST_SSDISABLECANCEL "" VALUE 0x8060707C DefaultValueRecordLayout_AUTOSAR_Platform_BaseTypes_uint16 65535.0 RB_PT_PCT_SWC_DST_CompuMethods_ident 0.0 65535. FORMAT "%10.5" /end CHARACTERISTIC
/begin CHARACTERISTIC DST_CALIB.DST_SSDISABLEDRIVEGRADNEG "" VALUE 0x8060707E DefaultValueRecordLayout_AUTOSAR_Platform_BaseTypes_sint16 65.4 RB_PT_PCT_SWC_DST_CompuMethods_ratio_0p001 -32.7 32.7 FORMAT "%10.5" /end CHARACTERISTIC
/begin CHARACTERISTIC DST_CALIB.DST_SSDISABLEDRIVEGRADPOS "" VALUE 0x80607080 DefaultValueRecordLayout_AUTOSAR_Platform_BaseTypes_sint16 65.4 RB_PT_PCT_SWC_DST_CompuMethods_ratio_0p001 -32.7 32.7 FORMAT "%10.5" /end CHARACTERISTIC
/begin CHARACTERISTIC DST_CALIB.DST_SSDISABLEGRADNEG "" VALUE 0x80607082 DefaultValueRecordLayout_AUTOSAR_Platform_BaseTypes_sint16 65.4 RB_PT_PCT_SWC_DST_CompuMethods_ratio_0p001 -32.7 32.7 FORMAT "%10.5" /end CHARACTERISTIC
/begin CHARACTERISTIC DST_CALIB.DST_SSDISABLEGRADPOS "" VALUE 0x80607084 DefaultValueRecordLayout_AUTOSAR_Platform_BaseTypes_sint16 65.4 RB_PT_PCT_SWC_DST_CompuMethods_ratio_0p001 -32.7 32.7 FORMAT "%10.5" /end CHARACTERISTIC
/begin CHARACTERISTIC DST_CALIB.DST_SSDISABLEREVGRADNEG "" VALUE 0x80607086 DefaultValueRecordLayout_AUTOSAR_Platform_BaseTypes_sint16 65.4 RB_PT_PCT_SWC_DST_CompuMethods_ratio_0p001 -32.7 32.7 FORMAT "%10.5" /end CHARACTERISTIC
/begin CHARACTERISTIC DST_CALIB.DST_SSDISABLEREVGRADPOS "" VALUE 0x80607088 DefaultValueRecordLayout_AUTOSAR_Platform_BaseTypes_sint16 65.4 RB_PT_PCT_SWC_DST_CompuMethods_ratio_0p001 -32.7 32.7 FORMAT "%10.5" /end CHARACTERISTIC
/begin CHARACTERISTIC DST_CALIB.DST_SSDISABLETRIG "" VALUE 0x8060708A DefaultValueRecordLayout_AUTOSAR_Platform_BaseTypes_uint16 65535.0 RB_PT_PCT_SWC_DST_CompuMethods_ident 0.0 65535. FORMAT "%10.5" /end CHARACTERISTIC
/begin CHARACTERISTIC DST_CALIB.DST_SSEENABLEDEC "" VALUE 0x806070E9 DefaultValueRecordLayout_AUTOSAR_Platform_BaseTypes_uint8 255.0 RB_PT_PCT_SWC_DST_CompuMethods_ident 0.0 255. FORMAT "%10.5" /end CHARACTERISTIC
/begin CHARACTERISTIC DST_CALIB.DST_SSENABLECOUNTMAX "" VALUE 0x8060708C DefaultValueRecordLayout_AUTOSAR_Platform_BaseTypes_uint16 65535.0 RB_PT_PCT_SWC_DST_CompuMethods_ident 0.0 65535. FORMAT "%10.5" /end CHARACTERISTIC
/begin CHARACTERISTIC DST_CALIB.DST_SSENABLEGRADNEG "" VALUE 0x8060708E DefaultValueRecordLayout_AUTOSAR_Platform_BaseTypes_sint16 65.4 RB_PT_PCT_SWC_DST_CompuMethods_ratio_0p001 -32.7 32.7 FORMAT "%10.5" /end CHARACTERISTIC
/begin CHARACTERISTIC DST_CALIB.DST_SSENABLEGRADPOS "" VALUE 0x80607090 DefaultValueRecordLayout_AUTOSAR_Platform_BaseTypes_sint16 65.4 RB_PT_PCT_SWC_DST_CompuMethods_ratio_0p001 -32.7 32.7 FORMAT "%10.5" /end CHARACTERISTIC
/begin CHARACTERISTIC DST_CALIB.DST_SSENABLEINC "" VALUE 0x806070EA DefaultValueRecordLayout_AUTOSAR_Platform_BaseTypes_uint8 255.0 RB_PT_PCT_SWC_DST_CompuMethods_ident 0.0 255. FORMAT "%10.5" /end CHARACTERISTIC
/begin CHARACTERISTIC DST_CALIB.DST_SSENGINESTARTCANCEL "" VALUE 0x80607092 DefaultValueRecordLayout_AUTOSAR_Platform_BaseTypes_uint16 65535.0 RB_PT_PCT_SWC_DST_CompuMethods_ident 0.0 65535. FORMAT "%10.5" /end CHARACTERISTIC
/begin CHARACTERISTIC DST_CALIB.DST_SSENGINESTARTCOUNTMAX "" VALUE 0x80607094 DefaultValueRecordLayout_AUTOSAR_Platform_BaseTypes_uint16 65535.0 RB_PT_PCT_SWC_DST_CompuMethods_ident 0.0 65535. FORMAT "%10.5" /end CHARACTERISTIC
/begin CHARACTERISTIC DST_CALIB.DST_SSENGINESTARTDEC "" VALUE 0x806070EB DefaultValueRecordLayout_AUTOSAR_Platform_BaseTypes_uint8 255.0 RB_PT_PCT_SWC_DST_CompuMethods_ident 0.0 255. FORMAT "%10.5" /end CHARACTERISTIC
/begin CHARACTERISTIC DST_CALIB.DST_SSENGINESTARTINC "" VALUE 0x806070EC DefaultValueRecordLayout_AUTOSAR_Platform_BaseTypes_uint8 255.0 RB_PT_PCT_SWC_DST_CompuMethods_ident 0.0 255. FORMAT "%10.5"
 /begin ANNOTATION ANNOTATION_LABEL "Description (coming from AUTOSAR DESC field)" /begin ANNOTATION_TEXT "Increase step\r\n" /end ANNOTATION_TEXT /end ANNOTATION
/end CHARACTERISTIC
/begin CHARACTERISTIC DST_CALIB.DST_SSENGINESTARTTRIG "" VALUE 0x80607096 DefaultValueRecordLayout_AUTOSAR_Platform_BaseTypes_uint16 65535.0 RB_PT_PCT_SWC_DST_CompuMethods_ident 0.0 65535. FORMAT "%10.5" /end CHARACTERISTIC
/begin CHARACTERISTIC DST_CALIB.DST_SSENGNOTSTARTGRADNEG "" VALUE 0x80607098 DefaultValueRecordLayout_AUTOSAR_Platform_BaseTypes_sint16 65.4 RB_PT_PCT_SWC_DST_CompuMethods_ratio_0p001 -32.7 32.7 FORMAT "%10.5" /end CHARACTERISTIC
/begin CHARACTERISTIC DST_CALIB.DST_SSENGNOTSTARTGRADPOS "" VALUE 0x8060709A DefaultValueRecordLayout_AUTOSAR_Platform_BaseTypes_sint16 65.4 RB_PT_PCT_SWC_DST_CompuMethods_ratio_0p001 -32.7 32.7 FORMAT "%10.5" /end CHARACTERISTIC
/begin CHARACTERISTIC DST_CALIB.DST_SSENGSTARTDRIGRADNEG "" VALUE 0x8060709C DefaultValueRecordLayout_AUTOSAR_Platform_BaseTypes_sint16 65.4 RB_PT_PCT_SWC_DST_CompuMethods_ratio_0p001 -32.7 32.7 FORMAT "%10.5" /end CHARACTERISTIC
/begin CHARACTERISTIC DST_CALIB.DST_SSENGSTARTDRIVEGRADPOS "" VALUE 0x8060709E DefaultValueRecordLayout_AUTOSAR_Platform_BaseTypes_sint16 65.4 RB_PT_PCT_SWC_DST_CompuMethods_ratio_0p001 -32.7 32.7 FORMAT "%10.5" /end CHARACTERISTIC
/begin CHARACTERISTIC DST_CALIB.DST_SSENGSTARTGRADNEG "" VALUE 0x806070A0 DefaultValueRecordLayout_AUTOSAR_Platform_BaseTypes_sint16 65.4 RB_PT_PCT_SWC_DST_CompuMethods_ratio_0p001 -32.7 32.7 FORMAT "%10.5" /end CHARACTERISTIC
/begin CHARACTERISTIC DST_CALIB.DST_SSENGSTARTGRADPOS "" VALUE 0x806070A2 DefaultValueRecordLayout_AUTOSAR_Platform_BaseTypes_sint16 65.4 RB_PT_PCT_SWC_DST_CompuMethods_ratio_0p001 -32.7 32.7 FORMAT "%10.5" /end CHARACTERISTIC
/begin CHARACTERISTIC DST_CALIB.DST_SSENGSTARTREVGRADNEG "" VALUE 0x806070A4 DefaultValueRecordLayout_AUTOSAR_Platform_BaseTypes_sint16 65.4 RB_PT_PCT_SWC_DST_CompuMethods_ratio_0p001 -32.7 32.7 FORMAT "%10.5" /end CHARACTERISTIC
/begin CHARACTERISTIC DST_CALIB.DST_SSENGSTARTREVGRADPOS "" VALUE 0x806070A6 DefaultValueRecordLayout_AUTOSAR_Platform_BaseTypes_sint16 65.4 RB_PT_PCT_SWC_DST_CompuMethods_ratio_0p001 -32.7 32.7 FORMAT "%10.5" /end CHARACTERISTIC
/begin CHARACTERISTIC DST_CALIB.DST_SSFAULTENABLE "" VALUE 0x806070ED DefaultValueRecordLayout_AUTOSAR_Platform_BaseTypes_uint8 255.0 DefaultIdenticalCompu 0.0 255. FORMAT "%10.5"
 /begin ANNOTATION ANNOTATION_LABEL "Description (coming from AUTOSAR DESC field)"
  /begin ANNOTATION_TEXT "If true, Long acc fault will set stop start disable.  If false, Long acc fault will set Engine must start to true\r\n" /end ANNOTATION_TEXT
 /end ANNOTATION
/end CHARACTERISTIC
/begin CHARACTERISTIC DST_CALIB.DST_SSFAULTSTART "" VALUE 0x806070EE DefaultValueRecordLayout_AUTOSAR_Platform_BaseTypes_uint8 255.0 DefaultIdenticalCompu 0.0 255. FORMAT "%10.5" /end CHARACTERISTIC
/begin CHARACTERISTIC DST_CALIB.DST_SSFILTERRAWGRAD "" VALUE 0x806070EF DefaultValueRecordLayout_AUTOSAR_Platform_BaseTypes_uint8 255.0 DefaultIdenticalCompu 0.0 255. FORMAT "%10.5"
 /begin ANNOTATION ANNOTATION_LABEL "Description (coming from AUTOSAR DESC field)"
  /begin ANNOTATION_TEXT "If true, the first order filter applies to the Raw gradient\r\n" /end ANNOTATION_TEXT
 /end ANNOTATION
/end CHARACTERISTIC
/begin CHARACTERISTIC DST_CALIB.DST_SSGRADFILTEN "" VALUE 0x806070F0 DefaultValueRecordLayout_AUTOSAR_Platform_BaseTypes_uint8 255.0 DefaultIdenticalCompu 0.0 255. FORMAT "%10.5" /end CHARACTERISTIC
/begin CHARACTERISTIC DST_CALIB.DST_SSGRADGAIN "" VALUE 0x806070A8 DefaultValueRecordLayout_AUTOSAR_Platform_BaseTypes_uint16 1.0 RB_PT_PCT_SWC_DST_CompuMethods_ratio_0p0001 0.0 1. FORMAT "%10.5"
 /begin ANNOTATION ANNOTATION_LABEL "Description (coming from AUTOSAR DESC field)" /begin ANNOTATION_TEXT "Filter gain for gradient\r\n" /end ANNOTATION_TEXT /end ANNOTATION
/end CHARACTERISTIC
/begin CHARACTERISTIC DST_CALIB.DST_STOPSTARTNPDISABLE "" VALUE 0x806070F1 DefaultValueRecordLayout_AUTOSAR_Platform_BaseTypes_uint8 255.0 DefaultIdenticalCompu 0.0 255. FORMAT "%10.5" /end CHARACTERISTIC
/begin CHARACTERISTIC DST_CALIB.DST_STOPSTARTSTATUSMANDISABLE "" VALUE 0x806070F2 DefaultValueRecordLayout_AUTOSAR_Platform_BaseTypes_uint8 5.0 RB_PT_PCT_SWC_DST_CompuMethods_ident 0.0 5. FORMAT "%10.5"
 /begin ANNOTATION ANNOTATION_LABEL "Description (coming from AUTOSAR DESC field)"
  /begin ANNOTATION_TEXT "Flag to prevent manaul mode if engine ran out of petrol\r\n" /end ANNOTATION_TEXT
 /end ANNOTATION
/end CHARACTERISTIC
/begin CHARACTERISTIC DST_CALIB.DST_SYNCBNEUTRALNEGLIMIT "" VALUE 0x806070AA DefaultValueRecordLayout_AUTOSAR_Platform_BaseTypes_sint16 40.0 RB_PT_PCT_SWC_DST_CompuMethods_ratio_0p001 -20. 20. FORMAT "%10.5"
 /begin ANNOTATION ANNOTATION_LABEL "Description (coming from AUTOSAR DESC field)" /begin ANNOTATION_TEXT "Negative limit of sync B to be considered in Neutral\r\n" /end ANNOTATION_TEXT /end ANNOTATION
/end CHARACTERISTIC
/begin CHARACTERISTIC DST_CALIB.DST_SYNCBNEUTRALPOSLIMIT "" VALUE 0x806070AC DefaultValueRecordLayout_AUTOSAR_Platform_BaseTypes_sint16 40.0 RB_PT_PCT_SWC_DST_CompuMethods_ratio_0p001 -20. 20. FORMAT "%10.5"
 /begin ANNOTATION ANNOTATION_LABEL "Description (coming from AUTOSAR DESC field)" /begin ANNOTATION_TEXT "Positive limit of sync B to be considered in Neutral\r\n" /end ANNOTATION_TEXT /end ANNOTATION
/end CHARACTERISTIC
/begin CHARACTERISTIC DST_CALIB.DST_TOOFASTFORPWARNCOUNT "" VALUE 0x806070F3 DefaultValueRecordLayout_AUTOSAR_Platform_BaseTypes_uint8 255.0 RB_PT_PCT_SWC_DST_CompuMethods_ident 0.0 255. FORMAT "%10.5"
 /begin ANNOTATION ANNOTATION_LABEL "Description (coming from AUTOSAR DESC field)"
  /begin ANNOTATION_TEXT "Counter to control how ogn too fast for P is displayed\r\n" /end ANNOTATION_TEXT
 /end ANNOTATION
/end CHARACTERISTIC
/begin CHARACTERISTIC DST_CALIB.DST_WHEELTRACK "" VALUE 0x806070AE DefaultValueRecordLayout_AUTOSAR_Platform_BaseTypes_uint16 9.6 RB_PT_PCT_SWC_DST_CompuMethods_ratio_0p01 0.4 10. FORMAT "%10.5"
 /begin ANNOTATION ANNOTATION_LABEL "Description (coming from AUTOSAR DESC field)"
  /begin ANNOTATION_TEXT "Distance between the wheels for calculation of lateral acceleration\r\n" /end ANNOTATION_TEXT
 /end ANNOTATION
/end CHARACTERISTIC
/begin CHARACTERISTIC DST_CALIB.L2_PARKFROML2 "" VALUE 0x806070F8 DefaultValueRecordLayout_AUTOSAR_Platform_BaseTypes_boolean 255.0 AUTOSAR_Platform_CompuMethods_boolean 0.0 255. FORMAT "%10.5" /end CHARACTERISTIC
/begin CHARACTERISTIC DST_EFLASHB.DST_ASGRequest.DST_ASGAUTODOWNRPMTHRESH "" VAL_BLK 0x80605F90 DefaultValueRecordLayout_AUTOSAR_Platform_BaseTypes_sint16 20000.0 RB_PT_PCT_SWC_DST_CompuMethods_DST_Ident 0.0 20000. FORMAT "%10.5"
 /begin ANNOTATION ANNOTATION_LABEL "Description (coming from AUTOSAR DESC field)"
  /begin ANNOTATION_TEXT "Gear dependant engine speed in target gear to ASG downshift to\r\n" /end ANNOTATION_TEXT
 /end ANNOTATION
 MATRIX_DIM 17 1 1 /end CHARACTERISTIC
/begin CHARACTERISTIC DST_EFLASHB.DST_ASGRequest.DST_ASGDECELDOWNTHROTTLE2CANCEL "" VALUE 0x806060BA DefaultValueRecordLayout_AUTOSAR_Platform_BaseTypes_uint8 102.0 RB_PT_PCT_SWC_DST_CompuMethods_ratio_0p4 0.0 102. FORMAT "%10.5"
 /begin ANNOTATION ANNOTATION_LABEL "Description (coming from AUTOSAR DESC field)" /begin ANNOTATION_TEXT "Throttle angle to set DST_ASGDecelLatch to false\r\n" /end ANNOTATION_TEXT /end ANNOTATION
/end CHARACTERISTIC
/begin CHARACTERISTIC DST_EFLASHB.DST_ASGRequest.DST_ASGDECELDOWNTIMEPOSTBRAKECANCEL "" VALUE 0x806060AA DefaultValueRecordLayout_AUTOSAR_Platform_BaseTypes_uint16 655.35 RB_PT_PCT_SWC_DST_CompuMethods_DST_Time 0.0 655.35 FORMAT "%10.5"
 /begin ANNOTATION ANNOTATION_LABEL "Description (coming from AUTOSAR DESC field)"
  /begin ANNOTATION_TEXT "TImer after the brake has been release to cancel ASGDecel downshift requests\r\n" /end ANNOTATION_TEXT
 /end ANNOTATION
/end CHARACTERISTIC
/begin CHARACTERISTIC DST_EFLASHB.DST_ASGRequest.DST_ASGDECELGTHRESH "" VAL_BLK 0x80605FB2 DefaultValueRecordLayout_AUTOSAR_Platform_BaseTypes_sint16 10.0 RB_PT_PCT_SWC_DST_CompuMethods_ratio_0p01 -5. 5. FORMAT "%10.5"
 /begin ANNOTATION ANNOTATION_LABEL "Description (coming from AUTOSAR DESC field)"
  /begin ANNOTATION_TEXT "Depending on Decel mode aggression, acceleration to enter ASG mode\r\n" /end ANNOTATION_TEXT
 /end ANNOTATION
 MATRIX_DIM 17 1 1 /end CHARACTERISTIC
/begin CHARACTERISTIC DST_EFLASHB.DST_ASGRequest.DST_ASGDECELRPMINDEMANDTHRESH "" VAL_BLK 0x80605FD4 DefaultValueRecordLayout_AUTOSAR_Platform_BaseTypes_sint16 20000.0 RB_PT_PCT_SWC_DST_CompuMethods_DST_Ident 0.0 20000. FORMAT "%10.5"
 /begin ANNOTATION ANNOTATION_LABEL "Description (coming from AUTOSAR DESC field)"
  /begin ANNOTATION_TEXT "Gear dependant engine speed in target gear to ASG downshift to\r\n" /end ANNOTATION_TEXT
 /end ANNOTATION
 MATRIX_DIM 17 1 1 /end CHARACTERISTIC
/begin CHARACTERISTIC DST_EFLASHB.DST_ASGRequest.DST_ASGDEMANDDELTAASGKICKDOWN "" VAL_BLK 0x806060A0 DefaultValueRecordLayout_AUTOSAR_Platform_BaseTypes_boolean 255.0 AUTOSAR_Platform_CompuMethods_boolean 0.0 255. FORMAT "%10.5"
 /begin ANNOTATION ANNOTATION_LABEL "Description (coming from AUTOSAR DESC field)"
  /begin ANNOTATION_TEXT "Array of gear deltas (SEQ_CurrentTorqueGear -DST_DemandGear) for which to perform an ASG kickdown shift\r\n" /end ANNOTATION_TEXT
 /end ANNOTATION
 MATRIX_DIM 10 1 1 /end CHARACTERISTIC
/begin CHARACTERISTIC DST_EFLASHB.DST_ASGRequest.DST_ASGDOWNRPMHYST "" VALUE 0x806060AC DefaultValueRecordLayout_AUTOSAR_Platform_BaseTypes_sint16 20000.0 RB_PT_PCT_SWC_DST_CompuMethods_DST_Ident 0.0 20000. FORMAT "%10.5"
 /begin ANNOTATION ANNOTATION_LABEL "Description (coming from AUTOSAR DESC field)"
  /begin ANNOTATION_TEXT "Rpm in demand hysteresis used to determine if shift should be ASG or not\r\n" /end ANNOTATION_TEXT
 /end ANNOTATION
/end CHARACTERISTIC
/begin CHARACTERISTIC DST_EFLASHB.DST_ASGRequest.DST_ASGDOWNSHIFTGEARSTACKED "" VALUE 0x806060BB DefaultValueRecordLayout_AUTOSAR_Platform_BaseTypes_uint8 11.0 RB_PT_PCT_SWC_DST_CompuMethods_ident 0.0 11. FORMAT "%10.5"
 /begin ANNOTATION ANNOTATION_LABEL "Description (coming from AUTOSAR DESC field)"
  /begin ANNOTATION_TEXT "Number of gears above DST_DemandGear SEQ_CurrentTorque gear is before ASG downshifts will be requested\r\n" /end ANNOTATION_TEXT
 /end ANNOTATION
/end CHARACTERISTIC
/begin CHARACTERISTIC DST_EFLASHB.DST_ASGRequest.DST_ASGENABLEMANUALDOWNS "" VAL_BLK 0x8060605C DefaultValueRecordLayout_AUTOSAR_Platform_BaseTypes_boolean 255.0 AUTOSAR_Platform_CompuMethods_boolean 0.0 255. FORMAT "%10.5"
 /begin ANNOTATION ANNOTATION_LABEL "Description (coming from AUTOSAR DESC field)"
  /begin ANNOTATION_TEXT "Array to allow or disable ASG shifts in each driving mode\r\n" /end ANNOTATION_TEXT
 /end ANNOTATION
 MATRIX_DIM 17 1 1 /end CHARACTERISTIC
/begin CHARACTERISTIC DST_EFLASHB.DST_ASGRequest.DST_ASGLOWTEMPSHIFTMODES "" VAL_BLK 0x8060606D DefaultValueRecordLayout_AUTOSAR_Platform_BaseTypes_boolean 255.0 AUTOSAR_Platform_CompuMethods_boolean 0.0 255. FORMAT "%10.5"
 /begin ANNOTATION ANNOTATION_LABEL "Description (coming from AUTOSAR DESC field)"
  /begin ANNOTATION_TEXT "Array to allow or disable ASG shifts in each driving mode\r\n" /end ANNOTATION_TEXT
 /end ANNOTATION
 MATRIX_DIM 17 1 1 /end CHARACTERISTIC
/begin CHARACTERISTIC DST_EFLASHB.DST_ASGRequest.DST_ASGMANDOWNRPMTHRESH "" VAL_BLK 0x80605FF6 DefaultValueRecordLayout_AUTOSAR_Platform_BaseTypes_sint16 20000.0 RB_PT_PCT_SWC_DST_CompuMethods_DST_Ident 0.0 20000. FORMAT "%10.5"
 /begin ANNOTATION ANNOTATION_LABEL "Description (coming from AUTOSAR DESC field)"
  /begin ANNOTATION_TEXT "Gear dependant engine speed in target gear to ASG downshift to\r\n" /end ANNOTATION_TEXT
 /end ANNOTATION
 MATRIX_DIM 17 1 1 /end CHARACTERISTIC
/begin CHARACTERISTIC DST_EFLASHB.DST_ASGRequest.DST_ASGPEDALRELATEDDOWNSHIFT "" VAL_BLK 0x8060607E DefaultValueRecordLayout_AUTOSAR_Platform_BaseTypes_uint8 102.0 RB_PT_PCT_SWC_DST_CompuMethods_ratio_0p4 0.0 102. FORMAT "%10.5"
 /begin ANNOTATION ANNOTATION_LABEL "Description (coming from AUTOSAR DESC field)"
  /begin ANNOTATION_TEXT "Minimum throttle pedal to allow ASG style kick-downs in each shift mode\r\n" /end ANNOTATION_TEXT
 /end ANNOTATION
 MATRIX_DIM 17 1 1 /end CHARACTERISTIC
/begin CHARACTERISTIC DST_EFLASHB.DST_ASGRequest.DST_ASGSTACKEDBRKPRESSURE "" VALUE 0x806060AE DefaultValueRecordLayout_AUTOSAR_Platform_BaseTypes_uint16 409.5 RB_PT_PCT_SWC_DST_CompuMethods_ratio_0p1 0.0 409.5 FORMAT "%10.5"
 /begin ANNOTATION ANNOTATION_LABEL "Description (coming from AUTOSAR DESC field)"
  /begin ANNOTATION_TEXT "Minimum brake pressure to enable stacked ASG downshifts\r\n" /end ANNOTATION_TEXT
 /end ANNOTATION
/end CHARACTERISTIC
/begin CHARACTERISTIC DST_EFLASHB.DST_ASGRequest.DST_ASGSTACKEDRPMGEAR "" VALUE 0x806060BC DefaultValueRecordLayout_AUTOSAR_Platform_BaseTypes_uint8 11.0 RB_PT_PCT_SWC_DST_CompuMethods_ident 0.0 11. FORMAT "%10.5"
 /begin ANNOTATION ANNOTATION_LABEL "Description (coming from AUTOSAR DESC field)" /begin ANNOTATION_TEXT "Gears above demand gear to check engine speed\r\n" /end ANNOTATION_TEXT /end ANNOTATION
/end CHARACTERISTIC
/begin CHARACTERISTIC DST_EFLASHB.DST_ASGRequest.DST_ASGSTACKEDRPMGEAROFFSET "" VALUE 0x806060B0 DefaultValueRecordLayout_AUTOSAR_Platform_BaseTypes_sint16 20000.0 RB_PT_PCT_SWC_DST_CompuMethods_ident -10000. 10000. FORMAT "%10.5"
 /begin ANNOTATION ANNOTATION_LABEL "Description (coming from AUTOSAR DESC field)"
  /begin ANNOTATION_TEXT "Offset applied to rpm in gear to request stacked ASG downshift\r\n" /end ANNOTATION_TEXT
 /end ANNOTATION
/end CHARACTERISTIC
/begin CHARACTERISTIC DST_EFLASHB.DST_ASGRequest.DST_ASGSTACKEDTIMEFOOTBRK "" VALUE 0x806060B2 DefaultValueRecordLayout_AUTOSAR_Platform_BaseTypes_uint16 655.35 RB_PT_PCT_SWC_DST_CompuMethods_DST_Time 0.0 655.35 FORMAT "%10.5"
 /begin ANNOTATION ANNOTATION_LABEL "Description (coming from AUTOSAR DESC field)" /begin ANNOTATION_TEXT "Max time since foot brake to activate function.\r\n" /end ANNOTATION_TEXT /end ANNOTATION
/end CHARACTERISTIC
/begin CHARACTERISTIC DST_EFLASHB.DST_ASGRequest.DST_ASGSTACKEDWHEELACCEL "" VALUE 0x806060B4 DefaultValueRecordLayout_AUTOSAR_Platform_BaseTypes_sint16 4.0 RB_PT_PCT_SWC_DST_CompuMethods_ratio_0p0001 -2. 2. FORMAT "%10.5"
 /begin ANNOTATION ANNOTATION_LABEL "Description (coming from AUTOSAR DESC field)"
  /begin ANNOTATION_TEXT "Minimum acceleration to trigger stacked ASG downshifts\r\n" /end ANNOTATION_TEXT
 /end ANNOTATION
/end CHARACTERISTIC
/begin CHARACTERISTIC DST_EFLASHB.DST_ASGRequest.DST_ASGTORQUERELATEDDOWNSHIFT "" VAL_BLK 0x80606018 DefaultValueRecordLayout_AUTOSAR_Platform_BaseTypes_sint16 4000.0 RB_PT_PCT_SWC_DST_CompuMethods_ratio_0p1 -2000. 2000. FORMAT "%10.5"
 /begin ANNOTATION ANNOTATION_LABEL "Description (coming from AUTOSAR DESC field)"
  /begin ANNOTATION_TEXT "Minimum current engine torque to allow ASG style kick-downs in each shift mode\r\n" /end ANNOTATION_TEXT
 /end ANNOTATION
 MATRIX_DIM 17 1 1 /end CHARACTERISTIC
/begin CHARACTERISTIC DST_EFLASHB.DST_ASGRequest.DST_ASGUPMINPEDAL "" VAL_BLK 0x8060608F DefaultValueRecordLayout_AUTOSAR_Platform_BaseTypes_uint8 102.0 RB_PT_PCT_SWC_DST_CompuMethods_ratio_0p4 0.0 102. FORMAT "%10.5"
 /begin ANNOTATION ANNOTATION_LABEL "Description (coming from AUTOSAR DESC field)"
  /begin ANNOTATION_TEXT "Minimum throttle pedal in each mode to allow ASG style up-shifts\r\n" /end ANNOTATION_TEXT
 /end ANNOTATION
 MATRIX_DIM 17 1 1 /end CHARACTERISTIC
/begin CHARACTERISTIC DST_EFLASHB.DST_ASGRequest.DST_ASGUPMINRPM "" VAL_BLK 0x8060603A DefaultValueRecordLayout_AUTOSAR_Platform_BaseTypes_sint16 20000.0 RB_PT_PCT_SWC_DST_CompuMethods_DST_Ident 0.0 20000. FORMAT "%10.5"
 /begin ANNOTATION ANNOTATION_LABEL "Description (coming from AUTOSAR DESC field)"
  /begin ANNOTATION_TEXT "Minimum rpm in each shift mode to allow ASG up-shifts\r\n" /end ANNOTATION_TEXT
 /end ANNOTATION
 MATRIX_DIM 17 1 1 /end CHARACTERISTIC
/begin CHARACTERISTIC DST_EFLASHB.DST_ASGRequest.DST_ASGUPSHIFTMINGEAR "" VALUE 0x806060BD DefaultValueRecordLayout_AUTOSAR_Platform_BaseTypes_uint8 11.0 RB_PT_PCT_SWC_DST_CompuMethods_ident 0.0 11. FORMAT "%10.5"
 /begin ANNOTATION ANNOTATION_LABEL "Description (coming from AUTOSAR DESC field)" /begin ANNOTATION_TEXT "Minimum gear in Manual to ASG down to\r\n" /end ANNOTATION_TEXT /end ANNOTATION
/end CHARACTERISTIC
/begin CHARACTERISTIC DST_EFLASHB.DST_ASGRequest.DST_ENABLEASGDOWNSHIFTS "" VALUE 0x806060BE DefaultValueRecordLayout_AUTOSAR_Platform_BaseTypes_boolean 255.0 AUTOSAR_Platform_CompuMethods_boolean 0.0 255. FORMAT "%10.5"
 /begin ANNOTATION ANNOTATION_LABEL "Description (coming from AUTOSAR DESC field)" /begin ANNOTATION_TEXT "If true torque interrupt shifts willbe enabled\r\n" /end ANNOTATION_TEXT /end ANNOTATION
/end CHARACTERISTIC
/begin CHARACTERISTIC DST_EFLASHB.DST_ASGRequest.DST_ENABLEASGUPSHIFTS "" VALUE 0x806060BF DefaultValueRecordLayout_AUTOSAR_Platform_BaseTypes_boolean 255.0 AUTOSAR_Platform_CompuMethods_boolean 0.0 255. FORMAT "%10.5"
 /begin ANNOTATION ANNOTATION_LABEL "Description (coming from AUTOSAR DESC field)" /begin ANNOTATION_TEXT "Flag to enable torque interrupt up-shifts\r\n" /end ANNOTATION_TEXT /end ANNOTATION
/end CHARACTERISTIC
/begin CHARACTERISTIC DST_EFLASHB.DST_ASGRequest.DST_FORCEASGDOWNSHIFT "" VALUE 0x806060C0 DefaultValueRecordLayout_AUTOSAR_Platform_BaseTypes_boolean 255.0 AUTOSAR_Platform_CompuMethods_boolean 0.0 255. FORMAT "%10.5"
 /begin ANNOTATION ANNOTATION_LABEL "Description (coming from AUTOSAR DESC field)"
  /begin ANNOTATION_TEXT "If true, all downshifts will be requested as torque interrupt shifts\r\n" /end ANNOTATION_TEXT
 /end ANNOTATION
/end CHARACTERISTIC
/begin CHARACTERISTIC DST_EFLASHB.DST_ASGRequest.DST_FORCEASGUPSHIFT "" VALUE 0x806060C1 DefaultValueRecordLayout_AUTOSAR_Platform_BaseTypes_boolean 255.0 AUTOSAR_Platform_CompuMethods_boolean 0.0 255. FORMAT "%10.5"
 /begin ANNOTATION ANNOTATION_LABEL "Description (coming from AUTOSAR DESC field)"
  /begin ANNOTATION_TEXT "If ture, all upshifts will be requested as ASG shifts\r\n" /end ANNOTATION_TEXT
 /end ANNOTATION
/end CHARACTERISTIC
/begin CHARACTERISTIC DST_EFLASHB.DST_ASGRequest.DST_MAXTHROTTLEFORASGROLLOUT "" VALUE 0x806060C2 DefaultValueRecordLayout_AUTOSAR_Platform_BaseTypes_uint8 102.0 RB_PT_PCT_SWC_DST_CompuMethods_ratio_0p4 0.0 102. FORMAT "%10.5"
 /begin ANNOTATION ANNOTATION_LABEL "Description (coming from AUTOSAR DESC field)"
  /begin ANNOTATION_TEXT "Throttle must be below this value to request an ASG auto roll-out downshift\r\n" /end ANNOTATION_TEXT
 /end ANNOTATION
/end CHARACTERISTIC
/begin CHARACTERISTIC DST_EFLASHB.DST_ASGRequest.DST_THROTLE4ASGMANDOWNCANCEL "" VALUE 0x806060C3 DefaultValueRecordLayout_AUTOSAR_Platform_BaseTypes_uint8 102.0 RB_PT_PCT_SWC_DST_CompuMethods_ratio_0p4 0.0 102. FORMAT "%10.5"
 /begin ANNOTATION ANNOTATION_LABEL "Description (coming from AUTOSAR DESC field)"
  /begin ANNOTATION_TEXT "Throttle pedal above which DST_ASGDownLowPwrOrPwrOffManual will be set false\r\n" /end ANNOTATION_TEXT
 /end ANNOTATION
/end CHARACTERISTIC
/begin CHARACTERISTIC DST_EFLASHB.DST_ASGRequest.DST_THROTLE4ASGMANDOWNSET "" VALUE 0x806060C4 DefaultValueRecordLayout_AUTOSAR_Platform_BaseTypes_uint8 102.0 RB_PT_PCT_SWC_DST_CompuMethods_ratio_0p4 0.0 102. FORMAT "%10.5"
 /begin ANNOTATION ANNOTATION_LABEL "Description (coming from AUTOSAR DESC field)"
  /begin ANNOTATION_TEXT "Throttle pedal below which Manual downshifts will be requested as ASG shifts\r\n" /end ANNOTATION_TEXT
 /end ANNOTATION
/end CHARACTERISTIC
/begin CHARACTERISTIC DST_EFLASHB.DST_ASGRequest.DST_TORQUE4ASGMANDOWNCANCEL "" VALUE 0x806060B6 DefaultValueRecordLayout_AUTOSAR_Platform_BaseTypes_sint16 4000.0 RB_PT_PCT_SWC_DST_CompuMethods_ratio_0p1 -2000. 2000. FORMAT "%10.5"
 /begin ANNOTATION ANNOTATION_LABEL "Description (coming from AUTOSAR DESC field)"
  /begin ANNOTATION_TEXT "Engine torque above which DST_ASGDownLowPwrOrPwrOffManual will be set false\r\n" /end ANNOTATION_TEXT
 /end ANNOTATION
/end CHARACTERISTIC
/begin CHARACTERISTIC DST_EFLASHB.DST_ASGRequest.DST_TORQUE4ASGMANDOWNSET "" VALUE 0x806060B8 DefaultValueRecordLayout_AUTOSAR_Platform_BaseTypes_sint16 4000.0 RB_PT_PCT_SWC_DST_CompuMethods_ratio_0p1 -2000. 2000. FORMAT "%10.5"
 /begin ANNOTATION ANNOTATION_LABEL "Description (coming from AUTOSAR DESC field)"
  /begin ANNOTATION_TEXT "Engine torque below which Manual downshifts will be requested as ASG shifts\r\n" /end ANNOTATION_TEXT
 /end ANNOTATION
/end CHARACTERISTIC
/begin CHARACTERISTIC DST_EFLASHB.DST_ASGRequest.DST_TORQUEBASEDASGSHIFTDECISIONS "" VALUE 0x806060C5 DefaultValueRecordLayout_AUTOSAR_Platform_BaseTypes_boolean 255.0 AUTOSAR_Platform_CompuMethods_boolean 0.0 255. FORMAT "%10.5"
 /begin ANNOTATION ANNOTATION_LABEL "Description (coming from AUTOSAR DESC field)"
  /begin ANNOTATION_TEXT "Flag to use current engine torque for ASG downshift decisions as opposed to throttle position\r\n" /end ANNOTATION_TEXT
 /end ANNOTATION
/end CHARACTERISTIC
/begin CHARACTERISTIC DST_EFLASHB.DST_BOBDPRESELECTGEARENABLE "" VALUE 0x80605F8C DefaultValueRecordLayout_AUTOSAR_Platform_BaseTypes_uint16 65535.0 RB_PT_PCT_SWC_DST_CompuMethods_ident 0.0 65535. FORMAT "%10.5"
 /begin ANNOTATION ANNOTATION_LABEL "Description (coming from AUTOSAR DESC field)"
  /begin ANNOTATION_TEXT "Set to true if manual override of demand gear is required\r\n" /end ANNOTATION_TEXT
 /end ANNOTATION
/end CHARACTERISTIC
/begin CHARACTERISTIC DST_EFLASHB.DST_BOBPRESELECTGEAR "" VALUE 0x80605F8E DefaultValueRecordLayout_AUTOSAR_Platform_BaseTypes_uint8 11.0 RB_PT_PCT_SWC_DST_CompuMethods_ident 0.0 11. FORMAT "%10.5"
 /begin ANNOTATION ANNOTATION_LABEL "Description (coming from AUTOSAR DESC field)"
  /begin ANNOTATION_TEXT "When DST_BOBPRESELECTGEARENABLE is set to 21930, this will be used as the preselect gear\r\n" /end ANNOTATION_TEXT
 /end ANNOTATION
/end CHARACTERISTIC
/begin CHARACTERISTIC DST_EFLASHB.DST_DG.DST_AutoManGearTargets.DST_HIGHGEARRPMHYST "" VALUE 0x806060CA DefaultValueRecordLayout_AUTOSAR_Platform_BaseTypes_sint16 100.0 RB_PT_PCT_SWC_DST_CompuMethods_DST_Ident 0.0 100. FORMAT "%10.5"
 /begin ANNOTATION ANNOTATION_LABEL "Description (coming from AUTOSAR DESC field)" /begin ANNOTATION_TEXT "Hyst applied to high gear lower limit\r\n" /end ANNOTATION_TEXT /end ANNOTATION
/end CHARACTERISTIC
/begin CHARACTERISTIC DST_EFLASHB.DST_DG.DST_AutoManGearTargets.DST_LOWGEARPMHYST "" VALUE 0x806060CC DefaultValueRecordLayout_AUTOSAR_Platform_BaseTypes_sint16 100.0 RB_PT_PCT_SWC_DST_CompuMethods_DST_Ident 0.0 100. FORMAT "%10.5"
 /begin ANNOTATION ANNOTATION_LABEL "Description (coming from AUTOSAR DESC field)" /begin ANNOTATION_TEXT "Hyst applied to high gear lower limit\r\n" /end ANNOTATION_TEXT /end ANNOTATION
/end CHARACTERISTIC
/begin CHARACTERISTIC DST_EFLASHB.DST_DG.DST_DGSelect.DST_ALWAYSPERFORMDIRECTDOWNSHIFTS "" VALUE 0x80606256 DefaultValueRecordLayout_AUTOSAR_Platform_BaseTypes_boolean 255.0 AUTOSAR_Platform_CompuMethods_boolean 0.0 255. FORMAT "%10.5"
 /begin ANNOTATION ANNOTATION_LABEL "Description (coming from AUTOSAR DESC field)"
  /begin ANNOTATION_TEXT "If true, downshifts will always be performed directly from the shift maps\r\n" /end ANNOTATION_TEXT
 /end ANNOTATION
/end CHARACTERISTIC
/end MODULE
/end PROJECT
