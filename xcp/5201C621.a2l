ASAP2_VERSION 1 60
/begin PROJECT LB74x_TCU "5201C621"
/begin HEADER "" VERSION "5201C621" PROJECT_NO LB74x_TCU /end HEADER
/begin MODULE DIM ""
/begin MOD_COMMON "" BYTE_ORDER MSB_LAST ALIGNMENT_BYTE 1 ALIGNMENT_WORD 2 ALIGNMENT_LONG 4 ALIGNMENT_INT64 4 ALIGNMENT_FLOAT32_IEEE 4 ALIGNMENT_FLOAT64_IEEE 4 DATA_SIZE 32 /end MOD_COMMON
/begin CHARACTERISTIC DST_EFLASHB.DST_PSG.DST_PREDNPWROFFTHROTTLESET "" VALUE 0x80606F15 DefaultValueRecordLayout_AUTOSAR_Platform_BaseTypes_uint8 102.0 RB_PT_PCT_SWC_DST_CompuMethods_ratio_0p4 0.0 102. FORMAT "%10.5"
 /begin ANNOTATION ANNOTATION_LABEL "Description (coming from AUTOSAR DESC field)"
  /begin ANNOTATION_TEXT "THrottle angle below which the power off down preselect is set\r\n" /end ANNOTATION_TEXT
 /end ANNOTATION
/end CHARACTERISTIC
/begin CHARACTERISTIC DST_EFLASHB.DST_PSG.DST_PREDNTOPGEAR "" VALUE 0x80606F16 DefaultValueRecordLayout_AUTOSAR_Platform_BaseTypes_uint8 255.0 RB_PT_PCT_SWC_DST_CompuMethods_ident 0.0 255. FORMAT "%10.5"
 /begin ANNOTATION ANNOTATION_LABEL "Description (coming from AUTOSAR DESC field)"
  /begin ANNOTATION_TEXT "Preselect down priority if the two stage down-shift paddle is half pulled\r\n" /end ANNOTATION_TEXT
 /end ANNOTATION
/end CHARACTERISTIC
/begin CHARACTERISTIC DST_EFLASHB.DST_PSG.DST_PREFILLRPMCANCEL "" VALUE 0x80606EE6 DefaultValueRecordLayout_AUTOSAR_Platform_BaseTypes_sint16 20000.0 RB_PT_PCT_SWC_DST_CompuMethods_DST_Ident 0.0 20000. FORMAT "%10.5"
 /begin ANNOTATION ANNOTATION_LABEL "Description (coming from AUTOSAR DESC field)"
  /begin ANNOTATION_TEXT "rpm in demand below which up-shift prefill will be cancelled\r\n" /end ANNOTATION_TEXT
 /end ANNOTATION
/end CHARACTERISTIC
/begin CHARACTERISTIC DST_EFLASHB.DST_PSG.DST_PREFILLRPMSET "" VALUE 0x80606EE8 DefaultValueRecordLayout_AUTOSAR_Platform_BaseTypes_sint16 20000.0 RB_PT_PCT_SWC_DST_CompuMethods_DST_Ident 0.0 20000. FORMAT "%10.5"
 /begin ANNOTATION ANNOTATION_LABEL "Description (coming from AUTOSAR DESC field)"
  /begin ANNOTATION_TEXT "Rpm in demand above which up shift prefill will be set\r\n" /end ANNOTATION_TEXT
 /end ANNOTATION
/end CHARACTERISTIC
/begin CHARACTERISTIC DST_EFLASHB.DST_PSG.DST_PREFILLTHROTTLECANCEL "" VALUE 0x80606F17 DefaultValueRecordLayout_AUTOSAR_Platform_BaseTypes_uint8 102.0 RB_PT_PCT_SWC_DST_CompuMethods_ratio_0p4 0.0 102. FORMAT "%10.5"
 /begin ANNOTATION ANNOTATION_LABEL "Description (coming from AUTOSAR DESC field)" /begin ANNOTATION_TEXT "Percent throttle that will cancel upshift prefill\r\n" /end ANNOTATION_TEXT /end ANNOTATION
/end CHARACTERISTIC
/begin CHARACTERISTIC DST_EFLASHB.DST_PSG.DST_PREFILLTHROTTLESET "" VALUE 0x80606F18 DefaultValueRecordLayout_AUTOSAR_Platform_BaseTypes_uint8 102.0 RB_PT_PCT_SWC_DST_CompuMethods_ratio_0p4 0.0 102. FORMAT "%10.5"
 /begin ANNOTATION ANNOTATION_LABEL "Description (coming from AUTOSAR DESC field)" /begin ANNOTATION_TEXT "Percent throttle that will set upshift prefill\r\n" /end ANNOTATION_TEXT /end ANNOTATION
/end CHARACTERISTIC
/begin CHARACTERISTIC DST_EFLASHB.DST_PSG.DST_PREFWDINREVDISABLE "" VALUE 0x80606EEA DefaultValueRecordLayout_AUTOSAR_Platform_BaseTypes_uint16 500.0 RB_PT_PCT_SWC_DST_CompuMethods_kph_0p1 0.0 500. FORMAT "%10.5"
 /begin ANNOTATION ANNOTATION_LABEL "Description (coming from AUTOSAR DESC field)"
  /begin ANNOTATION_TEXT "Vehicle speed below which in Reverse a forward gear can be selected\r\n" /end ANNOTATION_TEXT
 /end ANNOTATION
/end CHARACTERISTIC
/begin CHARACTERISTIC DST_EFLASHB.DST_PSG.DST_PREFWDINREVENABLE "" VALUE 0x80606EEC DefaultValueRecordLayout_AUTOSAR_Platform_BaseTypes_uint16 500.0 RB_PT_PCT_SWC_DST_CompuMethods_kph_0p1 0.0 500. FORMAT "%10.5"
 /begin ANNOTATION ANNOTATION_LABEL "Description (coming from AUTOSAR DESC field)"
  /begin ANNOTATION_TEXT "Vehicle speed below which in Reverse a forward gear can be selected\r\n" /end ANNOTATION_TEXT
 /end ANNOTATION
/end CHARACTERISTIC
/begin CHARACTERISTIC DST_EFLASHB.DST_PSG.DST_PRESELECTDISABLEGEAR "" VALUE 0x80606F19 DefaultValueRecordLayout_AUTOSAR_Platform_BaseTypes_uint8 11.0 RB_PT_PCT_SWC_DST_CompuMethods_ident 0.0 11. FORMAT "%10.5"
 /begin ANNOTATION ANNOTATION_LABEL "Description (coming from AUTOSAR DESC field)"
  /begin ANNOTATION_TEXT "If DST_DISABLE.....GEARS is true, this gives the option to still allow preselect in the lower gears\r\n" /end ANNOTATION_TEXT
 /end ANNOTATION
/end CHARACTERISTIC
/begin CHARACTERISTIC DST_EFLASHB.DST_PSG.DST_PRESELECTGEARCONF "" VAL_BLK 0x80606EA1 DefaultValueRecordLayout_AUTOSAR_Platform_BaseTypes_uint8 10.0 RB_PT_PCT_SWC_DST_CompuMethods_ident 0.0 10. FORMAT "%10.5"
 /begin ANNOTATION ANNOTATION_LABEL "Description (coming from AUTOSAR DESC field)"
  /begin ANNOTATION_TEXT "Configuration of preselect gears.  Row 0 = Preselect down gear, 1 = Preselect up gear\r\n" /end ANNOTATION_TEXT
 /end ANNOTATION
 MATRIX_DIM 17 2 1 /end CHARACTERISTIC
/begin CHARACTERISTIC DST_EFLASHB.DST_PSG.DST_PRESELECTUPINFIRST "" VAL_BLK 0x80606EC3 DefaultValueRecordLayout_AUTOSAR_Platform_BaseTypes_boolean 255.0 AUTOSAR_Platform_CompuMethods_boolean 0.0 255. FORMAT "%10.5"
 /begin ANNOTATION ANNOTATION_LABEL "Description (coming from AUTOSAR DESC field)" /begin ANNOTATION_TEXT "Based on shiftmode\r\n" /end ANNOTATION_TEXT /end ANNOTATION
 MATRIX_DIM 17 1 1 /end CHARACTERISTIC
/begin CHARACTERISTIC DST_EFLASHB.DST_PSG.DST_PRESELECTUPMODERPMCANCEL "" VAL_BLK 0x80606E2A DefaultValueRecordLayout_AUTOSAR_Platform_BaseTypes_sint16 20000.0 RB_PT_PCT_SWC_DST_CompuMethods_DST_Ident 0.0 20000. FORMAT "%10.5"
 /begin ANNOTATION ANNOTATION_LABEL "Description (coming from AUTOSAR DESC field)"
  /begin ANNOTATION_TEXT "Engine speed above which in the mode preselect up will be requested\r\n" /end ANNOTATION_TEXT
 /end ANNOTATION
 MATRIX_DIM 17 1 1 /end CHARACTERISTIC
/begin CHARACTERISTIC DST_EFLASHB.DST_PSG.DST_PRESELECTUPMODERPMTRIGGER "" VAL_BLK 0x80606E4C DefaultValueRecordLayout_AUTOSAR_Platform_BaseTypes_sint16 20000.0 RB_PT_PCT_SWC_DST_CompuMethods_DST_Ident 0.0 20000. FORMAT "%10.5"
 /begin ANNOTATION ANNOTATION_LABEL "Description (coming from AUTOSAR DESC field)"
  /begin ANNOTATION_TEXT "Engine speed above which in the mode preselect up will be requested\r\n" /end ANNOTATION_TEXT
 /end ANNOTATION
 MATRIX_DIM 17 1 1 /end CHARACTERISTIC
/begin CHARACTERISTIC DST_EFLASHB.DST_PSG.DST_PREUP_ABOUT2UPSHIFTCANCELTIME "" VALUE 0x80606EF6 DefaultValueRecordLayout_AUTOSAR_Platform_BaseTypes_uint16 655.35 RB_PT_PCT_SWC_DST_CompuMethods_DST_Time 0.0 655.35 FORMAT "%10.5"
 /begin ANNOTATION ANNOTATION_LABEL "Description (coming from AUTOSAR DESC field)" /begin ANNOTATION_TEXT "Time since preup set conditions true\r\n" /end ANNOTATION_TEXT /end ANNOTATION
/end CHARACTERISTIC
/begin CHARACTERISTIC DST_EFLASHB.DST_PSG.DST_PREUPABOUT2SHIFT "" VALUE 0x80606F1A DefaultValueRecordLayout_AUTOSAR_Platform_BaseTypes_uint8 255.0 RB_PT_PCT_SWC_DST_CompuMethods_ident 0.0 255. FORMAT "%10.5"
 /begin ANNOTATION ANNOTATION_LABEL "Description (coming from AUTOSAR DESC field)"
  /begin ANNOTATION_TEXT "Preselect priority for preselect up request due time to shift\r\n" /end ANNOTATION_TEXT
 /end ANNOTATION
/end CHARACTERISTIC
/begin CHARACTERISTIC DST_EFLASHB.DST_PSG.DST_PREUPFORWARD1STMAXIDLE "" VALUE 0x80606EEE DefaultValueRecordLayout_AUTOSAR_Platform_BaseTypes_uint16 20000.0 RB_PT_PCT_SWC_DST_CompuMethods_ident 0.0 20000. FORMAT "%10.5"
 /begin ANNOTATION ANNOTATION_LABEL "Description (coming from AUTOSAR DESC field)"
  /begin ANNOTATION_TEXT "Idle speed below which 2nd gear will be preselected when the demand gear is 1st\r\n" /end ANNOTATION_TEXT
 /end ANNOTATION
/end CHARACTERISTIC
/begin CHARACTERISTIC DST_EFLASHB.DST_PSG.DST_PREUPFORWARD1STMAXKMH "" VALUE 0x80606EF0 DefaultValueRecordLayout_AUTOSAR_Platform_BaseTypes_uint16 500.0 RB_PT_PCT_SWC_DST_CompuMethods_kph_0p1 0.0 500. FORMAT "%10.5"
 /begin ANNOTATION ANNOTATION_LABEL "Description (coming from AUTOSAR DESC field)"
  /begin ANNOTATION_TEXT "Vehicle speed below which 2nd will preselected when 1st gear is requested\r\n" /end ANNOTATION_TEXT
 /end ANNOTATION
/end CHARACTERISTIC
/begin CHARACTERISTIC DST_EFLASHB.DST_PSG.DST_PREUPFORWARDIN1ST "" VALUE 0x80606F1B DefaultValueRecordLayout_AUTOSAR_Platform_BaseTypes_uint8 255.0 RB_PT_PCT_SWC_DST_CompuMethods_ident 0.0 255. FORMAT "%10.5"
 /begin ANNOTATION ANNOTATION_LABEL "Description (coming from AUTOSAR DESC field)"
  /begin ANNOTATION_TEXT "Preselect priority for preselect up request due 1st gear being engaged and the vehicle travelling forwards\r\n" /end ANNOTATION_TEXT
 /end ANNOTATION
/end CHARACTERISTIC
/begin CHARACTERISTIC DST_EFLASHB.DST_PSG.DST_PREUPFORWARDMINTHROTTLE "" VALUE 0x80606F1C DefaultValueRecordLayout_AUTOSAR_Platform_BaseTypes_uint8 102.0 RB_PT_PCT_SWC_DST_CompuMethods_ratio_0p4 0.0 102. FORMAT "%10.5"
 /begin ANNOTATION ANNOTATION_LABEL "Description (coming from AUTOSAR DESC field)"
  /begin ANNOTATION_TEXT "Throttle pedal when not in Neutral above which 2nd gear preselect inhibit due to high idle is prevented\r\n" /end ANNOTATION_TEXT
 /end ANNOTATION
/end CHARACTERISTIC
/begin CHARACTERISTIC DST_EFLASHB.DST_PSG.DST_PREUPHALFPULLUPPAD "" VALUE 0x80606F1D DefaultValueRecordLayout_AUTOSAR_Platform_BaseTypes_uint8 255.0 RB_PT_PCT_SWC_DST_CompuMethods_ident 0.0 255. FORMAT "%10.5"
 /begin ANNOTATION ANNOTATION_LABEL "Description (coming from AUTOSAR DESC field)"
  /begin ANNOTATION_TEXT "Preselect priority if a two stage upshift paddle is half pulled\r\n" /end ANNOTATION_TEXT
 /end ANNOTATION
/end CHARACTERISTIC
/begin CHARACTERISTIC DST_EFLASHB.DST_PSG.DST_PREUPHIGHREVS "" VALUE 0x80606F1E DefaultValueRecordLayout_AUTOSAR_Platform_BaseTypes_uint8 255.0 RB_PT_PCT_SWC_DST_CompuMethods_ident 0.0 255. FORMAT "%10.5"
 /begin ANNOTATION ANNOTATION_LABEL "Description (coming from AUTOSAR DESC field)"
  /begin ANNOTATION_TEXT "Preselect priority for preselect up with high engine speed\r\n" /end ANNOTATION_TEXT
 /end ANNOTATION
/end CHARACTERISTIC
/begin CHARACTERISTIC DST_EFLASHB.DST_PSG.DST_PREUPHIGHRPMCANCEL "" VALUE 0x80606EF2 DefaultValueRecordLayout_AUTOSAR_Platform_BaseTypes_sint16 20000.0 RB_PT_PCT_SWC_DST_CompuMethods_DST_Ident 0.0 20000. FORMAT "%10.5"
 /begin ANNOTATION ANNOTATION_LABEL "Description (coming from AUTOSAR DESC field)"
  /begin ANNOTATION_TEXT "Input speed above which a downshift is not possible and an upshift is immenant (probably)\r\n" /end ANNOTATION_TEXT
 /end ANNOTATION
/end CHARACTERISTIC
/begin CHARACTERISTIC DST_EFLASHB.DST_PSG.DST_PREUPHIGHRPMSET "" VALUE 0x80606EF4 DefaultValueRecordLayout_AUTOSAR_Platform_BaseTypes_sint16 20000.0 RB_PT_PCT_SWC_DST_CompuMethods_DST_Ident 0.0 20000. FORMAT "%10.5"
 /begin ANNOTATION ANNOTATION_LABEL "Description (coming from AUTOSAR DESC field)"
  /begin ANNOTATION_TEXT "Input speed above which a downshift is not possible and an upshift is immenant (probably)\r\n" /end ANNOTATION_TEXT
 /end ANNOTATION
/end CHARACTERISTIC
/begin CHARACTERISTIC DST_EFLASHB.DST_PSG.DST_PREUPMODE "" VALUE 0x80606F1F DefaultValueRecordLayout_AUTOSAR_Platform_BaseTypes_uint8 255.0 RB_PT_PCT_SWC_DST_CompuMethods_ident 0.0 255. FORMAT "%10.5"
 /begin ANNOTATION ANNOTATION_LABEL "Description (coming from AUTOSAR DESC field)"
  /begin ANNOTATION_TEXT "Preselect priority for preselect up request due to drivin gmode\r\n" /end ANNOTATION_TEXT
 /end ANNOTATION
/end CHARACTERISTIC
/begin CHARACTERISTIC DST_EFLASHB.DST_PSG.DST_PREUPSEQUENTIALUPS "" VALUE 0x80606F20 DefaultValueRecordLayout_AUTOSAR_Platform_BaseTypes_uint8 255.0 RB_PT_PCT_SWC_DST_CompuMethods_ident 0.0 255. FORMAT "%10.5"
 /begin ANNOTATION ANNOTATION_LABEL "Description (coming from AUTOSAR DESC field)"
  /begin ANNOTATION_TEXT "Priority for preselect up when a sequential upshift is expected\r\n" /end ANNOTATION_TEXT
 /end ANNOTATION
/end CHARACTERISTIC
/begin CHARACTERISTIC DST_EFLASHB.DST_PSG.DST_REFSPDTOALLOWPRESELECTDOWN1ST "" VALUE 0x80606EF8 DefaultValueRecordLayout_AUTOSAR_Platform_BaseTypes_uint16 500.0 RB_PT_PCT_SWC_DST_CompuMethods_kph_0p1 0.0 500. FORMAT "%10.5"
 /begin ANNOTATION ANNOTATION_LABEL "Description (coming from AUTOSAR DESC field)"
  /begin ANNOTATION_TEXT "Reference speed above which preselecting down to first is disabled\r\n" /end ANNOTATION_TEXT
 /end ANNOTATION
/end CHARACTERISTIC
/begin CHARACTERISTIC DST_EFLASHB.DST_PSG.DST_REFSPDTOBLOCKPRESELECTDOWN1ST "" VALUE 0x80606EFA DefaultValueRecordLayout_AUTOSAR_Platform_BaseTypes_uint16 500.0 RB_PT_PCT_SWC_DST_CompuMethods_kph_0p1 0.0 500. FORMAT "%10.5"
 /begin ANNOTATION ANNOTATION_LABEL "Description (coming from AUTOSAR DESC field)"
  /begin ANNOTATION_TEXT "Reference speed above which preselecting down to first is disabled\r\n" /end ANNOTATION_TEXT
 /end ANNOTATION
/end CHARACTERISTIC
/begin CHARACTERISTIC DST_EFLASHB.DST_PSG.DST_ShiftTimeComp_Preselect.DST_MINRPM2PREDN "" VALUE 0x80606F24 DefaultValueRecordLayout_AUTOSAR_Platform_BaseTypes_uint16 1500.0 RB_PT_PCT_SWC_DST_CompuMethods_ident 0.0 1500. FORMAT "%10.5"
 /begin ANNOTATION ANNOTATION_LABEL "Description (coming from AUTOSAR DESC field)"
  /begin ANNOTATION_TEXT "Minimum engine speed to preselect up, regardless of gradient calc\r\n" /end ANNOTATION_TEXT
 /end ANNOTATION
/end CHARACTERISTIC
/begin CHARACTERISTIC DST_EFLASHB.DST_PSG.DST_ShiftTimeComp_Preselect.DST_MINRPM2PREUP "" VALUE 0x80606F26 DefaultValueRecordLayout_AUTOSAR_Platform_BaseTypes_uint16 1500.0 RB_PT_PCT_SWC_DST_CompuMethods_ident 0.0 1500. FORMAT "%10.5"
 /begin ANNOTATION ANNOTATION_LABEL "Description (coming from AUTOSAR DESC field)"
  /begin ANNOTATION_TEXT "Minimum engine speed to preselect up, regardless of gradient calc\r\n" /end ANNOTATION_TEXT
 /end ANNOTATION
/end CHARACTERISTIC
/begin CHARACTERISTIC DST_EFLASHB.DST_PSG.DST_ShiftTimeComp_Preselect.DST_MINUPSHIFT4PS "" VALUE 0x80606F28 DefaultValueRecordLayout_AUTOSAR_Platform_BaseTypes_sint16 20000.0 RB_PT_PCT_SWC_DST_CompuMethods_DST_Ident 0.0 20000. FORMAT "%10.5"
 /begin ANNOTATION ANNOTATION_LABEL "Description (coming from AUTOSAR DESC field)"
  /begin ANNOTATION_TEXT "up shift trigger rpm below which preselect will not be requested before the shift\r\n" /end ANNOTATION_TEXT
 /end ANNOTATION
/end CHARACTERISTIC
/begin CHARACTERISTIC DST_EFLASHB.DST_PSG.DST_ShiftTimeComp_Preselect.DST_PRESELECT_HYST "" VALUE 0x80606F2A DefaultValueRecordLayout_AUTOSAR_Platform_BaseTypes_sint16 20000.0 RB_PT_PCT_SWC_DST_CompuMethods_DST_Ident 0.0 20000. FORMAT "%10.5"
 /begin ANNOTATION ANNOTATION_LABEL "Description (coming from AUTOSAR DESC field)"
  /begin ANNOTATION_TEXT "Hysteresis between preselect set and preselect cancel\r\n" /end ANNOTATION_TEXT
 /end ANNOTATION
/end CHARACTERISTIC
/begin CHARACTERISTIC DST_EFLASHB.DST_PSG.DST_SHUTTLEACTIVEMAXTIME "" VALUE 0x80606EFC DefaultValueRecordLayout_AUTOSAR_Platform_BaseTypes_uint16 655.35 RB_PT_PCT_SWC_DST_CompuMethods_DST_Time 0.0 655.35 FORMAT "%10.5"
 /begin ANNOTATION ANNOTATION_LABEL "Description (coming from AUTOSAR DESC field)"
  /begin ANNOTATION_TEXT "Time since Reverse was selected to cancel Shuttle preselect\r\n" /end ANNOTATION_TEXT
 /end ANNOTATION
/end CHARACTERISTIC
/begin CHARACTERISTIC DST_EFLASHB.DST_PSG.DST_SHUTTLECANCELKMH "" VALUE 0x80606EFE DefaultValueRecordLayout_AUTOSAR_Platform_BaseTypes_uint16 500.0 RB_PT_PCT_SWC_DST_CompuMethods_kph_0p1 0.0 500. FORMAT "%10.5"
 /begin ANNOTATION ANNOTATION_LABEL "Description (coming from AUTOSAR DESC field)"
  /begin ANNOTATION_TEXT "When not in R, vehicle speed above which shuttling flag will be set false\r\n" /end ANNOTATION_TEXT
 /end ANNOTATION
/end CHARACTERISTIC
/begin CHARACTERISTIC DST_EFLASHB.DST_PSG.DST_SHUTTLECANCELTHROTTLE "" VALUE 0x80606F21 DefaultValueRecordLayout_AUTOSAR_Platform_BaseTypes_uint8 102.0 RB_PT_PCT_SWC_DST_CompuMethods_ratio_0p4 0.0 102. FORMAT "%10.5"
 /begin ANNOTATION ANNOTATION_LABEL "Description (coming from AUTOSAR DESC field)"
  /begin ANNOTATION_TEXT "Throttle pedal when not in Reverse above which shuttling is cancelled\r\n" /end ANNOTATION_TEXT
 /end ANNOTATION
/end CHARACTERISTIC
/begin CHARACTERISTIC DST_EFLASHB.DST_PSG.DST_SHUTTLEENABLE "" VALUE 0x80606F22 DefaultValueRecordLayout_AUTOSAR_Platform_BaseTypes_boolean 255.0 AUTOSAR_Platform_CompuMethods_boolean 0.0 255. FORMAT "%10.5"
 /begin ANNOTATION ANNOTATION_LABEL "Description (coming from AUTOSAR DESC field)"
  /begin ANNOTATION_TEXT "Set true if the shuttling preselection logic is to be used\r\n" /end ANNOTATION_TEXT
 /end ANNOTATION
/end CHARACTERISTIC
/begin CHARACTERISTIC DST_EFLASHB.DST_PSG.DST_SHUTTLEINPUTSPEEDDISABLE "" VALUE 0x80606F00 DefaultValueRecordLayout_AUTOSAR_Platform_BaseTypes_uint16 20000.0 RB_PT_PCT_SWC_DST_CompuMethods_ident 0.0 20000. FORMAT "%10.5"
 /begin ANNOTATION ANNOTATION_LABEL "Description (coming from AUTOSAR DESC field)" /begin ANNOTATION_TEXT "Input speed above which shuttling is disabled\r\n" /end ANNOTATION_TEXT /end ANNOTATION
/end CHARACTERISTIC
/begin CHARACTERISTIC DST_EFLASHB.DST_PSG.DST_SHUTTLEINPUTSPEEDENABLE "" VALUE 0x80606F02 DefaultValueRecordLayout_AUTOSAR_Platform_BaseTypes_uint16 20000.0 RB_PT_PCT_SWC_DST_CompuMethods_ident 0.0 20000. FORMAT "%10.5"
 /begin ANNOTATION ANNOTATION_LABEL "Description (coming from AUTOSAR DESC field)" /begin ANNOTATION_TEXT "Input shaft speed below which shuttling is enabled\r\n" /end ANNOTATION_TEXT /end ANNOTATION
/end CHARACTERISTIC
/begin CHARACTERISTIC DST_EFLASHB.DST_PSG.DST_SHUTTLESETKMH1st "" VALUE 0x80606F04 DefaultValueRecordLayout_AUTOSAR_Platform_BaseTypes_uint16 500.0 RB_PT_PCT_SWC_DST_CompuMethods_kph_0p1 0.0 500. FORMAT "%10.5"
 /begin ANNOTATION ANNOTATION_LABEL "Description (coming from AUTOSAR DESC field)"
  /begin ANNOTATION_TEXT "When not in R, vehicle speed above which shuttling flag will be set false\r\n" /end ANNOTATION_TEXT
 /end ANNOTATION
/end CHARACTERISTIC
/begin CHARACTERISTIC DST_EFLASHB.DST_PSG.DST_SHUTTLETRUEINPARK "" VALUE 0x80606F23 DefaultValueRecordLayout_AUTOSAR_Platform_BaseTypes_boolean 255.0 AUTOSAR_Platform_CompuMethods_boolean 0.0 255. FORMAT "%10.5"
 /begin ANNOTATION ANNOTATION_LABEL "Description (coming from AUTOSAR DESC field)" /begin ANNOTATION_TEXT "If true, shutting will be set true in Park\r\n" /end ANNOTATION_TEXT /end ANNOTATION
/end CHARACTERISTIC
/begin CHARACTERISTIC DST_EFLASHB.DST_RefSpdCalc.DST_DECELFROMLATACC "" CURVE 0x80606F3C RB_PT_PCT_SWC_DST_RecordLayouts_RL_Curve_uint16_3_uint8_3 5.0 RB_PT_PCT_SWC_DST_CompuMethods_ratio_0p01 0.0 5. FORMAT "%10.5"
 /begin ANNOTATION ANNOTATION_LABEL "Description (coming from AUTOSAR DESC field)" /begin ANNOTATION_TEXT "Deceleration limit from Lateral accelerometer\r\n" /end ANNOTATION_TEXT /end ANNOTATION
 /begin AXIS_DESCR STD_AXIS NO_INPUT_QUANTITY RB_PT_PCT_SWC_DST_CompuMethods_ratio_0p01 3 0.0 1.27 FORMAT "%10.5" DEPOSIT ABSOLUTE /end AXIS_DESCR
/end CHARACTERISTIC
/begin CHARACTERISTIC DST_EFLASHB.DST_RefSpdCalc.DST_DECELFROMLONGACC "" CURVE 0x80606F48 RB_PT_PCT_SWC_DST_RecordLayouts_RL_Curve_uint16_3_sint16_3 5.0 RB_PT_PCT_SWC_DST_CompuMethods_ratio_0p01 0.0 5. FORMAT "%10.5"
 /begin ANNOTATION ANNOTATION_LABEL "Description (coming from AUTOSAR DESC field)"
  /begin ANNOTATION_TEXT "Limit of Reference Speed Deceleration based on Longitudinal acceleration\r\n" /end ANNOTATION_TEXT
 /end ANNOTATION
 /begin AXIS_DESCR STD_AXIS NO_INPUT_QUANTITY RB_PT_PCT_SWC_DST_CompuMethods_ratio_0p03125 3 -16. 15.96875 FORMAT "%10.5" DEPOSIT ABSOLUTE /end AXIS_DESCR
/end CHARACTERISTIC
/begin CHARACTERISTIC DST_EFLASHB.DST_RefSpdCalc.DST_GRADIENTZEROROLLINGROADTIME "" VALUE 0x80606F2C DefaultValueRecordLayout_AUTOSAR_Platform_BaseTypes_uint16 655.35 RB_PT_PCT_SWC_DST_CompuMethods_DST_Time 0.0 655.35 FORMAT "%10.5"
 /begin ANNOTATION ANNOTATION_LABEL "Description (coming from AUTOSAR DESC field)"
  /begin ANNOTATION_TEXT "Time front to rear error needs to be 10km/h to enable rolling road detection and reset gradient\r\n" /end ANNOTATION_TEXT
 /end ANNOTATION
/end CHARACTERISTIC
/begin CHARACTERISTIC DST_EFLASHB.DST_RefSpdCalc.DST_KL15HIGH2SENSORSOK "" VALUE 0x80606F2E DefaultValueRecordLayout_AUTOSAR_Platform_BaseTypes_uint16 100.0 RB_PT_PCT_SWC_DST_CompuMethods_DST_Time 0.0 100. FORMAT "%10.5"
 /begin ANNOTATION ANNOTATION_LABEL "Description (coming from AUTOSAR DESC field)" /begin ANNOTATION_TEXT "Time after KL15 is on before the sensors are ok\r\n" /end ANNOTATION_TEXT /end ANNOTATION
/end CHARACTERISTIC
/begin CHARACTERISTIC DST_EFLASHB.DST_RefSpdCalc.DST_MAXACCELFROMLONGACC "" CURVE 0x80606F56 RB_PT_PCT_SWC_DST_RecordLayouts_RL_Curve_uint16_3_sint16_3 5.0 RB_PT_PCT_SWC_DST_CompuMethods_ratio_0p01 0.0 5. FORMAT "%10.5"
 /begin ANNOTATION ANNOTATION_LABEL "Description (coming from AUTOSAR DESC field)" /begin ANNOTATION_TEXT "Maximum acceleration from Long acc sensor\r\n" /end ANNOTATION_TEXT /end ANNOTATION
 /begin AXIS_DESCR STD_AXIS NO_INPUT_QUANTITY RB_PT_PCT_SWC_DST_CompuMethods_ratio_0p03125 3 -16. 15.96875 FORMAT "%10.5" DEPOSIT ABSOLUTE /end AXIS_DESCR
/end CHARACTERISTIC
/begin CHARACTERISTIC DST_EFLASHB.DST_RefSpdCalc.DST_MAXACCELVSREFSPD "" CURVE 0x80606F64 RB_PT_PCT_SWC_DST_RecordLayouts_RL_Curve_uint16_6_uint16_6 5.0 RB_PT_PCT_SWC_DST_CompuMethods_ratio_0p01 0.0 5. FORMAT "%10.5"
 /begin ANNOTATION ANNOTATION_LABEL "Description (coming from AUTOSAR DESC field)"
  /begin ANNOTATION_TEXT "Maximum allowed increase of reference speed based on the current vehicle speed\r\n" /end ANNOTATION_TEXT
 /end ANNOTATION
 /begin AXIS_DESCR STD_AXIS NO_INPUT_QUANTITY RB_PT_PCT_SWC_DST_CompuMethods_ratio_0p01 6 0.0 500. FORMAT "%10.5" DEPOSIT ABSOLUTE /end AXIS_DESCR
/end CHARACTERISTIC
/begin CHARACTERISTIC DST_EFLASHB.DST_RefSpdCalc.DST_MAXDECEL "" VALUE 0x80606F38 DefaultValueRecordLayout_AUTOSAR_Platform_BaseTypes_uint8 5.0 RB_PT_PCT_SWC_DST_CompuMethods_kph_0p1 0.0 5. FORMAT "%10.5"
 /begin ANNOTATION ANNOTATION_LABEL "Description (coming from AUTOSAR DESC field)" /begin ANNOTATION_TEXT "Limit of Deceleration (1g = 0.353 km/h /100ms)\r\n" /end ANNOTATION_TEXT /end ANNOTATION
/end CHARACTERISTIC
/begin CHARACTERISTIC DST_EFLASHB.DST_RefSpdCalc.DST_MAXSLIPVSSPEED "" CURVE 0x80606F7E RB_PT_PCT_SWC_DST_RecordLayouts_RL_Curve_uint16_6_uint16_6 1.0 RB_PT_PCT_SWC_DST_CompuMethods_ratio_0p01 0.0 1. FORMAT "%10.5"
 /begin ANNOTATION ANNOTATION_LABEL "Description (coming from AUTOSAR DESC field)"
  /begin ANNOTATION_TEXT "Maximum allowed slip calculation based on reference speed (prevents\r\n" /end ANNOTATION_TEXT
 /end ANNOTATION
 /begin AXIS_DESCR STD_AXIS NO_INPUT_QUANTITY RB_PT_PCT_SWC_DST_CompuMethods_kph_0p1 6 0.0 500. FORMAT "%10.5" DEPOSIT ABSOLUTE /end AXIS_DESCR
/end CHARACTERISTIC
/begin CHARACTERISTIC DST_EFLASHB.DST_RefSpdCalc.DST_REFSPDEXCESSLIPCANCEL "" VALUE 0x80606F30 DefaultValueRecordLayout_AUTOSAR_Platform_BaseTypes_sint16 200.0 RB_PT_PCT_SWC_DST_CompuMethods_ident -100. 100. FORMAT "%10.5"
 /begin ANNOTATION ANNOTATION_LABEL "Description (coming from AUTOSAR DESC field)"
  /begin ANNOTATION_TEXT "Driven wheel excess slip to set DST_RefSpdExcessSlip to true\r\n" /end ANNOTATION_TEXT
 /end ANNOTATION
/end CHARACTERISTIC
/begin CHARACTERISTIC DST_EFLASHB.DST_RefSpdCalc.DST_REFSPDEXCESSLIPSET "" VALUE 0x80606F32 DefaultValueRecordLayout_AUTOSAR_Platform_BaseTypes_sint16 200.0 RB_PT_PCT_SWC_DST_CompuMethods_ident -100. 100. FORMAT "%10.5"
 /begin ANNOTATION ANNOTATION_LABEL "Description (coming from AUTOSAR DESC field)"
  /begin ANNOTATION_TEXT "Driven wheel excess slip to set DST_RefSpdExcessSlip to true\r\n" /end ANNOTATION_TEXT
 /end ANNOTATION
/end CHARACTERISTIC
/begin CHARACTERISTIC DST_EFLASHB.DST_RefSpdCalc.DST_REFSPDIPSHAFTFILTGAIN "" VALUE 0x80606F39 DefaultValueRecordLayout_AUTOSAR_Platform_BaseTypes_uint8 1.0 RB_PT_PCT_SWC_DST_CompuMethods_ratio_0p01 0.0 1. FORMAT "%10.5"
 /begin ANNOTATION ANNOTATION_LABEL "Description (coming from AUTOSAR DESC field)" /begin ANNOTATION_TEXT "Filter gain for input shaft filtering\r\n" /end ANNOTATION_TEXT /end ANNOTATION
/end CHARACTERISTIC
/begin CHARACTERISTIC DST_EFLASHB.DST_RefSpdCalc.DST_REFSPDMAXCHANGEvsERROR "" CURVE 0x80606F98 RB_PT_PCT_SWC_DST_RecordLayouts_RL_Curve_uint16_5_sint16_5 5.0 RB_PT_PCT_SWC_DST_CompuMethods_ratio_0p01 0.0 5. FORMAT "%10.5"
 /begin ANNOTATION ANNOTATION_LABEL "Description (coming from AUTOSAR DESC field)"
  /begin ANNOTATION_TEXT "When the reference speed is in back-up, this determines the maximum acceleration based on the speed error\r\n" /end ANNOTATION_TEXT
 /end ANNOTATION
 /begin AXIS_DESCR STD_AXIS NO_INPUT_QUANTITY RB_PT_PCT_SWC_DST_CompuMethods_kph_0p1 5 -500. 500. FORMAT "%10.5" DEPOSIT ABSOLUTE /end AXIS_DESCR
/end CHARACTERISTIC
/begin CHARACTERISTIC DST_EFLASHB.DST_RefSpdCalc.DST_REFSPEEDBLOCKSHIFTS4SLIP "" VALUE 0x80606F34 DefaultValueRecordLayout_AUTOSAR_Platform_BaseTypes_uint16 500.0 RB_PT_PCT_SWC_DST_CompuMethods_ratio_0p01 0.0 500. FORMAT "%10.5"
 /begin ANNOTATION ANNOTATION_LABEL "Description (coming from AUTOSAR DESC field)"
  /begin ANNOTATION_TEXT "Reference speed below which positive slip on the driven wheels can be used to prevent up-shifts\r\n" /end ANNOTATION_TEXT
 /end ANNOTATION
/end CHARACTERISTIC
/begin CHARACTERISTIC DST_EFLASHB.DST_RefSpdCalc.DST_REFSPEEDDIAGSENSITIVITY "" VALUE 0x80606F3A DefaultValueRecordLayout_AUTOSAR_Platform_BaseTypes_uint8 3.0 RB_PT_PCT_SWC_DST_CompuMethods_ident 0.0 3. FORMAT "%10.5"
 /begin ANNOTATION ANNOTATION_LABEL "Description (coming from AUTOSAR DESC field)"
  /begin ANNOTATION_TEXT "Sensitibity of Ref Speed Status; 0 = Off, 1 = Least sensitive, 3 = Very sensitive, 3 = Least sensitive\r\n" /end ANNOTATION_TEXT
 /end ANNOTATION
/end CHARACTERISTIC
/begin CHARACTERISTIC DST_EFLASHB.DST_RefSpdCalc.DST_TIME2REFSPDFAIL "" VALUE 0x80606F36 DefaultValueRecordLayout_AUTOSAR_Platform_BaseTypes_uint16 100.0 RB_PT_PCT_SWC_DST_CompuMethods_DST_Time 0.0 100. FORMAT "%10.5"
 /begin ANNOTATION ANNOTATION_LABEL "Description (coming from AUTOSAR DESC field)"
  /begin ANNOTATION_TEXT "Time in seconds between the reference speed status flags being faulty and the reference speed status going true (and neutral being selected)\r\n" /end ANNOTATION_TEXT
 /end ANNOTATION
/end CHARACTERISTIC
/begin CHARACTERISTIC DST_EFLASHB.DST_SailingLogic.DST_SAILCANCELBRAKEPRESSURE "" VALUE 0x80606FC0 DefaultValueRecordLayout_AUTOSAR_Platform_BaseTypes_uint16 409.5 RB_PT_PCT_SWC_DST_CompuMethods_ratio_0p1 0.0 409.5 FORMAT "%10.5"
 /begin ANNOTATION ANNOTATION_LABEL "Description (coming from AUTOSAR DESC field)" /begin ANNOTATION_TEXT "Brake pressure above this sailing will be disabled\r\n" /end ANNOTATION_TEXT /end ANNOTATION
/end CHARACTERISTIC
/begin CHARACTERISTIC DST_EFLASHB.DST_SailingLogic.DST_SAILCANCELENGSPD "" VALUE 0x80606FC2 DefaultValueRecordLayout_AUTOSAR_Platform_BaseTypes_uint16 20000.0 RB_PT_PCT_SWC_DST_CompuMethods_ident 0.0 20000. FORMAT "%10.5"
 /begin ANNOTATION ANNOTATION_LABEL "Description (coming from AUTOSAR DESC field)"
  /begin ANNOTATION_TEXT "Sailing will only be enabled when the engine speed is below this threshold\r\n" /end ANNOTATION_TEXT
 /end ANNOTATION
/end CHARACTERISTIC
/begin CHARACTERISTIC DST_EFLASHB.DST_SailingLogic.DST_SAILCANCELTHROTTLE "" VALUE 0x80606FD8 DefaultValueRecordLayout_AUTOSAR_Platform_BaseTypes_uint8 102.0 RB_PT_PCT_SWC_DST_CompuMethods_ratio_0p4 0.0 102. FORMAT "%10.5"
 /begin ANNOTATION ANNOTATION_LABEL "Description (coming from AUTOSAR DESC field)"
  /begin ANNOTATION_TEXT "If the throttle pedal is above this threshold, sailing style down-shifts will be cancelled\r\n" /end ANNOTATION_TEXT
 /end ANNOTATION
/end CHARACTERISTIC
/begin CHARACTERISTIC DST_EFLASHB.DST_SailingLogic.DST_SAILCANCELTIMESINCEBRAKE "" VALUE 0x80606FC4 DefaultValueRecordLayout_AUTOSAR_Platform_BaseTypes_uint16 655.35 RB_PT_PCT_SWC_DST_CompuMethods_DST_Time 0.0 655.35 FORMAT "%10.5"
 /begin ANNOTATION ANNOTATION_LABEL "Description (coming from AUTOSAR DESC field)"
  /begin ANNOTATION_TEXT "The foot brake must have been applied this or less seconds ago to enable sailing\r\n" /end ANNOTATION_TEXT
 /end ANNOTATION
/end CHARACTERISTIC
/begin CHARACTERISTIC DST_EFLASHB.DST_SailingLogic.DST_SAILDISABLEGRADHIGH "" VALUE 0x80606FC6 DefaultValueRecordLayout_AUTOSAR_Platform_BaseTypes_sint16 65.4 RB_PT_PCT_SWC_DST_CompuMethods_ratio_0p001 -32.7 32.7 FORMAT "%10.5"
 /begin ANNOTATION ANNOTATION_LABEL "Description (coming from AUTOSAR DESC field)"
  /begin ANNOTATION_TEXT "When the gradient is above this value, sailing power-off down-shifts will be disabled\r\n" /end ANNOTATION_TEXT
 /end ANNOTATION
/end CHARACTERISTIC
/begin CHARACTERISTIC DST_EFLASHB.DST_SailingLogic.DST_SAILDISABLEGRADLOW "" VALUE 0x80606FC8 DefaultValueRecordLayout_AUTOSAR_Platform_BaseTypes_sint16 65.4 RB_PT_PCT_SWC_DST_CompuMethods_ratio_0p001 -32.7 32.7 FORMAT "%10.5"
 /begin ANNOTATION ANNOTATION_LABEL "Description (coming from AUTOSAR DESC field)"
  /begin ANNOTATION_TEXT "When the gradient is below this value, sailing power-off down-shifts will be disabled\r\n" /end ANNOTATION_TEXT
 /end ANNOTATION
/end CHARACTERISTIC
/begin CHARACTERISTIC DST_EFLASHB.DST_SailingLogic.DST_SAILDISABLELONGACCLOW "" VALUE 0x80606FCA DefaultValueRecordLayout_AUTOSAR_Platform_BaseTypes_sint16 4.0 RB_PT_PCT_SWC_DST_CompuMethods_ratio_0p01 -2. 2. FORMAT "%10.5"
 /begin ANNOTATION ANNOTATION_LABEL "Description (coming from AUTOSAR DESC field)"
  /begin ANNOTATION_TEXT "Longitudinal acceleration below which sailing will be disabled\r\n" /end ANNOTATION_TEXT
 /end ANNOTATION
/end CHARACTERISTIC
/begin CHARACTERISTIC DST_EFLASHB.DST_SailingLogic.DST_SAILENABLEGRADHIGH "" VALUE 0x80606FCC DefaultValueRecordLayout_AUTOSAR_Platform_BaseTypes_sint16 65.4 RB_PT_PCT_SWC_DST_CompuMethods_ratio_0p001 -32.7 32.7 FORMAT "%10.5"
 /begin ANNOTATION ANNOTATION_LABEL "Description (coming from AUTOSAR DESC field)"
  /begin ANNOTATION_TEXT "Upper gradient limit to allow sailing style down-shifts\r\n" /end ANNOTATION_TEXT
 /end ANNOTATION
/end CHARACTERISTIC
/begin CHARACTERISTIC DST_EFLASHB.DST_SailingLogic.DST_SAILENABLEGRADLOW "" VALUE 0x80606FCE DefaultValueRecordLayout_AUTOSAR_Platform_BaseTypes_sint16 65.4 RB_PT_PCT_SWC_DST_CompuMethods_ratio_0p001 -32.7 32.7 FORMAT "%10.5"
 /begin ANNOTATION ANNOTATION_LABEL "Description (coming from AUTOSAR DESC field)"
  /begin ANNOTATION_TEXT "Lower gradient limit to allow sailing style down-shifts\r\n" /end ANNOTATION_TEXT
 /end ANNOTATION
/end CHARACTERISTIC
/begin CHARACTERISTIC DST_EFLASHB.DST_SailingLogic.DST_SAILENABLELONGACC "" VALUE 0x80606FD0 DefaultValueRecordLayout_AUTOSAR_Platform_BaseTypes_sint16 4.0 RB_PT_PCT_SWC_DST_CompuMethods_ratio_0p01 -2. 2. FORMAT "%10.5"
 /begin ANNOTATION ANNOTATION_LABEL "Description (coming from AUTOSAR DESC field)"
  /begin ANNOTATION_TEXT "Longitudinal acceleration below which sailing will be disabled\r\n" /end ANNOTATION_TEXT
 /end ANNOTATION
/end CHARACTERISTIC
/begin CHARACTERISTIC DST_EFLASHB.DST_SailingLogic.DST_SAILENABLEMAXGEAR "" VALUE 0x80606FD9 DefaultValueRecordLayout_AUTOSAR_Platform_BaseTypes_uint8 11.0 RB_PT_PCT_SWC_DST_CompuMethods_ident 0.0 11. FORMAT "%10.5"
 /begin ANNOTATION ANNOTATION_LABEL "Description (coming from AUTOSAR DESC field)"
  /begin ANNOTATION_TEXT "Lowest target gear that sailing style down-shifts will be enabled\r\n" /end ANNOTATION_TEXT
 /end ANNOTATION
/end CHARACTERISTIC
/begin CHARACTERISTIC DST_EFLASHB.DST_SailingLogic.DST_SAILENABLEMINGEAR "" VALUE 0x80606FDA DefaultValueRecordLayout_AUTOSAR_Platform_BaseTypes_uint8 11.0 RB_PT_PCT_SWC_DST_CompuMethods_ident 0.0 11. FORMAT "%10.5"
 /begin ANNOTATION ANNOTATION_LABEL "Description (coming from AUTOSAR DESC field)"
  /begin ANNOTATION_TEXT "Lowest target gear that sailing style down-shifts will be enabled\r\n" /end ANNOTATION_TEXT
 /end ANNOTATION
/end CHARACTERISTIC
/begin CHARACTERISTIC DST_EFLASHB.DST_SailingLogic.DST_SAILENABLESHIFTMODE "" VAL_BLK 0x80606FAE DefaultValueRecordLayout_AUTOSAR_Platform_BaseTypes_boolean 255.0 AUTOSAR_Platform_CompuMethods_boolean 0.0 255. FORMAT "%10.5"
 /begin ANNOTATION ANNOTATION_LABEL "Description (coming from AUTOSAR DESC field)"
  /begin ANNOTATION_TEXT "If element is true, for that shift mode, open clutch power-off down-shifting will be enabled\r\n" /end ANNOTATION_TEXT
 /end ANNOTATION
 MATRIX_DIM 17 1 1 /end CHARACTERISTIC
/begin CHARACTERISTIC DST_EFLASHB.DST_SailingLogic.DST_SAILTRIGGERBRAKEPRESSURE "" VALUE 0x80606FD2 DefaultValueRecordLayout_AUTOSAR_Platform_BaseTypes_uint16 409.5 RB_PT_PCT_SWC_DST_CompuMethods_ratio_0p1 0.0 409.5 FORMAT "%10.5"
 /begin ANNOTATION ANNOTATION_LABEL "Description (coming from AUTOSAR DESC field)" /begin ANNOTATION_TEXT "Brake pressure above this sailing will be disabled\r\n" /end ANNOTATION_TEXT /end ANNOTATION
/end CHARACTERISTIC
/begin CHARACTERISTIC DST_EFLASHB.DST_SailingLogic.DST_SAILTRIGGERTHROTTLE "" VALUE 0x80606FDB DefaultValueRecordLayout_AUTOSAR_Platform_BaseTypes_uint8 102.0 RB_PT_PCT_SWC_DST_CompuMethods_ratio_0p4 0.0 102. FORMAT "%10.5"
 /begin ANNOTATION ANNOTATION_LABEL "Description (coming from AUTOSAR DESC field)"
  /begin ANNOTATION_TEXT "Maximum throttle pedal angle to enable sailing style down-shifts\r\n" /end ANNOTATION_TEXT
 /end ANNOTATION
/end CHARACTERISTIC
/begin CHARACTERISTIC DST_EFLASHB.DST_SailingLogic.DST_SAILTRIGGERTIMESINCEBRAKE "" VALUE 0x80606FD4 DefaultValueRecordLayout_AUTOSAR_Platform_BaseTypes_uint16 655.35 RB_PT_PCT_SWC_DST_CompuMethods_DST_Time 0.0 655.35 FORMAT "%10.5"
 /begin ANNOTATION ANNOTATION_LABEL "Description (coming from AUTOSAR DESC field)"
  /begin ANNOTATION_TEXT "The foot brake must have been applied this or less seconds ago to enable sailing\r\n" /end ANNOTATION_TEXT
 /end ANNOTATION
/end CHARACTERISTIC
/begin CHARACTERISTIC DST_EFLASHB.DST_SailingLogic.DST_TIMEOFFTHROTTLE2SAIL "" VALUE 0x80606FD6 DefaultValueRecordLayout_AUTOSAR_Platform_BaseTypes_uint16 655.35 RB_PT_PCT_SWC_DST_CompuMethods_DST_Time 0.0 655.35 FORMAT "%10.5"
 /begin ANNOTATION ANNOTATION_LABEL "Description (coming from AUTOSAR DESC field)"
  /begin ANNOTATION_TEXT "Time the throttle must be zero before sailing is triggered\r\n" /end ANNOTATION_TEXT
 /end ANNOTATION
/end CHARACTERISTIC
/begin CHARACTERISTIC DST_EFLASHB_MKT.DST_ModeSelectGeneric.DST_BOBCALSELECT "" VALUE 0x80605F88 DefaultValueRecordLayout_AUTOSAR_Platform_BaseTypes_uint8 6.0 RB_PT_PCT_SWC_DST_CompuMethods_Enumerations_DST_CalSelect 0.0 6. FORMAT "%10.5"
 /begin ANNOTATION ANNOTATION_LABEL "Description (coming from AUTOSAR DESC field)"
  /begin ANNOTATION_TEXT "Used to force the calibration in use.  For testing only\r\n" /end ANNOTATION_TEXT
 /end ANNOTATION
/end CHARACTERISTIC
/begin CHARACTERISTIC DST_EFLASHROMB.DST_DG.DST_ShiftPointsAndComp.DST_ShiftCompensation.DST_CORNERMAXOFFSET "" MAP 0x80604556 RB_PT_PCT_SWC_DST_RecordLayouts_RL_Map_sint16_68_uint8_4_uint8_17 20000.0 RB_PT_PCT_SWC_DST_CompuMethods_DST_Ident -10000. 10000. FORMAT "%10.5"
 /begin ANNOTATION ANNOTATION_LABEL "Description (coming from AUTOSAR DESC field)"
  /begin ANNOTATION_TEXT "Offset to apply to the maximum engine speed after gradient compensation\r\n" /end ANNOTATION_TEXT
 /end ANNOTATION
 /begin AXIS_DESCR STD_AXIS NO_INPUT_QUANTITY RB_PT_PCT_SWC_DST_CompuMethods_ratio_0p01 4 0.0 1.27 FORMAT "%10.5" DEPOSIT ABSOLUTE /end AXIS_DESCR
 /begin AXIS_DESCR STD_AXIS NO_INPUT_QUANTITY RB_PT_PCT_SWC_DST_CompuMethods_ident 17 0.0 16. FORMAT "%10.5" DEPOSIT ABSOLUTE /end AXIS_DESCR
/end CHARACTERISTIC
/begin CHARACTERISTIC DST_EFLASHROMB.DST_DG.DST_ShiftPointsAndComp.DST_ShiftCompensation.DST_CORNERMINOFFSET "" MAP 0x806045F8 RB_PT_PCT_SWC_DST_RecordLayouts_RL_Map_sint16_68_uint8_4_uint8_17 20000.0 RB_PT_PCT_SWC_DST_CompuMethods_DST_Ident -10000. 10000. FORMAT "%10.5"
 /begin ANNOTATION ANNOTATION_LABEL "Description (coming from AUTOSAR DESC field)"
  /begin ANNOTATION_TEXT "Offset to apply to the minimum engine speed after gradient compensation\r\n" /end ANNOTATION_TEXT
 /end ANNOTATION
 /begin AXIS_DESCR STD_AXIS NO_INPUT_QUANTITY RB_PT_PCT_SWC_DST_CompuMethods_ratio_0p01 4 0.0 1.27 FORMAT "%10.5" DEPOSIT ABSOLUTE /end AXIS_DESCR
 /begin AXIS_DESCR STD_AXIS NO_INPUT_QUANTITY RB_PT_PCT_SWC_DST_CompuMethods_ident 17 0.0 16. FORMAT "%10.5" DEPOSIT ABSOLUTE /end AXIS_DESCR
/end CHARACTERISTIC
/begin CHARACTERISTIC DST_EFLASHROMB.DST_DG.DST_ShiftPointsAndComp.DST_ShiftCompensation.DST_DECELDOWNSHIFTRPM "" MAP 0x8060469A RB_PT_PCT_SWC_DST_RecordLayouts_RL_Map_sint16_36_sint16_6_uint8_6 20000.0 RB_PT_PCT_SWC_DST_CompuMethods_DST_Ident 0.0 20000. FORMAT "%10.5"
 /begin ANNOTATION ANNOTATION_LABEL "Description (coming from AUTOSAR DESC field)" /begin ANNOTATION_TEXT "Minimum engine speed in each gear in Decel\r\n" /end ANNOTATION_TEXT /end ANNOTATION
 /begin AXIS_DESCR STD_AXIS NO_INPUT_QUANTITY RB_PT_PCT_SWC_DST_CompuMethods_ratio_0p01 6 -5. 5. FORMAT "%10.5" DEPOSIT ABSOLUTE /end AXIS_DESCR
 /begin AXIS_DESCR STD_AXIS NO_INPUT_QUANTITY RB_PT_PCT_SWC_DST_CompuMethods_ident 6 0.0 5. FORMAT "%10.5" DEPOSIT ABSOLUTE /end AXIS_DESCR
/end CHARACTERISTIC
/begin CHARACTERISTIC DST_EFLASHROMB.DST_DG.DST_ShiftPointsAndComp.DST_ShiftCompensation.DST_DECELDOWNSHIFTRPMMAXBRAKE "" MAP 0x806046F8 RB_PT_PCT_SWC_DST_RecordLayouts_RL_Map_uint16_60_uint8_6_uint8_10 20000.0 RB_PT_PCT_SWC_DST_CompuMethods_ident 0.0 20000. FORMAT "%10.5"
 /begin ANNOTATION ANNOTATION_LABEL "Description (coming from AUTOSAR DESC field)"
  /begin ANNOTATION_TEXT "When DST_HighBrakingLatched is true and in an automatic mode, these are the downshift points, inputs Decel Aggresssion and forward gear\r\n" /end ANNOTATION_TEXT
 /end ANNOTATION
 /begin AXIS_DESCR STD_AXIS NO_INPUT_QUANTITY RB_PT_PCT_SWC_DST_CompuMethods_ident 6 0.0 5. FORMAT "%10.5" DEPOSIT ABSOLUTE /end AXIS_DESCR
 /begin AXIS_DESCR STD_AXIS NO_INPUT_QUANTITY RB_PT_PCT_SWC_DST_CompuMethods_ident 10 0.0 10. FORMAT "%10.5" DEPOSIT ABSOLUTE /end AXIS_DESCR
/end CHARACTERISTIC
/begin CHARACTERISTIC DST_EFLASHROMB.DST_DG.DST_ShiftPointsAndComp.DST_ShiftCompensation.DST_DECElGEAROFFSET "" MAP 0x80604784 RB_PT_PCT_SWC_DST_RecordLayouts_RL_Map_uint16_60_uint8_6_uint8_10 2.0 RB_PT_PCT_SWC_DST_CompuMethods_ratio_0p001 0.0 2. FORMAT "%10.5"
 /begin ANNOTATION ANNOTATION_LABEL "Description (coming from AUTOSAR DESC field)" /begin ANNOTATION_TEXT "Offset to multiply to the min rpm based on the gear\r\n" /end ANNOTATION_TEXT /end ANNOTATION
 /begin AXIS_DESCR STD_AXIS NO_INPUT_QUANTITY RB_PT_PCT_SWC_DST_CompuMethods_ident 6 0.0 5. FORMAT "%10.5" DEPOSIT ABSOLUTE /end AXIS_DESCR
 /begin AXIS_DESCR STD_AXIS NO_INPUT_QUANTITY RB_PT_PCT_SWC_DST_CompuMethods_ident 10 0.0 10. FORMAT "%10.5" DEPOSIT ABSOLUTE /end AXIS_DESCR
/end CHARACTERISTIC
/begin CHARACTERISTIC DST_EFLASHROMB.DST_DG.DST_ShiftPointsAndComp.DST_ShiftCompensation.DST_DOWNSHIFTABOVEIDLEENGTEMP "" CURVE 0x80604810 RB_PT_PCT_SWC_DST_RecordLayouts_RL_Curve_uint16_7_sint16_7 20000.0 RB_PT_PCT_SWC_DST_CompuMethods_ident 0.0 20000. FORMAT "%10.5"
 /begin ANNOTATION ANNOTATION_LABEL "Description (coming from AUTOSAR DESC field)"
  /begin ANNOTATION_TEXT "Minimum engine speed above idle to request a downshift based on engine temperature\r\n" /end ANNOTATION_TEXT
 /end ANNOTATION
 /begin AXIS_DESCR STD_AXIS NO_INPUT_QUANTITY RB_PT_PCT_SWC_DST_CompuMethods_ident 7 -60. 200. FORMAT "%10.5" DEPOSIT ABSOLUTE /end AXIS_DESCR
/end CHARACTERISTIC
/begin CHARACTERISTIC DST_EFLASHROMB.DST_DG.DST_ShiftPointsAndComp.DST_ShiftCompensation.DST_DOWNSHIFTABOVEIDLEIDLESPEED "" CURVE 0x8060482E RB_PT_PCT_SWC_DST_RecordLayouts_RL_Curve_uint16_7_uint16_7 20000.0 RB_PT_PCT_SWC_DST_CompuMethods_ident 0.0 20000. FORMAT "%10.5"
 /begin ANNOTATION ANNOTATION_LABEL "Description (coming from AUTOSAR DESC field)"
  /begin ANNOTATION_TEXT "Minimum downshift rpm above idle based on the idle speed flag sent on CAN\r\n" /end ANNOTATION_TEXT
 /end ANNOTATION
 /begin AXIS_DESCR STD_AXIS NO_INPUT_QUANTITY RB_PT_PCT_SWC_DST_CompuMethods_ident 7 0.0 20000. FORMAT "%10.5" DEPOSIT ABSOLUTE /end AXIS_DESCR
/end CHARACTERISTIC
/begin CHARACTERISTIC DST_EFLASHROMB.DST_DG.DST_ShiftPointsAndComp.DST_ShiftCompensation.DST_GRADMAXOFFSET "" MAP 0x8060484C RB_PT_PCT_SWC_DST_RecordLayouts_RL_Map_sint16_99_sint16_9_uint8_11 20000.0 RB_PT_PCT_SWC_DST_CompuMethods_DST_Ident -10000. 10000. FORMAT "%10.5"
 /begin ANNOTATION ANNOTATION_LABEL "Description (coming from AUTOSAR DESC field)"
  /begin ANNOTATION_TEXT "Offset to add to the maximum engine speed depending on the gradient\r\n" /end ANNOTATION_TEXT
 /end ANNOTATION
 /begin AXIS_DESCR STD_AXIS NO_INPUT_QUANTITY RB_PT_PCT_SWC_DST_CompuMethods_ratio_0p001 9 -32.7 32.7 FORMAT "%10.5" DEPOSIT ABSOLUTE /end AXIS_DESCR
 /begin AXIS_DESCR STD_AXIS NO_INPUT_QUANTITY RB_PT_PCT_SWC_DST_CompuMethods_ident 11 0.0 11. FORMAT "%10.5" DEPOSIT ABSOLUTE /end AXIS_DESCR
/end CHARACTERISTIC
/begin CHARACTERISTIC DST_EFLASHROMB.DST_DG.DST_ShiftPointsAndComp.DST_ShiftCompensation.DST_GRADMINOFFSET "" MAP 0x80604934 RB_PT_PCT_SWC_DST_RecordLayouts_RL_Map_sint16_81_sint16_9_uint8_9 20000.0 RB_PT_PCT_SWC_DST_CompuMethods_DST_Ident -10000. 10000. FORMAT "%10.5"
 /begin ANNOTATION ANNOTATION_LABEL "Description (coming from AUTOSAR DESC field)"
  /begin ANNOTATION_TEXT "Offset to subtract from the minimum engine speed depending on the gradient\r\n" /end ANNOTATION_TEXT
 /end ANNOTATION
 /begin AXIS_DESCR STD_AXIS NO_INPUT_QUANTITY RB_PT_PCT_SWC_DST_CompuMethods_ratio_0p001 9 -32.7 32.7 FORMAT "%10.5" DEPOSIT ABSOLUTE /end AXIS_DESCR
 /begin AXIS_DESCR STD_AXIS NO_INPUT_QUANTITY RB_PT_PCT_SWC_DST_CompuMethods_ident 9 0.0 10. FORMAT "%10.5" DEPOSIT ABSOLUTE /end AXIS_DESCR
/end CHARACTERISTIC
/begin CHARACTERISTIC DST_EFLASHROMB.DST_DG.DST_ShiftPointsAndComp.DST_ShiftCompensation.DST_MINSHIFTHYSTIDLEENGTEMP "" CURVE 0x806049F6 RB_PT_PCT_SWC_DST_RecordLayouts_RL_Curve_uint16_7_sint16_7 20000.0 RB_PT_PCT_SWC_DST_CompuMethods_ident 0.0 20000. FORMAT "%10.5"
 /begin ANNOTATION ANNOTATION_LABEL "Description (coming from AUTOSAR DESC field)"
  /begin ANNOTATION_TEXT "Added to IdleMinDownshift to generate the lowest rpm requested after an upshift (DST_IdleMinRpmAfterUpshift)\r\n" /end ANNOTATION_TEXT
 /end ANNOTATION
 /begin AXIS_DESCR STD_AXIS NO_INPUT_QUANTITY RB_PT_PCT_SWC_DST_CompuMethods_ident 7 -60. 200. FORMAT "%10.5" DEPOSIT ABSOLUTE /end AXIS_DESCR
/end CHARACTERISTIC
/begin CHARACTERISTIC DST_EFLASHROMB.DST_DG.DST_ShiftPointsAndComp.DST_ShiftCompensation.DST_MINSHIFTHYSTIDLESPEED "" CURVE 0x80604A14 RB_PT_PCT_SWC_DST_RecordLayouts_RL_Curve_uint16_7_uint16_7 20000.0 RB_PT_PCT_SWC_DST_CompuMethods_ident 0.0 20000. FORMAT "%10.5"
 /begin ANNOTATION ANNOTATION_LABEL "Description (coming from AUTOSAR DESC field)"
  /begin ANNOTATION_TEXT "Added to IdleMinDownshift to generate the lowest rpm requested after an upshift (DST_IdleMinRpmAfterUpshift)\r\n" /end ANNOTATION_TEXT
 /end ANNOTATION
 /begin AXIS_DESCR STD_AXIS NO_INPUT_QUANTITY RB_PT_PCT_SWC_DST_CompuMethods_ident 7 0.0 20000. FORMAT "%10.5" DEPOSIT ABSOLUTE /end AXIS_DESCR
/end CHARACTERISTIC
/begin CHARACTERISTIC DST_EFLASHROMB.DST_DG.DST_ShiftPointsAndComp.DST_ShiftCompensation.DST_MINSHIFTHYSTSHIFTMODE "" VAL_BLK 0x80604534 DefaultValueRecordLayout_AUTOSAR_Platform_BaseTypes_uint16 20000.0 RB_PT_PCT_SWC_DST_CompuMethods_ident 0.0 20000. FORMAT "%10.5"
 /begin ANNOTATION ANNOTATION_LABEL "Description (coming from AUTOSAR DESC field)"
  /begin ANNOTATION_TEXT "Value added to idle speed and rpm above idle speed to generate minimum rpm allowed in next highest gear after and upshift\r\n" /end ANNOTATION_TEXT
 /end ANNOTATION
 MATRIX_DIM 17 1 1 /end CHARACTERISTIC
/begin CHARACTERISTIC DST_EFLASHROMB.DST_DG.DST_ShiftPointsAndComp.DST_ShiftMaps.DST_KDMODES "" VAL_BLK 0x80604A76 DefaultValueRecordLayout_AUTOSAR_Platform_BaseTypes_boolean 255.0 AUTOSAR_Platform_CompuMethods_boolean 0.0 255. FORMAT "%10.5"
 /begin ANNOTATION ANNOTATION_LABEL "Description (coming from AUTOSAR DESC field)" /begin ANNOTATION_TEXT "If true, Kickdown is allowed in associated  mode\r\n" /end ANNOTATION_TEXT /end ANNOTATION
 MATRIX_DIM 17 1 1 /end CHARACTERISTIC
/begin CHARACTERISTIC DST_EFLASHROMB.DST_DG.DST_ShiftPointsAndComp.DST_ShiftMaps.DST_MAXRPM_AUTO_01 "" MAP 0x80604BAE RB_PT_PCT_SWC_DST_RecordLayouts_RL_Map_sint16_108_uint16_12_uint8_9 20000.0 RB_PT_PCT_SWC_DST_CompuMethods_DST_Ident 0.0 20000. FORMAT "%10.5"
 /begin ANNOTATION ANNOTATION_LABEL "Description (coming from AUTOSAR DESC field)"
  /begin ANNOTATION_TEXT "Min Engine Speed for each gear at a given driver demand\r\n" /end ANNOTATION_TEXT
 /end ANNOTATION
 /begin AXIS_DESCR STD_AXIS NO_INPUT_QUANTITY RB_PT_PCT_SWC_DST_CompuMethods_ratio_0p1 12 0.0 110. FORMAT "%10.5" DEPOSIT ABSOLUTE /end AXIS_DESCR
 /begin AXIS_DESCR STD_AXIS NO_INPUT_QUANTITY RB_PT_PCT_SWC_DST_CompuMethods_ident 9 1. 9. FORMAT "%10.5" DEPOSIT ABSOLUTE /end AXIS_DESCR
/end CHARACTERISTIC
/begin CHARACTERISTIC DST_EFLASHROMB.DST_DG.DST_ShiftPointsAndComp.DST_ShiftMaps.DST_MAXRPM_AUTO_02 "" MAP 0x80604CAC RB_PT_PCT_SWC_DST_RecordLayouts_RL_Map_sint16_108_uint16_12_uint8_9 20000.0 RB_PT_PCT_SWC_DST_CompuMethods_DST_Ident 0.0 20000. FORMAT "%10.5"
 /begin ANNOTATION ANNOTATION_LABEL "Description (coming from AUTOSAR DESC field)"
  /begin ANNOTATION_TEXT "Min Engine Speed for each gear at a given driver demand\r\n" /end ANNOTATION_TEXT
 /end ANNOTATION
 /begin AXIS_DESCR STD_AXIS NO_INPUT_QUANTITY RB_PT_PCT_SWC_DST_CompuMethods_ratio_0p1 12 0.0 110. FORMAT "%10.5" DEPOSIT ABSOLUTE /end AXIS_DESCR
 /begin AXIS_DESCR STD_AXIS NO_INPUT_QUANTITY RB_PT_PCT_SWC_DST_CompuMethods_ident 9 1. 9. FORMAT "%10.5" DEPOSIT ABSOLUTE /end AXIS_DESCR
/end CHARACTERISTIC
/begin CHARACTERISTIC DST_EFLASHROMB.DST_DG.DST_ShiftPointsAndComp.DST_ShiftMaps.DST_MAXRPM_AUTO_03 "" MAP 0x80604DAA RB_PT_PCT_SWC_DST_RecordLayouts_RL_Map_sint16_108_uint16_12_uint8_9 20000.0 RB_PT_PCT_SWC_DST_CompuMethods_DST_Ident 0.0 20000. FORMAT "%10.5"
 /begin ANNOTATION ANNOTATION_LABEL "Description (coming from AUTOSAR DESC field)"
  /begin ANNOTATION_TEXT "Min Engine Speed for each gear at a given driver demand\r\n" /end ANNOTATION_TEXT
 /end ANNOTATION
 /begin AXIS_DESCR STD_AXIS NO_INPUT_QUANTITY RB_PT_PCT_SWC_DST_CompuMethods_ratio_0p1 12 0.0 110. FORMAT "%10.5" DEPOSIT ABSOLUTE /end AXIS_DESCR
 /begin AXIS_DESCR STD_AXIS NO_INPUT_QUANTITY RB_PT_PCT_SWC_DST_CompuMethods_ident 9 1. 9. FORMAT "%10.5" DEPOSIT ABSOLUTE /end AXIS_DESCR
/end CHARACTERISTIC
/begin CHARACTERISTIC DST_EFLASHROMB.DST_DG.DST_ShiftPointsAndComp.DST_ShiftMaps.DST_MAXRPM_AUTO_04 "" MAP 0x80604EA8 RB_PT_PCT_SWC_DST_RecordLayouts_RL_Map_sint16_108_uint16_12_uint8_9 20000.0 RB_PT_PCT_SWC_DST_CompuMethods_DST_Ident 0.0 20000. FORMAT "%10.5"
 /begin ANNOTATION ANNOTATION_LABEL "Description (coming from AUTOSAR DESC field)"
  /begin ANNOTATION_TEXT "Min Engine Speed for each gear at a given driver demand\r\n" /end ANNOTATION_TEXT
 /end ANNOTATION
 /begin AXIS_DESCR STD_AXIS NO_INPUT_QUANTITY RB_PT_PCT_SWC_DST_CompuMethods_ratio_0p1 12 0.0 110. FORMAT "%10.5" DEPOSIT ABSOLUTE /end AXIS_DESCR
 /begin AXIS_DESCR STD_AXIS NO_INPUT_QUANTITY RB_PT_PCT_SWC_DST_CompuMethods_ident 9 1. 9. FORMAT "%10.5" DEPOSIT ABSOLUTE /end AXIS_DESCR
/end CHARACTERISTIC
/begin CHARACTERISTIC DST_EFLASHROMB.DST_DG.DST_ShiftPointsAndComp.DST_ShiftMaps.DST_MAXRPM_AUTO_05 "" MAP 0x80604FA6 RB_PT_PCT_SWC_DST_RecordLayouts_RL_Map_sint16_108_uint16_12_uint8_9 20000.0 RB_PT_PCT_SWC_DST_CompuMethods_DST_Ident 0.0 20000. FORMAT "%10.5"
 /begin ANNOTATION ANNOTATION_LABEL "Description (coming from AUTOSAR DESC field)"
  /begin ANNOTATION_TEXT "Min Engine Speed for each gear at a given driver demand\r\n" /end ANNOTATION_TEXT
 /end ANNOTATION
 /begin AXIS_DESCR STD_AXIS NO_INPUT_QUANTITY RB_PT_PCT_SWC_DST_CompuMethods_ratio_0p1 12 0.0 110. FORMAT "%10.5" DEPOSIT ABSOLUTE /end AXIS_DESCR
 /begin AXIS_DESCR STD_AXIS NO_INPUT_QUANTITY RB_PT_PCT_SWC_DST_CompuMethods_ident 9 1. 9. FORMAT "%10.5" DEPOSIT ABSOLUTE /end AXIS_DESCR
/end CHARACTERISTIC
/begin CHARACTERISTIC DST_EFLASHROMB.DST_DG.DST_ShiftPointsAndComp.DST_ShiftMaps.DST_MAXRPM_AUTO_06 "" MAP 0x806050A4 RB_PT_PCT_SWC_DST_RecordLayouts_RL_Map_sint16_108_uint16_12_uint8_9 20000.0 RB_PT_PCT_SWC_DST_CompuMethods_DST_Ident 0.0 20000. FORMAT "%10.5"
 /begin ANNOTATION ANNOTATION_LABEL "Description (coming from AUTOSAR DESC field)"
  /begin ANNOTATION_TEXT "Min Engine Speed for each gear at a given driver demand\r\n" /end ANNOTATION_TEXT
 /end ANNOTATION
 /begin AXIS_DESCR STD_AXIS NO_INPUT_QUANTITY RB_PT_PCT_SWC_DST_CompuMethods_ratio_0p1 12 0.0 110. FORMAT "%10.5" DEPOSIT ABSOLUTE /end AXIS_DESCR
 /begin AXIS_DESCR STD_AXIS NO_INPUT_QUANTITY RB_PT_PCT_SWC_DST_CompuMethods_ident 9 1. 9. FORMAT "%10.5" DEPOSIT ABSOLUTE /end AXIS_DESCR
/end CHARACTERISTIC
/begin CHARACTERISTIC DST_EFLASHROMB.DST_DG.DST_ShiftPointsAndComp.DST_ShiftMaps.DST_MAXRPM_AUTO_07 "" MAP 0x806051A2 RB_PT_PCT_SWC_DST_RecordLayouts_RL_Map_sint16_108_uint16_12_uint8_9 20000.0 RB_PT_PCT_SWC_DST_CompuMethods_DST_Ident 0.0 20000. FORMAT "%10.5"
 /begin ANNOTATION ANNOTATION_LABEL "Description (coming from AUTOSAR DESC field)"
  /begin ANNOTATION_TEXT "Min Engine Speed for each gear at a given driver demand\r\n" /end ANNOTATION_TEXT
 /end ANNOTATION
 /begin AXIS_DESCR STD_AXIS NO_INPUT_QUANTITY RB_PT_PCT_SWC_DST_CompuMethods_ratio_0p1 12 0.0 110. FORMAT "%10.5" DEPOSIT ABSOLUTE /end AXIS_DESCR
 /begin AXIS_DESCR STD_AXIS NO_INPUT_QUANTITY RB_PT_PCT_SWC_DST_CompuMethods_ident 9 1. 9. FORMAT "%10.5" DEPOSIT ABSOLUTE /end AXIS_DESCR
/end CHARACTERISTIC
/begin CHARACTERISTIC DST_EFLASHROMB.DST_DG.DST_ShiftPointsAndComp.DST_ShiftMaps.DST_MAXRPM_AUTO_08 "" MAP 0x806052A0 RB_PT_PCT_SWC_DST_RecordLayouts_RL_Map_sint16_108_uint16_12_uint8_9 20000.0 RB_PT_PCT_SWC_DST_CompuMethods_DST_Ident 0.0 20000. FORMAT "%10.5"
 /begin ANNOTATION ANNOTATION_LABEL "Description (coming from AUTOSAR DESC field)"
  /begin ANNOTATION_TEXT "Min Engine Speed for each gear at a given driver demand\r\n" /end ANNOTATION_TEXT
 /end ANNOTATION
 /begin AXIS_DESCR STD_AXIS NO_INPUT_QUANTITY RB_PT_PCT_SWC_DST_CompuMethods_ratio_0p1 12 0.0 110. FORMAT "%10.5" DEPOSIT ABSOLUTE /end AXIS_DESCR
 /begin AXIS_DESCR STD_AXIS NO_INPUT_QUANTITY RB_PT_PCT_SWC_DST_CompuMethods_ident 9 1. 9. FORMAT "%10.5" DEPOSIT ABSOLUTE /end AXIS_DESCR
/end CHARACTERISTIC
/begin CHARACTERISTIC DST_EFLASHROMB.DST_DG.DST_ShiftPointsAndComp.DST_ShiftMaps.DST_MAXRPM_AUTO_09 "" MAP 0x8060539E RB_PT_PCT_SWC_DST_RecordLayouts_RL_Map_sint16_108_uint16_12_uint8_9 20000.0 RB_PT_PCT_SWC_DST_CompuMethods_DST_Ident 0.0 20000. FORMAT "%10.5"
 /begin ANNOTATION ANNOTATION_LABEL "Description (coming from AUTOSAR DESC field)"
  /begin ANNOTATION_TEXT "Min Engine Speed for each gear at a given driver demand\r\n" /end ANNOTATION_TEXT
 /end ANNOTATION
 /begin AXIS_DESCR STD_AXIS NO_INPUT_QUANTITY RB_PT_PCT_SWC_DST_CompuMethods_ratio_0p1 12 0.0 110. FORMAT "%10.5" DEPOSIT ABSOLUTE /end AXIS_DESCR
 /begin AXIS_DESCR STD_AXIS NO_INPUT_QUANTITY RB_PT_PCT_SWC_DST_CompuMethods_ident 9 1. 9. FORMAT "%10.5" DEPOSIT ABSOLUTE /end AXIS_DESCR
/end CHARACTERISTIC
/begin CHARACTERISTIC DST_EFLASHROMB.DST_DG.DST_ShiftPointsAndComp.DST_ShiftMaps.DST_MAXRPM_AUTO_10 "" MAP 0x8060549C RB_PT_PCT_SWC_DST_RecordLayouts_RL_Map_sint16_108_uint16_12_uint8_9 20000.0 RB_PT_PCT_SWC_DST_CompuMethods_DST_Ident 0.0 20000. FORMAT "%10.5"
 /begin ANNOTATION ANNOTATION_LABEL "Description (coming from AUTOSAR DESC field)"
  /begin ANNOTATION_TEXT "Min Engine Speed for each gear at a given driver demand\r\n" /end ANNOTATION_TEXT
 /end ANNOTATION
 /begin AXIS_DESCR STD_AXIS NO_INPUT_QUANTITY RB_PT_PCT_SWC_DST_CompuMethods_ratio_0p1 12 0.0 110. FORMAT "%10.5" DEPOSIT ABSOLUTE /end AXIS_DESCR
 /begin AXIS_DESCR STD_AXIS NO_INPUT_QUANTITY RB_PT_PCT_SWC_DST_CompuMethods_ident 9 1. 9. FORMAT "%10.5" DEPOSIT ABSOLUTE /end AXIS_DESCR
/end CHARACTERISTIC
/begin CHARACTERISTIC DST_EFLASHROMB.DST_DG.DST_ShiftPointsAndComp.DST_ShiftMaps.DST_MAXRPM_LAUNCH "" VAL_BLK 0x80604B22 DefaultValueRecordLayout_AUTOSAR_Platform_BaseTypes_sint16 20000.0 RB_PT_PCT_SWC_DST_CompuMethods_DST_Ident 0.0 20000. FORMAT "%10.5"
 /begin ANNOTATION ANNOTATION_LABEL "Description (coming from AUTOSAR DESC field)" /begin ANNOTATION_TEXT "Maximum engine speed in each gearin manual mode\r\n" /end ANNOTATION_TEXT /end ANNOTATION
 MATRIX_DIM 10 1 1 /end CHARACTERISTIC
/begin CHARACTERISTIC DST_EFLASHROMB.DST_DG.DST_ShiftPointsAndComp.DST_ShiftMaps.DST_MAXRPM_MAN_01 "" VAL_BLK 0x80604B36 DefaultValueRecordLayout_AUTOSAR_Platform_BaseTypes_sint16 20000.0 RB_PT_PCT_SWC_DST_CompuMethods_DST_Ident 0.0 20000. FORMAT "%10.5"
 /begin ANNOTATION ANNOTATION_LABEL "Description (coming from AUTOSAR DESC field)" /begin ANNOTATION_TEXT "Maximum engine speed in each gearin manual mode\r\n" /end ANNOTATION_TEXT /end ANNOTATION
 MATRIX_DIM 10 1 1 /end CHARACTERISTIC
/begin CHARACTERISTIC DST_EFLASHROMB.DST_DG.DST_ShiftPointsAndComp.DST_ShiftMaps.DST_MAXRPM_MAN_02 "" VAL_BLK 0x80604B4A DefaultValueRecordLayout_AUTOSAR_Platform_BaseTypes_sint16 20000.0 RB_PT_PCT_SWC_DST_CompuMethods_DST_Ident 0.0 20000. FORMAT "%10.5"
 /begin ANNOTATION ANNOTATION_LABEL "Description (coming from AUTOSAR DESC field)" /begin ANNOTATION_TEXT "Maximum engine speed in each gearin manual mode\r\n" /end ANNOTATION_TEXT /end ANNOTATION
 MATRIX_DIM 10 1 1 /end CHARACTERISTIC
/begin CHARACTERISTIC DST_EFLASHROMB.DST_DG.DST_ShiftPointsAndComp.DST_ShiftMaps.DST_MAXRPM_MAN_03 "" VAL_BLK 0x80604B5E DefaultValueRecordLayout_AUTOSAR_Platform_BaseTypes_sint16 20000.0 RB_PT_PCT_SWC_DST_CompuMethods_DST_Ident 0.0 20000. FORMAT "%10.5"
 /begin ANNOTATION ANNOTATION_LABEL "Description (coming from AUTOSAR DESC field)" /begin ANNOTATION_TEXT "Maximum engine speed in each gearin manual mode\r\n" /end ANNOTATION_TEXT /end ANNOTATION
 MATRIX_DIM 10 1 1 /end CHARACTERISTIC
/begin CHARACTERISTIC DST_EFLASHROMB.DST_DG.DST_ShiftPointsAndComp.DST_ShiftMaps.DST_MAXRPM_MAN_04 "" VAL_BLK 0x80604B72 DefaultValueRecordLayout_AUTOSAR_Platform_BaseTypes_sint16 20000.0 RB_PT_PCT_SWC_DST_CompuMethods_DST_Ident 0.0 20000. FORMAT "%10.5"
 /begin ANNOTATION ANNOTATION_LABEL "Description (coming from AUTOSAR DESC field)" /begin ANNOTATION_TEXT "Maximum engine speed in each gearin manual mode\r\n" /end ANNOTATION_TEXT /end ANNOTATION
 MATRIX_DIM 10 1 1 /end CHARACTERISTIC
/begin CHARACTERISTIC DST_EFLASHROMB.DST_DG.DST_ShiftPointsAndComp.DST_ShiftMaps.DST_MAXRPM_MAN_05 "" VAL_BLK 0x80604B86 DefaultValueRecordLayout_AUTOSAR_Platform_BaseTypes_sint16 20000.0 RB_PT_PCT_SWC_DST_CompuMethods_DST_Ident 0.0 20000. FORMAT "%10.5"
 /begin ANNOTATION ANNOTATION_LABEL "Description (coming from AUTOSAR DESC field)" /begin ANNOTATION_TEXT "Maximum engine speed in each gearin manual mode\r\n" /end ANNOTATION_TEXT /end ANNOTATION
 MATRIX_DIM 10 1 1 /end CHARACTERISTIC
/begin CHARACTERISTIC DST_EFLASHROMB.DST_DG.DST_ShiftPointsAndComp.DST_ShiftMaps.DST_MAXRPM_MAN_06 "" VAL_BLK 0x80604B9A DefaultValueRecordLayout_AUTOSAR_Platform_BaseTypes_sint16 20000.0 RB_PT_PCT_SWC_DST_CompuMethods_DST_Ident 0.0 20000. FORMAT "%10.5"
 /begin ANNOTATION ANNOTATION_LABEL "Description (coming from AUTOSAR DESC field)" /begin ANNOTATION_TEXT "Maximum engine speed in each gearin manual mode\r\n" /end ANNOTATION_TEXT /end ANNOTATION
 MATRIX_DIM 10 1 1 /end CHARACTERISTIC
/begin CHARACTERISTIC DST_EFLASHROMB.DST_DG.DST_ShiftPointsAndComp.DST_ShiftMaps.DST_MINRPM_AUTO_01 "" MAP 0x8060559A RB_PT_PCT_SWC_DST_RecordLayouts_RL_Map_sint16_108_uint16_12_uint8_9 20000.0 RB_PT_PCT_SWC_DST_CompuMethods_DST_Ident 0.0 20000. FORMAT "%10.5"
 /begin ANNOTATION ANNOTATION_LABEL "Description (coming from AUTOSAR DESC field)"
  /begin ANNOTATION_TEXT "Min Engine Speed for each gear at a given driver demand\r\n" /end ANNOTATION_TEXT
 /end ANNOTATION
 /begin AXIS_DESCR STD_AXIS NO_INPUT_QUANTITY RB_PT_PCT_SWC_DST_CompuMethods_ratio_0p1 12 0.0 110. FORMAT "%10.5" DEPOSIT ABSOLUTE /end AXIS_DESCR
 /begin AXIS_DESCR STD_AXIS NO_INPUT_QUANTITY RB_PT_PCT_SWC_DST_CompuMethods_ident 9 2. 10. FORMAT "%10.5" DEPOSIT ABSOLUTE /end AXIS_DESCR
/end CHARACTERISTIC
/begin CHARACTERISTIC DST_EFLASHROMB.DST_DG.DST_ShiftPointsAndComp.DST_ShiftMaps.DST_MINRPM_AUTO_02 "" MAP 0x80605698 RB_PT_PCT_SWC_DST_RecordLayouts_RL_Map_sint16_108_uint16_12_uint8_9 20000.0 RB_PT_PCT_SWC_DST_CompuMethods_DST_Ident 0.0 20000. FORMAT "%10.5"
 /begin ANNOTATION ANNOTATION_LABEL "Description (coming from AUTOSAR DESC field)"
  /begin ANNOTATION_TEXT "Min Engine Speed for each gear at a given driver demand\r\n" /end ANNOTATION_TEXT
 /end ANNOTATION
 /begin AXIS_DESCR STD_AXIS NO_INPUT_QUANTITY RB_PT_PCT_SWC_DST_CompuMethods_ratio_0p1 12 0.0 110. FORMAT "%10.5" DEPOSIT ABSOLUTE /end AXIS_DESCR
 /begin AXIS_DESCR STD_AXIS NO_INPUT_QUANTITY RB_PT_PCT_SWC_DST_CompuMethods_ident 9 2. 10. FORMAT "%10.5" DEPOSIT ABSOLUTE /end AXIS_DESCR
/end CHARACTERISTIC
/begin CHARACTERISTIC DST_EFLASHROMB.DST_DG.DST_ShiftPointsAndComp.DST_ShiftMaps.DST_MINRPM_AUTO_03 "" MAP 0x80605796 RB_PT_PCT_SWC_DST_RecordLayouts_RL_Map_sint16_108_uint16_12_uint8_9 20000.0 RB_PT_PCT_SWC_DST_CompuMethods_DST_Ident 0.0 20000. FORMAT "%10.5"
 /begin ANNOTATION ANNOTATION_LABEL "Description (coming from AUTOSAR DESC field)"
  /begin ANNOTATION_TEXT "Min Engine Speed for each gear at a given driver demand\r\n" /end ANNOTATION_TEXT
 /end ANNOTATION
 /begin AXIS_DESCR STD_AXIS NO_INPUT_QUANTITY RB_PT_PCT_SWC_DST_CompuMethods_ratio_0p1 12 0.0 110. FORMAT "%10.5" DEPOSIT ABSOLUTE /end AXIS_DESCR
 /begin AXIS_DESCR STD_AXIS NO_INPUT_QUANTITY RB_PT_PCT_SWC_DST_CompuMethods_ident 9 2. 10. FORMAT "%10.5" DEPOSIT ABSOLUTE /end AXIS_DESCR
/end CHARACTERISTIC
/begin CHARACTERISTIC DST_EFLASHROMB.DST_DG.DST_ShiftPointsAndComp.DST_ShiftMaps.DST_MINRPM_AUTO_04 "" MAP 0x80605894 RB_PT_PCT_SWC_DST_RecordLayouts_RL_Map_sint16_108_uint16_12_uint8_9 20000.0 RB_PT_PCT_SWC_DST_CompuMethods_DST_Ident 0.0 20000. FORMAT "%10.5"
 /begin ANNOTATION ANNOTATION_LABEL "Description (coming from AUTOSAR DESC field)"
  /begin ANNOTATION_TEXT "Min Engine Speed for each gear at a given driver demand\r\n" /end ANNOTATION_TEXT
 /end ANNOTATION
 /begin AXIS_DESCR STD_AXIS NO_INPUT_QUANTITY RB_PT_PCT_SWC_DST_CompuMethods_ratio_0p1 12 0.0 110. FORMAT "%10.5" DEPOSIT ABSOLUTE /end AXIS_DESCR
 /begin AXIS_DESCR STD_AXIS NO_INPUT_QUANTITY RB_PT_PCT_SWC_DST_CompuMethods_ident 9 2. 10. FORMAT "%10.5" DEPOSIT ABSOLUTE /end AXIS_DESCR
/end CHARACTERISTIC
/begin CHARACTERISTIC DST_EFLASHROMB.DST_DG.DST_ShiftPointsAndComp.DST_ShiftMaps.DST_MINRPM_AUTO_05 "" MAP 0x80605992 RB_PT_PCT_SWC_DST_RecordLayouts_RL_Map_sint16_108_uint16_12_uint8_9 20000.0 RB_PT_PCT_SWC_DST_CompuMethods_DST_Ident 0.0 20000. FORMAT "%10.5"
 /begin ANNOTATION ANNOTATION_LABEL "Description (coming from AUTOSAR DESC field)"
  /begin ANNOTATION_TEXT "Min Engine Speed for each gear at a given driver demand\r\n" /end ANNOTATION_TEXT
 /end ANNOTATION
 /begin AXIS_DESCR STD_AXIS NO_INPUT_QUANTITY RB_PT_PCT_SWC_DST_CompuMethods_ratio_0p1 12 0.0 110. FORMAT "%10.5" DEPOSIT ABSOLUTE /end AXIS_DESCR
 /begin AXIS_DESCR STD_AXIS NO_INPUT_QUANTITY RB_PT_PCT_SWC_DST_CompuMethods_ident 9 2. 10. FORMAT "%10.5" DEPOSIT ABSOLUTE /end AXIS_DESCR
/end CHARACTERISTIC
/begin CHARACTERISTIC DST_EFLASHROMB.DST_DG.DST_ShiftPointsAndComp.DST_ShiftMaps.DST_MINRPM_AUTO_06 "" MAP 0x80605A90 RB_PT_PCT_SWC_DST_RecordLayouts_RL_Map_sint16_108_uint16_12_uint8_9 20000.0 RB_PT_PCT_SWC_DST_CompuMethods_DST_Ident 0.0 20000. FORMAT "%10.5"
 /begin ANNOTATION ANNOTATION_LABEL "Description (coming from AUTOSAR DESC field)"
  /begin ANNOTATION_TEXT "Min Engine Speed for each gear at a given driver demand\r\n" /end ANNOTATION_TEXT
 /end ANNOTATION
 /begin AXIS_DESCR STD_AXIS NO_INPUT_QUANTITY RB_PT_PCT_SWC_DST_CompuMethods_ratio_0p1 12 0.0 110. FORMAT "%10.5" DEPOSIT ABSOLUTE /end AXIS_DESCR
 /begin AXIS_DESCR STD_AXIS NO_INPUT_QUANTITY RB_PT_PCT_SWC_DST_CompuMethods_ident 9 2. 10. FORMAT "%10.5" DEPOSIT ABSOLUTE /end AXIS_DESCR
/end CHARACTERISTIC
/begin CHARACTERISTIC DST_EFLASHROMB.DST_DG.DST_ShiftPointsAndComp.DST_ShiftMaps.DST_MINRPM_AUTO_07 "" MAP 0x80605B8E RB_PT_PCT_SWC_DST_RecordLayouts_RL_Map_sint16_108_uint16_12_uint8_9 20000.0 RB_PT_PCT_SWC_DST_CompuMethods_DST_Ident 0.0 20000. FORMAT "%10.5"
 /begin ANNOTATION ANNOTATION_LABEL "Description (coming from AUTOSAR DESC field)"
  /begin ANNOTATION_TEXT "Min Engine Speed for each gear at a given driver demand\r\n" /end ANNOTATION_TEXT
 /end ANNOTATION
 /begin AXIS_DESCR STD_AXIS NO_INPUT_QUANTITY RB_PT_PCT_SWC_DST_CompuMethods_ratio_0p1 12 0.0 110. FORMAT "%10.5" DEPOSIT ABSOLUTE /end AXIS_DESCR
 /begin AXIS_DESCR STD_AXIS NO_INPUT_QUANTITY RB_PT_PCT_SWC_DST_CompuMethods_ident 9 2. 10. FORMAT "%10.5" DEPOSIT ABSOLUTE /end AXIS_DESCR
/end CHARACTERISTIC
/begin CHARACTERISTIC DST_EFLASHROMB.DST_DG.DST_ShiftPointsAndComp.DST_ShiftMaps.DST_MINRPM_AUTO_08 "" MAP 0x80605C8C RB_PT_PCT_SWC_DST_RecordLayouts_RL_Map_sint16_108_uint16_12_uint8_9 20000.0 RB_PT_PCT_SWC_DST_CompuMethods_DST_Ident 0.0 20000. FORMAT "%10.5"
 /begin ANNOTATION ANNOTATION_LABEL "Description (coming from AUTOSAR DESC field)"
  /begin ANNOTATION_TEXT "Min Engine Speed for each gear at a given driver demand\r\n" /end ANNOTATION_TEXT
 /end ANNOTATION
 /begin AXIS_DESCR STD_AXIS NO_INPUT_QUANTITY RB_PT_PCT_SWC_DST_CompuMethods_ratio_0p1 12 0.0 110. FORMAT "%10.5" DEPOSIT ABSOLUTE /end AXIS_DESCR
 /begin AXIS_DESCR STD_AXIS NO_INPUT_QUANTITY RB_PT_PCT_SWC_DST_CompuMethods_ident 9 2. 10. FORMAT "%10.5" DEPOSIT ABSOLUTE /end AXIS_DESCR
/end CHARACTERISTIC
/begin CHARACTERISTIC DST_EFLASHROMB.DST_DG.DST_ShiftPointsAndComp.DST_ShiftMaps.DST_MINRPM_AUTO_09 "" MAP 0x80605D8A RB_PT_PCT_SWC_DST_RecordLayouts_RL_Map_sint16_108_uint16_12_uint8_9 20000.0 RB_PT_PCT_SWC_DST_CompuMethods_DST_Ident 0.0 20000. FORMAT "%10.5"
 /begin ANNOTATION ANNOTATION_LABEL "Description (coming from AUTOSAR DESC field)"
  /begin ANNOTATION_TEXT "Min Engine Speed for each gear at a given driver demand\r\n" /end ANNOTATION_TEXT
 /end ANNOTATION
 /begin AXIS_DESCR STD_AXIS NO_INPUT_QUANTITY RB_PT_PCT_SWC_DST_CompuMethods_ratio_0p1 12 0.0 110. FORMAT "%10.5" DEPOSIT ABSOLUTE /end AXIS_DESCR
 /begin AXIS_DESCR STD_AXIS NO_INPUT_QUANTITY RB_PT_PCT_SWC_DST_CompuMethods_ident 9 2. 10. FORMAT "%10.5" DEPOSIT ABSOLUTE /end AXIS_DESCR
/end CHARACTERISTIC
/begin CHARACTERISTIC DST_EFLASHROMB.DST_DG.DST_ShiftPointsAndComp.DST_ShiftMaps.DST_MINRPM_AUTO_10 "" MAP 0x80605E88 RB_PT_PCT_SWC_DST_RecordLayouts_RL_Map_sint16_108_uint16_12_uint8_9 20000.0 RB_PT_PCT_SWC_DST_CompuMethods_DST_Ident 0.0 20000. FORMAT "%10.5"
 /begin ANNOTATION ANNOTATION_LABEL "Description (coming from AUTOSAR DESC field)"
  /begin ANNOTATION_TEXT "Min Engine Speed for each gear at a given driver demand\r\n" /end ANNOTATION_TEXT
 /end ANNOTATION
 /begin AXIS_DESCR STD_AXIS NO_INPUT_QUANTITY RB_PT_PCT_SWC_DST_CompuMethods_ratio_0p1 12 0.0 110. FORMAT "%10.5" DEPOSIT ABSOLUTE /end AXIS_DESCR
 /begin AXIS_DESCR STD_AXIS NO_INPUT_QUANTITY RB_PT_PCT_SWC_DST_CompuMethods_ident 9 2. 10. FORMAT "%10.5" DEPOSIT ABSOLUTE /end AXIS_DESCR
/end CHARACTERISTIC
/begin CHARACTERISTIC DST_EFLASHROMB.DST_DG.DST_ShiftPointsAndComp.DST_ShiftMaps.DST_MINRPM_MAN_01 "" VAL_BLK 0x80604A88 DefaultValueRecordLayout_AUTOSAR_Platform_BaseTypes_sint16 20000.0 RB_PT_PCT_SWC_DST_CompuMethods_DST_Ident 0.0 20000. FORMAT "%10.5"
 /begin ANNOTATION ANNOTATION_LABEL "Description (coming from AUTOSAR DESC field)"
  /begin ANNOTATION_TEXT "Minimum engine speed in each gear in manual mode with 0% driver demand\r\n" /end ANNOTATION_TEXT
 /end ANNOTATION
 MATRIX_DIM 11 1 1 /end CHARACTERISTIC
/begin CHARACTERISTIC DST_EFLASHROMB.DST_DG.DST_ShiftPointsAndComp.DST_ShiftMaps.DST_MINRPM_MAN_02 "" VAL_BLK 0x80604A9E DefaultValueRecordLayout_AUTOSAR_Platform_BaseTypes_sint16 20000.0 RB_PT_PCT_SWC_DST_CompuMethods_DST_Ident 0.0 20000. FORMAT "%10.5"
 /begin ANNOTATION ANNOTATION_LABEL "Description (coming from AUTOSAR DESC field)"
  /begin ANNOTATION_TEXT "Minimum engine speed in each gear in manual mode with 0% driver demand\r\n" /end ANNOTATION_TEXT
 /end ANNOTATION
 MATRIX_DIM 11 1 1 /end CHARACTERISTIC
/begin CHARACTERISTIC DST_EFLASHROMB.DST_DG.DST_ShiftPointsAndComp.DST_ShiftMaps.DST_MINRPM_MAN_03 "" VAL_BLK 0x80604AB4 DefaultValueRecordLayout_AUTOSAR_Platform_BaseTypes_sint16 20000.0 RB_PT_PCT_SWC_DST_CompuMethods_DST_Ident 0.0 20000. FORMAT "%10.5"
 /begin ANNOTATION ANNOTATION_LABEL "Description (coming from AUTOSAR DESC field)"
  /begin ANNOTATION_TEXT "Minimum engine speed in each gear in manual mode with 0% driver demand\r\n" /end ANNOTATION_TEXT
 /end ANNOTATION
 MATRIX_DIM 11 1 1 /end CHARACTERISTIC
/begin CHARACTERISTIC DST_EFLASHROMB.DST_DG.DST_ShiftPointsAndComp.DST_ShiftMaps.DST_MINRPM_MAN_04_NOTROLLOUT "" VAL_BLK 0x80604ACA DefaultValueRecordLayout_AUTOSAR_Platform_BaseTypes_sint16 20000.0 RB_PT_PCT_SWC_DST_CompuMethods_DST_Ident 0.0 20000. FORMAT "%10.5"
 /begin ANNOTATION ANNOTATION_LABEL "Description (coming from AUTOSAR DESC field)"
  /begin ANNOTATION_TEXT "Minimum engine speed in each gear when the driver demand is above 5%\r\n" /end ANNOTATION_TEXT
 /end ANNOTATION
 MATRIX_DIM 11 1 1 /end CHARACTERISTIC
/begin CHARACTERISTIC DST_EFLASHROMB.DST_DG.DST_ShiftPointsAndComp.DST_ShiftMaps.DST_MINRPM_MAN_04_ROLLOUT "" VAL_BLK 0x80604AE0 DefaultValueRecordLayout_AUTOSAR_Platform_BaseTypes_sint16 20000.0 RB_PT_PCT_SWC_DST_CompuMethods_DST_Ident 0.0 20000. FORMAT "%10.5"
 /begin ANNOTATION ANNOTATION_LABEL "Description (coming from AUTOSAR DESC field)"
  /begin ANNOTATION_TEXT "Minimum engine speed in each gear in manual mode with 0% driver demand\r\n" /end ANNOTATION_TEXT
 /end ANNOTATION
 MATRIX_DIM 11 1 1 /end CHARACTERISTIC
/begin CHARACTERISTIC DST_EFLASHROMB.DST_DG.DST_ShiftPointsAndComp.DST_ShiftMaps.DST_MINRPM_MAN_05 "" VAL_BLK 0x80604AF6 DefaultValueRecordLayout_AUTOSAR_Platform_BaseTypes_sint16 20000.0 RB_PT_PCT_SWC_DST_CompuMethods_DST_Ident 0.0 20000. FORMAT "%10.5"
 /begin ANNOTATION ANNOTATION_LABEL "Description (coming from AUTOSAR DESC field)"
  /begin ANNOTATION_TEXT "Minimum engine speed in each gear when the driver demand is above 5%\r\n" /end ANNOTATION_TEXT
 /end ANNOTATION
 MATRIX_DIM 11 1 1 /end CHARACTERISTIC
/begin CHARACTERISTIC DST_EFLASHROMB.DST_DG.DST_ShiftPointsAndComp.DST_ShiftMaps.DST_MINRPM_MAN_06 "" VAL_BLK 0x80604B0C DefaultValueRecordLayout_AUTOSAR_Platform_BaseTypes_sint16 20000.0 RB_PT_PCT_SWC_DST_CompuMethods_DST_Ident 0.0 20000. FORMAT "%10.5"
 /begin ANNOTATION ANNOTATION_LABEL "Description (coming from AUTOSAR DESC field)"
  /begin ANNOTATION_TEXT "Minimum engine speed in each gear when the driver demand is above 5%\r\n" /end ANNOTATION_TEXT
 /end ANNOTATION
 MATRIX_DIM 11 1 1 /end CHARACTERISTIC
/begin CHARACTERISTIC DST_EFLASHROMB.DST_DG.DST_ShiftPointsAndComp.DST_ShiftMaps.DST_PULLAWAYMAXSPEED "" VAL_BLK 0x80604A32 DefaultValueRecordLayout_AUTOSAR_Platform_BaseTypes_uint16 500.0 RB_PT_PCT_SWC_DST_CompuMethods_kph_0p1 0.0 500. FORMAT "%10.5"
 /begin ANNOTATION ANNOTATION_LABEL "Description (coming from AUTOSAR DESC field)"
  /begin ANNOTATION_TEXT "Vehicle speed in each shift mode below which the pullaway logic is enable (ensure max rpm is greater than a threshold)\r\n" /end ANNOTATION_TEXT
 /end ANNOTATION
 MATRIX_DIM 17 1 1 /end CHARACTERISTIC
/begin CHARACTERISTIC DST_EFLASHROMB.DST_DG.DST_ShiftPointsAndComp.DST_ShiftMaps.DST_REVLIMITBOUNCETIME "" VAL_BLK 0x80604A54 DefaultValueRecordLayout_AUTOSAR_Platform_BaseTypes_uint16 655.35 RB_PT_PCT_SWC_DST_CompuMethods_DST_Time 0.0 655.35 FORMAT "%10.5"
 /begin ANNOTATION ANNOTATION_LABEL "Description (coming from AUTOSAR DESC field)"
  /begin ANNOTATION_TEXT "Time in each mode the engine speed must be above the max up-shift line before a shift will be requested\r\n" /end ANNOTATION_TEXT
 /end ANNOTATION
 MATRIX_DIM 17 1 1 /end CHARACTERISTIC
/begin CHARACTERISTIC DST_EFLASHROMB.DST_In_DriverDemand.DST_ZERO "" VALUE 0x80605F86 DefaultValueRecordLayout_AUTOSAR_Platform_BaseTypes_uint16 327.67 RB_PT_PCT_SWC_DST_CompuMethods_DST_Time 0.0 327.67 FORMAT "%10.5"
 /begin ANNOTATION ANNOTATION_LABEL "Description (coming from AUTOSAR DESC field)" /begin ANNOTATION_TEXT "Zero implementation\r\n" /end ANNOTATION_TEXT /end ANNOTATION
/end CHARACTERISTIC
/begin CHARACTERISTIC DST_MINSHIFTHYST "unsigned integer 16bit" VALUE 0x80604016 DefaultValueRecordLayout_AUTOSAR_Platform_BaseTypes_uint16 20000.0 RB_PT_PCT_SWC_DST_CompuMethods_ident 0.0 20000. FORMAT "%10.5"
 /begin ANNOTATION ANNOTATION_LABEL "Description (coming from AUTOSAR DESC field)"
  /begin ANNOTATION_TEXT "Minimum engine speed between the maximum upshift rpm and maximum downshift rpm\r\n" /end ANNOTATION_TEXT
 /end ANNOTATION
/end CHARACTERISTIC
/begin CHARACTERISTIC DWC_CALIB.BOB_BITLOSSTYPE "" VALUE 0x8060E71C DefaultValueRecordLayout_AUTOSAR_Platform_BaseTypes_uint8 255.0 RB_PT_PCT_SWC_DWC_CompuMethods_ident 0.0 255. FORMAT "%10.5"
 /begin ANNOTATION ANNOTATION_LABEL "Description (coming from AUTOSAR DESC field)" /begin ANNOTATION_TEXT "Break out box override for SEQ Final Target Gear\r\n" /end ANNOTATION_TEXT /end ANNOTATION
/end CHARACTERISTIC
/begin CHARACTERISTIC DWC_CALIB.DWC_37DETECTMININPUTSPD "" VALUE 0x8060E6F4 DefaultValueRecordLayout_AUTOSAR_Platform_BaseTypes_uint16 20000.0 RB_PT_PCT_SWC_DWC_CompuMethods_ident 0.0 20000. FORMAT "%10.5"
 /begin ANNOTATION ANNOTATION_LABEL "Description (coming from AUTOSAR DESC field)" /begin ANNOTATION_TEXT "Min input speed required for 37 detect.\r\n" /end ANNOTATION_TEXT /end ANNOTATION
/end CHARACTERISTIC
/begin CHARACTERISTIC DWC_CALIB.DWC_37DETECTRESETFAOBD "" VALUE 0x8060E71D DefaultValueRecordLayout_AUTOSAR_Platform_BaseTypes_uint8 255.0 DefaultIdenticalCompu 0.0 255. FORMAT "%10.5"
 /begin ANNOTATION ANNOTATION_LABEL "Description (coming from AUTOSAR DESC field)"
  /begin ANNOTATION_TEXT "Calibration to enable the reset of failure action associated with 37 detect.\r\n" /end ANNOTATION_TEXT
 /end ANNOTATION
/end CHARACTERISTIC
/begin CHARACTERISTIC DWC_CALIB.DWC_37FixedTimer "" VALUE 0x8060E6F6 DefaultValueRecordLayout_AUTOSAR_Platform_BaseTypes_uint16 327.675 RB_PT_PCT_SWC_DWC_CompuMethods_ratio_0p005 0.0 327.675 FORMAT "%10.5"
 /begin ANNOTATION ANNOTATION_LABEL "Description (coming from AUTOSAR DESC field)" /begin ANNOTATION_TEXT "Timeto detect an issue withthe 37 gear\r\n" /end ANNOTATION_TEXT /end ANNOTATION
/end CHARACTERISTIC
/begin CHARACTERISTIC DWC_CALIB.DWC_37MAX37SLIP "" VALUE 0x8060E6F8 DefaultValueRecordLayout_AUTOSAR_Platform_BaseTypes_uint16 20000.0 RB_PT_PCT_SWC_DWC_CompuMethods_ident 0.0 20000. FORMAT "%10.5"
 /begin ANNOTATION ANNOTATION_LABEL "Description (coming from AUTOSAR DESC field)" /begin ANNOTATION_TEXT "Max Slip to enable 37 detect\r\n" /end ANNOTATION_TEXT /end ANNOTATION
/end CHARACTERISTIC
/begin CHARACTERISTIC DWC_CALIB.DWC_37MAXAPOS "" VALUE 0x8060E6FA DefaultValueRecordLayout_AUTOSAR_Platform_BaseTypes_sint16 40.0 RB_PT_PCT_SWC_DWC_CompuMethods_ratio_0p001__2 -20. 20. FORMAT "%10.5"
 /begin ANNOTATION ANNOTATION_LABEL "Description (coming from AUTOSAR DESC field)" /begin ANNOTATION_TEXT "Max sync A for 37 detect\r\n" /end ANNOTATION_TEXT /end ANNOTATION
/end CHARACTERISTIC
/begin CHARACTERISTIC DWC_CALIB.DWC_37MaxRatio "" VALUE 0x8060E702 DefaultValueRecordLayout_AUTOSAR_Platform_BaseTypes_uint16 65.535 RB_PT_PCT_SWC_DWC_CompuMethods_ratio_0p001__2 0.0 65.535 FORMAT "%10.5"
 /begin ANNOTATION ANNOTATION_LABEL "Description (coming from AUTOSAR DESC field)" /begin ANNOTATION_TEXT "Max ratio to determine 37 slipping\r\n" /end ANNOTATION_TEXT /end ANNOTATION
/end CHARACTERISTIC
/begin CHARACTERISTIC DWC_CALIB.DWC_37MINOILTEMP "" VALUE 0x8060E6FC DefaultValueRecordLayout_AUTOSAR_Platform_BaseTypes_sint16 250.0 RB_PT_PCT_SWC_DWC_CompuMethods_ident -50. 200. FORMAT "%10.5"
 /begin ANNOTATION ANNOTATION_LABEL "Description (coming from AUTOSAR DESC field)" /begin ANNOTATION_TEXT "Min oil temp for for 37 detect.\r\n" /end ANNOTATION_TEXT /end ANNOTATION
/end CHARACTERISTIC
/begin CHARACTERISTIC DWC_CALIB.DWC_37MinRatio "" VALUE 0x8060E704 DefaultValueRecordLayout_AUTOSAR_Platform_BaseTypes_uint16 65.535 RB_PT_PCT_SWC_DWC_CompuMethods_ratio_0p001__2 0.0 65.535 FORMAT "%10.5"
 /begin ANNOTATION ANNOTATION_LABEL "Description (coming from AUTOSAR DESC field)" /begin ANNOTATION_TEXT "Max ratio to determine 37 slipping\r\n" /end ANNOTATION_TEXT /end ANNOTATION
/end CHARACTERISTIC
/begin CHARACTERISTIC DWC_CALIB.DWC_37MINSECSLIP "" VALUE 0x8060E6FE DefaultValueRecordLayout_AUTOSAR_Platform_BaseTypes_uint16 20000.0 RB_PT_PCT_SWC_DWC_CompuMethods_ident 0.0 20000. FORMAT "%10.5"
 /begin ANNOTATION ANNOTATION_LABEL "Description (coming from AUTOSAR DESC field)" /begin ANNOTATION_TEXT "Max Slip to enable 37 detect\r\n" /end ANNOTATION_TEXT /end ANNOTATION
/end CHARACTERISTIC
/begin CHARACTERISTIC DWC_CALIB.DWC_37MINSPEEDDETECT "" VALUE 0x8060E700 DefaultValueRecordLayout_AUTOSAR_Platform_BaseTypes_uint16 500.0 RB_PT_PCT_SWC_DWC_CompuMethods_ratio_0p01 0.0 500. FORMAT "%10.5"
 /begin ANNOTATION ANNOTATION_LABEL "Description (coming from AUTOSAR DESC field)" /begin ANNOTATION_TEXT "Min speed for 37 detect.\r\n" /end ANNOTATION_TEXT /end ANNOTATION
/end CHARACTERISTIC
/begin CHARACTERISTIC DWC_CALIB.DWC_BALANCEBOOSTFACTRANSTEMP "" CURVE 0x8060FFA0 RB_PT_PCT_SWC_DWC_RecordLayouts_RL_Curve_uint16_6_sint16_6 2.0 RB_PT_PCT_SWC_DWC_CompuMethods_ratio_0p01 0.0 2. FORMAT "%10.5"
 /begin ANNOTATION ANNOTATION_LABEL "Description (coming from AUTOSAR DESC field)" /begin ANNOTATION_TEXT "Balance boost modifier in relation to transoil temp.\r\n" /end ANNOTATION_TEXT /end ANNOTATION
 /begin AXIS_DESCR STD_AXIS NO_INPUT_QUANTITY RB_PT_PCT_SWC_DWC_CompuMethods_ident 6 -50. 200. FORMAT "%10.5" DEPOSIT ABSOLUTE /end AXIS_DESCR
/end CHARACTERISTIC
/begin CHARACTERISTIC DWC_CALIB.DWC_BALANCEBOOSTFACTVEHICLESPEED "" CURVE 0x8060FFBA RB_PT_PCT_SWC_DWC_RecordLayouts_RL_Curve_uint16_6_uint16_6 2.0 RB_PT_PCT_SWC_DWC_CompuMethods_ratio_0p01 0.0 2. FORMAT "%10.5"
 /begin ANNOTATION ANNOTATION_LABEL "Description (coming from AUTOSAR DESC field)" /begin ANNOTATION_TEXT "Balance boost modifier in relation to transoil temp.\r\n" /end ANNOTATION_TEXT /end ANNOTATION
 /begin AXIS_DESCR STD_AXIS NO_INPUT_QUANTITY RB_PT_PCT_SWC_DWC_CompuMethods_ratio_0p01 6 0.0 500. FORMAT "%10.5" DEPOSIT ABSOLUTE /end AXIS_DESCR
/end CHARACTERISTIC
/begin CHARACTERISTIC DWC_CALIB.DWC_BALANCEBOOSTFLOW2D "" MAP 0x8060FFD4 RB_PT_PCT_SWC_DWC_RecordLayouts_RL_Map_uint16_25_uint16_5_uint16_5 127.5 RB_PT_PCT_SWC_DWC_CompuMethods_flow_0p01 0.0 127.5 FORMAT "%10.5"
 /begin ANNOTATION ANNOTATION_LABEL "Description (coming from AUTOSAR DESC field)"
  /begin ANNOTATION_TEXT "Balance chamber cooling flow boost WRT x-time since engine stop y-time engine off\r\n" /end ANNOTATION_TEXT
 /end ANNOTATION
 /begin AXIS_DESCR STD_AXIS NO_INPUT_QUANTITY RB_PT_PCT_SWC_DWC_CompuMethods_ratio_0p05 5 0.0 3276.75 FORMAT "%10.5" DEPOSIT ABSOLUTE /end AXIS_DESCR
 /begin AXIS_DESCR STD_AXIS NO_INPUT_QUANTITY RB_PT_PCT_SWC_DWC_CompuMethods_ratio_0p05 5 0.0 3276.75 FORMAT "%10.5" DEPOSIT ABSOLUTE /end AXIS_DESCR
/end CHARACTERISTIC
/begin CHARACTERISTIC DWC_CALIB.DWC_BOBENBLIDLOSSTYPE "" VALUE 0x8060E71E DefaultValueRecordLayout_AUTOSAR_Platform_BaseTypes_uint8 255.0 DefaultIdenticalCompu 0.0 255. FORMAT "%10.5"
 /begin ANNOTATION ANNOTATION_LABEL "Description (coming from AUTOSAR DESC field)" /begin ANNOTATION_TEXT "temporary flag to indicate vehicle is hybrid layout\r\n" /end ANNOTATION_TEXT /end ANNOTATION
/end CHARACTERISTIC
/begin CHARACTERISTIC DWC_CALIB.DWC_BOBROUTINEREQUEST "" VALUE 0x8060E71F DefaultValueRecordLayout_AUTOSAR_Platform_BaseTypes_uint8 59.0 RB_PT_PCT_SWC_DWC_CompuMethods_Enumerations_OBD_RoutineCommand_PCCU 0.0 59. FORMAT "%10.5"
 /begin ANNOTATION ANNOTATION_LABEL "Description (coming from AUTOSAR DESC field)" /begin ANNOTATION_TEXT "BOBed routine request to DWC\r\n" /end ANNOTATION_TEXT /end ANNOTATION
/end CHARACTERISTIC
/begin CHARACTERISTIC DWC_CALIB.DWC_CLEARMAXTEMPS "" VALUE 0x8060E720 DefaultValueRecordLayout_AUTOSAR_Platform_BaseTypes_boolean 255.0 AUTOSAR_Platform_CompuMethods_boolean 0.0 255. FORMAT "%10.5"
 /begin ANNOTATION ANNOTATION_LABEL "Description (coming from AUTOSAR DESC field)" /begin ANNOTATION_TEXT "Flag to clear only the maximum stored temperatures.\r\n" /end ANNOTATION_TEXT /end ANNOTATION
/end CHARACTERISTIC
/begin CHARACTERISTIC DWC_CALIB.DWC_CURRENTIVSS1 "" VALUE 0x8060E706 DefaultValueRecordLayout_AUTOSAR_Platform_BaseTypes_uint16 5000.0 RB_PT_PCT_SWC_DWC_CompuMethods_ident 0.0 5000. FORMAT "%10.5"
 /begin ANNOTATION ANNOTATION_LABEL "Description (coming from AUTOSAR DESC field)" /begin ANNOTATION_TEXT "Current demand to IVSS1 when fill is not active\r\n" /end ANNOTATION_TEXT /end ANNOTATION
/end CHARACTERISTIC
/begin CHARACTERISTIC DWC_CALIB.DWC_CURRENTSTEPIVSS1 "" VALUE 0x8060E708 DefaultValueRecordLayout_AUTOSAR_Platform_BaseTypes_uint16 5000.0 RB_PT_PCT_SWC_DWC_CompuMethods_ident 0.0 5000. FORMAT "%10.5"
 /begin ANNOTATION ANNOTATION_LABEL "Description (coming from AUTOSAR DESC field)" /begin ANNOTATION_TEXT "Current change each dT when fill complete\r\n" /end ANNOTATION_TEXT /end ANNOTATION
/end CHARACTERISTIC
/begin CHARACTERISTIC DWC_CALIB.DWC_DISABLEGEAROILOBDFLAG "" VALUE 0x8060E721 DefaultValueRecordLayout_AUTOSAR_Platform_BaseTypes_boolean 255.0 AUTOSAR_Platform_CompuMethods_boolean 0.0 255. FORMAT "%10.5"
 /begin ANNOTATION ANNOTATION_LABEL "Description (coming from AUTOSAR DESC field)"
  /begin ANNOTATION_TEXT "Flag to disable gear oil over temperature warning flag\r\n" /end ANNOTATION_TEXT
 /end ANNOTATION
/end CHARACTERISTIC
/begin CHARACTERISTIC DWC_CALIB.DWC_DISABLELOCATIONSPECIFICCLEAR "" VALUE 0x8060E722 DefaultValueRecordLayout_AUTOSAR_Platform_BaseTypes_boolean 255.0 AUTOSAR_Platform_CompuMethods_boolean 0.0 255. FORMAT "%10.5"
 /begin ANNOTATION ANNOTATION_LABEL "Description (coming from AUTOSAR DESC field)" /begin ANNOTATION_TEXT "Flag to disable nv location specific clearing.\r\n" /end ANNOTATION_TEXT /end ANNOTATION
/end CHARACTERISTIC
/begin CHARACTERISTIC DWC_CALIB.DWC_FLGALLOWWRITEFROMUDS "" VALUE 0x8060E723 DefaultValueRecordLayout_AUTOSAR_Platform_BaseTypes_boolean 255.0 AUTOSAR_Platform_CompuMethods_boolean 0.0 255. FORMAT "%10.5"
 /begin ANNOTATION ANNOTATION_LABEL "Description (coming from AUTOSAR DESC field)" /begin ANNOTATION_TEXT "Flag to enable WDBI via UDS.\r\n" /end ANNOTATION_TEXT /end ANNOTATION
/end CHARACTERISTIC
/begin CHARACTERISTIC DWC_CALIB.DWC_FLGBLOCKYELLOWTEMPWARNING4LAUNCH "" VALUE 0x8060E724 DefaultValueRecordLayout_AUTOSAR_Platform_BaseTypes_boolean 255.0 AUTOSAR_Platform_CompuMethods_boolean 0.0 255. FORMAT "%10.5"
 /begin ANNOTATION ANNOTATION_LABEL "Description (coming from AUTOSAR DESC field)"
  /begin ANNOTATION_TEXT "Block yellow temperature warning during launch control.\r\n" /end ANNOTATION_TEXT
 /end ANNOTATION
/end CHARACTERISTIC
/begin CHARACTERISTIC DWC_CALIB.DWC_FLGBOBENABLEROUTINEREQUEST "" VALUE 0x8060E725 DefaultValueRecordLayout_AUTOSAR_Platform_BaseTypes_boolean 255.0 AUTOSAR_Platform_CompuMethods_boolean 0.0 255. FORMAT "%10.5"
 /begin ANNOTATION ANNOTATION_LABEL "Description (coming from AUTOSAR DESC field)" /begin ANNOTATION_TEXT "Enable BOBed routine request to DWC\r\n" /end ANNOTATION_TEXT /end ANNOTATION
/end CHARACTERISTIC
/begin CHARACTERISTIC DWC_CALIB.DWC_FLGBOTHSOFAILEDFORDFC "" VALUE 0x8060E726 DefaultValueRecordLayout_AUTOSAR_Platform_BaseTypes_boolean 255.0 AUTOSAR_Platform_CompuMethods_boolean 0.0 255. FORMAT "%10.5"
 /begin ANNOTATION ANNOTATION_LABEL "Description (coming from AUTOSAR DESC field)" /begin ANNOTATION_TEXT "Require both SO routines to fail before raising DFC.\r\n" /end ANNOTATION_TEXT /end ANNOTATION
/end CHARACTERISTIC
/begin CHARACTERISTIC DWC_CALIB.DWC_FLGDRVOUTNOTRDYBLNK "" VALUE 0x8060E727 DefaultValueRecordLayout_AUTOSAR_Platform_BaseTypes_boolean 255.0 AUTOSAR_Platform_CompuMethods_boolean 0.0 255. FORMAT "%10.5"
 /begin ANNOTATION ANNOTATION_LABEL "Description (coming from AUTOSAR DESC field)" /begin ANNOTATION_TEXT "Blank system status when drive outputs not ready\r\n" /end ANNOTATION_TEXT /end ANNOTATION
/end CHARACTERISTIC
/begin CHARACTERISTIC DWC_CALIB.DWC_FLGENABLEAUTOVALVERINSEINGEAR "" VALUE 0x8060E728 DefaultValueRecordLayout_AUTOSAR_Platform_BaseTypes_uint8 255.0 DefaultIdenticalCompu 0.0 255. FORMAT "%10.5"
 /begin ANNOTATION ANNOTATION_LABEL "Description (coming from AUTOSAR DESC field)" /begin ANNOTATION_TEXT "Enable automatic valve rinsing when in gear\r\n" /end ANNOTATION_TEXT /end ANNOTATION
/end CHARACTERISTIC
/begin CHARACTERISTIC DWC_CALIB.DWC_FLGENABLEAUTOVALVERINSENEUTRAL "" VALUE 0x8060E729 DefaultValueRecordLayout_AUTOSAR_Platform_BaseTypes_uint8 255.0 DefaultIdenticalCompu 0.0 255. FORMAT "%10.5"
 /begin ANNOTATION ANNOTATION_LABEL "Description (coming from AUTOSAR DESC field)" /begin ANNOTATION_TEXT "Enable automatic valve rinsing when in neutral\r\n" /end ANNOTATION_TEXT /end ANNOTATION
/end CHARACTERISTIC
/begin CHARACTERISTIC DWC_CALIB.DWC_FLGENABLEAUTOVALVERINSESHUTOFF "" VALUE 0x8060E72A DefaultValueRecordLayout_AUTOSAR_Platform_BaseTypes_uint8 255.0 DefaultIdenticalCompu 0.0 255. FORMAT "%10.5"
 /begin ANNOTATION ANNOTATION_LABEL "Description (coming from AUTOSAR DESC field)" /begin ANNOTATION_TEXT "Enable automatic valve rinsing when in shutoff\r\n" /end ANNOTATION_TEXT /end ANNOTATION
/end CHARACTERISTIC
/begin CHARACTERISTIC DWC_CALIB.DWC_FLGENABLEDEPRESSURE "" VALUE 0x8060E72B DefaultValueRecordLayout_AUTOSAR_Platform_BaseTypes_boolean 255.0 AUTOSAR_Platform_CompuMethods_boolean 0.0 255. FORMAT "%10.5"
 /begin ANNOTATION ANNOTATION_LABEL "Description (coming from AUTOSAR DESC field)" /begin ANNOTATION_TEXT "Set true to enable depressure routine\r\n" /end ANNOTATION_TEXT /end ANNOTATION
/end CHARACTERISTIC
/begin CHARACTERISTIC DWC_CALIB.DWC_FLGFAILP2ODDANDEVEN "" VALUE 0x8060E72C DefaultValueRecordLayout_AUTOSAR_Platform_BaseTypes_uint8 255.0 DefaultIdenticalCompu 0.0 255. FORMAT "%10.5"
 /begin ANNOTATION ANNOTATION_LABEL "Description (coming from AUTOSAR DESC field)"
  /begin ANNOTATION_TEXT "Flag to enable the logic that will fail P2 odd and even if both singular hybrid modes are failed.\r\n" /end ANNOTATION_TEXT
 /end ANNOTATION
/end CHARACTERISTIC
/begin CHARACTERISTIC DWC_CALIB.DWC_FLGIGNOREVSS1STATUS "" VALUE 0x8060E72D DefaultValueRecordLayout_AUTOSAR_Platform_BaseTypes_boolean 255.0 AUTOSAR_Platform_CompuMethods_boolean 0.0 255. FORMAT "%10.5"
 /begin ANNOTATION ANNOTATION_LABEL "Description (coming from AUTOSAR DESC field)" /begin ANNOTATION_TEXT "Ignore VSS1 status when allowing depressure\r\n" /end ANNOTATION_TEXT /end ANNOTATION
/end CHARACTERISTIC
/begin CHARACTERISTIC DWC_CALIB.DWC_FLGMONITORSTATUSANDINSTERR "" VALUE 0x8060E72E DefaultValueRecordLayout_AUTOSAR_Platform_BaseTypes_boolean 255.0 AUTOSAR_Platform_CompuMethods_boolean 0.0 255. FORMAT "%10.5"
 /begin ANNOTATION ANNOTATION_LABEL "Description (coming from AUTOSAR DESC field)"
  /begin ANNOTATION_TEXT "Flag to enable monitoring of status and instant error for thermal model.\r\n" /end ANNOTATION_TEXT
 /end ANNOTATION
/end CHARACTERISTIC
/begin CHARACTERISTIC DWC_CALIB.DWC_FLGOVERRIDESYSTEMSTATUS "" VALUE 0x8060E72F DefaultValueRecordLayout_AUTOSAR_Platform_BaseTypes_boolean 255.0 AUTOSAR_Platform_CompuMethods_boolean 0.0 255. FORMAT "%10.5"
 /begin ANNOTATION ANNOTATION_LABEL "Description (coming from AUTOSAR DESC field)" /begin ANNOTATION_TEXT "Flag to force the system status to zero.\r\n" /end ANNOTATION_TEXT /end ANNOTATION
/end CHARACTERISTIC
/begin CHARACTERISTIC DWC_CALIB.DWC_FLGSSUSEHYBRIDDISENGAGEMAPS "" VALUE 0x8060E730 DefaultValueRecordLayout_AUTOSAR_Platform_BaseTypes_boolean 255.0 AUTOSAR_Platform_CompuMethods_boolean 0.0 255. FORMAT "%10.5"
 /begin ANNOTATION ANNOTATION_LABEL "Description (coming from AUTOSAR DESC field)" /begin ANNOTATION_TEXT "Flag to use hybrid specific disengage rate maps.\r\n" /end ANNOTATION_TEXT /end ANNOTATION
/end CHARACTERISTIC
/begin CHARACTERISTIC DWC_CALIB.DWC_FLGUSECLEANTODEPRESSURE "" VALUE 0x8060E731 DefaultValueRecordLayout_AUTOSAR_Platform_BaseTypes_uint8 255.0 DefaultIdenticalCompu 0.0 255. FORMAT "%10.5"
 /begin ANNOTATION ANNOTATION_LABEL "Description (coming from AUTOSAR DESC field)" /begin ANNOTATION_TEXT "Use clutch cleaning to start depressure procedure\r\n" /end ANNOTATION_TEXT /end ANNOTATION
/end CHARACTERISTIC
/begin CHARACTERISTIC DWC_CALIB.DWC_FLGUSEGACCOUPLINGLOSSID "" VALUE 0x8060E732 DefaultValueRecordLayout_AUTOSAR_Platform_BaseTypes_uint8 255.0 DefaultIdenticalCompu 0.0 255. FORMAT "%10.5"
 /begin ANNOTATION ANNOTATION_LABEL "Description (coming from AUTOSAR DESC field)"
  /begin ANNOTATION_TEXT "Use torque demand =/ -2000 instead of gac state for loss ID\r\n" /end ANNOTATION_TEXT
 /end ANNOTATION
/end CHARACTERISTIC
/begin CHARACTERISTIC DWC_CALIB.DWC_FLGUSESIGNEDSPEEDS "" VALUE 0x8060E733 DefaultValueRecordLayout_AUTOSAR_Platform_BaseTypes_boolean 255.0 AUTOSAR_Platform_CompuMethods_boolean 0.0 255. FORMAT "%10.5"
 /begin ANNOTATION ANNOTATION_LABEL "Description (coming from AUTOSAR DESC field)"
  /begin ANNOTATION_TEXT "Set true to import signed speeds into DWC_InputProcessing\r\n" /end ANNOTATION_TEXT
 /end ANNOTATION
/end CHARACTERISTIC
/begin CHARACTERISTIC DWC_CALIB.DWC_FLGUSETORQUEREQLOSSID "" VALUE 0x8060E734 DefaultValueRecordLayout_AUTOSAR_Platform_BaseTypes_uint8 255.0 DefaultIdenticalCompu 0.0 255. FORMAT "%10.5"
 /begin ANNOTATION ANNOTATION_LABEL "Description (coming from AUTOSAR DESC field)"
  /begin ANNOTATION_TEXT "Use torque demand =/ -2000 instead of gac state for loss ID\r\n" /end ANNOTATION_TEXT
 /end ANNOTATION
/end CHARACTERISTIC
/begin CHARACTERISTIC DWC_CALIB.DWC_InputProcessing.DWC_ENABLEDELAYEDSPEEDSIGNAL "" VALUE 0x8060E738 DefaultValueRecordLayout_AUTOSAR_Platform_BaseTypes_boolean 255.0 AUTOSAR_Platform_CompuMethods_boolean 0.0 255. FORMAT "%10.5"
 /begin ANNOTATION ANNOTATION_LABEL "Description (coming from AUTOSAR DESC field)"
  /begin ANNOTATION_TEXT "Enable delayed speed signals when engine speed goes to backup.\r\n" /end ANNOTATION_TEXT
 /end ANNOTATION
/end CHARACTERISTIC
/begin CHARACTERISTIC DWC_CALIB.DWC_InputProcessing.DWC_EnableHighBrakePressureEPB "" VALUE 0x8060E739 DefaultValueRecordLayout_AUTOSAR_Platform_BaseTypes_uint8 255.0 DefaultIdenticalCompu 0.0 255. FORMAT "%10.5"
 /begin ANNOTATION ANNOTATION_LABEL "Description (coming from AUTOSAR DESC field)" /begin ANNOTATION_TEXT "flag to enable high brake pressure when EPB ON.\r\n" /end ANNOTATION_TEXT /end ANNOTATION
/end CHARACTERISTIC
/begin CHARACTERISTIC DWC_CALIB.DWC_InputProcessing.DWC_INPUT1SPEEDDELAYCYCLES "" VALUE 0x8060E73A DefaultValueRecordLayout_AUTOSAR_Platform_BaseTypes_uint8 28.0 RB_PT_PCT_SWC_DWC_CompuMethods_ident 0.0 28. FORMAT "%10.5"
 /begin ANNOTATION ANNOTATION_LABEL "Description (coming from AUTOSAR DESC field)" /begin ANNOTATION_TEXT "Number of cycles to delay input 1 speed.\r\n" /end ANNOTATION_TEXT /end ANNOTATION
/end CHARACTERISTIC
/begin CHARACTERISTIC DWC_CALIB.DWC_InputProcessing.DWC_INPUT2SPEEDDELAYCYCLES "" VALUE 0x8060E73B DefaultValueRecordLayout_AUTOSAR_Platform_BaseTypes_uint8 28.0 RB_PT_PCT_SWC_DWC_CompuMethods_ident 0.0 28. FORMAT "%10.5"
 /begin ANNOTATION ANNOTATION_LABEL "Description (coming from AUTOSAR DESC field)" /begin ANNOTATION_TEXT "Number of cycles to delay input 1 speed.\r\n" /end ANNOTATION_TEXT /end ANNOTATION
/end CHARACTERISTIC
/begin CHARACTERISTIC DWC_CALIB.DWC_InputProcessing.DWC_K1PressureCorrect.DWC_FLGENABLEFAULTLATCH "" VALUE 0x8060E73E DefaultValueRecordLayout_AUTOSAR_Platform_BaseTypes_uint8 255.0 DefaultIdenticalCompu 0.0 255. FORMAT "%10.5"
 /begin ANNOTATION ANNOTATION_LABEL "Description (coming from AUTOSAR DESC field)" /begin ANNOTATION_TEXT "Flag to enable pressure adaption fault to latch.\r\n" /end ANNOTATION_TEXT /end ANNOTATION
/end CHARACTERISTIC
/begin CHARACTERISTIC DWC_CALIB.DWC_InputProcessing.DWC_K1PressureCorrect.DWC_PIAutoReset "" VALUE 0x8060E73F DefaultValueRecordLayout_AUTOSAR_Platform_BaseTypes_uint8 255.0 DefaultIdenticalCompu 0.0 255. FORMAT "%10.5"
 /begin ANNOTATION ANNOTATION_LABEL "Description (coming from AUTOSAR DESC field)"
  /begin ANNOTATION_TEXT "will fore a reset if the pi adaption hits max or min allowable limits.\r\n" /end ANNOTATION_TEXT
 /end ANNOTATION
/end CHARACTERISTIC
/begin CHARACTERISTIC DWC_CALIB.DWC_InputProcessing.DWC_K2PressureCorrect.DWC_FLGENABLEFAULTLATCH "" VALUE 0x8060E740 DefaultValueRecordLayout_AUTOSAR_Platform_BaseTypes_uint8 255.0 DefaultIdenticalCompu 0.0 255. FORMAT "%10.5"
 /begin ANNOTATION ANNOTATION_LABEL "Description (coming from AUTOSAR DESC field)" /begin ANNOTATION_TEXT "Flag to enable pressure adaption fault to latch.\r\n" /end ANNOTATION_TEXT /end ANNOTATION
/end CHARACTERISTIC
/begin CHARACTERISTIC DWC_CALIB.DWC_InputProcessing.DWC_K2PressureCorrect.DWC_PIAutoReset "" VALUE 0x8060E741 DefaultValueRecordLayout_AUTOSAR_Platform_BaseTypes_uint8 255.0 DefaultIdenticalCompu 0.0 255. FORMAT "%10.5"
 /begin ANNOTATION ANNOTATION_LABEL "Description (coming from AUTOSAR DESC field)"
  /begin ANNOTATION_TEXT "will fore a reset if the pi adaption hits max or min allowable limits.\r\n" /end ANNOTATION_TEXT
 /end ANNOTATION
/end CHARACTERISTIC
/begin CHARACTERISTIC DWC_CALIB.DWC_InputProcessing.DWC_MaxThrotEPBEnggaged "" VALUE 0x8060E73C DefaultValueRecordLayout_AUTOSAR_Platform_BaseTypes_uint8 102.0 RB_PT_PCT_SWC_DWC_CompuMethods_ratio_0p4 0.0 102. FORMAT "%10.5"
 /begin ANNOTATION ANNOTATION_LABEL "Description (coming from AUTOSAR DESC field)" /begin ANNOTATION_TEXT "limit throttle input in DWC when EPB engaged.\r\n" /end ANNOTATION_TEXT /end ANNOTATION
/end CHARACTERISTIC
/begin CHARACTERISTIC DWC_CALIB.DWC_InputProcessing.DWC_VirtualK1Pressure.DWC_FLGCAPVPRESTOLINEPRES "" VALUE 0x8060E742 DefaultValueRecordLayout_AUTOSAR_Platform_BaseTypes_boolean 255.0 AUTOSAR_Platform_CompuMethods_boolean 0.0 255. FORMAT "%10.5"
 /begin ANNOTATION ANNOTATION_LABEL "Description (coming from AUTOSAR DESC field)"
  /begin ANNOTATION_TEXT "Flag to enable virtual pressure to be capped by line pressure.\r\n" /end ANNOTATION_TEXT
 /end ANNOTATION
/end CHARACTERISTIC
/begin CHARACTERISTIC DWC_CALIB.DWC_InputProcessing.DWC_VirtualK2Pressure.DWC_FLGCAPVPRESTOLINEPRES "" VALUE 0x8060E743 DefaultValueRecordLayout_AUTOSAR_Platform_BaseTypes_boolean 255.0 AUTOSAR_Platform_CompuMethods_boolean 0.0 255. FORMAT "%10.5"
 /begin ANNOTATION ANNOTATION_LABEL "Description (coming from AUTOSAR DESC field)"
  /begin ANNOTATION_TEXT "Flag to enable virtual pressure to be capped by line pressure.\r\n" /end ANNOTATION_TEXT
 /end ANNOTATION
/end CHARACTERISTIC
/begin CHARACTERISTIC DWC_CALIB.DWC_K1DeviceControl.DWC_BOBFLGRQBLIPGAC "" VALUE 0x8060E760 DefaultValueRecordLayout_AUTOSAR_Platform_BaseTypes_boolean 255.0 AUTOSAR_Platform_CompuMethods_boolean 0.0 255. FORMAT "%10.5"
 /begin ANNOTATION ANNOTATION_LABEL "Description (coming from AUTOSAR DESC field)" /begin ANNOTATION_TEXT "GAC Clutch blip request\r\n" /end ANNOTATION_TEXT /end ANNOTATION
/end CHARACTERISTIC
/begin CHARACTERISTIC DWC_CALIB.DWC_K1DeviceControl.DWC_BOBGACBLIPENABRQ "" VALUE 0x8060E761 DefaultValueRecordLayout_AUTOSAR_Platform_BaseTypes_boolean 255.0 AUTOSAR_Platform_CompuMethods_boolean 0.0 255. FORMAT "%10.5"
 /begin ANNOTATION ANNOTATION_LABEL "Description (coming from AUTOSAR DESC field)" /begin ANNOTATION_TEXT "GAC clutch blip BOB enable.\r\n" /end ANNOTATION_TEXT /end ANNOTATION
/end CHARACTERISTIC
/begin CHARACTERISTIC DWC_CALIB.DWC_K1DeviceControl.DWC_BypassPreparePulse.DWC_BYPASSPULSEPROFILE "" CURVE 0x8060E78C RB_PT_PCT_SWC_DWC_RecordLayouts_RL_Curve_uint8_11_uint16_11 1.0 RB_PT_PCT_SWC_DWC_CompuMethods_ratio_0p01 0.0 1. FORMAT "%10.5"
 /begin ANNOTATION ANNOTATION_LABEL "Description (coming from AUTOSAR DESC field)"
  /begin ANNOTATION_TEXT "Remap bypass pulse time remaining into a profile shape.\r\n" /end ANNOTATION_TEXT
 /end ANNOTATION
 /begin AXIS_DESCR STD_AXIS NO_INPUT_QUANTITY RB_PT_PCT_SWC_DWC_CompuMethods_ratio_0p001__2 11 0.0 1. FORMAT "%10.5" DEPOSIT ABSOLUTE /end AXIS_DESCR
/end CHARACTERISTIC
/begin CHARACTERISTIC DWC_CALIB.DWC_K1DeviceControl.DWC_BypassPreparePulse.DWC_BYPASSREINITCYCLES "" VALUE 0x8060E786 DefaultValueRecordLayout_AUTOSAR_Platform_BaseTypes_uint8 6.0 RB_PT_PCT_SWC_DWC_CompuMethods_ident 0.0 6. FORMAT "%10.5"
 /begin ANNOTATION ANNOTATION_LABEL "Description (coming from AUTOSAR DESC field)" /begin ANNOTATION_TEXT "How many cycles the bypass pulse should reinit for.\r\n" /end ANNOTATION_TEXT /end ANNOTATION
/end CHARACTERISTIC
/begin CHARACTERISTIC DWC_CALIB.DWC_K1DeviceControl.DWC_BypassPreparePulse.DWC_ENGINERUNTIMEFACTOR2D "" MAP 0x8060E7B0 RB_PT_PCT_SWC_DWC_RecordLayouts_RL_Map_uint16_40_uint16_5_uint16_8 2.0 RB_PT_PCT_SWC_DWC_CompuMethods_ratio_0p001__2 0.0 2. FORMAT "%10.5"
 /begin ANNOTATION ANNOTATION_LABEL "Description (coming from AUTOSAR DESC field)"
  /begin ANNOTATION_TEXT "factor applied to increase fill time wrt time engine off and engine running to compensate for balance chamber volume.\r\n" /end ANNOTATION_TEXT
 /end ANNOTATION
 /begin AXIS_DESCR STD_AXIS NO_INPUT_QUANTITY RB_PT_PCT_SWC_DWC_CompuMethods_ratio_0p05 5 0.0 3276.75 FORMAT "%10.5" DEPOSIT ABSOLUTE /end AXIS_DESCR
 /begin AXIS_DESCR STD_AXIS NO_INPUT_QUANTITY RB_PT_PCT_SWC_DWC_CompuMethods_ratio_0p1 8 0.0 6553.5 FORMAT "%10.5" DEPOSIT ABSOLUTE /end AXIS_DESCR
/end CHARACTERISTIC
/begin CHARACTERISTIC DWC_CALIB.DWC_K1DeviceControl.DWC_BypassPreparePulse.DWC_FILLADAPTMAX "" VALUE 0x8060E77A DefaultValueRecordLayout_AUTOSAR_Platform_BaseTypes_uint16 2.0 RB_PT_PCT_SWC_DWC_CompuMethods_ratio_0p001__2 0.0 2. FORMAT "%10.5"
 /begin ANNOTATION ANNOTATION_LABEL "Description (coming from AUTOSAR DESC field)" /begin ANNOTATION_TEXT "Max value fill adapt value\r\n" /end ANNOTATION_TEXT /end ANNOTATION
/end CHARACTERISTIC
/begin CHARACTERISTIC DWC_CALIB.DWC_K1DeviceControl.DWC_BypassPreparePulse.DWC_FILLADAPTMIN "" VALUE 0x8060E77C DefaultValueRecordLayout_AUTOSAR_Platform_BaseTypes_uint16 2.0 RB_PT_PCT_SWC_DWC_CompuMethods_ratio_0p001__2 0.0 2. FORMAT "%10.5"
 /begin ANNOTATION ANNOTATION_LABEL "Description (coming from AUTOSAR DESC field)" /begin ANNOTATION_TEXT "Min value fill adapt value\r\n" /end ANNOTATION_TEXT /end ANNOTATION
/end CHARACTERISTIC
/begin CHARACTERISTIC DWC_CALIB.DWC_K1DeviceControl.DWC_BypassPreparePulse.DWC_FLGCLEARMAXFILLOVERSHTENGOFF "" VALUE 0x8060E787 DefaultValueRecordLayout_AUTOSAR_Platform_BaseTypes_uint8 255.0 DefaultIdenticalCompu 0.0 255. FORMAT "%10.5"
 /begin ANNOTATION ANNOTATION_LABEL "Description (coming from AUTOSAR DESC field)" /begin ANNOTATION_TEXT "Reset DWC_FillMaxOvershoot when engine is off.\r\n" /end ANNOTATION_TEXT /end ANNOTATION
/end CHARACTERISTIC
/begin CHARACTERISTIC DWC_CALIB.DWC_K1DeviceControl.DWC_BypassPreparePulse.DWC_FLGENABLEBYPASSPROFILE "" VALUE 0x8060E788 DefaultValueRecordLayout_AUTOSAR_Platform_BaseTypes_boolean 255.0 AUTOSAR_Platform_CompuMethods_boolean 0.0 255. FORMAT "%10.5"
 /begin ANNOTATION ANNOTATION_LABEL "Description (coming from AUTOSAR DESC field)"
  /begin ANNOTATION_TEXT "Flag to enable the bypass pulse profile to be modified.\r\n" /end ANNOTATION_TEXT
 /end ANNOTATION
/end CHARACTERISTIC
/begin CHARACTERISTIC DWC_CALIB.DWC_K1DeviceControl.DWC_BypassPreparePulse.DWC_FLGENABLEBYPASSREINITLOOP "" VALUE 0x8060E789 DefaultValueRecordLayout_AUTOSAR_Platform_BaseTypes_boolean 255.0 AUTOSAR_Platform_CompuMethods_boolean 0.0 255. FORMAT "%10.5"
 /begin ANNOTATION ANNOTATION_LABEL "Description (coming from AUTOSAR DESC field)" /begin ANNOTATION_TEXT "Flag to reinit the bypass pulse more than once.\r\n" /end ANNOTATION_TEXT /end ANNOTATION
/end CHARACTERISTIC
/begin CHARACTERISTIC DWC_CALIB.DWC_K1DeviceControl.DWC_BypassPreparePulse.DWC_MAXFILLSPD4FILLADAPT "" VALUE 0x8060E77E DefaultValueRecordLayout_AUTOSAR_Platform_BaseTypes_uint16 20000.0 RB_PT_PCT_SWC_DWC_CompuMethods_ident 0.0 20000. FORMAT "%10.5"
 /begin ANNOTATION ANNOTATION_LABEL "Description (coming from AUTOSAR DESC field)" /begin ANNOTATION_TEXT "Max fill engine speed to enable a fill adapt.\r\n" /end ANNOTATION_TEXT /end ANNOTATION
/end CHARACTERISTIC
/begin CHARACTERISTIC DWC_CALIB.DWC_K1DeviceControl.DWC_BypassPreparePulse.DWC_MAXFILLTRQ4FILLADAPT "" VALUE 0x8060E780 DefaultValueRecordLayout_AUTOSAR_Platform_BaseTypes_sint16 4000.0 RB_PT_PCT_SWC_DWC_CompuMethods_ratio_0p1 -2000. 2000. FORMAT "%10.5"
 /begin ANNOTATION ANNOTATION_LABEL "Description (coming from AUTOSAR DESC field)" /begin ANNOTATION_TEXT "Max fill torque to enable a fill adapt.\r\n" /end ANNOTATION_TEXT /end ANNOTATION
/end CHARACTERISTIC
/begin CHARACTERISTIC DWC_CALIB.DWC_K1DeviceControl.DWC_BypassPreparePulse.DWC_MINPRESS2FFCOMPLETE "" VALUE 0x8060E782 DefaultValueRecordLayout_AUTOSAR_Platform_BaseTypes_sint16 34.0 RB_PT_PCT_SWC_DWC_CompuMethods_ratio_0p001__2 -2. 32. FORMAT "%10.5"
 /begin ANNOTATION ANNOTATION_LABEL "Description (coming from AUTOSAR DESC field)"
  /begin ANNOTATION_TEXT "min pressure to disable first fill flag with engine running.\r\n" /end ANNOTATION_TEXT
 /end ANNOTATION
/end CHARACTERISTIC
/begin CHARACTERISTIC DWC_CALIB.DWC_K1DeviceControl.DWC_BypassPreparePulse.DWC_MINTEMP4FILLADAPT "" VALUE 0x8060E784 DefaultValueRecordLayout_AUTOSAR_Platform_BaseTypes_sint16 250.0 RB_PT_PCT_SWC_DWC_CompuMethods_ident -50. 200. FORMAT "%10.5"
 /begin ANNOTATION ANNOTATION_LABEL "Description (coming from AUTOSAR DESC field)" /begin ANNOTATION_TEXT "min transoiltemp to allow filladaption\r\n" /end ANNOTATION_TEXT /end ANNOTATION
/end CHARACTERISTIC
/begin CHARACTERISTIC DWC_CALIB.DWC_K1DeviceControl.DWC_BypassPreparePulse.DWC_PULSEPRESSTEMPOFFSET "" CURVE 0x8060E81E RB_PT_PCT_SWC_DWC_RecordLayouts_RL_Curve_sint8_4_sint16_4 2.0 RB_PT_PCT_SWC_DWC_CompuMethods_ratio_0p01 -1. 1. FORMAT "%10.5"
 /begin ANNOTATION ANNOTATION_LABEL "Description (coming from AUTOSAR DESC field)"
  /begin ANNOTATION_TEXT "Temperature related offset to be applied to pulse pressure.\r\n" /end ANNOTATION_TEXT
 /end ANNOTATION
 /begin AXIS_DESCR STD_AXIS NO_INPUT_QUANTITY RB_PT_PCT_SWC_DWC_CompuMethods_ident 4 -50. 200. FORMAT "%10.5" DEPOSIT ABSOLUTE /end AXIS_DESCR
/end CHARACTERISTIC
/begin CHARACTERISTIC DWC_CALIB.DWC_K1DeviceControl.DWC_BypassPreparePulse.DWC_RESETTIMEOFFPRESSHIGH "" VALUE 0x8060E78A DefaultValueRecordLayout_AUTOSAR_Platform_BaseTypes_boolean 255.0 AUTOSAR_Platform_CompuMethods_boolean 0.0 255. FORMAT "%10.5" /end CHARACTERISTIC
/begin CHARACTERISTIC DWC_CALIB.DWC_K1DeviceControl.DWC_ClosedPressureDiag.DWC_ENABLEHYSTERESISFORDITHER "" VALUE 0x8060E82C DefaultValueRecordLayout_AUTOSAR_Platform_BaseTypes_boolean 255.0 AUTOSAR_Platform_CompuMethods_boolean 0.0 255. FORMAT "%10.5"
 /begin ANNOTATION ANNOTATION_LABEL "Description (coming from AUTOSAR DESC field)"
  /begin ANNOTATION_TEXT "Use hysteresis when enabling dither in a pressure error scenario.\r\n" /end ANNOTATION_TEXT
 /end ANNOTATION
/end CHARACTERISTIC
/begin CHARACTERISTIC DWC_CALIB.DWC_K1DeviceControl.DWC_CLUBLIPABORTSPEED "" VALUE 0x8060E744 DefaultValueRecordLayout_AUTOSAR_Platform_BaseTypes_sint16 40000.0 RB_PT_PCT_SWC_DWC_CompuMethods_ident -20000. 20000. FORMAT "%10.5"
 /begin ANNOTATION ANNOTATION_LABEL "Description (coming from AUTOSAR DESC field)" /begin ANNOTATION_TEXT "Input speed at which to abort blip.\r\n" /end ANNOTATION_TEXT /end ANNOTATION
/end CHARACTERISTIC
/begin CHARACTERISTIC DWC_CALIB.DWC_K1DeviceControl.DWC_CLUBLIPSPDMONTYPE "" VALUE 0x8060E762 DefaultValueRecordLayout_AUTOSAR_Platform_BaseTypes_uint8 2.0 RB_PT_PCT_SWC_DWC_CompuMethods_ident 0.0 2. FORMAT "%10.5"
 /begin ANNOTATION ANNOTATION_LABEL "Description (coming from AUTOSAR DESC field)"
  /begin ANNOTATION_TEXT "Speed monitoring type, 0 = OFF, 1 = Abort above input speed, 2 = wait at KP until speed seen.\r\n" /end ANNOTATION_TEXT
 /end ANNOTATION
/end CHARACTERISTIC
/begin CHARACTERISTIC DWC_CALIB.DWC_K1DeviceControl.DWC_CLUBLIPTIMEOUT "" VALUE 0x8060E746 DefaultValueRecordLayout_AUTOSAR_Platform_BaseTypes_uint16 1.0 RB_PT_PCT_SWC_DWC_CompuMethods_ratio_0p001__2 0.0 1. FORMAT "%10.5"
 /begin ANNOTATION ANNOTATION_LABEL "Description (coming from AUTOSAR DESC field)" /begin ANNOTATION_TEXT "Timeout for clutch blip.\r\n" /end ANNOTATION_TEXT /end ANNOTATION
/end CHARACTERISTIC
/begin CHARACTERISTIC DWC_CALIB.DWC_K1DeviceControl.DWC_CLUBLIPTMFACTPROF "" CURVE 0x8060EA90 RB_PT_PCT_SWC_DWC_RecordLayouts_RL_Curve_uint8_11_uint8_11 1.0 RB_PT_PCT_SWC_DWC_CompuMethods_ratio_0p01 0.0 1. FORMAT "%10.5"
 /begin ANNOTATION ANNOTATION_LABEL "Description (coming from AUTOSAR DESC field)" /begin ANNOTATION_TEXT "Clutch blip profile based on time factor.\r\n" /end ANNOTATION_TEXT /end ANNOTATION
 /begin AXIS_DESCR STD_AXIS NO_INPUT_QUANTITY RB_PT_PCT_SWC_DWC_CompuMethods_ratio_0p01 11 0.0 1. FORMAT "%10.5" DEPOSIT ABSOLUTE /end AXIS_DESCR
/end CHARACTERISTIC
/begin CHARACTERISTIC DWC_CALIB.DWC_K1DeviceControl.DWC_Clutch "" VALUE 0x8060E763 DefaultValueRecordLayout_AUTOSAR_Platform_BaseTypes_uint8 2.0 RB_PT_PCT_SWC_DWC_CompuMethods_ident 0.0 2. FORMAT "%10.5"
 /begin ANNOTATION ANNOTATION_LABEL "Description (coming from AUTOSAR DESC field)"
  /begin ANNOTATION_TEXT "Indication of which clutch is assigned to device controller dataset.\r\n" /end ANNOTATION_TEXT
 /end ANNOTATION
/end CHARACTERISTIC
/begin CHARACTERISTIC DWC_CALIB.DWC_K1DeviceControl.DWC_CLUTCHBLIPHIGHPRESS "" VALUE 0x8060E748 DefaultValueRecordLayout_AUTOSAR_Platform_BaseTypes_sint16 34.0 RB_PT_PCT_SWC_DWC_CompuMethods_ratio_0p001__2 -2. 32. FORMAT "%10.5"
 /begin ANNOTATION ANNOTATION_LABEL "Description (coming from AUTOSAR DESC field)"
  /begin ANNOTATION_TEXT "Pressure threshold for potential torque transfer during gear engagements.\r\n" /end ANNOTATION_TEXT
 /end ANNOTATION
/end CHARACTERISTIC
/begin CHARACTERISTIC DWC_CALIB.DWC_K1DeviceControl.DWC_CLUTCHBLIPTIME "" CURVE 0x8060EAA8 RB_PT_PCT_SWC_DWC_RecordLayouts_RL_Curve_uint8_4_sint16_4 1.0 RB_PT_PCT_SWC_DWC_CompuMethods_ratio_0p01 0.0 1. FORMAT "%10.5"
 /begin ANNOTATION ANNOTATION_LABEL "Description (coming from AUTOSAR DESC field)" /begin ANNOTATION_TEXT "Time for clutch blip\r\n" /end ANNOTATION_TEXT /end ANNOTATION
 /begin AXIS_DESCR STD_AXIS NO_INPUT_QUANTITY RB_PT_PCT_SWC_DWC_CompuMethods_ident 4 -50. 200. FORMAT "%10.5" DEPOSIT ABSOLUTE /end AXIS_DESCR
/end CHARACTERISTIC
/begin CHARACTERISTIC DWC_CALIB.DWC_K1DeviceControl.DWC_ENABLEFAIL37GEARSTATUS "" VALUE 0x8060E764 DefaultValueRecordLayout_AUTOSAR_Platform_BaseTypes_uint8 255.0 DefaultIdenticalCompu 0.0 255. FORMAT "%10.5"
 /begin ANNOTATION ANNOTATION_LABEL "Description (coming from AUTOSAR DESC field)"
  /begin ANNOTATION_TEXT "flag to enable failing of bank of gears for 37 gear status\r\n" /end ANNOTATION_TEXT
 /end ANNOTATION
/end CHARACTERISTIC
/begin CHARACTERISTIC DWC_CALIB.DWC_K1DeviceControl.DWC_ENABLEFAILEDSTATUSFORUSERABORT "" VALUE 0x8060E765 DefaultValueRecordLayout_AUTOSAR_Platform_BaseTypes_boolean 255.0 AUTOSAR_Platform_CompuMethods_boolean 0.0 255. FORMAT "%10.5"
 /begin ANNOTATION ANNOTATION_LABEL "Description (coming from AUTOSAR DESC field)"
  /begin ANNOTATION_TEXT "Allow the reported status to say 'failed' if the user aborts a routine.\r\n" /end ANNOTATION_TEXT
 /end ANNOTATION
/end CHARACTERISTIC
/begin CHARACTERISTIC DWC_CALIB.DWC_K1DeviceControl.DWC_ENABLESELFTESTDIAGNOSTIC "" VALUE 0x8060E766 DefaultValueRecordLayout_AUTOSAR_Platform_BaseTypes_boolean 255.0 AUTOSAR_Platform_CompuMethods_boolean 0.0 255. FORMAT "%10.5"
 /begin ANNOTATION ANNOTATION_LABEL "Description (coming from AUTOSAR DESC field)"
  /begin ANNOTATION_TEXT "Flag to enable diagnostics when in self test and no routine running.\r\n" /end ANNOTATION_TEXT
 /end ANNOTATION
/end CHARACTERISTIC
/begin CHARACTERISTIC DWC_CALIB.DWC_K1DeviceControl.DWC_ENGOFFPRESS "" CURVE 0x8060EAB6 RB_PT_PCT_SWC_DWC_RecordLayouts_RL_Curve_sint16_4_uint8_4 34.0 RB_PT_PCT_SWC_DWC_CompuMethods_ratio_0p001__2 -2. 32. FORMAT "%10.5"
 /begin ANNOTATION ANNOTATION_LABEL "Description (coming from AUTOSAR DESC field)" /begin ANNOTATION_TEXT "Pressure request when engine is off.\r\n" /end ANNOTATION_TEXT /end ANNOTATION
 /begin AXIS_DESCR STD_AXIS NO_INPUT_QUANTITY RB_PT_PCT_SWC_DWC_CompuMethods_ratio_0p005 4 0.0 1. FORMAT "%10.5" DEPOSIT ABSOLUTE /end AXIS_DESCR
/end CHARACTERISTIC
/begin CHARACTERISTIC DWC_CALIB.DWC_K1DeviceControl.DWC_FillController.DWC_FLGENABLEFILLTEST "" VALUE 0x8060E830 DefaultValueRecordLayout_AUTOSAR_Platform_BaseTypes_boolean 255.0 AUTOSAR_Platform_CompuMethods_boolean 0.0 255. FORMAT "%10.5"
 /begin ANNOTATION ANNOTATION_LABEL "Description (coming from AUTOSAR DESC field)"
  /begin ANNOTATION_TEXT "Set true to use a single parameter for fill pressure for testing/characterisation work\r\n" /end ANNOTATION_TEXT
 /end ANNOTATION
/end CHARACTERISTIC
/begin CHARACTERISTIC DWC_CALIB.DWC_K1DeviceControl.DWC_FillController.DWC_PRESFILLTEST "" VALUE 0x8060E82E DefaultValueRecordLayout_AUTOSAR_Platform_BaseTypes_uint16 32.0 RB_PT_PCT_SWC_DWC_CompuMethods_ratio_0p001__2 0.0 32. FORMAT "%10.5"
 /begin ANNOTATION ANNOTATION_LABEL "Description (coming from AUTOSAR DESC field)" /begin ANNOTATION_TEXT "Pressure for fill test\r\n" /end ANNOTATION_TEXT /end ANNOTATION
/end CHARACTERISTIC
/begin CHARACTERISTIC DWC_CALIB.DWC_K1DeviceControl.DWC_FLGCLUTCHBLIPENABLED "" VALUE 0x8060E767 DefaultValueRecordLayout_AUTOSAR_Platform_BaseTypes_boolean 255.0 AUTOSAR_Platform_CompuMethods_boolean 0.0 255. FORMAT "%10.5"
 /begin ANNOTATION ANNOTATION_LABEL "Description (coming from AUTOSAR DESC field)" /begin ANNOTATION_TEXT "Flag to enable clutch blip requests from GAC.\r\n" /end ANNOTATION_TEXT /end ANNOTATION
/end CHARACTERISTIC
/begin CHARACTERISTIC DWC_CALIB.DWC_K1DeviceControl.DWC_FLGDISABLEDIAG4DEPRESSURE "" VALUE 0x8060E768 DefaultValueRecordLayout_AUTOSAR_Platform_BaseTypes_boolean 255.0 AUTOSAR_Platform_CompuMethods_boolean 0.0 255. FORMAT "%10.5"
 /begin ANNOTATION ANNOTATION_LABEL "Description (coming from AUTOSAR DESC field)"
  /begin ANNOTATION_TEXT "Disable DWC diagnostics when a depressure routine is active.\r\n" /end ANNOTATION_TEXT
 /end ANNOTATION
/end CHARACTERISTIC
/begin CHARACTERISTIC DWC_CALIB.DWC_K1DeviceControl.DWC_FLGENABLEAUTOVALVECLOSEDCLEAN "" VALUE 0x8060E769 DefaultValueRecordLayout_AUTOSAR_Platform_BaseTypes_uint8 255.0 DefaultIdenticalCompu 0.0 255. FORMAT "%10.5"
 /begin ANNOTATION ANNOTATION_LABEL "Description (coming from AUTOSAR DESC field)" /begin ANNOTATION_TEXT "Enable automatic cleaning on a closed clutch\r\n" /end ANNOTATION_TEXT /end ANNOTATION
/end CHARACTERISTIC
/begin CHARACTERISTIC DWC_CALIB.DWC_K1DeviceControl.DWC_FLGENABLEAUTOVALVEOPENCLEAN "" VALUE 0x8060E76A DefaultValueRecordLayout_AUTOSAR_Platform_BaseTypes_uint8 255.0 DefaultIdenticalCompu 0.0 255. FORMAT "%10.5"
 /begin ANNOTATION ANNOTATION_LABEL "Description (coming from AUTOSAR DESC field)" /begin ANNOTATION_TEXT "Enable automatic cleaning on an open clutch\r\n" /end ANNOTATION_TEXT /end ANNOTATION
/end CHARACTERISTIC
/begin CHARACTERISTIC DWC_CALIB.DWC_K1DeviceControl.DWC_FLGENABLEAUTOVALVERINSE "" VALUE 0x8060E76B DefaultValueRecordLayout_AUTOSAR_Platform_BaseTypes_uint8 255.0 DefaultIdenticalCompu 0.0 255. FORMAT "%10.5"
 /begin ANNOTATION ANNOTATION_LABEL "Description (coming from AUTOSAR DESC field)" /begin ANNOTATION_TEXT "Enable automatic rinsing on the clutch valve\r\n" /end ANNOTATION_TEXT /end ANNOTATION
/end CHARACTERISTIC
/begin CHARACTERISTIC DWC_CALIB.DWC_K1DeviceControl.DWC_FLGENABLEENGOFFPRES "" VALUE 0x8060E76C DefaultValueRecordLayout_AUTOSAR_Platform_BaseTypes_boolean 255.0 AUTOSAR_Platform_CompuMethods_boolean 0.0 255. FORMAT "%10.5"
 /begin ANNOTATION ANNOTATION_LABEL "Description (coming from AUTOSAR DESC field)"
  /begin ANNOTATION_TEXT "Flag to enable seperate engine off pressure for rinsing.\r\n" /end ANNOTATION_TEXT
 /end ANNOTATION
/end CHARACTERISTIC
/begin CHARACTERISTIC DWC_CALIB.DWC_K1DeviceControl.DWC_FLGENABLEFAILEDHYBMDTABLE "" VALUE 0x8060E76D DefaultValueRecordLayout_AUTOSAR_Platform_BaseTypes_boolean 255.0 AUTOSAR_Platform_CompuMethods_boolean 0.0 255. FORMAT "%10.5"
 /begin ANNOTATION ANNOTATION_LABEL "Description (coming from AUTOSAR DESC field)"
  /begin ANNOTATION_TEXT "Flag to enable DWC device controller to write to failed hybrid mode table.\r\n" /end ANNOTATION_TEXT
 /end ANNOTATION
/end CHARACTERISTIC
/begin CHARACTERISTIC DWC_CALIB.DWC_K1DeviceControl.DWC_FLGFORCETPRESET "" VALUE 0x8060E76E DefaultValueRecordLayout_AUTOSAR_Platform_BaseTypes_boolean 255.0 AUTOSAR_Platform_CompuMethods_boolean 0.0 255. FORMAT "%10.5"
 /begin ANNOTATION ANNOTATION_LABEL "Description (coming from AUTOSAR DESC field)" /begin ANNOTATION_TEXT "Set true to force torque to pressure reset\r\n" /end ANNOTATION_TEXT /end ANNOTATION
/end CHARACTERISTIC
/begin CHARACTERISTIC DWC_CALIB.DWC_K1DeviceControl.DWC_FLGFORCEZEROPRSFAILGEAR "" VALUE 0x8060E76F DefaultValueRecordLayout_AUTOSAR_Platform_BaseTypes_boolean 255.0 AUTOSAR_Platform_CompuMethods_boolean 0.0 255. FORMAT "%10.5"
 /begin ANNOTATION ANNOTATION_LABEL "Description (coming from AUTOSAR DESC field)"
  /begin ANNOTATION_TEXT "Flag to force pressure demand to zero when gears are failed.\r\n" /end ANNOTATION_TEXT
 /end ANNOTATION
/end CHARACTERISTIC
/begin CHARACTERISTIC DWC_CALIB.DWC_K1DeviceControl.DWC_FORCENOPREFILLBEFORESO "" VALUE 0x8060E770 DefaultValueRecordLayout_AUTOSAR_Platform_BaseTypes_uint8 255.0 DefaultIdenticalCompu 0.0 255. FORMAT "%10.5" /end CHARACTERISTIC
/begin CHARACTERISTIC DWC_CALIB.DWC_K1DeviceControl.DWC_L2MaxDoubleSeqTime "" VALUE 0x8060E74A DefaultValueRecordLayout_AUTOSAR_Platform_BaseTypes_uint16 327.675 RB_PT_PCT_SWC_DWC_CompuMethods_ratio_0p005 0.0 327.675 FORMAT "%10.5"
 /begin ANNOTATION ANNOTATION_LABEL "Description (coming from AUTOSAR DESC field)"
  /begin ANNOTATION_TEXT "Time the L2 sequence will stop and open both clutches\r\n" /end ANNOTATION_TEXT
 /end ANNOTATION
/end CHARACTERISTIC
/begin CHARACTERISTIC DWC_CALIB.DWC_K1DeviceControl.DWC_L2SetTroque "" CURVE 0x8060EAC4 RB_PT_PCT_SWC_DWC_RecordLayouts_RL_Curve_sint16_50_uint16_50 4000.0 RB_PT_PCT_SWC_DWC_CompuMethods_ratio_0p1 -2000. 2000. FORMAT "%10.5"
 /begin ANNOTATION ANNOTATION_LABEL "Description (coming from AUTOSAR DESC field)" /begin ANNOTATION_TEXT "Torque sequence in relation to time.\r\n" /end ANNOTATION_TEXT /end ANNOTATION
 /begin AXIS_DESCR STD_AXIS NO_INPUT_QUANTITY RB_PT_PCT_SWC_DWC_CompuMethods_ratio_0p005 50 0.0 327.675 FORMAT "%10.5" DEPOSIT ABSOLUTE /end AXIS_DESCR
/end CHARACTERISTIC
/begin CHARACTERISTIC DWC_CALIB.DWC_K1DeviceControl.DWC_LINEPRESSUREDIAGDISABLE "" VALUE 0x8060E74C DefaultValueRecordLayout_AUTOSAR_Platform_BaseTypes_sint16 105.0 RB_PT_PCT_SWC_DWC_CompuMethods_ratio_0p005 -5. 100. FORMAT "%10.5"
 /begin ANNOTATION ANNOTATION_LABEL "Description (coming from AUTOSAR DESC field)" /begin ANNOTATION_TEXT "Lower line pressure at which diags become disabled.\r\n" /end ANNOTATION_TEXT /end ANNOTATION
/end CHARACTERISTIC
/begin CHARACTERISTIC DWC_CALIB.DWC_K1DeviceControl.DWC_MAXOUTPUTSPDFORCLUTCHBLIP "" VALUE 0x8060E74E DefaultValueRecordLayout_AUTOSAR_Platform_BaseTypes_sint16 40000.0 RB_PT_PCT_SWC_DWC_CompuMethods_ident -20000. 20000. FORMAT "%10.5"
 /begin ANNOTATION ANNOTATION_LABEL "Description (coming from AUTOSAR DESC field)" /begin ANNOTATION_TEXT "Minimum outspeed to allow for clutch blip\r\n" /end ANNOTATION_TEXT /end ANNOTATION
/end CHARACTERISTIC
/begin CHARACTERISTIC DWC_CALIB.DWC_K1DeviceControl.DWC_MINLINEPRESSURE4DIAG "" VALUE 0x8060E750 DefaultValueRecordLayout_AUTOSAR_Platform_BaseTypes_sint16 105.0 RB_PT_PCT_SWC_DWC_CompuMethods_ratio_0p005 -5. 100. FORMAT "%10.5"
 /begin ANNOTATION ANNOTATION_LABEL "Description (coming from AUTOSAR DESC field)"
  /begin ANNOTATION_TEXT "Minimum line pressure to be seen to enable DC diagnostics.\r\n" /end ANNOTATION_TEXT
 /end ANNOTATION
/end CHARACTERISTIC
/begin CHARACTERISTIC DWC_CALIB.DWC_K1DeviceControl.DWC_MINSOHLINEPRESSURE "" VALUE 0x8060E752 DefaultValueRecordLayout_AUTOSAR_Platform_BaseTypes_sint16 105.0 RB_PT_PCT_SWC_DWC_CompuMethods_ratio_0p005 -5. 100. FORMAT "%10.5"
 /begin ANNOTATION ANNOTATION_LABEL "Description (coming from AUTOSAR DESC field)" /begin ANNOTATION_TEXT "Minimum line pressure to allow shut off test.\r\n" /end ANNOTATION_TEXT /end ANNOTATION
/end CHARACTERISTIC
/begin CHARACTERISTIC DWC_CALIB.DWC_K1DeviceControl.DWC_OPENDEMANDKICK "" CURVE 0x8060EB8E RB_PT_PCT_SWC_DWC_RecordLayouts_RL_Curve_sint16_4_sint16_4 34.0 RB_PT_PCT_SWC_DWC_CompuMethods_ratio_0p001__2 -2. 32. FORMAT "%10.5"
 /begin ANNOTATION ANNOTATION_LABEL "Description (coming from AUTOSAR DESC field)" /begin ANNOTATION_TEXT "Temperature dependancy on prefill kick.\r\n" /end ANNOTATION_TEXT /end ANNOTATION
 /begin AXIS_DESCR STD_AXIS NO_INPUT_QUANTITY RB_PT_PCT_SWC_DWC_CompuMethods_ident 4 -50. 200. FORMAT "%10.5" DEPOSIT ABSOLUTE /end AXIS_DESCR
/end CHARACTERISTIC
/begin CHARACTERISTIC DWC_CALIB.DWC_K1DeviceControl.DWC_OpenPressureDiag.DWC_ENABLEHYSTERESISFORDITHER "" VALUE 0x8060E832 DefaultValueRecordLayout_AUTOSAR_Platform_BaseTypes_boolean 255.0 AUTOSAR_Platform_CompuMethods_boolean 0.0 255. FORMAT "%10.5"
 /begin ANNOTATION ANNOTATION_LABEL "Description (coming from AUTOSAR DESC field)"
  /begin ANNOTATION_TEXT "Use hysteresis when enabling dither in a pressure error scenario.\r\n" /end ANNOTATION_TEXT
 /end ANNOTATION
/end CHARACTERISTIC
/begin CHARACTERISTIC DWC_CALIB.DWC_K1DeviceControl.DWC_PKFILTENGVSPRESRATE "" MAP 0x8060EBA0 RB_PT_PCT_SWC_DWC_RecordLayouts_RL_Map_uint16_48_uint16_6_sint16_8 1.0 RB_PT_PCT_SWC_DWC_CompuMethods_ratio_0p01 0.0 1. FORMAT "%10.5"
 /begin ANNOTATION ANNOTATION_LABEL "Description (coming from AUTOSAR DESC field)"
  /begin ANNOTATION_TEXT "Filter PK in relation to engine speed and rate of change target pressure\r\n" /end ANNOTATION_TEXT
 /end ANNOTATION
 /begin AXIS_DESCR STD_AXIS NO_INPUT_QUANTITY RB_PT_PCT_SWC_DWC_CompuMethods_ident 6 0.0 20000. FORMAT "%10.5" DEPOSIT ABSOLUTE /end AXIS_DESCR
 /begin AXIS_DESCR STD_AXIS NO_INPUT_QUANTITY RB_PT_PCT_SWC_DWC_CompuMethods_pressure_0p1 8 -3200. 3200. FORMAT "%10.5" DEPOSIT ABSOLUTE /end AXIS_DESCR
/end CHARACTERISTIC
/begin CHARACTERISTIC DWC_CALIB.DWC_K1DeviceControl.DWC_POSTFILLTIME "" VALUE 0x8060E754 DefaultValueRecordLayout_AUTOSAR_Platform_BaseTypes_uint16 655.35 RB_PT_PCT_SWC_DWC_CompuMethods_DST_Time 0.0 655.35 FORMAT "%10.5"
 /begin ANNOTATION ANNOTATION_LABEL "Description (coming from AUTOSAR DESC field)"
  /begin ANNOTATION_TEXT "Time used to postpone pK filter after any form of fill.\r\n" /end ANNOTATION_TEXT
 /end ANNOTATION
/end CHARACTERISTIC
/begin CHARACTERISTIC DWC_CALIB.DWC_K1DeviceControl.DWC_PREFILLKICKMODE "" VALUE 0x8060E771 DefaultValueRecordLayout_AUTOSAR_Platform_BaseTypes_uint8 2.0 RB_PT_PCT_SWC_DWC_CompuMethods_ident 0.0 2. FORMAT "%10.5" /end CHARACTERISTIC
/begin CHARACTERISTIC DWC_CALIB.DWC_K1DeviceControl.DWC_PRES2CLUBLIPMAG "" MAP 0x8060EC20 RB_PT_PCT_SWC_DWC_RecordLayouts_RL_Map_uint8_24_sint16_6_sint16_4 15.0 RB_PT_PCT_SWC_DWC_CompuMethods_ratio_0p1 0.0 15. FORMAT "%10.5"
 /begin ANNOTATION ANNOTATION_LABEL "Description (coming from AUTOSAR DESC field)" /begin ANNOTATION_TEXT "Pressure to clutch blip magnitude.\r\n" /end ANNOTATION_TEXT /end ANNOTATION
 /begin AXIS_DESCR STD_AXIS NO_INPUT_QUANTITY RB_PT_PCT_SWC_DWC_CompuMethods_ratio_0p001__2 6 -2. 32. FORMAT "%10.5" DEPOSIT ABSOLUTE /end AXIS_DESCR
 /begin AXIS_DESCR STD_AXIS NO_INPUT_QUANTITY RB_PT_PCT_SWC_DWC_CompuMethods_ident 4 -50. 200. FORMAT "%10.5" DEPOSIT ABSOLUTE /end AXIS_DESCR
/end CHARACTERISTIC
/begin CHARACTERISTIC DWC_CALIB.DWC_K1DeviceControl.DWC_PressCurrent.DWC_HYSTERESISBANDWIDTH "" MAP 0x8060E83C RB_PT_PCT_SWC_DWC_RecordLayouts_RL_Map_uint16_55_sint16_11_sint16_5 1.0 RB_PT_PCT_SWC_DWC_CompuMethods_ratio_0p0001 0.0 1. FORMAT "%10.5"
 /begin AXIS_DESCR STD_AXIS NO_INPUT_QUANTITY RB_PT_PCT_SWC_DWC_CompuMethods_ratio_0p001__2 11 -2. 32. FORMAT "%10.5" DEPOSIT ABSOLUTE /end AXIS_DESCR
 /begin AXIS_DESCR STD_AXIS NO_INPUT_QUANTITY RB_PT_PCT_SWC_DWC_CompuMethods_ident 5 -50. 200. FORMAT "%10.5" DEPOSIT ABSOLUTE /end AXIS_DESCR
/end CHARACTERISTIC
/begin CHARACTERISTIC DWC_CALIB.DWC_K1DeviceControl.DWC_PressCurrent.DWC_MAXCURDEMFORADAPTION "" VALUE 0x8060E834 DefaultValueRecordLayout_AUTOSAR_Platform_BaseTypes_uint16 5000.0 RB_PT_PCT_SWC_DWC_CompuMethods_ident 0.0 5000. FORMAT "%10.5"
 /begin ANNOTATION ANNOTATION_LABEL "Description (coming from AUTOSAR DESC field)" /begin ANNOTATION_TEXT "Maximum allowed current demand to allow adaption.\r\n" /end ANNOTATION_TEXT /end ANNOTATION
/end CHARACTERISTIC
/begin CHARACTERISTIC DWC_CALIB.DWC_K1DeviceControl.DWC_PressCurrent.DWC_MINDYNAMICPCTEMP "" VALUE 0x8060E836 DefaultValueRecordLayout_AUTOSAR_Platform_BaseTypes_sint16 250.0 RB_PT_PCT_SWC_DWC_CompuMethods_ident -50. 200. FORMAT "%10.5"
 /begin ANNOTATION ANNOTATION_LABEL "Description (coming from AUTOSAR DESC field)"
  /begin ANNOTATION_TEXT "Temperature condition for dynamic pressure to current.\r\n" /end ANNOTATION_TEXT
 /end ANNOTATION
/end CHARACTERISTIC
/begin CHARACTERISTIC DWC_CALIB.DWC_K1DeviceControl.DWC_PressCurrent.DWC_MINLINEPRESSADAPT "" VALUE 0x8060E838 DefaultValueRecordLayout_AUTOSAR_Platform_BaseTypes_sint16 105.0 RB_PT_PCT_SWC_DWC_CompuMethods_ratio_0p005 -5. 100. FORMAT "%10.5"
 /begin ANNOTATION ANNOTATION_LABEL "Description (coming from AUTOSAR DESC field)" /begin ANNOTATION_TEXT "Minimum line pressure for adaption to run.\r\n" /end ANNOTATION_TEXT /end ANNOTATION
/end CHARACTERISTIC
/begin CHARACTERISTIC DWC_CALIB.DWC_K1DeviceControl.DWC_PressCurrent.DWC_PIAdaptAutoReset "" VALUE 0x8060E83A DefaultValueRecordLayout_AUTOSAR_Platform_BaseTypes_uint8 255.0 DefaultIdenticalCompu 0.0 255. FORMAT "%10.5"
 /begin ANNOTATION ANNOTATION_LABEL "Description (coming from AUTOSAR DESC field)"
  /begin ANNOTATION_TEXT "Allow auto reset if PI adaption hits the max allowable limits.\r\n" /end ANNOTATION_TEXT
 /end ANNOTATION
/end CHARACTERISTIC
/begin CHARACTERISTIC DWC_CALIB.DWC_K1DeviceControl.DWC_PressCurrent.DWC_PIDFEEDFORWARD "" MAP 0x8060E8CE RB_PT_PCT_SWC_DWC_RecordLayouts_RL_Map_sint16_49_sint16_7_sint16_7 2000.0 RB_PT_PCT_SWC_DWC_CompuMethods_ident -1000. 1000. FORMAT "%10.5"
 /begin AXIS_DESCR STD_AXIS NO_INPUT_QUANTITY RB_PT_PCT_SWC_DWC_CompuMethods_ratio_0p001__2 7 -32. 32. FORMAT "%10.5" DEPOSIT ABSOLUTE /end AXIS_DESCR
 /begin AXIS_DESCR STD_AXIS NO_INPUT_QUANTITY RB_PT_PCT_SWC_DWC_CompuMethods_ratio_0p001__2 7 -32. 32. FORMAT "%10.5" DEPOSIT ABSOLUTE /end AXIS_DESCR
/end CHARACTERISTIC
/begin CHARACTERISTIC DWC_CALIB.DWC_K1DeviceControl.DWC_PressCurrent.DWC_VALVEINTEGRALTEMPFACTOR "" CURVE 0x8060E950 RB_PT_PCT_SWC_DWC_RecordLayouts_RL_Curve_uint8_7_sint16_7 1.0 RB_PT_PCT_SWC_DWC_CompuMethods_ratio_0p01 0.0 1. FORMAT "%10.5"
 /begin ANNOTATION ANNOTATION_LABEL "Description (coming from AUTOSAR DESC field)" /begin ANNOTATION_TEXT "Temperature based factor for valve integral gain.\r\n" /end ANNOTATION_TEXT /end ANNOTATION
 /begin AXIS_DESCR STD_AXIS NO_INPUT_QUANTITY RB_PT_PCT_SWC_DWC_CompuMethods_ident 7 -50. 200. FORMAT "%10.5" DEPOSIT ABSOLUTE /end AXIS_DESCR
/end CHARACTERISTIC
/begin CHARACTERISTIC DWC_CALIB.DWC_K1DeviceControl.DWC_PRESSUREDELAYRATECALC "" VALUE 0x8060E772 DefaultValueRecordLayout_AUTOSAR_Platform_BaseTypes_uint8 30.0 RB_PT_PCT_SWC_DWC_CompuMethods_ident 0.0 30. FORMAT "%10.5"
 /begin ANNOTATION ANNOTATION_LABEL "Description (coming from AUTOSAR DESC field)" /begin ANNOTATION_TEXT "sample period to calc pressure tgt rate of change\r\n" /end ANNOTATION_TEXT /end ANNOTATION
/end CHARACTERISTIC
/begin CHARACTERISTIC DWC_CALIB.DWC_K1DeviceControl.DWC_PtoCSequence.DWC_MAXSLIP4TXISSUE "" VALUE 0x8060E968 DefaultValueRecordLayout_AUTOSAR_Platform_BaseTypes_sint16 40000.0 RB_PT_PCT_SWC_DWC_CompuMethods_ident -20000. 20000. FORMAT "%10.5"
 /begin ANNOTATION ANNOTATION_LABEL "Description (coming from AUTOSAR DESC field)"
  /begin ANNOTATION_TEXT "Max permissible slip during a PI adaption when adapting PI\r\n" /end ANNOTATION_TEXT
 /end ANNOTATION
/end CHARACTERISTIC
/begin CHARACTERISTIC DWC_CALIB.DWC_K1DeviceControl.DWC_PtoCSequence.DWC_MINOPSPEEDFORDYNAMICPC "" VALUE 0x8060E96A DefaultValueRecordLayout_AUTOSAR_Platform_BaseTypes_sint16 40000.0 RB_PT_PCT_SWC_DWC_CompuMethods_ident -20000. 20000. FORMAT "%10.5"
 /begin ANNOTATION ANNOTATION_LABEL "Description (coming from AUTOSAR DESC field)"
  /begin ANNOTATION_TEXT "Minimum output speed required to run dynamic pc. Logic added to prevent stationary pc learn in neutral/park\r\n" /end ANNOTATION_TEXT
 /end ANNOTATION
/end CHARACTERISTIC
/begin CHARACTERISTIC DWC_CALIB.DWC_K1DeviceControl.DWC_RESETPICLOSEDSTATUS "" VALUE 0x8060E773 DefaultValueRecordLayout_AUTOSAR_Platform_BaseTypes_uint8 255.0 DefaultIdenticalCompu 0.0 255. FORMAT "%10.5"
 /begin ANNOTATION ANNOTATION_LABEL "Description (coming from AUTOSAR DESC field)" /begin ANNOTATION_TEXT "Flag to enable the reset of PI on closed status.\r\n" /end ANNOTATION_TEXT /end ANNOTATION
/end CHARACTERISTIC
/begin CHARACTERISTIC DWC_CALIB.DWC_K1DeviceControl.DWC_RESETPIOPENSTATUS "" VALUE 0x8060E774 DefaultValueRecordLayout_AUTOSAR_Platform_BaseTypes_uint8 255.0 DefaultIdenticalCompu 0.0 255. FORMAT "%10.5"
 /begin ANNOTATION ANNOTATION_LABEL "Description (coming from AUTOSAR DESC field)" /begin ANNOTATION_TEXT "Flag to enable the reset of PI on open status.\r\n" /end ANNOTATION_TEXT /end ANNOTATION
/end CHARACTERISTIC
/begin CHARACTERISTIC DWC_CALIB.DWC_K1DeviceControl.DWC_SEQTORQUE "" CURVE 0x8060EC50 RB_PT_PCT_SWC_DWC_RecordLayouts_RL_Curve_sint16_50_uint16_50 4000.0 RB_PT_PCT_SWC_DWC_CompuMethods_ratio_0p1 -2000. 2000. FORMAT "%10.5"
 /begin ANNOTATION ANNOTATION_LABEL "Description (coming from AUTOSAR DESC field)" /begin ANNOTATION_TEXT "Torque sequence in relation to time.\r\n" /end ANNOTATION_TEXT /end ANNOTATION
 /begin AXIS_DESCR STD_AXIS NO_INPUT_QUANTITY RB_PT_PCT_SWC_DWC_CompuMethods_ratio_0p005 50 0.0 327.675 FORMAT "%10.5" DEPOSIT ABSOLUTE /end AXIS_DESCR
/end CHARACTERISTIC
/begin CHARACTERISTIC DWC_CALIB.DWC_K1DeviceControl.DWC_ShutOffHandler.DWC_FLGALLOWAUTOPASSSOH "" VALUE 0x8060E96E DefaultValueRecordLayout_AUTOSAR_Platform_BaseTypes_boolean 255.0 AUTOSAR_Platform_CompuMethods_boolean 0.0 255. FORMAT "%10.5"
 /begin ANNOTATION ANNOTATION_LABEL "Description (coming from AUTOSAR DESC field)" /begin ANNOTATION_TEXT "Flag to enable the SOH auto pass logic.\r\n" /end ANNOTATION_TEXT /end ANNOTATION
/end CHARACTERISTIC
/begin CHARACTERISTIC DWC_CALIB.DWC_K1DeviceControl.DWC_ShutOffHandler.DWC_FLGALLOWSLAVESOTEST "" VALUE 0x8060E96F DefaultValueRecordLayout_AUTOSAR_Platform_BaseTypes_boolean 255.0 AUTOSAR_Platform_CompuMethods_boolean 0.0 255. FORMAT "%10.5"
 /begin ANNOTATION ANNOTATION_LABEL "Description (coming from AUTOSAR DESC field)"
  /begin ANNOTATION_TEXT "Flag to enable slave to run SO test if master is failed.\r\n" /end ANNOTATION_TEXT
 /end ANNOTATION
/end CHARACTERISTIC
/begin CHARACTERISTIC DWC_CALIB.DWC_K1DeviceControl.DWC_ShutOffHandler.DWC_FLGENABLEAUTOFAIL "" VALUE 0x8060E970 DefaultValueRecordLayout_AUTOSAR_Platform_BaseTypes_boolean 255.0 AUTOSAR_Platform_CompuMethods_boolean 0.0 255. FORMAT "%10.5"
 /begin ANNOTATION ANNOTATION_LABEL "Description (coming from AUTOSAR DESC field)" /begin ANNOTATION_TEXT "Flag to enable auto fail logic.\r\n" /end ANNOTATION_TEXT /end ANNOTATION
/end CHARACTERISTIC
/begin CHARACTERISTIC DWC_CALIB.DWC_K1DeviceControl.DWC_ShutOffHandler.DWC_FLGENABLEFIRSTSTATETIMEOUT "" VALUE 0x8060E971 DefaultValueRecordLayout_AUTOSAR_Platform_BaseTypes_boolean 255.0 AUTOSAR_Platform_CompuMethods_boolean 0.0 255. FORMAT "%10.5"
 /begin ANNOTATION ANNOTATION_LABEL "Description (coming from AUTOSAR DESC field)" /begin ANNOTATION_TEXT "Flag to enable a timeout in the first state.\r\n" /end ANNOTATION_TEXT /end ANNOTATION
/end CHARACTERISTIC
/begin CHARACTERISTIC DWC_CALIB.DWC_K1DeviceControl.DWC_ShutOffHandler.DWC_FLGOVRDDEVCHECK "" VALUE 0x8060E972 DefaultValueRecordLayout_AUTOSAR_Platform_BaseTypes_boolean 255.0 AUTOSAR_Platform_CompuMethods_boolean 0.0 255. FORMAT "%10.5"
 /begin ANNOTATION ANNOTATION_LABEL "Description (coming from AUTOSAR DESC field)"
  /begin ANNOTATION_TEXT "Flag to override device check in auto fail. Required to fix bug\r\n" /end ANNOTATION_TEXT
 /end ANNOTATION
/end CHARACTERISTIC
/begin CHARACTERISTIC DWC_CALIB.DWC_K1DeviceControl.DWC_ShutOffHandler.DWC_FLGUSESOMASTERRULE1FIX "" VALUE 0x8060E973 DefaultValueRecordLayout_AUTOSAR_Platform_BaseTypes_boolean 255.0 AUTOSAR_Platform_CompuMethods_boolean 0.0 255. FORMAT "%10.5"
 /begin ANNOTATION ANNOTATION_LABEL "Description (coming from AUTOSAR DESC field)"
  /begin ANNOTATION_TEXT "Flag to use the functionality described in the comment for master rule 1.\r\n" /end ANNOTATION_TEXT
 /end ANNOTATION
/end CHARACTERISTIC
/begin CHARACTERISTIC DWC_CALIB.DWC_K1DeviceControl.DWC_ShutOffHandler.DWC_REINITSOHTEST "" VALUE 0x8060E96C DefaultValueRecordLayout_AUTOSAR_Platform_BaseTypes_uint16 65535.0 RB_PT_PCT_SWC_DWC_CompuMethods_ident 0.0 65535. FORMAT "%10.5"
 /begin ANNOTATION ANNOTATION_LABEL "Description (coming from AUTOSAR DESC field)" /begin ANNOTATION_TEXT "Parameter to reinitialise the SOH test.\r\n" /end ANNOTATION_TEXT /end ANNOTATION
/end CHARACTERISTIC
/begin CHARACTERISTIC DWC_CALIB.DWC_K1DeviceControl.DWC_ShutOffHandler.DWC_RERUNONLYIFFAILED "" VALUE 0x8060E974 DefaultValueRecordLayout_AUTOSAR_Platform_BaseTypes_boolean 255.0 AUTOSAR_Platform_CompuMethods_boolean 0.0 255. FORMAT "%10.5"
 /begin ANNOTATION ANNOTATION_LABEL "Description (coming from AUTOSAR DESC field)"
  /begin ANNOTATION_TEXT "Flag to re run SO test from diag reset only if the test has previously failed.\r\n" /end ANNOTATION_TEXT
 /end ANNOTATION
/end CHARACTERISTIC
/begin CHARACTERISTIC DWC_CALIB.DWC_K1DeviceControl.DWC_ShutOffHandler.DWC_SHUTOFFONLYFOR2FAILEDBANKS "" VALUE 0x8060E975 DefaultValueRecordLayout_AUTOSAR_Platform_BaseTypes_boolean 255.0 AUTOSAR_Platform_CompuMethods_boolean 0.0 255. FORMAT "%10.5"
 /begin ANNOTATION ANNOTATION_LABEL "Description (coming from AUTOSAR DESC field)" /begin ANNOTATION_TEXT "Trigger the shut off only when 2 banks have failed.\r\n" /end ANNOTATION_TEXT /end ANNOTATION
/end CHARACTERISTIC
/begin CHARACTERISTIC DWC_CALIB.DWC_K1DeviceControl.DWC_ShutOffHandler.DWC_SOALLOWEDINSELFTEST "" VALUE 0x8060E976 DefaultValueRecordLayout_AUTOSAR_Platform_BaseTypes_boolean 255.0 AUTOSAR_Platform_CompuMethods_boolean 0.0 255. FORMAT "%10.5"
 /begin ANNOTATION ANNOTATION_LABEL "Description (coming from AUTOSAR DESC field)"
  /begin ANNOTATION_TEXT "Flag to enabe log that allows shut off when clutch is in self test.\r\n" /end ANNOTATION_TEXT
 /end ANNOTATION
/end CHARACTERISTIC
/begin CHARACTERISTIC DWC_CALIB.DWC_K1DeviceControl.DWC_ShutOffHandler.DWC_SOHPRESSURENORESPONSETIMEMAP "" CURVE 0x8060E978 RB_PT_PCT_SWC_DWC_RecordLayouts_RL_Curve_uint16_4_sint16_4 10.0 RB_PT_PCT_SWC_DWC_CompuMethods_ratio_0p001__2 0.0 10. FORMAT "%10.5"
 /begin ANNOTATION ANNOTATION_LABEL "Description (coming from AUTOSAR DESC field)"
  /begin ANNOTATION_TEXT "Maximum time, after which the clutch main pressure valve is considered failed/cut off valve failed on, against temp.\r\n" /end ANNOTATION_TEXT
 /end ANNOTATION
 /begin AXIS_DESCR STD_AXIS NO_INPUT_QUANTITY RB_PT_PCT_SWC_DWC_CompuMethods_ident 4 -50. 200. FORMAT "%10.5" DEPOSIT ABSOLUTE /end AXIS_DESCR
/end CHARACTERISTIC
/begin CHARACTERISTIC DWC_CALIB.DWC_K1DeviceControl.DWC_ShutOffHandler.DWC_SOHPRESSURESLOWRESPONSETIMEMAP "" CURVE 0x8060E98A RB_PT_PCT_SWC_DWC_RecordLayouts_RL_Curve_uint16_4_sint16_4 10.0 RB_PT_PCT_SWC_DWC_CompuMethods_ratio_0p001__2 0.0 10. FORMAT "%10.5"
 /begin ANNOTATION ANNOTATION_LABEL "Description (coming from AUTOSAR DESC field)"
  /begin ANNOTATION_TEXT "Maximum time, after which the clutch main pressure valve is considered slow, and a larger request will be applied (also, starting diagnostics on that valve), against temp.\r\n" /end ANNOTATION_TEXT
 /end ANNOTATION
 /begin AXIS_DESCR STD_AXIS NO_INPUT_QUANTITY RB_PT_PCT_SWC_DWC_CompuMethods_ident 4 -50. 200. FORMAT "%10.5" DEPOSIT ABSOLUTE /end AXIS_DESCR
/end CHARACTERISTIC
/begin CHARACTERISTIC DWC_CALIB.DWC_K1DeviceControl.DWC_ShutOffHandler.DWC_SOHVALVERESPONSEMAXTIMEMAP "" CURVE 0x8060E99C RB_PT_PCT_SWC_DWC_RecordLayouts_RL_Curve_uint16_4_sint16_4 10.0 RB_PT_PCT_SWC_DWC_CompuMethods_ratio_0p001__2 0.0 10. FORMAT "%10.5"
 /begin ANNOTATION ANNOTATION_LABEL "Description (coming from AUTOSAR DESC field)"
  /begin ANNOTATION_TEXT "Maximum time for shut off valve to respond, after which it will be marked as failed, against temp.\r\n" /end ANNOTATION_TEXT
 /end ANNOTATION
 /begin AXIS_DESCR STD_AXIS NO_INPUT_QUANTITY RB_PT_PCT_SWC_DWC_CompuMethods_ident 4 -50. 200. FORMAT "%10.5" DEPOSIT ABSOLUTE /end AXIS_DESCR
/end CHARACTERISTIC
/begin CHARACTERISTIC DWC_CALIB.DWC_K1DeviceControl.DWC_TEMPMAXVALVECLEAN "" VALUE 0x8060E756 DefaultValueRecordLayout_AUTOSAR_Platform_BaseTypes_sint16 250.0 RB_PT_PCT_SWC_DWC_CompuMethods_ident -50. 200. FORMAT "%10.5"
 /begin ANNOTATION ANNOTATION_LABEL "Description (coming from AUTOSAR DESC field)" /begin ANNOTATION_TEXT "Maximum temperature to allow valve clean\r\n" /end ANNOTATION_TEXT /end ANNOTATION
/end CHARACTERISTIC
/begin CHARACTERISTIC DWC_CALIB.DWC_K1DeviceControl.DWC_TEMPMAXVALVERINSE "" VALUE 0x8060E758 DefaultValueRecordLayout_AUTOSAR_Platform_BaseTypes_sint16 250.0 RB_PT_PCT_SWC_DWC_CompuMethods_ident -50. 200. FORMAT "%10.5"
 /begin ANNOTATION ANNOTATION_LABEL "Description (coming from AUTOSAR DESC field)" /begin ANNOTATION_TEXT "Maximum temperature to allow valve rinse\r\n" /end ANNOTATION_TEXT /end ANNOTATION
/end CHARACTERISTIC
/begin CHARACTERISTIC DWC_CALIB.DWC_K1DeviceControl.DWC_TEMPMINBLIP "" VALUE 0x8060E75A DefaultValueRecordLayout_AUTOSAR_Platform_BaseTypes_sint16 250.0 RB_PT_PCT_SWC_DWC_CompuMethods_ident -50. 200. FORMAT "%10.5"
 /begin ANNOTATION ANNOTATION_LABEL "Description (coming from AUTOSAR DESC field)"
  /begin ANNOTATION_TEXT "Minimum blip temperature cal when temperature status is true.\r\n" /end ANNOTATION_TEXT
 /end ANNOTATION
/end CHARACTERISTIC
/begin CHARACTERISTIC DWC_CALIB.DWC_K1DeviceControl.DWC_TEMPMINVALVECLEAN "" VALUE 0x8060E75C DefaultValueRecordLayout_AUTOSAR_Platform_BaseTypes_sint16 250.0 RB_PT_PCT_SWC_DWC_CompuMethods_ident -50. 200. FORMAT "%10.5"
 /begin ANNOTATION ANNOTATION_LABEL "Description (coming from AUTOSAR DESC field)" /begin ANNOTATION_TEXT "Minimum temperature to allow valve clean\r\n" /end ANNOTATION_TEXT /end ANNOTATION
/end CHARACTERISTIC
/begin CHARACTERISTIC DWC_CALIB.DWC_K1DeviceControl.DWC_TEMPMINVALVERINSE "" VALUE 0x8060E75E DefaultValueRecordLayout_AUTOSAR_Platform_BaseTypes_sint16 250.0 RB_PT_PCT_SWC_DWC_CompuMethods_ident -50. 200. FORMAT "%10.5"
 /begin ANNOTATION ANNOTATION_LABEL "Description (coming from AUTOSAR DESC field)" /begin ANNOTATION_TEXT "Minimum temperature to allow valve rinse\r\n" /end ANNOTATION_TEXT /end ANNOTATION
/end CHARACTERISTIC
/begin CHARACTERISTIC DWC_CALIB.DWC_K1DeviceControl.DWC_TrqPress.DWC_ENABLEKPSTATEMIN "" VALUE 0x8060E9AE DefaultValueRecordLayout_AUTOSAR_Platform_BaseTypes_uint8 255.0 DefaultIdenticalCompu 0.0 255. FORMAT "%10.5"
 /begin ANNOTATION ANNOTATION_LABEL "Description (coming from AUTOSAR DESC field)" /begin ANNOTATION_TEXT "use to enable TP adaption fault for KP hit min limit\r\n" /end ANNOTATION_TEXT /end ANNOTATION
/end CHARACTERISTIC
/begin CHARACTERISTIC DWC_CALIB.DWC_K1DeviceControl.DWC_TrqPress.DWC_ENABLEMAXTPSTATEMAX "" VALUE 0x8060E9AF DefaultValueRecordLayout_AUTOSAR_Platform_BaseTypes_uint8 255.0 DefaultIdenticalCompu 0.0 255. FORMAT "%10.5"
 /begin ANNOTATION ANNOTATION_LABEL "Description (coming from AUTOSAR DESC field)"
  /begin ANNOTATION_TEXT "use to enable TP adaption fault for max torque max limit hit\r\n" /end ANNOTATION_TEXT
 /end ANNOTATION
/end CHARACTERISTIC
/begin CHARACTERISTIC DWC_CALIB.DWC_K1DeviceControl.DWC_TrqPress.DWC_ENABLEMAXTPSTATEMIN "" VALUE 0x8060E9B0 DefaultValueRecordLayout_AUTOSAR_Platform_BaseTypes_uint8 255.0 DefaultIdenticalCompu 0.0 255. FORMAT "%10.5"
 /begin ANNOTATION ANNOTATION_LABEL "Description (coming from AUTOSAR DESC field)"
  /begin ANNOTATION_TEXT "use to enable TP adaption fault for max torque min limit hit\r\n" /end ANNOTATION_TEXT
 /end ANNOTATION
/end CHARACTERISTIC
/begin CHARACTERISTIC DWC_CALIB.DWC_K1DeviceControl.DWC_TrqPress.DWC_EnableTP67Copy "" VALUE 0x8060E9B2 DefaultValueRecordLayout_AUTOSAR_Platform_BaseTypes_uint8 255.0 DefaultIdenticalCompu 0.0 255. FORMAT "%10.5"
 /begin ANNOTATION ANNOTATION_LABEL "Description (coming from AUTOSAR DESC field)" /begin ANNOTATION_TEXT "flag to copy adaption from position 6 to 7\r\n" /end ANNOTATION_TEXT /end ANNOTATION
/end CHARACTERISTIC
/begin CHARACTERISTIC DWC_CALIB.DWC_K1DeviceControl.DWC_TrqPress.DWC_ENABLKPSTATEMAX "" VALUE 0x8060E9B1 DefaultValueRecordLayout_AUTOSAR_Platform_BaseTypes_uint8 255.0 DefaultIdenticalCompu 0.0 255. FORMAT "%10.5"
 /begin ANNOTATION ANNOTATION_LABEL "Description (coming from AUTOSAR DESC field)" /begin ANNOTATION_TEXT "use to enable TP adaption fault for KP hit max limit\r\n" /end ANNOTATION_TEXT /end ANNOTATION
/end CHARACTERISTIC
/begin CHARACTERISTIC DWC_CALIB.DWC_K1DeviceControl.DWC_TrqPress.DWC_KisspointSequencer.DWC_BOBSTATICKPSMFIX "" VALUE 0x8060E9B8 DefaultValueRecordLayout_AUTOSAR_Platform_BaseTypes_boolean 255.0 AUTOSAR_Platform_CompuMethods_boolean 0.0 255. FORMAT "%10.5"
 /begin ANNOTATION ANNOTATION_LABEL "Description (coming from AUTOSAR DESC field)"
  /begin ANNOTATION_TEXT "Parameter to enable to fix that will allow static adaptions to cancel when OBD_NOTEST is seen.\r\n" /end ANNOTATION_TEXT
 /end ANNOTATION
/end CHARACTERISTIC
/begin CHARACTERISTIC DWC_CALIB.DWC_K1DeviceControl.DWC_TrqPress.DWC_KisspointSequencer.DWC_FLGABORTFORGEARTIMEOUT "" VALUE 0x8060E9B9 DefaultValueRecordLayout_AUTOSAR_Platform_BaseTypes_boolean 255.0 AUTOSAR_Platform_CompuMethods_boolean 0.0 255. FORMAT "%10.5"
 /begin ANNOTATION ANNOTATION_LABEL "Description (coming from AUTOSAR DESC field)" /begin ANNOTATION_TEXT "Flag to enable KP learn due to gear engage timeout.\r\n" /end ANNOTATION_TEXT /end ANNOTATION
/end CHARACTERISTIC
/begin CHARACTERISTIC DWC_CALIB.DWC_K1DeviceControl.DWC_TrqPress.DWC_KisspointSequencer.DWC_KPABORTTRUETIME "" VALUE 0x8060E9B4 DefaultValueRecordLayout_AUTOSAR_Platform_BaseTypes_uint16 10.0 RB_PT_PCT_SWC_DWC_CompuMethods_ratio_0p001__2 0.0 10. FORMAT "%10.5"
 /begin ANNOTATION ANNOTATION_LABEL "Description (coming from AUTOSAR DESC field)" /begin ANNOTATION_TEXT "Time for which abort flag should be true.\r\n" /end ANNOTATION_TEXT /end ANNOTATION
/end CHARACTERISTIC
/begin CHARACTERISTIC DWC_CALIB.DWC_K1DeviceControl.DWC_TrqPress.DWC_KisspointSequencer.DWC_KPMAXTIMEFORENGAGINGGEAR "" VALUE 0x8060E9B6 DefaultValueRecordLayout_AUTOSAR_Platform_BaseTypes_uint16 10.0 RB_PT_PCT_SWC_DWC_CompuMethods_ratio_0p001__2 0.0 10. FORMAT "%10.5"
 /begin ANNOTATION ANNOTATION_LABEL "Description (coming from AUTOSAR DESC field)" /begin ANNOTATION_TEXT "Max allowable timeout for gear engagement\r\n" /end ANNOTATION_TEXT /end ANNOTATION
/end CHARACTERISTIC
/begin CHARACTERISTIC DWC_CALIB.DWC_K1DeviceControl.DWC_TrqPress.DWC_MAXADAPTSTATUSINDEX "" VALUE 0x8060E9B3 DefaultValueRecordLayout_AUTOSAR_Platform_BaseTypes_uint8 8.0 RB_PT_PCT_SWC_DWC_CompuMethods_ident 0.0 8. FORMAT "%10.5"
 /begin ANNOTATION ANNOTATION_LABEL "Description (coming from AUTOSAR DESC field)"
  /begin ANNOTATION_TEXT "Index of TP adaption to monitor for out of bounds errors.\r\n" /end ANNOTATION_TEXT
 /end ANNOTATION
/end CHARACTERISTIC
/begin CHARACTERISTIC DWC_CALIB.DWC_K1DeviceControl.DWC_USEIOPPRESSUREFORDIAG "" VALUE 0x8060E775 DefaultValueRecordLayout_AUTOSAR_Platform_BaseTypes_boolean 255.0 AUTOSAR_Platform_CompuMethods_boolean 0.0 255. FORMAT "%10.5"
 /begin ANNOTATION ANNOTATION_LABEL "Description (coming from AUTOSAR DESC field)"
  /begin ANNOTATION_TEXT "Set true to use 'raw' pressure signal from IOP rather than from DWC input processing.\r\n" /end ANNOTATION_TEXT
 /end ANNOTATION
/end CHARACTERISTIC
/begin CHARACTERISTIC DWC_CALIB.DWC_K1DeviceControl.DWC_USELINEPRESSUREFOROSG "" VALUE 0x8060E776 DefaultValueRecordLayout_AUTOSAR_Platform_BaseTypes_boolean 255.0 AUTOSAR_Platform_CompuMethods_boolean 0.0 255. FORMAT "%10.5"
 /begin ANNOTATION ANNOTATION_LABEL "Description (coming from AUTOSAR DESC field)"
  /begin ANNOTATION_TEXT "Flag to use line pressure for 'Oil Supply Good' flag.\r\n" /end ANNOTATION_TEXT
 /end ANNOTATION
/end CHARACTERISTIC
/begin CHARACTERISTIC DWC_CALIB.DWC_K1DeviceControl.DWC_USEVALVECLEANDEMANDS "" VALUE 0x8060E777 DefaultValueRecordLayout_AUTOSAR_Platform_BaseTypes_uint8 255.0 DefaultIdenticalCompu 0.0 255. FORMAT "%10.5"
 /begin ANNOTATION ANNOTATION_LABEL "Description (coming from AUTOSAR DESC field)"
  /begin ANNOTATION_TEXT "Set true to use pressure demands that have been passed through the valve clean class\r\n" /end ANNOTATION_TEXT
 /end ANNOTATION
/end CHARACTERISTIC
/begin CHARACTERISTIC DWC_CALIB.DWC_K1DeviceControl.DWC_USEVCPRESDEMWHENCLEANING "" VALUE 0x8060E778 DefaultValueRecordLayout_AUTOSAR_Platform_BaseTypes_boolean 255.0 AUTOSAR_Platform_CompuMethods_boolean 0.0 255. FORMAT "%10.5"
 /begin ANNOTATION ANNOTATION_LABEL "Description (coming from AUTOSAR DESC field)"
  /begin ANNOTATION_TEXT "Flag to use VC pressure demand when a clean is active.\r\n" /end ANNOTATION_TEXT
 /end ANNOTATION
/end CHARACTERISTIC
/begin CHARACTERISTIC DWC_CALIB.DWC_K1DeviceControl.DWC_ValveClean.DWC_PCTVALVECLOSEDCLEANEARLYCOMPLETE "" VALUE 0x8060E9D6 DefaultValueRecordLayout_AUTOSAR_Platform_BaseTypes_uint8 1.0 RB_PT_PCT_SWC_DWC_CompuMethods_ratio_0p01 0.0 1. FORMAT "%10.5"
 /begin ANNOTATION ANNOTATION_LABEL "Description (coming from AUTOSAR DESC field)"
  /begin ANNOTATION_TEXT "Percentage of full rinse time where an early abortion still leads to a timeout condition\r\n" /end ANNOTATION_TEXT
 /end ANNOTATION
/end CHARACTERISTIC
/begin CHARACTERISTIC DWC_CALIB.DWC_K1DeviceControl.DWC_ValveClean.DWC_PCTVALVEOPENCLEANEARLYCOMPLETE "" VALUE 0x8060E9D7 DefaultValueRecordLayout_AUTOSAR_Platform_BaseTypes_uint8 1.0 RB_PT_PCT_SWC_DWC_CompuMethods_ratio_0p01 0.0 1. FORMAT "%10.5"
 /begin ANNOTATION ANNOTATION_LABEL "Description (coming from AUTOSAR DESC field)"
  /begin ANNOTATION_TEXT "Percentage of full rinse time where an early abortion still leads to a timeout condition\r\n" /end ANNOTATION_TEXT
 /end ANNOTATION
/end CHARACTERISTIC
/begin CHARACTERISTIC DWC_CALIB.DWC_K1DeviceControl.DWC_ValveClean.DWC_PCTVALVERINSEEARLYCOMPLETE "" VALUE 0x8060E9D8 DefaultValueRecordLayout_AUTOSAR_Platform_BaseTypes_uint8 1.0 RB_PT_PCT_SWC_DWC_CompuMethods_ratio_0p01 0.0 1. FORMAT "%10.5"
 /begin ANNOTATION ANNOTATION_LABEL "Description (coming from AUTOSAR DESC field)"
  /begin ANNOTATION_TEXT "Percentage of full rinse time where an early abortion still leads to a timeout condition\r\n" /end ANNOTATION_TEXT
 /end ANNOTATION
/end CHARACTERISTIC
/begin CHARACTERISTIC DWC_CALIB.DWC_K1DeviceControl.DWC_ValveClean.DWC_PRESSURECLOSEDCLEANMAX "" CURVE 0x8060E9DA RB_PT_PCT_SWC_DWC_RecordLayouts_RL_Curve_sint16_5_sint16_5 34.0 RB_PT_PCT_SWC_DWC_CompuMethods_ratio_0p001__2 -2. 32. FORMAT "%10.5"
 /begin ANNOTATION ANNOTATION_LABEL "Description (coming from AUTOSAR DESC field)" /begin ANNOTATION_TEXT "Lower limit lookup\r\n" /end ANNOTATION_TEXT /end ANNOTATION
 /begin AXIS_DESCR STD_AXIS NO_INPUT_QUANTITY RB_PT_PCT_SWC_DWC_CompuMethods_ratio_0p001__2 5 -2. 32. FORMAT "%10.5" DEPOSIT ABSOLUTE /end AXIS_DESCR
/end CHARACTERISTIC
/begin CHARACTERISTIC DWC_CALIB.DWC_K1DeviceControl.DWC_ValveClean.DWC_PRESSUREOPENCLEANMAX "" CURVE 0x8060E9F0 RB_PT_PCT_SWC_DWC_RecordLayouts_RL_Curve_sint16_5_sint16_5 34.0 RB_PT_PCT_SWC_DWC_CompuMethods_ratio_0p001__2 -2. 32. FORMAT "%10.5"
 /begin ANNOTATION ANNOTATION_LABEL "Description (coming from AUTOSAR DESC field)" /begin ANNOTATION_TEXT "Lower limit lookup\r\n" /end ANNOTATION_TEXT /end ANNOTATION
 /begin AXIS_DESCR STD_AXIS NO_INPUT_QUANTITY RB_PT_PCT_SWC_DWC_CompuMethods_ratio_0p001__2 5 -2. 32. FORMAT "%10.5" DEPOSIT ABSOLUTE /end AXIS_DESCR
/end CHARACTERISTIC
/begin CHARACTERISTIC DWC_CALIB.DWC_K1DeviceControl.DWC_ValveClean.DWC_PRESSUREOVERHEADMAX "" CURVE 0x8060EA06 RB_PT_PCT_SWC_DWC_RecordLayouts_RL_Curve_sint16_5_sint16_5 34.0 RB_PT_PCT_SWC_DWC_CompuMethods_ratio_0p001__2 -2. 32. FORMAT "%10.5"
 /begin ANNOTATION ANNOTATION_LABEL "Description (coming from AUTOSAR DESC field)" /begin ANNOTATION_TEXT "Lower limit lookup\r\n" /end ANNOTATION_TEXT /end ANNOTATION
 /begin AXIS_DESCR STD_AXIS NO_INPUT_QUANTITY RB_PT_PCT_SWC_DWC_CompuMethods_ratio_0p001__2 5 -2. 32. FORMAT "%10.5" DEPOSIT ABSOLUTE /end AXIS_DESCR
/end CHARACTERISTIC
/begin CHARACTERISTIC DWC_CALIB.DWC_K1DeviceControl.DWC_ValveClean.DWC_PRESSUREOVERHEADMIN "" CURVE 0x8060EA1C RB_PT_PCT_SWC_DWC_RecordLayouts_RL_Curve_sint16_5_sint16_5 34.0 RB_PT_PCT_SWC_DWC_CompuMethods_ratio_0p001__2 -2. 32. FORMAT "%10.5"
 /begin ANNOTATION ANNOTATION_LABEL "Description (coming from AUTOSAR DESC field)" /begin ANNOTATION_TEXT "Lower limit lookup\r\n" /end ANNOTATION_TEXT /end ANNOTATION
 /begin AXIS_DESCR STD_AXIS NO_INPUT_QUANTITY RB_PT_PCT_SWC_DWC_CompuMethods_ratio_0p001__2 5 -2. 32. FORMAT "%10.5" DEPOSIT ABSOLUTE /end AXIS_DESCR
/end CHARACTERISTIC
/begin CHARACTERISTIC DWC_CALIB.DWC_K1DeviceControl.DWC_ValveClean.DWC_TF_FCTROPENCLEANCURRENT "" CURVE 0x8060EA32 RB_PT_PCT_SWC_DWC_RecordLayouts_RL_Curve_uint16_11_uint16_11 1.0 RB_PT_PCT_SWC_DWC_CompuMethods_Ratio_0p001 0.0 1. FORMAT "%10.5"
 /begin ANNOTATION ANNOTATION_LABEL "Description (coming from AUTOSAR DESC field)" /begin ANNOTATION_TEXT "Depressure fctr\r\n" /end ANNOTATION_TEXT /end ANNOTATION
 /begin AXIS_DESCR STD_AXIS NO_INPUT_QUANTITY RB_PT_PCT_SWC_DWC_CompuMethods_DST_Time 11 0.0 655.35 FORMAT "%10.5" DEPOSIT ABSOLUTE /end AXIS_DESCR
/end CHARACTERISTIC
/begin CHARACTERISTIC DWC_CALIB.DWC_K1DeviceControl.DWC_ValveClean.DWC_TF_FCTRROUTINECLEANCURRENT "" CURVE 0x8060EA60 RB_PT_PCT_SWC_DWC_RecordLayouts_RL_Curve_uint16_11_uint16_11 1.0 RB_PT_PCT_SWC_DWC_CompuMethods_Ratio_0p001 0.0 1. FORMAT "%10.5"
 /begin ANNOTATION ANNOTATION_LABEL "Description (coming from AUTOSAR DESC field)" /begin ANNOTATION_TEXT "Depressure fctr\r\n" /end ANNOTATION_TEXT /end ANNOTATION
 /begin AXIS_DESCR STD_AXIS NO_INPUT_QUANTITY RB_PT_PCT_SWC_DWC_CompuMethods_DST_Time 11 0.0 655.35 FORMAT "%10.5" DEPOSIT ABSOLUTE /end AXIS_DESCR
/end CHARACTERISTIC
/begin CHARACTERISTIC DWC_CALIB.DWC_K1DeviceControl.DWC_ValveClean.DWC_TIMEROUTINECLEAN "" VALUE 0x8060E9C8 DefaultValueRecordLayout_AUTOSAR_Platform_BaseTypes_uint16 65.535 RB_PT_PCT_SWC_DWC_CompuMethods_ratio_0p001__2 0.0 65.535 FORMAT "%10.5"
 /begin ANNOTATION ANNOTATION_LABEL "Description (coming from AUTOSAR DESC field)" /begin ANNOTATION_TEXT "Maximum time before valve clean timeout\r\n" /end ANNOTATION_TEXT /end ANNOTATION
/end CHARACTERISTIC
/begin CHARACTERISTIC DWC_CALIB.DWC_K1DeviceControl.DWC_ValveClean.DWC_TIMEVALVECLEANHALFCYCLE "" VALUE 0x8060E9D9 DefaultValueRecordLayout_AUTOSAR_Platform_BaseTypes_uint8 1.275 RB_PT_PCT_SWC_DWC_CompuMethods_ratio_0p005 0.0 1.275 FORMAT "%10.5"
 /begin ANNOTATION ANNOTATION_LABEL "Description (coming from AUTOSAR DESC field)" /begin ANNOTATION_TEXT "Half period of valve cycle\r\n" /end ANNOTATION_TEXT /end ANNOTATION
/end CHARACTERISTIC
/begin CHARACTERISTIC DWC_CALIB.DWC_K1DeviceControl.DWC_ValveClean.DWC_TIMEVALVECLOSEDCLEAN "" VALUE 0x8060E9CA DefaultValueRecordLayout_AUTOSAR_Platform_BaseTypes_uint16 65.535 RB_PT_PCT_SWC_DWC_CompuMethods_ratio_0p001__2 0.0 65.535 FORMAT "%10.5"
 /begin ANNOTATION ANNOTATION_LABEL "Description (coming from AUTOSAR DESC field)" /begin ANNOTATION_TEXT "Maximum time before valve clean timeout\r\n" /end ANNOTATION_TEXT /end ANNOTATION
/end CHARACTERISTIC
/begin CHARACTERISTIC DWC_CALIB.DWC_K1DeviceControl.DWC_ValveClean.DWC_TIMEVALVECLOSEDCLEANRESET "" VALUE 0x8060E9BC DefaultValueRecordLayout_AUTOSAR_Platform_BaseTypes_uint32 4294967.295 RB_PT_PCT_SWC_DWC_CompuMethods_ratio_0p001__2 0.0 4294967.295 FORMAT "%10.5"
 /begin ANNOTATION ANNOTATION_LABEL "Description (coming from AUTOSAR DESC field)" /begin ANNOTATION_TEXT "Maximum time before valve rinse timeout\r\n" /end ANNOTATION_TEXT /end ANNOTATION
/end CHARACTERISTIC
/begin CHARACTERISTIC DWC_CALIB.DWC_K1DeviceControl.DWC_ValveClean.DWC_TIMEVALVEOPENCLEAN "" VALUE 0x8060E9CC DefaultValueRecordLayout_AUTOSAR_Platform_BaseTypes_uint16 65.535 RB_PT_PCT_SWC_DWC_CompuMethods_ratio_0p001__2 0.0 65.535 FORMAT "%10.5"
 /begin ANNOTATION ANNOTATION_LABEL "Description (coming from AUTOSAR DESC field)" /begin ANNOTATION_TEXT "Maximum time before valve clean timeout\r\n" /end ANNOTATION_TEXT /end ANNOTATION
/end CHARACTERISTIC
/begin CHARACTERISTIC DWC_CALIB.DWC_K1DeviceControl.DWC_ValveClean.DWC_TIMEVALVEOPENCLEANRESET "" VALUE 0x8060E9C0 DefaultValueRecordLayout_AUTOSAR_Platform_BaseTypes_uint32 4294967.295 RB_PT_PCT_SWC_DWC_CompuMethods_ratio_0p001__2 0.0 4294967.295 FORMAT "%10.5"
 /begin ANNOTATION ANNOTATION_LABEL "Description (coming from AUTOSAR DESC field)" /begin ANNOTATION_TEXT "Maximum time before valve rinse timeout\r\n" /end ANNOTATION_TEXT /end ANNOTATION
/end CHARACTERISTIC
/begin CHARACTERISTIC DWC_CALIB.DWC_K1DeviceControl.DWC_ValveClean.DWC_TIMEVALVEPRECLOSEDCLEAN "" VALUE 0x8060E9CE DefaultValueRecordLayout_AUTOSAR_Platform_BaseTypes_uint16 65.535 RB_PT_PCT_SWC_DWC_CompuMethods_ratio_0p001__2 0.0 65.535 FORMAT "%10.5"
 /begin ANNOTATION ANNOTATION_LABEL "Description (coming from AUTOSAR DESC field)" /begin ANNOTATION_TEXT "Maximum time before valve clean timeout\r\n" /end ANNOTATION_TEXT /end ANNOTATION
/end CHARACTERISTIC
/begin CHARACTERISTIC DWC_CALIB.DWC_K1DeviceControl.DWC_ValveClean.DWC_TIMEVALVEPREOPENCLEAN "" VALUE 0x8060E9D0 DefaultValueRecordLayout_AUTOSAR_Platform_BaseTypes_uint16 65.535 RB_PT_PCT_SWC_DWC_CompuMethods_ratio_0p001__2 0.0 65.535 FORMAT "%10.5"
 /begin ANNOTATION ANNOTATION_LABEL "Description (coming from AUTOSAR DESC field)" /begin ANNOTATION_TEXT "Maximum time before valve clean timeout\r\n" /end ANNOTATION_TEXT /end ANNOTATION
/end CHARACTERISTIC
/begin CHARACTERISTIC DWC_CALIB.DWC_K1DeviceControl.DWC_ValveClean.DWC_TIMEVALVEPRERINSE "" VALUE 0x8060E9D2 DefaultValueRecordLayout_AUTOSAR_Platform_BaseTypes_uint16 65.535 RB_PT_PCT_SWC_DWC_CompuMethods_ratio_0p001__2 0.0 65.535 FORMAT "%10.5"
 /begin ANNOTATION ANNOTATION_LABEL "Description (coming from AUTOSAR DESC field)" /begin ANNOTATION_TEXT "Maximum time before valve clean timeout\r\n" /end ANNOTATION_TEXT /end ANNOTATION
/end CHARACTERISTIC
/begin CHARACTERISTIC DWC_CALIB.DWC_K1DeviceControl.DWC_ValveClean.DWC_TIMEVALVERINSE "" VALUE 0x8060E9D4 DefaultValueRecordLayout_AUTOSAR_Platform_BaseTypes_uint16 65.535 RB_PT_PCT_SWC_DWC_CompuMethods_ratio_0p001__2 0.0 65.535 FORMAT "%10.5"
 /begin ANNOTATION ANNOTATION_LABEL "Description (coming from AUTOSAR DESC field)" /begin ANNOTATION_TEXT "Maximum time before valve clean timeout\r\n" /end ANNOTATION_TEXT /end ANNOTATION
/end CHARACTERISTIC
/begin CHARACTERISTIC DWC_CALIB.DWC_K1DeviceControl.DWC_ValveClean.DWC_TIMEVALVERINSERESET "" VALUE 0x8060E9C4 DefaultValueRecordLayout_AUTOSAR_Platform_BaseTypes_uint32 4294967.295 RB_PT_PCT_SWC_DWC_CompuMethods_ratio_0p001__2 0.0 4294967.295 FORMAT "%10.5"
 /begin ANNOTATION ANNOTATION_LABEL "Description (coming from AUTOSAR DESC field)" /begin ANNOTATION_TEXT "Maximum time before valve rinse timeout\r\n" /end ANNOTATION_TEXT /end ANNOTATION
/end CHARACTERISTIC
/begin CHARACTERISTIC DWC_CALIB.DWC_K2DeviceControl.DWC_BOBFLGRQBLIPGAC "" VALUE 0x8060ED38 DefaultValueRecordLayout_AUTOSAR_Platform_BaseTypes_boolean 255.0 AUTOSAR_Platform_CompuMethods_boolean 0.0 255. FORMAT "%10.5"
 /begin ANNOTATION ANNOTATION_LABEL "Description (coming from AUTOSAR DESC field)" /begin ANNOTATION_TEXT "GAC Clutch blip request\r\n" /end ANNOTATION_TEXT /end ANNOTATION
/end CHARACTERISTIC
/begin CHARACTERISTIC DWC_CALIB.DWC_K2DeviceControl.DWC_BOBGACBLIPENABRQ "" VALUE 0x8060ED39 DefaultValueRecordLayout_AUTOSAR_Platform_BaseTypes_boolean 255.0 AUTOSAR_Platform_CompuMethods_boolean 0.0 255. FORMAT "%10.5"
 /begin ANNOTATION ANNOTATION_LABEL "Description (coming from AUTOSAR DESC field)" /begin ANNOTATION_TEXT "GAC clutch blip BOB enable.\r\n" /end ANNOTATION_TEXT /end ANNOTATION
/end CHARACTERISTIC
/begin CHARACTERISTIC DWC_CALIB.DWC_K2DeviceControl.DWC_BypassPreparePulse.DWC_BYPASSPULSEPROFILE "" CURVE 0x8060ED64 RB_PT_PCT_SWC_DWC_RecordLayouts_RL_Curve_uint8_11_uint16_11 1.0 RB_PT_PCT_SWC_DWC_CompuMethods_ratio_0p01 0.0 1. FORMAT "%10.5"
 /begin ANNOTATION ANNOTATION_LABEL "Description (coming from AUTOSAR DESC field)"
  /begin ANNOTATION_TEXT "Remap bypass pulse time remaining into a profile shape.\r\n" /end ANNOTATION_TEXT
 /end ANNOTATION
 /begin AXIS_DESCR STD_AXIS NO_INPUT_QUANTITY RB_PT_PCT_SWC_DWC_CompuMethods_ratio_0p001__2 11 0.0 1. FORMAT "%10.5" DEPOSIT ABSOLUTE /end AXIS_DESCR
/end CHARACTERISTIC
/begin CHARACTERISTIC DWC_CALIB.DWC_K2DeviceControl.DWC_BypassPreparePulse.DWC_BYPASSREINITCYCLES "" VALUE 0x8060ED5E DefaultValueRecordLayout_AUTOSAR_Platform_BaseTypes_uint8 6.0 RB_PT_PCT_SWC_DWC_CompuMethods_ident 0.0 6. FORMAT "%10.5"
 /begin ANNOTATION ANNOTATION_LABEL "Description (coming from AUTOSAR DESC field)" /begin ANNOTATION_TEXT "How many cycles the bypass pulse should reinit for.\r\n" /end ANNOTATION_TEXT /end ANNOTATION
/end CHARACTERISTIC
/begin CHARACTERISTIC DWC_CALIB.DWC_K2DeviceControl.DWC_BypassPreparePulse.DWC_ENGINERUNTIMEFACTOR2D "" MAP 0x8060ED88 RB_PT_PCT_SWC_DWC_RecordLayouts_RL_Map_uint16_40_uint16_5_uint16_8 2.0 RB_PT_PCT_SWC_DWC_CompuMethods_ratio_0p001__2 0.0 2. FORMAT "%10.5"
 /begin ANNOTATION ANNOTATION_LABEL "Description (coming from AUTOSAR DESC field)"
  /begin ANNOTATION_TEXT "factor applied to increase fill time wrt time engine off and engine running to compensate for balance chamber volume.\r\n" /end ANNOTATION_TEXT
 /end ANNOTATION
 /begin AXIS_DESCR STD_AXIS NO_INPUT_QUANTITY RB_PT_PCT_SWC_DWC_CompuMethods_ratio_0p05 5 0.0 3276.75 FORMAT "%10.5" DEPOSIT ABSOLUTE /end AXIS_DESCR
 /begin AXIS_DESCR STD_AXIS NO_INPUT_QUANTITY RB_PT_PCT_SWC_DWC_CompuMethods_ratio_0p1 8 0.0 6553.5 FORMAT "%10.5" DEPOSIT ABSOLUTE /end AXIS_DESCR
/end CHARACTERISTIC
/begin CHARACTERISTIC DWC_CALIB.DWC_K2DeviceControl.DWC_BypassPreparePulse.DWC_FILLADAPTMAX "" VALUE 0x8060ED52 DefaultValueRecordLayout_AUTOSAR_Platform_BaseTypes_uint16 2.0 RB_PT_PCT_SWC_DWC_CompuMethods_ratio_0p001__2 0.0 2. FORMAT "%10.5"
 /begin ANNOTATION ANNOTATION_LABEL "Description (coming from AUTOSAR DESC field)" /begin ANNOTATION_TEXT "Max value fill adapt value\r\n" /end ANNOTATION_TEXT /end ANNOTATION
/end CHARACTERISTIC
/begin CHARACTERISTIC DWC_CALIB.DWC_K2DeviceControl.DWC_BypassPreparePulse.DWC_FILLADAPTMIN "" VALUE 0x8060ED54 DefaultValueRecordLayout_AUTOSAR_Platform_BaseTypes_uint16 2.0 RB_PT_PCT_SWC_DWC_CompuMethods_ratio_0p001__2 0.0 2. FORMAT "%10.5"
 /begin ANNOTATION ANNOTATION_LABEL "Description (coming from AUTOSAR DESC field)" /begin ANNOTATION_TEXT "Min value fill adapt value\r\n" /end ANNOTATION_TEXT /end ANNOTATION
/end CHARACTERISTIC
/begin CHARACTERISTIC DWC_CALIB.DWC_K2DeviceControl.DWC_BypassPreparePulse.DWC_FLGCLEARMAXFILLOVERSHTENGOFF "" VALUE 0x8060ED5F DefaultValueRecordLayout_AUTOSAR_Platform_BaseTypes_uint8 255.0 DefaultIdenticalCompu 0.0 255. FORMAT "%10.5"
 /begin ANNOTATION ANNOTATION_LABEL "Description (coming from AUTOSAR DESC field)" /begin ANNOTATION_TEXT "Reset DWC_FillMaxOvershoot when engine is off.\r\n" /end ANNOTATION_TEXT /end ANNOTATION
/end CHARACTERISTIC
/begin CHARACTERISTIC DWC_CALIB.DWC_K2DeviceControl.DWC_BypassPreparePulse.DWC_FLGENABLEBYPASSPROFILE "" VALUE 0x8060ED60 DefaultValueRecordLayout_AUTOSAR_Platform_BaseTypes_boolean 255.0 AUTOSAR_Platform_CompuMethods_boolean 0.0 255. FORMAT "%10.5"
 /begin ANNOTATION ANNOTATION_LABEL "Description (coming from AUTOSAR DESC field)"
  /begin ANNOTATION_TEXT "Flag to enable the bypass pulse profile to be modified.\r\n" /end ANNOTATION_TEXT
 /end ANNOTATION
/end CHARACTERISTIC
/begin CHARACTERISTIC DWC_CALIB.DWC_K2DeviceControl.DWC_BypassPreparePulse.DWC_FLGENABLEBYPASSREINITLOOP "" VALUE 0x8060ED61 DefaultValueRecordLayout_AUTOSAR_Platform_BaseTypes_boolean 255.0 AUTOSAR_Platform_CompuMethods_boolean 0.0 255. FORMAT "%10.5"
 /begin ANNOTATION ANNOTATION_LABEL "Description (coming from AUTOSAR DESC field)" /begin ANNOTATION_TEXT "Flag to reinit the bypass pulse more than once.\r\n" /end ANNOTATION_TEXT /end ANNOTATION
/end CHARACTERISTIC
/begin CHARACTERISTIC DWC_CALIB.DWC_K2DeviceControl.DWC_BypassPreparePulse.DWC_MAXFILLSPD4FILLADAPT "" VALUE 0x8060ED56 DefaultValueRecordLayout_AUTOSAR_Platform_BaseTypes_uint16 20000.0 RB_PT_PCT_SWC_DWC_CompuMethods_ident 0.0 20000. FORMAT "%10.5"
 /begin ANNOTATION ANNOTATION_LABEL "Description (coming from AUTOSAR DESC field)" /begin ANNOTATION_TEXT "Max fill engine speed to enable a fill adapt.\r\n" /end ANNOTATION_TEXT /end ANNOTATION
/end CHARACTERISTIC
/begin CHARACTERISTIC DWC_CALIB.DWC_K2DeviceControl.DWC_BypassPreparePulse.DWC_MAXFILLTRQ4FILLADAPT "" VALUE 0x8060ED58 DefaultValueRecordLayout_AUTOSAR_Platform_BaseTypes_sint16 4000.0 RB_PT_PCT_SWC_DWC_CompuMethods_ratio_0p1 -2000. 2000. FORMAT "%10.5"
 /begin ANNOTATION ANNOTATION_LABEL "Description (coming from AUTOSAR DESC field)" /begin ANNOTATION_TEXT "Max fill torque to enable a fill adapt.\r\n" /end ANNOTATION_TEXT /end ANNOTATION
/end CHARACTERISTIC
/begin CHARACTERISTIC DWC_CALIB.DWC_K2DeviceControl.DWC_BypassPreparePulse.DWC_MINPRESS2FFCOMPLETE "" VALUE 0x8060ED5A DefaultValueRecordLayout_AUTOSAR_Platform_BaseTypes_sint16 34.0 RB_PT_PCT_SWC_DWC_CompuMethods_ratio_0p001__2 -2. 32. FORMAT "%10.5"
 /begin ANNOTATION ANNOTATION_LABEL "Description (coming from AUTOSAR DESC field)"
  /begin ANNOTATION_TEXT "min pressure to disable first fill flag with engine running.\r\n" /end ANNOTATION_TEXT
 /end ANNOTATION
/end CHARACTERISTIC
/begin CHARACTERISTIC DWC_CALIB.DWC_K2DeviceControl.DWC_BypassPreparePulse.DWC_MINTEMP4FILLADAPT "" VALUE 0x8060ED5C DefaultValueRecordLayout_AUTOSAR_Platform_BaseTypes_sint16 250.0 RB_PT_PCT_SWC_DWC_CompuMethods_ident -50. 200. FORMAT "%10.5"
 /begin ANNOTATION ANNOTATION_LABEL "Description (coming from AUTOSAR DESC field)" /begin ANNOTATION_TEXT "min transoiltemp to allow filladaption\r\n" /end ANNOTATION_TEXT /end ANNOTATION
/end CHARACTERISTIC
/begin CHARACTERISTIC DWC_CALIB.DWC_K2DeviceControl.DWC_BypassPreparePulse.DWC_PULSEPRESSTEMPOFFSET "" CURVE 0x8060EDF6 RB_PT_PCT_SWC_DWC_RecordLayouts_RL_Curve_sint8_4_sint16_4 2.0 RB_PT_PCT_SWC_DWC_CompuMethods_ratio_0p01 -1. 1. FORMAT "%10.5"
 /begin ANNOTATION ANNOTATION_LABEL "Description (coming from AUTOSAR DESC field)"
  /begin ANNOTATION_TEXT "Temperature related offset to be applied to pulse pressure.\r\n" /end ANNOTATION_TEXT
 /end ANNOTATION
 /begin AXIS_DESCR STD_AXIS NO_INPUT_QUANTITY RB_PT_PCT_SWC_DWC_CompuMethods_ident 4 -50. 200. FORMAT "%10.5" DEPOSIT ABSOLUTE /end AXIS_DESCR
/end CHARACTERISTIC
/begin CHARACTERISTIC DWC_CALIB.DWC_K2DeviceControl.DWC_BypassPreparePulse.DWC_RESETTIMEOFFPRESSHIGH "" VALUE 0x8060ED62 DefaultValueRecordLayout_AUTOSAR_Platform_BaseTypes_boolean 255.0 AUTOSAR_Platform_CompuMethods_boolean 0.0 255. FORMAT "%10.5" /end CHARACTERISTIC
/begin CHARACTERISTIC DWC_CALIB.DWC_K2DeviceControl.DWC_ClosedPressureDiag.DWC_ENABLEHYSTERESISFORDITHER "" VALUE 0x8060EE04 DefaultValueRecordLayout_AUTOSAR_Platform_BaseTypes_boolean 255.0 AUTOSAR_Platform_CompuMethods_boolean 0.0 255. FORMAT "%10.5"
 /begin ANNOTATION ANNOTATION_LABEL "Description (coming from AUTOSAR DESC field)"
  /begin ANNOTATION_TEXT "Use hysteresis when enabling dither in a pressure error scenario.\r\n" /end ANNOTATION_TEXT
 /end ANNOTATION
/end CHARACTERISTIC
/begin CHARACTERISTIC DWC_CALIB.DWC_K2DeviceControl.DWC_CLUBLIPABORTSPEED "" VALUE 0x8060ED1C DefaultValueRecordLayout_AUTOSAR_Platform_BaseTypes_sint16 40000.0 RB_PT_PCT_SWC_DWC_CompuMethods_ident -20000. 20000. FORMAT "%10.5"
 /begin ANNOTATION ANNOTATION_LABEL "Description (coming from AUTOSAR DESC field)" /begin ANNOTATION_TEXT "Input speed at which to abort blip.\r\n" /end ANNOTATION_TEXT /end ANNOTATION
/end CHARACTERISTIC
/begin CHARACTERISTIC DWC_CALIB.DWC_K2DeviceControl.DWC_CLUBLIPSPDMONTYPE "" VALUE 0x8060ED3A DefaultValueRecordLayout_AUTOSAR_Platform_BaseTypes_uint8 2.0 RB_PT_PCT_SWC_DWC_CompuMethods_ident 0.0 2. FORMAT "%10.5"
 /begin ANNOTATION ANNOTATION_LABEL "Description (coming from AUTOSAR DESC field)"
  /begin ANNOTATION_TEXT "Speed monitoring type, 0 = OFF, 1 = Abort above input speed, 2 = wait at KP until speed seen.\r\n" /end ANNOTATION_TEXT
 /end ANNOTATION
/end CHARACTERISTIC
/begin CHARACTERISTIC DWC_CALIB.DWC_K2DeviceControl.DWC_CLUBLIPTIMEOUT "" VALUE 0x8060ED1E DefaultValueRecordLayout_AUTOSAR_Platform_BaseTypes_uint16 1.0 RB_PT_PCT_SWC_DWC_CompuMethods_ratio_0p001__2 0.0 1. FORMAT "%10.5"
 /begin ANNOTATION ANNOTATION_LABEL "Description (coming from AUTOSAR DESC field)" /begin ANNOTATION_TEXT "Timeout for clutch blip.\r\n" /end ANNOTATION_TEXT /end ANNOTATION
/end CHARACTERISTIC
/begin CHARACTERISTIC DWC_CALIB.DWC_K2DeviceControl.DWC_CLUBLIPTMFACTPROF "" CURVE 0x8060F068 RB_PT_PCT_SWC_DWC_RecordLayouts_RL_Curve_uint8_11_uint8_11 1.0 RB_PT_PCT_SWC_DWC_CompuMethods_ratio_0p01 0.0 1. FORMAT "%10.5"
 /begin ANNOTATION ANNOTATION_LABEL "Description (coming from AUTOSAR DESC field)" /begin ANNOTATION_TEXT "Clutch blip profile based on time factor.\r\n" /end ANNOTATION_TEXT /end ANNOTATION
 /begin AXIS_DESCR STD_AXIS NO_INPUT_QUANTITY RB_PT_PCT_SWC_DWC_CompuMethods_ratio_0p01 11 0.0 1. FORMAT "%10.5" DEPOSIT ABSOLUTE /end AXIS_DESCR
/end CHARACTERISTIC
/begin CHARACTERISTIC DWC_CALIB.DWC_K2DeviceControl.DWC_Clutch "" VALUE 0x8060ED3B DefaultValueRecordLayout_AUTOSAR_Platform_BaseTypes_uint8 2.0 RB_PT_PCT_SWC_DWC_CompuMethods_ident 0.0 2. FORMAT "%10.5"
 /begin ANNOTATION ANNOTATION_LABEL "Description (coming from AUTOSAR DESC field)"
  /begin ANNOTATION_TEXT "Indication of which clutch is assigned to device controller dataset.\r\n" /end ANNOTATION_TEXT
 /end ANNOTATION
/end CHARACTERISTIC
/begin CHARACTERISTIC DWC_CALIB.DWC_K2DeviceControl.DWC_CLUTCHBLIPHIGHPRESS "" VALUE 0x8060ED20 DefaultValueRecordLayout_AUTOSAR_Platform_BaseTypes_sint16 34.0 RB_PT_PCT_SWC_DWC_CompuMethods_ratio_0p001__2 -2. 32. FORMAT "%10.5"
 /begin ANNOTATION ANNOTATION_LABEL "Description (coming from AUTOSAR DESC field)"
  /begin ANNOTATION_TEXT "Pressure threshold for potential torque transfer during gear engagements.\r\n" /end ANNOTATION_TEXT
 /end ANNOTATION
/end CHARACTERISTIC
/begin CHARACTERISTIC DWC_CALIB.DWC_K2DeviceControl.DWC_CLUTCHBLIPTIME "" CURVE 0x8060F080 RB_PT_PCT_SWC_DWC_RecordLayouts_RL_Curve_uint8_4_sint16_4 1.0 RB_PT_PCT_SWC_DWC_CompuMethods_ratio_0p01 0.0 1. FORMAT "%10.5"
 /begin ANNOTATION ANNOTATION_LABEL "Description (coming from AUTOSAR DESC field)" /begin ANNOTATION_TEXT "Time for clutch blip\r\n" /end ANNOTATION_TEXT /end ANNOTATION
 /begin AXIS_DESCR STD_AXIS NO_INPUT_QUANTITY RB_PT_PCT_SWC_DWC_CompuMethods_ident 4 -50. 200. FORMAT "%10.5" DEPOSIT ABSOLUTE /end AXIS_DESCR
/end CHARACTERISTIC
/begin CHARACTERISTIC DWC_CALIB.DWC_K2DeviceControl.DWC_ENABLEFAIL37GEARSTATUS "" VALUE 0x8060ED3C DefaultValueRecordLayout_AUTOSAR_Platform_BaseTypes_uint8 255.0 DefaultIdenticalCompu 0.0 255. FORMAT "%10.5"
 /begin ANNOTATION ANNOTATION_LABEL "Description (coming from AUTOSAR DESC field)"
  /begin ANNOTATION_TEXT "flag to enable failing of bank of gears for 37 gear status\r\n" /end ANNOTATION_TEXT
 /end ANNOTATION
/end CHARACTERISTIC
/begin CHARACTERISTIC DWC_CALIB.DWC_K2DeviceControl.DWC_ENABLEFAILEDSTATUSFORUSERABORT "" VALUE 0x8060ED3D DefaultValueRecordLayout_AUTOSAR_Platform_BaseTypes_boolean 255.0 AUTOSAR_Platform_CompuMethods_boolean 0.0 255. FORMAT "%10.5"
 /begin ANNOTATION ANNOTATION_LABEL "Description (coming from AUTOSAR DESC field)"
  /begin ANNOTATION_TEXT "Allow the reported status to say 'failed' if the user aborts a routine.\r\n" /end ANNOTATION_TEXT
 /end ANNOTATION
/end CHARACTERISTIC
/begin CHARACTERISTIC DWC_CALIB.DWC_K2DeviceControl.DWC_ENABLESELFTESTDIAGNOSTIC "" VALUE 0x8060ED3E DefaultValueRecordLayout_AUTOSAR_Platform_BaseTypes_boolean 255.0 AUTOSAR_Platform_CompuMethods_boolean 0.0 255. FORMAT "%10.5"
 /begin ANNOTATION ANNOTATION_LABEL "Description (coming from AUTOSAR DESC field)"
  /begin ANNOTATION_TEXT "Flag to enable diagnostics when in self test and no routine running.\r\n" /end ANNOTATION_TEXT
 /end ANNOTATION
/end CHARACTERISTIC
/begin CHARACTERISTIC DWC_CALIB.DWC_K2DeviceControl.DWC_ENGOFFPRESS "" CURVE 0x8060F08E RB_PT_PCT_SWC_DWC_RecordLayouts_RL_Curve_sint16_4_uint8_4 34.0 RB_PT_PCT_SWC_DWC_CompuMethods_ratio_0p001__2 -2. 32. FORMAT "%10.5"
 /begin ANNOTATION ANNOTATION_LABEL "Description (coming from AUTOSAR DESC field)" /begin ANNOTATION_TEXT "Pressure request when engine is off.\r\n" /end ANNOTATION_TEXT /end ANNOTATION
 /begin AXIS_DESCR STD_AXIS NO_INPUT_QUANTITY RB_PT_PCT_SWC_DWC_CompuMethods_ratio_0p005 4 0.0 1. FORMAT "%10.5" DEPOSIT ABSOLUTE /end AXIS_DESCR
/end CHARACTERISTIC
/begin CHARACTERISTIC DWC_CALIB.DWC_K2DeviceControl.DWC_FillController.DWC_FLGENABLEFILLTEST "" VALUE 0x8060EE08 DefaultValueRecordLayout_AUTOSAR_Platform_BaseTypes_boolean 255.0 AUTOSAR_Platform_CompuMethods_boolean 0.0 255. FORMAT "%10.5"
 /begin ANNOTATION ANNOTATION_LABEL "Description (coming from AUTOSAR DESC field)"
  /begin ANNOTATION_TEXT "Set true to use a single parameter for fill pressure for testing/characterisation work\r\n" /end ANNOTATION_TEXT
 /end ANNOTATION
/end CHARACTERISTIC
/begin CHARACTERISTIC DWC_CALIB.DWC_K2DeviceControl.DWC_FillController.DWC_PRESFILLTEST "" VALUE 0x8060EE06 DefaultValueRecordLayout_AUTOSAR_Platform_BaseTypes_uint16 32.0 RB_PT_PCT_SWC_DWC_CompuMethods_ratio_0p001__2 0.0 32. FORMAT "%10.5"
 /begin ANNOTATION ANNOTATION_LABEL "Description (coming from AUTOSAR DESC field)" /begin ANNOTATION_TEXT "Pressure for fill test\r\n" /end ANNOTATION_TEXT /end ANNOTATION
/end CHARACTERISTIC
/begin CHARACTERISTIC DWC_CALIB.DWC_K2DeviceControl.DWC_FLGCLUTCHBLIPENABLED "" VALUE 0x8060ED3F DefaultValueRecordLayout_AUTOSAR_Platform_BaseTypes_boolean 255.0 AUTOSAR_Platform_CompuMethods_boolean 0.0 255. FORMAT "%10.5"
 /begin ANNOTATION ANNOTATION_LABEL "Description (coming from AUTOSAR DESC field)" /begin ANNOTATION_TEXT "Flag to enable clutch blip requests from GAC.\r\n" /end ANNOTATION_TEXT /end ANNOTATION
/end CHARACTERISTIC
/begin CHARACTERISTIC DWC_CALIB.DWC_K2DeviceControl.DWC_FLGDISABLEDIAG4DEPRESSURE "" VALUE 0x8060ED40 DefaultValueRecordLayout_AUTOSAR_Platform_BaseTypes_boolean 255.0 AUTOSAR_Platform_CompuMethods_boolean 0.0 255. FORMAT "%10.5"
 /begin ANNOTATION ANNOTATION_LABEL "Description (coming from AUTOSAR DESC field)"
  /begin ANNOTATION_TEXT "Disable DWC diagnostics when a depressure routine is active.\r\n" /end ANNOTATION_TEXT
 /end ANNOTATION
/end CHARACTERISTIC
/begin CHARACTERISTIC DWC_CALIB.DWC_K2DeviceControl.DWC_FLGENABLEAUTOVALVECLOSEDCLEAN "" VALUE 0x8060ED41 DefaultValueRecordLayout_AUTOSAR_Platform_BaseTypes_uint8 255.0 DefaultIdenticalCompu 0.0 255. FORMAT "%10.5"
 /begin ANNOTATION ANNOTATION_LABEL "Description (coming from AUTOSAR DESC field)" /begin ANNOTATION_TEXT "Enable automatic cleaning on a closed clutch\r\n" /end ANNOTATION_TEXT /end ANNOTATION
/end CHARACTERISTIC
/begin CHARACTERISTIC DWC_CALIB.DWC_K2DeviceControl.DWC_FLGENABLEAUTOVALVEOPENCLEAN "" VALUE 0x8060ED42 DefaultValueRecordLayout_AUTOSAR_Platform_BaseTypes_uint8 255.0 DefaultIdenticalCompu 0.0 255. FORMAT "%10.5"
 /begin ANNOTATION ANNOTATION_LABEL "Description (coming from AUTOSAR DESC field)" /begin ANNOTATION_TEXT "Enable automatic cleaning on an open clutch\r\n" /end ANNOTATION_TEXT /end ANNOTATION
/end CHARACTERISTIC
/begin CHARACTERISTIC DWC_CALIB.DWC_K2DeviceControl.DWC_FLGENABLEAUTOVALVERINSE "" VALUE 0x8060ED43 DefaultValueRecordLayout_AUTOSAR_Platform_BaseTypes_uint8 255.0 DefaultIdenticalCompu 0.0 255. FORMAT "%10.5"
 /begin ANNOTATION ANNOTATION_LABEL "Description (coming from AUTOSAR DESC field)" /begin ANNOTATION_TEXT "Enable automatic rinsing on the clutch valve\r\n" /end ANNOTATION_TEXT /end ANNOTATION
/end CHARACTERISTIC
/begin CHARACTERISTIC DWC_CALIB.DWC_K2DeviceControl.DWC_FLGENABLEENGOFFPRES "" VALUE 0x8060ED44 DefaultValueRecordLayout_AUTOSAR_Platform_BaseTypes_boolean 255.0 AUTOSAR_Platform_CompuMethods_boolean 0.0 255. FORMAT "%10.5"
 /begin ANNOTATION ANNOTATION_LABEL "Description (coming from AUTOSAR DESC field)"
  /begin ANNOTATION_TEXT "Flag to enable seperate engine off pressure for rinsing.\r\n" /end ANNOTATION_TEXT
 /end ANNOTATION
/end CHARACTERISTIC
/begin CHARACTERISTIC DWC_CALIB.DWC_K2DeviceControl.DWC_FLGENABLEFAILEDHYBMDTABLE "" VALUE 0x8060ED45 DefaultValueRecordLayout_AUTOSAR_Platform_BaseTypes_boolean 255.0 AUTOSAR_Platform_CompuMethods_boolean 0.0 255. FORMAT "%10.5"
 /begin ANNOTATION ANNOTATION_LABEL "Description (coming from AUTOSAR DESC field)"
  /begin ANNOTATION_TEXT "Flag to enable DWC device controller to write to failed hybrid mode table.\r\n" /end ANNOTATION_TEXT
 /end ANNOTATION
/end CHARACTERISTIC
/begin CHARACTERISTIC DWC_CALIB.DWC_K2DeviceControl.DWC_FLGFORCETPRESET "" VALUE 0x8060ED46 DefaultValueRecordLayout_AUTOSAR_Platform_BaseTypes_boolean 255.0 AUTOSAR_Platform_CompuMethods_boolean 0.0 255. FORMAT "%10.5"
 /begin ANNOTATION ANNOTATION_LABEL "Description (coming from AUTOSAR DESC field)" /begin ANNOTATION_TEXT "Set true to force torque to pressure reset\r\n" /end ANNOTATION_TEXT /end ANNOTATION
/end CHARACTERISTIC
/begin CHARACTERISTIC DWC_CALIB.DWC_K2DeviceControl.DWC_FLGFORCEZEROPRSFAILGEAR "" VALUE 0x8060ED47 DefaultValueRecordLayout_AUTOSAR_Platform_BaseTypes_boolean 255.0 AUTOSAR_Platform_CompuMethods_boolean 0.0 255. FORMAT "%10.5"
 /begin ANNOTATION ANNOTATION_LABEL "Description (coming from AUTOSAR DESC field)"
  /begin ANNOTATION_TEXT "Flag to force pressure demand to zero when gears are failed.\r\n" /end ANNOTATION_TEXT
 /end ANNOTATION
/end CHARACTERISTIC
/begin CHARACTERISTIC DWC_CALIB.DWC_K2DeviceControl.DWC_FORCENOPREFILLBEFORESO "" VALUE 0x8060ED48 DefaultValueRecordLayout_AUTOSAR_Platform_BaseTypes_uint8 255.0 DefaultIdenticalCompu 0.0 255. FORMAT "%10.5" /end CHARACTERISTIC
/begin CHARACTERISTIC DWC_CALIB.DWC_K2DeviceControl.DWC_L2MaxDoubleSeqTime "" VALUE 0x8060ED22 DefaultValueRecordLayout_AUTOSAR_Platform_BaseTypes_uint16 327.675 RB_PT_PCT_SWC_DWC_CompuMethods_ratio_0p005 0.0 327.675 FORMAT "%10.5"
 /begin ANNOTATION ANNOTATION_LABEL "Description (coming from AUTOSAR DESC field)"
  /begin ANNOTATION_TEXT "Time the L2 sequence will stop and open both clutches\r\n" /end ANNOTATION_TEXT
 /end ANNOTATION
/end CHARACTERISTIC
/begin CHARACTERISTIC DWC_CALIB.DWC_K2DeviceControl.DWC_L2SetTroque "" CURVE 0x8060F09C RB_PT_PCT_SWC_DWC_RecordLayouts_RL_Curve_sint16_50_uint16_50 4000.0 RB_PT_PCT_SWC_DWC_CompuMethods_ratio_0p1 -2000. 2000. FORMAT "%10.5"
 /begin ANNOTATION ANNOTATION_LABEL "Description (coming from AUTOSAR DESC field)" /begin ANNOTATION_TEXT "Torque sequence in relation to time.\r\n" /end ANNOTATION_TEXT /end ANNOTATION
 /begin AXIS_DESCR STD_AXIS NO_INPUT_QUANTITY RB_PT_PCT_SWC_DWC_CompuMethods_ratio_0p005 50 0.0 327.675 FORMAT "%10.5" DEPOSIT ABSOLUTE /end AXIS_DESCR
/end CHARACTERISTIC
/begin CHARACTERISTIC DWC_CALIB.DWC_K2DeviceControl.DWC_LINEPRESSUREDIAGDISABLE "" VALUE 0x8060ED24 DefaultValueRecordLayout_AUTOSAR_Platform_BaseTypes_sint16 105.0 RB_PT_PCT_SWC_DWC_CompuMethods_ratio_0p005 -5. 100. FORMAT "%10.5"
 /begin ANNOTATION ANNOTATION_LABEL "Description (coming from AUTOSAR DESC field)" /begin ANNOTATION_TEXT "Lower line pressure at which diags become disabled.\r\n" /end ANNOTATION_TEXT /end ANNOTATION
/end CHARACTERISTIC
/begin CHARACTERISTIC DWC_CALIB.DWC_K2DeviceControl.DWC_MAXOUTPUTSPDFORCLUTCHBLIP "" VALUE 0x8060ED26 DefaultValueRecordLayout_AUTOSAR_Platform_BaseTypes_sint16 40000.0 RB_PT_PCT_SWC_DWC_CompuMethods_ident -20000. 20000. FORMAT "%10.5"
 /begin ANNOTATION ANNOTATION_LABEL "Description (coming from AUTOSAR DESC field)" /begin ANNOTATION_TEXT "Minimum outspeed to allow for clutch blip\r\n" /end ANNOTATION_TEXT /end ANNOTATION
/end CHARACTERISTIC
/begin CHARACTERISTIC DWC_CALIB.DWC_K2DeviceControl.DWC_MINLINEPRESSURE4DIAG "" VALUE 0x8060ED28 DefaultValueRecordLayout_AUTOSAR_Platform_BaseTypes_sint16 105.0 RB_PT_PCT_SWC_DWC_CompuMethods_ratio_0p005 -5. 100. FORMAT "%10.5"
 /begin ANNOTATION ANNOTATION_LABEL "Description (coming from AUTOSAR DESC field)"
  /begin ANNOTATION_TEXT "Minimum line pressure to be seen to enable DC diagnostics.\r\n" /end ANNOTATION_TEXT
 /end ANNOTATION
/end CHARACTERISTIC
/begin CHARACTERISTIC DWC_CALIB.DWC_K2DeviceControl.DWC_MINSOHLINEPRESSURE "" VALUE 0x8060ED2A DefaultValueRecordLayout_AUTOSAR_Platform_BaseTypes_sint16 105.0 RB_PT_PCT_SWC_DWC_CompuMethods_ratio_0p005 -5. 100. FORMAT "%10.5"
 /begin ANNOTATION ANNOTATION_LABEL "Description (coming from AUTOSAR DESC field)" /begin ANNOTATION_TEXT "Minimum line pressure to allow shut off test.\r\n" /end ANNOTATION_TEXT /end ANNOTATION
/end CHARACTERISTIC
/begin CHARACTERISTIC DWC_CALIB.DWC_K2DeviceControl.DWC_OPENDEMANDKICK "" CURVE 0x8060F166 RB_PT_PCT_SWC_DWC_RecordLayouts_RL_Curve_sint16_4_sint16_4 34.0 RB_PT_PCT_SWC_DWC_CompuMethods_ratio_0p001__2 -2. 32. FORMAT "%10.5"
 /begin ANNOTATION ANNOTATION_LABEL "Description (coming from AUTOSAR DESC field)" /begin ANNOTATION_TEXT "Temperature dependancy on prefill kick.\r\n" /end ANNOTATION_TEXT /end ANNOTATION
 /begin AXIS_DESCR STD_AXIS NO_INPUT_QUANTITY RB_PT_PCT_SWC_DWC_CompuMethods_ident 4 -50. 200. FORMAT "%10.5" DEPOSIT ABSOLUTE /end AXIS_DESCR
/end CHARACTERISTIC
/begin CHARACTERISTIC DWC_CALIB.DWC_K2DeviceControl.DWC_OpenPressureDiag.DWC_ENABLEHYSTERESISFORDITHER "" VALUE 0x8060EE0A DefaultValueRecordLayout_AUTOSAR_Platform_BaseTypes_boolean 255.0 AUTOSAR_Platform_CompuMethods_boolean 0.0 255. FORMAT "%10.5"
 /begin ANNOTATION ANNOTATION_LABEL "Description (coming from AUTOSAR DESC field)"
  /begin ANNOTATION_TEXT "Use hysteresis when enabling dither in a pressure error scenario.\r\n" /end ANNOTATION_TEXT
 /end ANNOTATION
/end CHARACTERISTIC
/begin CHARACTERISTIC DWC_CALIB.DWC_K2DeviceControl.DWC_PKFILTENGVSPRESRATE "" MAP 0x8060F178 RB_PT_PCT_SWC_DWC_RecordLayouts_RL_Map_uint16_48_uint16_6_sint16_8 1.0 RB_PT_PCT_SWC_DWC_CompuMethods_ratio_0p01 0.0 1. FORMAT "%10.5"
 /begin ANNOTATION ANNOTATION_LABEL "Description (coming from AUTOSAR DESC field)"
  /begin ANNOTATION_TEXT "Filter PK in relation to engine speed and rate of change target pressure\r\n" /end ANNOTATION_TEXT
 /end ANNOTATION
 /begin AXIS_DESCR STD_AXIS NO_INPUT_QUANTITY RB_PT_PCT_SWC_DWC_CompuMethods_ident 6 0.0 20000. FORMAT "%10.5" DEPOSIT ABSOLUTE /end AXIS_DESCR
 /begin AXIS_DESCR STD_AXIS NO_INPUT_QUANTITY RB_PT_PCT_SWC_DWC_CompuMethods_pressure_0p1 8 -3200. 3200. FORMAT "%10.5" DEPOSIT ABSOLUTE /end AXIS_DESCR
/end CHARACTERISTIC
/begin CHARACTERISTIC DWC_CALIB.DWC_K2DeviceControl.DWC_POSTFILLTIME "" VALUE 0x8060ED2C DefaultValueRecordLayout_AUTOSAR_Platform_BaseTypes_uint16 655.35 RB_PT_PCT_SWC_DWC_CompuMethods_DST_Time 0.0 655.35 FORMAT "%10.5"
 /begin ANNOTATION ANNOTATION_LABEL "Description (coming from AUTOSAR DESC field)"
  /begin ANNOTATION_TEXT "Time used to postpone pK filter after any form of fill.\r\n" /end ANNOTATION_TEXT
 /end ANNOTATION
/end CHARACTERISTIC
/begin CHARACTERISTIC DWC_CALIB.DWC_K2DeviceControl.DWC_PREFILLKICKMODE "" VALUE 0x8060ED49 DefaultValueRecordLayout_AUTOSAR_Platform_BaseTypes_uint8 2.0 RB_PT_PCT_SWC_DWC_CompuMethods_ident 0.0 2. FORMAT "%10.5" /end CHARACTERISTIC
/begin CHARACTERISTIC DWC_CALIB.DWC_K2DeviceControl.DWC_PRES2CLUBLIPMAG "" MAP 0x8060F1F8 RB_PT_PCT_SWC_DWC_RecordLayouts_RL_Map_uint8_24_sint16_6_sint16_4 15.0 RB_PT_PCT_SWC_DWC_CompuMethods_ratio_0p1 0.0 15. FORMAT "%10.5"
 /begin ANNOTATION ANNOTATION_LABEL "Description (coming from AUTOSAR DESC field)" /begin ANNOTATION_TEXT "Pressure to clutch blip magnitude.\r\n" /end ANNOTATION_TEXT /end ANNOTATION
 /begin AXIS_DESCR STD_AXIS NO_INPUT_QUANTITY RB_PT_PCT_SWC_DWC_CompuMethods_ratio_0p001__2 6 -2. 32. FORMAT "%10.5" DEPOSIT ABSOLUTE /end AXIS_DESCR
 /begin AXIS_DESCR STD_AXIS NO_INPUT_QUANTITY RB_PT_PCT_SWC_DWC_CompuMethods_ident 4 -50. 200. FORMAT "%10.5" DEPOSIT ABSOLUTE /end AXIS_DESCR
/end CHARACTERISTIC
/begin CHARACTERISTIC DWC_CALIB.DWC_K2DeviceControl.DWC_PressCurrent.DWC_HYSTERESISBANDWIDTH "" MAP 0x8060EE14 RB_PT_PCT_SWC_DWC_RecordLayouts_RL_Map_uint16_55_sint16_11_sint16_5 1.0 RB_PT_PCT_SWC_DWC_CompuMethods_ratio_0p0001 0.0 1. FORMAT "%10.5"
 /begin AXIS_DESCR STD_AXIS NO_INPUT_QUANTITY RB_PT_PCT_SWC_DWC_CompuMethods_ratio_0p001__2 11 -2. 32. FORMAT "%10.5" DEPOSIT ABSOLUTE /end AXIS_DESCR
 /begin AXIS_DESCR STD_AXIS NO_INPUT_QUANTITY RB_PT_PCT_SWC_DWC_CompuMethods_ident 5 -50. 200. FORMAT "%10.5" DEPOSIT ABSOLUTE /end AXIS_DESCR
/end CHARACTERISTIC
/begin CHARACTERISTIC DWC_CALIB.DWC_K2DeviceControl.DWC_PressCurrent.DWC_MAXCURDEMFORADAPTION "" VALUE 0x8060EE0C DefaultValueRecordLayout_AUTOSAR_Platform_BaseTypes_uint16 5000.0 RB_PT_PCT_SWC_DWC_CompuMethods_ident 0.0 5000. FORMAT "%10.5"
 /begin ANNOTATION ANNOTATION_LABEL "Description (coming from AUTOSAR DESC field)" /begin ANNOTATION_TEXT "Maximum allowed current demand to allow adaption.\r\n" /end ANNOTATION_TEXT /end ANNOTATION
/end CHARACTERISTIC
/begin CHARACTERISTIC DWC_CALIB.DWC_K2DeviceControl.DWC_PressCurrent.DWC_MINDYNAMICPCTEMP "" VALUE 0x8060EE0E DefaultValueRecordLayout_AUTOSAR_Platform_BaseTypes_sint16 250.0 RB_PT_PCT_SWC_DWC_CompuMethods_ident -50. 200. FORMAT "%10.5"
 /begin ANNOTATION ANNOTATION_LABEL "Description (coming from AUTOSAR DESC field)"
  /begin ANNOTATION_TEXT "Temperature condition for dynamic pressure to current.\r\n" /end ANNOTATION_TEXT
 /end ANNOTATION
/end CHARACTERISTIC
/begin CHARACTERISTIC DWC_CALIB.DWC_K2DeviceControl.DWC_PressCurrent.DWC_MINLINEPRESSADAPT "" VALUE 0x8060EE10 DefaultValueRecordLayout_AUTOSAR_Platform_BaseTypes_sint16 105.0 RB_PT_PCT_SWC_DWC_CompuMethods_ratio_0p005 -5. 100. FORMAT "%10.5"
 /begin ANNOTATION ANNOTATION_LABEL "Description (coming from AUTOSAR DESC field)" /begin ANNOTATION_TEXT "Minimum line pressure for adaption to run.\r\n" /end ANNOTATION_TEXT /end ANNOTATION
/end CHARACTERISTIC
/begin CHARACTERISTIC DWC_CALIB.DWC_K2DeviceControl.DWC_PressCurrent.DWC_PIAdaptAutoReset "" VALUE 0x8060EE12 DefaultValueRecordLayout_AUTOSAR_Platform_BaseTypes_uint8 255.0 DefaultIdenticalCompu 0.0 255. FORMAT "%10.5"
 /begin ANNOTATION ANNOTATION_LABEL "Description (coming from AUTOSAR DESC field)"
  /begin ANNOTATION_TEXT "Allow auto reset if PI adaption hits the max allowable limits.\r\n" /end ANNOTATION_TEXT
 /end ANNOTATION
/end CHARACTERISTIC
/begin CHARACTERISTIC DWC_CALIB.DWC_K2DeviceControl.DWC_PressCurrent.DWC_PIDFEEDFORWARD "" MAP 0x8060EEA6 RB_PT_PCT_SWC_DWC_RecordLayouts_RL_Map_sint16_49_sint16_7_sint16_7 2000.0 RB_PT_PCT_SWC_DWC_CompuMethods_ident -1000. 1000. FORMAT "%10.5"
 /begin AXIS_DESCR STD_AXIS NO_INPUT_QUANTITY RB_PT_PCT_SWC_DWC_CompuMethods_ratio_0p001__2 7 -32. 32. FORMAT "%10.5" DEPOSIT ABSOLUTE /end AXIS_DESCR
 /begin AXIS_DESCR STD_AXIS NO_INPUT_QUANTITY RB_PT_PCT_SWC_DWC_CompuMethods_ratio_0p001__2 7 -32. 32. FORMAT "%10.5" DEPOSIT ABSOLUTE /end AXIS_DESCR
/end CHARACTERISTIC
/begin CHARACTERISTIC DWC_CALIB.DWC_K2DeviceControl.DWC_PressCurrent.DWC_VALVEINTEGRALTEMPFACTOR "" CURVE 0x8060EF28 RB_PT_PCT_SWC_DWC_RecordLayouts_RL_Curve_uint8_7_sint16_7 1.0 RB_PT_PCT_SWC_DWC_CompuMethods_ratio_0p01 0.0 1. FORMAT "%10.5"
 /begin ANNOTATION ANNOTATION_LABEL "Description (coming from AUTOSAR DESC field)" /begin ANNOTATION_TEXT "Temperature based factor for valve integral gain.\r\n" /end ANNOTATION_TEXT /end ANNOTATION
 /begin AXIS_DESCR STD_AXIS NO_INPUT_QUANTITY RB_PT_PCT_SWC_DWC_CompuMethods_ident 7 -50. 200. FORMAT "%10.5" DEPOSIT ABSOLUTE /end AXIS_DESCR
/end CHARACTERISTIC
/begin CHARACTERISTIC DWC_CALIB.DWC_K2DeviceControl.DWC_PRESSUREDELAYRATECALC "" VALUE 0x8060ED4A DefaultValueRecordLayout_AUTOSAR_Platform_BaseTypes_uint8 30.0 RB_PT_PCT_SWC_DWC_CompuMethods_ident 0.0 30. FORMAT "%10.5"
 /begin ANNOTATION ANNOTATION_LABEL "Description (coming from AUTOSAR DESC field)" /begin ANNOTATION_TEXT "sample period to calc pressure tgt rate of change\r\n" /end ANNOTATION_TEXT /end ANNOTATION
/end CHARACTERISTIC
/begin CHARACTERISTIC DWC_CALIB.DWC_K2DeviceControl.DWC_PtoCSequence.DWC_MAXSLIP4TXISSUE "" VALUE 0x8060EF40 DefaultValueRecordLayout_AUTOSAR_Platform_BaseTypes_sint16 40000.0 RB_PT_PCT_SWC_DWC_CompuMethods_ident -20000. 20000. FORMAT "%10.5"
 /begin ANNOTATION ANNOTATION_LABEL "Description (coming from AUTOSAR DESC field)"
  /begin ANNOTATION_TEXT "Max permissible slip during a PI adaption when adapting PI\r\n" /end ANNOTATION_TEXT
 /end ANNOTATION
/end CHARACTERISTIC
/begin CHARACTERISTIC DWC_CALIB.DWC_K2DeviceControl.DWC_PtoCSequence.DWC_MINOPSPEEDFORDYNAMICPC "" VALUE 0x8060EF42 DefaultValueRecordLayout_AUTOSAR_Platform_BaseTypes_sint16 40000.0 RB_PT_PCT_SWC_DWC_CompuMethods_ident -20000. 20000. FORMAT "%10.5"
 /begin ANNOTATION ANNOTATION_LABEL "Description (coming from AUTOSAR DESC field)"
  /begin ANNOTATION_TEXT "Minimum output speed required to run dynamic pc. Logic added to prevent stationary pc learn in neutral/park\r\n" /end ANNOTATION_TEXT
 /end ANNOTATION
/end CHARACTERISTIC
/begin CHARACTERISTIC DWC_CALIB.DWC_K2DeviceControl.DWC_RESETPICLOSEDSTATUS "" VALUE 0x8060ED4B DefaultValueRecordLayout_AUTOSAR_Platform_BaseTypes_uint8 255.0 DefaultIdenticalCompu 0.0 255. FORMAT "%10.5"
 /begin ANNOTATION ANNOTATION_LABEL "Description (coming from AUTOSAR DESC field)" /begin ANNOTATION_TEXT "Flag to enable the reset of PI on closed status.\r\n" /end ANNOTATION_TEXT /end ANNOTATION
/end CHARACTERISTIC
/begin CHARACTERISTIC DWC_CALIB.DWC_K2DeviceControl.DWC_RESETPIOPENSTATUS "" VALUE 0x8060ED4C DefaultValueRecordLayout_AUTOSAR_Platform_BaseTypes_uint8 255.0 DefaultIdenticalCompu 0.0 255. FORMAT "%10.5"
 /begin ANNOTATION ANNOTATION_LABEL "Description (coming from AUTOSAR DESC field)" /begin ANNOTATION_TEXT "Flag to enable the reset of PI on open status.\r\n" /end ANNOTATION_TEXT /end ANNOTATION
/end CHARACTERISTIC
/begin CHARACTERISTIC DWC_CALIB.DWC_K2DeviceControl.DWC_SEQTORQUE "" CURVE 0x8060F228 RB_PT_PCT_SWC_DWC_RecordLayouts_RL_Curve_sint16_50_uint16_50 4000.0 RB_PT_PCT_SWC_DWC_CompuMethods_ratio_0p1 -2000. 2000. FORMAT "%10.5"
 /begin ANNOTATION ANNOTATION_LABEL "Description (coming from AUTOSAR DESC field)" /begin ANNOTATION_TEXT "Torque sequence in relation to time.\r\n" /end ANNOTATION_TEXT /end ANNOTATION
 /begin AXIS_DESCR STD_AXIS NO_INPUT_QUANTITY RB_PT_PCT_SWC_DWC_CompuMethods_ratio_0p005 50 0.0 327.675 FORMAT "%10.5" DEPOSIT ABSOLUTE /end AXIS_DESCR
/end CHARACTERISTIC
/begin CHARACTERISTIC DWC_CALIB.DWC_K2DeviceControl.DWC_ShutOffHandler.DWC_FLGALLOWAUTOPASSSOH "" VALUE 0x8060EF46 DefaultValueRecordLayout_AUTOSAR_Platform_BaseTypes_boolean 255.0 AUTOSAR_Platform_CompuMethods_boolean 0.0 255. FORMAT "%10.5"
 /begin ANNOTATION ANNOTATION_LABEL "Description (coming from AUTOSAR DESC field)" /begin ANNOTATION_TEXT "Flag to enable the SOH auto pass logic.\r\n" /end ANNOTATION_TEXT /end ANNOTATION
/end CHARACTERISTIC
/begin CHARACTERISTIC DWC_CALIB.DWC_K2DeviceControl.DWC_ShutOffHandler.DWC_FLGALLOWSLAVESOTEST "" VALUE 0x8060EF47 DefaultValueRecordLayout_AUTOSAR_Platform_BaseTypes_boolean 255.0 AUTOSAR_Platform_CompuMethods_boolean 0.0 255. FORMAT "%10.5"
 /begin ANNOTATION ANNOTATION_LABEL "Description (coming from AUTOSAR DESC field)"
  /begin ANNOTATION_TEXT "Flag to enable slave to run SO test if master is failed.\r\n" /end ANNOTATION_TEXT
 /end ANNOTATION
/end CHARACTERISTIC
/begin CHARACTERISTIC DWC_CALIB.DWC_K2DeviceControl.DWC_ShutOffHandler.DWC_FLGENABLEAUTOFAIL "" VALUE 0x8060EF48 DefaultValueRecordLayout_AUTOSAR_Platform_BaseTypes_boolean 255.0 AUTOSAR_Platform_CompuMethods_boolean 0.0 255. FORMAT "%10.5"
 /begin ANNOTATION ANNOTATION_LABEL "Description (coming from AUTOSAR DESC field)" /begin ANNOTATION_TEXT "Flag to enable auto fail logic.\r\n" /end ANNOTATION_TEXT /end ANNOTATION
/end CHARACTERISTIC
/begin CHARACTERISTIC DWC_CALIB.DWC_K2DeviceControl.DWC_ShutOffHandler.DWC_FLGENABLEFIRSTSTATETIMEOUT "" VALUE 0x8060EF49 DefaultValueRecordLayout_AUTOSAR_Platform_BaseTypes_boolean 255.0 AUTOSAR_Platform_CompuMethods_boolean 0.0 255. FORMAT "%10.5"
 /begin ANNOTATION ANNOTATION_LABEL "Description (coming from AUTOSAR DESC field)" /begin ANNOTATION_TEXT "Flag to enable a timeout in the first state.\r\n" /end ANNOTATION_TEXT /end ANNOTATION
/end CHARACTERISTIC
/begin CHARACTERISTIC DWC_CALIB.DWC_K2DeviceControl.DWC_ShutOffHandler.DWC_FLGOVRDDEVCHECK "" VALUE 0x8060EF4A DefaultValueRecordLayout_AUTOSAR_Platform_BaseTypes_boolean 255.0 AUTOSAR_Platform_CompuMethods_boolean 0.0 255. FORMAT "%10.5"
 /begin ANNOTATION ANNOTATION_LABEL "Description (coming from AUTOSAR DESC field)"
  /begin ANNOTATION_TEXT "Flag to override device check in auto fail. Required to fix bug\r\n" /end ANNOTATION_TEXT
 /end ANNOTATION
/end CHARACTERISTIC
/begin CHARACTERISTIC DWC_CALIB.DWC_K2DeviceControl.DWC_ShutOffHandler.DWC_FLGUSESOMASTERRULE1FIX "" VALUE 0x8060EF4B DefaultValueRecordLayout_AUTOSAR_Platform_BaseTypes_boolean 255.0 AUTOSAR_Platform_CompuMethods_boolean 0.0 255. FORMAT "%10.5"
 /begin ANNOTATION ANNOTATION_LABEL "Description (coming from AUTOSAR DESC field)"
  /begin ANNOTATION_TEXT "Flag to use the functionality described in the comment for master rule 1.\r\n" /end ANNOTATION_TEXT
 /end ANNOTATION
/end CHARACTERISTIC
/begin CHARACTERISTIC DWC_CALIB.DWC_K2DeviceControl.DWC_ShutOffHandler.DWC_REINITSOHTEST "" VALUE 0x8060EF44 DefaultValueRecordLayout_AUTOSAR_Platform_BaseTypes_uint16 65535.0 RB_PT_PCT_SWC_DWC_CompuMethods_ident 0.0 65535. FORMAT "%10.5"
 /begin ANNOTATION ANNOTATION_LABEL "Description (coming from AUTOSAR DESC field)" /begin ANNOTATION_TEXT "Parameter to reinitialise the SOH test.\r\n" /end ANNOTATION_TEXT /end ANNOTATION
/end CHARACTERISTIC
/begin CHARACTERISTIC DWC_CALIB.DWC_K2DeviceControl.DWC_ShutOffHandler.DWC_RERUNONLYIFFAILED "" VALUE 0x8060EF4C DefaultValueRecordLayout_AUTOSAR_Platform_BaseTypes_boolean 255.0 AUTOSAR_Platform_CompuMethods_boolean 0.0 255. FORMAT "%10.5"
 /begin ANNOTATION ANNOTATION_LABEL "Description (coming from AUTOSAR DESC field)"
  /begin ANNOTATION_TEXT "Flag to re run SO test from diag reset only if the test has previously failed.\r\n" /end ANNOTATION_TEXT
 /end ANNOTATION
/end CHARACTERISTIC
/begin CHARACTERISTIC DWC_CALIB.DWC_K2DeviceControl.DWC_ShutOffHandler.DWC_SHUTOFFONLYFOR2FAILEDBANKS "" VALUE 0x8060EF4D DefaultValueRecordLayout_AUTOSAR_Platform_BaseTypes_boolean 255.0 AUTOSAR_Platform_CompuMethods_boolean 0.0 255. FORMAT "%10.5"
 /begin ANNOTATION ANNOTATION_LABEL "Description (coming from AUTOSAR DESC field)" /begin ANNOTATION_TEXT "Trigger the shut off only when 2 banks have failed.\r\n" /end ANNOTATION_TEXT /end ANNOTATION
/end CHARACTERISTIC
/begin CHARACTERISTIC DWC_CALIB.DWC_K2DeviceControl.DWC_ShutOffHandler.DWC_SOALLOWEDINSELFTEST "" VALUE 0x8060EF4E DefaultValueRecordLayout_AUTOSAR_Platform_BaseTypes_boolean 255.0 AUTOSAR_Platform_CompuMethods_boolean 0.0 255. FORMAT "%10.5"
 /begin ANNOTATION ANNOTATION_LABEL "Description (coming from AUTOSAR DESC field)"
  /begin ANNOTATION_TEXT "Flag to enabe log that allows shut off when clutch is in self test.\r\n" /end ANNOTATION_TEXT
 /end ANNOTATION
/end CHARACTERISTIC
/begin CHARACTERISTIC DWC_CALIB.DWC_K2DeviceControl.DWC_ShutOffHandler.DWC_SOHPRESSURENORESPONSETIMEMAP "" CURVE 0x8060EF50 RB_PT_PCT_SWC_DWC_RecordLayouts_RL_Curve_uint16_4_sint16_4 10.0 RB_PT_PCT_SWC_DWC_CompuMethods_ratio_0p001__2 0.0 10. FORMAT "%10.5"
 /begin ANNOTATION ANNOTATION_LABEL "Description (coming from AUTOSAR DESC field)"
  /begin ANNOTATION_TEXT "Maximum time, after which the clutch main pressure valve is considered failed/cut off valve failed on, against temp.\r\n" /end ANNOTATION_TEXT
 /end ANNOTATION
 /begin AXIS_DESCR STD_AXIS NO_INPUT_QUANTITY RB_PT_PCT_SWC_DWC_CompuMethods_ident 4 -50. 200. FORMAT "%10.5" DEPOSIT ABSOLUTE /end AXIS_DESCR
/end CHARACTERISTIC
/begin CHARACTERISTIC DWC_CALIB.DWC_K2DeviceControl.DWC_ShutOffHandler.DWC_SOHPRESSURESLOWRESPONSETIMEMAP "" CURVE 0x8060EF62 RB_PT_PCT_SWC_DWC_RecordLayouts_RL_Curve_uint16_4_sint16_4 10.0 RB_PT_PCT_SWC_DWC_CompuMethods_ratio_0p001__2 0.0 10. FORMAT "%10.5"
 /begin ANNOTATION ANNOTATION_LABEL "Description (coming from AUTOSAR DESC field)"
  /begin ANNOTATION_TEXT "Maximum time, after which the clutch main pressure valve is considered slow, and a larger request will be applied (also, starting diagnostics on that valve), against temp.\r\n" /end ANNOTATION_TEXT
 /end ANNOTATION
 /begin AXIS_DESCR STD_AXIS NO_INPUT_QUANTITY RB_PT_PCT_SWC_DWC_CompuMethods_ident 4 -50. 200. FORMAT "%10.5" DEPOSIT ABSOLUTE /end AXIS_DESCR
/end CHARACTERISTIC
/begin CHARACTERISTIC DWC_CALIB.DWC_K2DeviceControl.DWC_ShutOffHandler.DWC_SOHVALVERESPONSEMAXTIMEMAP "" CURVE 0x8060EF74 RB_PT_PCT_SWC_DWC_RecordLayouts_RL_Curve_uint16_4_sint16_4 10.0 RB_PT_PCT_SWC_DWC_CompuMethods_ratio_0p001__2 0.0 10. FORMAT "%10.5"
 /begin ANNOTATION ANNOTATION_LABEL "Description (coming from AUTOSAR DESC field)"
  /begin ANNOTATION_TEXT "Maximum time for shut off valve to respond, after which it will be marked as failed, against temp.\r\n" /end ANNOTATION_TEXT
 /end ANNOTATION
 /begin AXIS_DESCR STD_AXIS NO_INPUT_QUANTITY RB_PT_PCT_SWC_DWC_CompuMethods_ident 4 -50. 200. FORMAT "%10.5" DEPOSIT ABSOLUTE /end AXIS_DESCR
/end CHARACTERISTIC
/begin CHARACTERISTIC DWC_CALIB.DWC_K2DeviceControl.DWC_TEMPMAXVALVECLEAN "" VALUE 0x8060ED2E DefaultValueRecordLayout_AUTOSAR_Platform_BaseTypes_sint16 250.0 RB_PT_PCT_SWC_DWC_CompuMethods_ident -50. 200. FORMAT "%10.5"
 /begin ANNOTATION ANNOTATION_LABEL "Description (coming from AUTOSAR DESC field)" /begin ANNOTATION_TEXT "Maximum temperature to allow valve clean\r\n" /end ANNOTATION_TEXT /end ANNOTATION
/end CHARACTERISTIC
/begin CHARACTERISTIC DWC_CALIB.DWC_K2DeviceControl.DWC_TEMPMAXVALVERINSE "" VALUE 0x8060ED30 DefaultValueRecordLayout_AUTOSAR_Platform_BaseTypes_sint16 250.0 RB_PT_PCT_SWC_DWC_CompuMethods_ident -50. 200. FORMAT "%10.5"
 /begin ANNOTATION ANNOTATION_LABEL "Description (coming from AUTOSAR DESC field)" /begin ANNOTATION_TEXT "Maximum temperature to allow valve rinse\r\n" /end ANNOTATION_TEXT /end ANNOTATION
/end CHARACTERISTIC
/begin CHARACTERISTIC DWC_CALIB.DWC_K2DeviceControl.DWC_TEMPMINBLIP "" VALUE 0x8060ED32 DefaultValueRecordLayout_AUTOSAR_Platform_BaseTypes_sint16 250.0 RB_PT_PCT_SWC_DWC_CompuMethods_ident -50. 200. FORMAT "%10.5"
 /begin ANNOTATION ANNOTATION_LABEL "Description (coming from AUTOSAR DESC field)"
  /begin ANNOTATION_TEXT "Minimum blip temperature cal when temperature status is true.\r\n" /end ANNOTATION_TEXT
 /end ANNOTATION
/end CHARACTERISTIC
/begin CHARACTERISTIC DWC_CALIB.DWC_K2DeviceControl.DWC_TEMPMINVALVECLEAN "" VALUE 0x8060ED34 DefaultValueRecordLayout_AUTOSAR_Platform_BaseTypes_sint16 250.0 RB_PT_PCT_SWC_DWC_CompuMethods_ident -50. 200. FORMAT "%10.5"
 /begin ANNOTATION ANNOTATION_LABEL "Description (coming from AUTOSAR DESC field)" /begin ANNOTATION_TEXT "Minimum temperature to allow valve clean\r\n" /end ANNOTATION_TEXT /end ANNOTATION
/end CHARACTERISTIC
/begin CHARACTERISTIC DWC_CALIB.DWC_K2DeviceControl.DWC_TEMPMINVALVERINSE "" VALUE 0x8060ED36 DefaultValueRecordLayout_AUTOSAR_Platform_BaseTypes_sint16 250.0 RB_PT_PCT_SWC_DWC_CompuMethods_ident -50. 200. FORMAT "%10.5"
 /begin ANNOTATION ANNOTATION_LABEL "Description (coming from AUTOSAR DESC field)" /begin ANNOTATION_TEXT "Minimum temperature to allow valve rinse\r\n" /end ANNOTATION_TEXT /end ANNOTATION
/end CHARACTERISTIC
/begin CHARACTERISTIC DWC_CALIB.DWC_K2DeviceControl.DWC_TrqPress.DWC_ENABLEKPSTATEMIN "" VALUE 0x8060EF86 DefaultValueRecordLayout_AUTOSAR_Platform_BaseTypes_uint8 255.0 DefaultIdenticalCompu 0.0 255. FORMAT "%10.5"
 /begin ANNOTATION ANNOTATION_LABEL "Description (coming from AUTOSAR DESC field)" /begin ANNOTATION_TEXT "use to enable TP adaption fault for KP hit min limit\r\n" /end ANNOTATION_TEXT /end ANNOTATION
/end CHARACTERISTIC
/begin CHARACTERISTIC DWC_CALIB.DWC_K2DeviceControl.DWC_TrqPress.DWC_ENABLEMAXTPSTATEMAX "" VALUE 0x8060EF87 DefaultValueRecordLayout_AUTOSAR_Platform_BaseTypes_uint8 255.0 DefaultIdenticalCompu 0.0 255. FORMAT "%10.5"
 /begin ANNOTATION ANNOTATION_LABEL "Description (coming from AUTOSAR DESC field)"
  /begin ANNOTATION_TEXT "use to enable TP adaption fault for max torque max limit hit\r\n" /end ANNOTATION_TEXT
 /end ANNOTATION
/end CHARACTERISTIC
/begin CHARACTERISTIC DWC_CALIB.DWC_K2DeviceControl.DWC_TrqPress.DWC_ENABLEMAXTPSTATEMIN "" VALUE 0x8060EF88 DefaultValueRecordLayout_AUTOSAR_Platform_BaseTypes_uint8 255.0 DefaultIdenticalCompu 0.0 255. FORMAT "%10.5"
 /begin ANNOTATION ANNOTATION_LABEL "Description (coming from AUTOSAR DESC field)"
  /begin ANNOTATION_TEXT "use to enable TP adaption fault for max torque min limit hit\r\n" /end ANNOTATION_TEXT
 /end ANNOTATION
/end CHARACTERISTIC
/begin CHARACTERISTIC DWC_CALIB.DWC_K2DeviceControl.DWC_TrqPress.DWC_EnableTP67Copy "" VALUE 0x8060EF8A DefaultValueRecordLayout_AUTOSAR_Platform_BaseTypes_uint8 255.0 DefaultIdenticalCompu 0.0 255. FORMAT "%10.5"
 /begin ANNOTATION ANNOTATION_LABEL "Description (coming from AUTOSAR DESC field)" /begin ANNOTATION_TEXT "flag to copy adaption from position 6 to 7\r\n" /end ANNOTATION_TEXT /end ANNOTATION
/end CHARACTERISTIC
/begin CHARACTERISTIC DWC_CALIB.DWC_K2DeviceControl.DWC_TrqPress.DWC_ENABLKPSTATEMAX "" VALUE 0x8060EF89 DefaultValueRecordLayout_AUTOSAR_Platform_BaseTypes_uint8 255.0 DefaultIdenticalCompu 0.0 255. FORMAT "%10.5"
 /begin ANNOTATION ANNOTATION_LABEL "Description (coming from AUTOSAR DESC field)" /begin ANNOTATION_TEXT "use to enable TP adaption fault for KP hit max limit\r\n" /end ANNOTATION_TEXT /end ANNOTATION
/end CHARACTERISTIC
/begin CHARACTERISTIC DWC_CALIB.DWC_K2DeviceControl.DWC_TrqPress.DWC_KisspointSequencer.DWC_BOBSTATICKPSMFIX "" VALUE 0x8060EF90 DefaultValueRecordLayout_AUTOSAR_Platform_BaseTypes_boolean 255.0 AUTOSAR_Platform_CompuMethods_boolean 0.0 255. FORMAT "%10.5"
 /begin ANNOTATION ANNOTATION_LABEL "Description (coming from AUTOSAR DESC field)"
  /begin ANNOTATION_TEXT "Parameter to enable to fix that will allow static adaptions to cancel when OBD_NOTEST is seen.\r\n" /end ANNOTATION_TEXT
 /end ANNOTATION
/end CHARACTERISTIC
/begin CHARACTERISTIC DWC_CALIB.DWC_K2DeviceControl.DWC_TrqPress.DWC_KisspointSequencer.DWC_FLGABORTFORGEARTIMEOUT "" VALUE 0x8060EF91 DefaultValueRecordLayout_AUTOSAR_Platform_BaseTypes_boolean 255.0 AUTOSAR_Platform_CompuMethods_boolean 0.0 255. FORMAT "%10.5"
 /begin ANNOTATION ANNOTATION_LABEL "Description (coming from AUTOSAR DESC field)" /begin ANNOTATION_TEXT "Flag to enable KP learn due to gear engage timeout.\r\n" /end ANNOTATION_TEXT /end ANNOTATION
/end CHARACTERISTIC
/begin CHARACTERISTIC DWC_CALIB.DWC_K2DeviceControl.DWC_TrqPress.DWC_KisspointSequencer.DWC_KPABORTTRUETIME "" VALUE 0x8060EF8C DefaultValueRecordLayout_AUTOSAR_Platform_BaseTypes_uint16 10.0 RB_PT_PCT_SWC_DWC_CompuMethods_ratio_0p001__2 0.0 10. FORMAT "%10.5"
 /begin ANNOTATION ANNOTATION_LABEL "Description (coming from AUTOSAR DESC field)" /begin ANNOTATION_TEXT "Time for which abort flag should be true.\r\n" /end ANNOTATION_TEXT /end ANNOTATION
/end CHARACTERISTIC
/begin CHARACTERISTIC DWC_CALIB.DWC_K2DeviceControl.DWC_TrqPress.DWC_KisspointSequencer.DWC_KPMAXTIMEFORENGAGINGGEAR "" VALUE 0x8060EF8E DefaultValueRecordLayout_AUTOSAR_Platform_BaseTypes_uint16 10.0 RB_PT_PCT_SWC_DWC_CompuMethods_ratio_0p001__2 0.0 10. FORMAT "%10.5"
 /begin ANNOTATION ANNOTATION_LABEL "Description (coming from AUTOSAR DESC field)" /begin ANNOTATION_TEXT "Max allowable timeout for gear engagement\r\n" /end ANNOTATION_TEXT /end ANNOTATION
/end CHARACTERISTIC
/begin CHARACTERISTIC DWC_CALIB.DWC_K2DeviceControl.DWC_TrqPress.DWC_MAXADAPTSTATUSINDEX "" VALUE 0x8060EF8B DefaultValueRecordLayout_AUTOSAR_Platform_BaseTypes_uint8 8.0 RB_PT_PCT_SWC_DWC_CompuMethods_ident 0.0 8. FORMAT "%10.5"
 /begin ANNOTATION ANNOTATION_LABEL "Description (coming from AUTOSAR DESC field)"
  /begin ANNOTATION_TEXT "Index of TP adaption to monitor for out of bounds errors.\r\n" /end ANNOTATION_TEXT
 /end ANNOTATION
/end CHARACTERISTIC
/begin CHARACTERISTIC DWC_CALIB.DWC_K2DeviceControl.DWC_USEIOPPRESSUREFORDIAG "" VALUE 0x8060ED4D DefaultValueRecordLayout_AUTOSAR_Platform_BaseTypes_boolean 255.0 AUTOSAR_Platform_CompuMethods_boolean 0.0 255. FORMAT "%10.5"
 /begin ANNOTATION ANNOTATION_LABEL "Description (coming from AUTOSAR DESC field)"
  /begin ANNOTATION_TEXT "Set true to use 'raw' pressure signal from IOP rather than from DWC input processing.\r\n" /end ANNOTATION_TEXT
 /end ANNOTATION
/end CHARACTERISTIC
/begin CHARACTERISTIC DWC_CALIB.DWC_K2DeviceControl.DWC_USELINEPRESSUREFOROSG "" VALUE 0x8060ED4E DefaultValueRecordLayout_AUTOSAR_Platform_BaseTypes_boolean 255.0 AUTOSAR_Platform_CompuMethods_boolean 0.0 255. FORMAT "%10.5"
 /begin ANNOTATION ANNOTATION_LABEL "Description (coming from AUTOSAR DESC field)"
  /begin ANNOTATION_TEXT "Flag to use line pressure for 'Oil Supply Good' flag.\r\n" /end ANNOTATION_TEXT
 /end ANNOTATION
/end CHARACTERISTIC
/begin CHARACTERISTIC DWC_CALIB.DWC_K2DeviceControl.DWC_USEVALVECLEANDEMANDS "" VALUE 0x8060ED4F DefaultValueRecordLayout_AUTOSAR_Platform_BaseTypes_uint8 255.0 DefaultIdenticalCompu 0.0 255. FORMAT "%10.5"
 /begin ANNOTATION ANNOTATION_LABEL "Description (coming from AUTOSAR DESC field)"
  /begin ANNOTATION_TEXT "Set true to use pressure demands that have been passed through the valve clean class\r\n" /end ANNOTATION_TEXT
 /end ANNOTATION
/end CHARACTERISTIC
/begin CHARACTERISTIC DWC_CALIB.DWC_K2DeviceControl.DWC_USEVCPRESDEMWHENCLEANING "" VALUE 0x8060ED50 DefaultValueRecordLayout_AUTOSAR_Platform_BaseTypes_boolean 255.0 AUTOSAR_Platform_CompuMethods_boolean 0.0 255. FORMAT "%10.5"
 /begin ANNOTATION ANNOTATION_LABEL "Description (coming from AUTOSAR DESC field)"
  /begin ANNOTATION_TEXT "Flag to use VC pressure demand when a clean is active.\r\n" /end ANNOTATION_TEXT
 /end ANNOTATION
/end CHARACTERISTIC
/begin CHARACTERISTIC DWC_CALIB.DWC_K2DeviceControl.DWC_ValveClean.DWC_PCTVALVECLOSEDCLEANEARLYCOMPLETE "" VALUE 0x8060EFAE DefaultValueRecordLayout_AUTOSAR_Platform_BaseTypes_uint8 1.0 RB_PT_PCT_SWC_DWC_CompuMethods_ratio_0p01 0.0 1. FORMAT "%10.5"
 /begin ANNOTATION ANNOTATION_LABEL "Description (coming from AUTOSAR DESC field)"
  /begin ANNOTATION_TEXT "Percentage of full rinse time where an early abortion still leads to a timeout condition\r\n" /end ANNOTATION_TEXT
 /end ANNOTATION
/end CHARACTERISTIC
/begin CHARACTERISTIC DWC_CALIB.DWC_K2DeviceControl.DWC_ValveClean.DWC_PCTVALVEOPENCLEANEARLYCOMPLETE "" VALUE 0x8060EFAF DefaultValueRecordLayout_AUTOSAR_Platform_BaseTypes_uint8 1.0 RB_PT_PCT_SWC_DWC_CompuMethods_ratio_0p01 0.0 1. FORMAT "%10.5"
 /begin ANNOTATION ANNOTATION_LABEL "Description (coming from AUTOSAR DESC field)"
  /begin ANNOTATION_TEXT "Percentage of full rinse time where an early abortion still leads to a timeout condition\r\n" /end ANNOTATION_TEXT
 /end ANNOTATION
/end CHARACTERISTIC
/end MODULE
/end PROJECT
