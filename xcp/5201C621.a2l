ASAP2_VERSION 1 60
/begin PROJECT LB74x_TCU "5201C621"
/begin HEADER "" VERSION "5201C621" PROJECT_NO LB74x_TCU /end HEADER
/begin MODULE DIM ""
/begin MOD_COMMON "" BYTE_ORDER MSB_LAST ALIGNMENT_BYTE 1 ALIGNMENT_WORD 2 ALIGNMENT_LONG 4 ALIGNMENT_INT64 4 ALIGNMENT_FLOAT32_IEEE 4 ALIGNMENT_FLOAT64_IEEE 4 DATA_SIZE 32 /end MOD_COMMON
/begin CHARACTERISTIC GAC_CALIB.GAC_GracA.GAC_VELSGRACGRNEGVLOWSYNCTGT "" CURVE 0x806116C6 RB_PT_PCT_SWC_GAC_RecordLayouts_RL_Curve_sint16_4_sint16_4 2.4 RB_PT_PCT_SWC_GAC_CompuMethods_ratio_0p001 -1.2 1.2 FORMAT "%10.5"
 /begin ANNOTATION ANNOTATION_LABEL "Description (coming from AUTOSAR DESC field)"
  /begin ANNOTATION_TEXT "Gear actuator velocity targets for engaging negative gear in low aggression post-synchro phase.\r\n" /end ANNOTATION_TEXT
 /end ANNOTATION
 /begin AXIS_DESCR STD_AXIS NO_INPUT_QUANTITY RB_PT_PCT_SWC_GAC_CompuMethods_ident 4 -100. 100. FORMAT "%10.5" DEPOSIT ABSOLUTE /end AXIS_DESCR
/end CHARACTERISTIC
/begin CHARACTERISTIC GAC_CALIB.GAC_GracA.GAC_VELSGRACGRNEGVLOWTGT "" CURVE 0x806116D8 RB_PT_PCT_SWC_GAC_RecordLayouts_RL_Curve_sint16_8_sint16_8 2.4 RB_PT_PCT_SWC_GAC_CompuMethods_ratio_0p001 -1.2 1.2 FORMAT "%10.5"
 /begin ANNOTATION ANNOTATION_LABEL "Description (coming from AUTOSAR DESC field)"
  /begin ANNOTATION_TEXT "Gear actuator velocity targets for engaging negative gear in low aggression pre-synchro phase.\r\n" /end ANNOTATION_TEXT
 /end ANNOTATION
 /begin AXIS_DESCR STD_AXIS NO_INPUT_QUANTITY RB_PT_PCT_SWC_GAC_CompuMethods_ident 8 -100. 100. FORMAT "%10.5" DEPOSIT ABSOLUTE /end AXIS_DESCR
/end CHARACTERISTIC
/begin CHARACTERISTIC GAC_CALIB.GAC_GracA.GAC_VELSGRACGRPOSEVSYNCTGT "" CURVE 0x806116FA RB_PT_PCT_SWC_GAC_RecordLayouts_RL_Curve_sint16_4_sint16_4 2.4 RB_PT_PCT_SWC_GAC_CompuMethods_ratio_0p001 -1.2 1.2 FORMAT "%10.5"
 /begin ANNOTATION ANNOTATION_LABEL "Description (coming from AUTOSAR DESC field)"
  /begin ANNOTATION_TEXT "Gear actuator velocity targets for engaging positive gear in low aggression post-synchro phase.\r\n" /end ANNOTATION_TEXT
 /end ANNOTATION
 /begin AXIS_DESCR STD_AXIS NO_INPUT_QUANTITY RB_PT_PCT_SWC_GAC_CompuMethods_ident 4 -100. 100. FORMAT "%10.5" DEPOSIT ABSOLUTE /end AXIS_DESCR
/end CHARACTERISTIC
/begin CHARACTERISTIC GAC_CALIB.GAC_GracA.GAC_VELSGRACGRPOSEVTGT "" CURVE 0x8061170C RB_PT_PCT_SWC_GAC_RecordLayouts_RL_Curve_sint16_8_sint16_8 2.4 RB_PT_PCT_SWC_GAC_CompuMethods_ratio_0p001 -1.2 1.2 FORMAT "%10.5"
 /begin ANNOTATION ANNOTATION_LABEL "Description (coming from AUTOSAR DESC field)"
  /begin ANNOTATION_TEXT "Gear actuator velocity targets for engaging positive gear in low aggression pre-synchro phase.\r\n" /end ANNOTATION_TEXT
 /end ANNOTATION
 /begin AXIS_DESCR STD_AXIS NO_INPUT_QUANTITY RB_PT_PCT_SWC_GAC_CompuMethods_ident 8 -100. 100. FORMAT "%10.5" DEPOSIT ABSOLUTE /end AXIS_DESCR
/end CHARACTERISTIC
/begin CHARACTERISTIC GAC_CALIB.GAC_GracA.GAC_VELSGRACGRPOSHISYNCTGT "" CURVE 0x8061172E RB_PT_PCT_SWC_GAC_RecordLayouts_RL_Curve_sint16_4_sint16_4 2.4 RB_PT_PCT_SWC_GAC_CompuMethods_ratio_0p001 -1.2 1.2 FORMAT "%10.5"
 /begin ANNOTATION ANNOTATION_LABEL "Description (coming from AUTOSAR DESC field)"
  /begin ANNOTATION_TEXT "Gear actuator velocity targets for engaging positive gear in high aggression post-synchro phase.\r\n" /end ANNOTATION_TEXT
 /end ANNOTATION
 /begin AXIS_DESCR STD_AXIS NO_INPUT_QUANTITY RB_PT_PCT_SWC_GAC_CompuMethods_ident 4 -100. 100. FORMAT "%10.5" DEPOSIT ABSOLUTE /end AXIS_DESCR
/end CHARACTERISTIC
/begin CHARACTERISTIC GAC_CALIB.GAC_GracA.GAC_VELSGRACGRPOSHITGT "" CURVE 0x80611740 RB_PT_PCT_SWC_GAC_RecordLayouts_RL_Curve_sint16_8_sint16_8 2.4 RB_PT_PCT_SWC_GAC_CompuMethods_ratio_0p001 -1.2 1.2 FORMAT "%10.5"
 /begin ANNOTATION ANNOTATION_LABEL "Description (coming from AUTOSAR DESC field)"
  /begin ANNOTATION_TEXT "Gear actuator velocity targets for engaging positive gear in high aggression pre-synchro phase.\r\n" /end ANNOTATION_TEXT
 /end ANNOTATION
 /begin AXIS_DESCR STD_AXIS NO_INPUT_QUANTITY RB_PT_PCT_SWC_GAC_CompuMethods_ident 8 -100. 100. FORMAT "%10.5" DEPOSIT ABSOLUTE /end AXIS_DESCR
/end CHARACTERISTIC
/begin CHARACTERISTIC GAC_CALIB.GAC_GracA.GAC_VELSGRACGRPOSLOWSYNCTGT "" CURVE 0x80611762 RB_PT_PCT_SWC_GAC_RecordLayouts_RL_Curve_sint16_4_sint16_4 2.4 RB_PT_PCT_SWC_GAC_CompuMethods_ratio_0p001 -1.2 1.2 FORMAT "%10.5"
 /begin ANNOTATION ANNOTATION_LABEL "Description (coming from AUTOSAR DESC field)"
  /begin ANNOTATION_TEXT "Gear actuator velocity targets for engaging positive gear in low aggression post-synchro phase.\r\n" /end ANNOTATION_TEXT
 /end ANNOTATION
 /begin AXIS_DESCR STD_AXIS NO_INPUT_QUANTITY RB_PT_PCT_SWC_GAC_CompuMethods_ident 4 -100. 100. FORMAT "%10.5" DEPOSIT ABSOLUTE /end AXIS_DESCR
/end CHARACTERISTIC
/begin CHARACTERISTIC GAC_CALIB.GAC_GracA.GAC_VELSGRACGRPOSLOWTGT "" CURVE 0x80611774 RB_PT_PCT_SWC_GAC_RecordLayouts_RL_Curve_sint16_8_sint16_8 2.4 RB_PT_PCT_SWC_GAC_CompuMethods_ratio_0p001 -1.2 1.2 FORMAT "%10.5"
 /begin ANNOTATION ANNOTATION_LABEL "Description (coming from AUTOSAR DESC field)"
  /begin ANNOTATION_TEXT "Gear actuator velocity targets for engaging positive gear in low aggression pre-synchro phase.\r\n" /end ANNOTATION_TEXT
 /end ANNOTATION
 /begin AXIS_DESCR STD_AXIS NO_INPUT_QUANTITY RB_PT_PCT_SWC_GAC_CompuMethods_ident 8 -100. 100. FORMAT "%10.5" DEPOSIT ABSOLUTE /end AXIS_DESCR
/end CHARACTERISTIC
/begin CHARACTERISTIC GAC_CALIB.GAC_GracA.GAC_VELSGRACGRPOSMEDSYNCTGT "" CURVE 0x80611796 RB_PT_PCT_SWC_GAC_RecordLayouts_RL_Curve_sint16_4_sint16_4 2.4 RB_PT_PCT_SWC_GAC_CompuMethods_ratio_0p001 -1.2 1.2 FORMAT "%10.5"
 /begin ANNOTATION ANNOTATION_LABEL "Description (coming from AUTOSAR DESC field)"
  /begin ANNOTATION_TEXT "Gear actuator velocity targets for engaging positive gear in medium aggression post-synchro phase.\r\n" /end ANNOTATION_TEXT
 /end ANNOTATION
 /begin AXIS_DESCR STD_AXIS NO_INPUT_QUANTITY RB_PT_PCT_SWC_GAC_CompuMethods_ident 4 -100. 100. FORMAT "%10.5" DEPOSIT ABSOLUTE /end AXIS_DESCR
/end CHARACTERISTIC
/begin CHARACTERISTIC GAC_CALIB.GAC_GracA.GAC_VELSGRACGRPOSMEDTGT "" CURVE 0x806117A8 RB_PT_PCT_SWC_GAC_RecordLayouts_RL_Curve_sint16_8_sint16_8 2.4 RB_PT_PCT_SWC_GAC_CompuMethods_ratio_0p001 -1.2 1.2 FORMAT "%10.5"
 /begin ANNOTATION ANNOTATION_LABEL "Description (coming from AUTOSAR DESC field)"
  /begin ANNOTATION_TEXT "Gear actuator velocity targets for engaging positive gear in medium aggression pre-synchro phase.\r\n" /end ANNOTATION_TEXT
 /end ANNOTATION
 /begin AXIS_DESCR STD_AXIS NO_INPUT_QUANTITY RB_PT_PCT_SWC_GAC_CompuMethods_ident 8 -100. 100. FORMAT "%10.5" DEPOSIT ABSOLUTE /end AXIS_DESCR
/end CHARACTERISTIC
/begin CHARACTERISTIC GAC_CALIB.GAC_GracA.GAC_VELSGRACGRPOSSTATICSYNCTGT "" CURVE 0x806117CA RB_PT_PCT_SWC_GAC_RecordLayouts_RL_Curve_sint16_4_sint16_4 2.4 RB_PT_PCT_SWC_GAC_CompuMethods_ratio_0p001 -1.2 1.2 FORMAT "%10.5"
 /begin ANNOTATION ANNOTATION_LABEL "Description (coming from AUTOSAR DESC field)"
  /begin ANNOTATION_TEXT "Gear actuator velocity targets for engaging positive gear in low aggression post-synchro phase.\r\n" /end ANNOTATION_TEXT
 /end ANNOTATION
 /begin AXIS_DESCR STD_AXIS NO_INPUT_QUANTITY RB_PT_PCT_SWC_GAC_CompuMethods_ident 4 -100. 100. FORMAT "%10.5" DEPOSIT ABSOLUTE /end AXIS_DESCR
/end CHARACTERISTIC
/begin CHARACTERISTIC GAC_CALIB.GAC_GracA.GAC_VELSGRACGRPOSSTATICTGT "" CURVE 0x806117DC RB_PT_PCT_SWC_GAC_RecordLayouts_RL_Curve_sint16_8_sint16_8 2.4 RB_PT_PCT_SWC_GAC_CompuMethods_ratio_0p001 -1.2 1.2 FORMAT "%10.5"
 /begin ANNOTATION ANNOTATION_LABEL "Description (coming from AUTOSAR DESC field)"
  /begin ANNOTATION_TEXT "Gear actuator velocity targets for engaging positive gear in low aggression pre-synchro phase.\r\n" /end ANNOTATION_TEXT
 /end ANNOTATION
 /begin AXIS_DESCR STD_AXIS NO_INPUT_QUANTITY RB_PT_PCT_SWC_GAC_CompuMethods_ident 8 -100. 100. FORMAT "%10.5" DEPOSIT ABSOLUTE /end AXIS_DESCR
/end CHARACTERISTIC
/begin CHARACTERISTIC GAC_CALIB.GAC_GracA.GAC_VELSGRACGRPOSVLOWSYNCTGT "" CURVE 0x806117FE RB_PT_PCT_SWC_GAC_RecordLayouts_RL_Curve_sint16_4_sint16_4 2.4 RB_PT_PCT_SWC_GAC_CompuMethods_ratio_0p001 -1.2 1.2 FORMAT "%10.5"
 /begin ANNOTATION ANNOTATION_LABEL "Description (coming from AUTOSAR DESC field)"
  /begin ANNOTATION_TEXT "Gear actuator velocity targets for engaging positive gear in low aggression post-synchro phase.\r\n" /end ANNOTATION_TEXT
 /end ANNOTATION
 /begin AXIS_DESCR STD_AXIS NO_INPUT_QUANTITY RB_PT_PCT_SWC_GAC_CompuMethods_ident 4 -100. 100. FORMAT "%10.5" DEPOSIT ABSOLUTE /end AXIS_DESCR
/end CHARACTERISTIC
/begin CHARACTERISTIC GAC_CALIB.GAC_GracA.GAC_VELSGRACGRPOSVLOWTGT "" CURVE 0x80611810 RB_PT_PCT_SWC_GAC_RecordLayouts_RL_Curve_sint16_8_sint16_8 2.4 RB_PT_PCT_SWC_GAC_CompuMethods_ratio_0p001 -1.2 1.2 FORMAT "%10.5"
 /begin ANNOTATION ANNOTATION_LABEL "Description (coming from AUTOSAR DESC field)"
  /begin ANNOTATION_TEXT "Gear actuator velocity targets for engaging positive gear in low aggression pre-synchro phase.\r\n" /end ANNOTATION_TEXT
 /end ANNOTATION
 /begin AXIS_DESCR STD_AXIS NO_INPUT_QUANTITY RB_PT_PCT_SWC_GAC_CompuMethods_ident 8 -100. 100. FORMAT "%10.5" DEPOSIT ABSOLUTE /end AXIS_DESCR
/end CHARACTERISTIC
/begin CHARACTERISTIC GAC_CALIB.GAC_GracA.GAC_VELSGRACNSTARTGRNEGHI "" CURVE 0x80611832 RB_PT_PCT_SWC_GAC_RecordLayouts_RL_Curve_sint16_3_sint16_3 2.4 RB_PT_PCT_SWC_GAC_CompuMethods_ratio_0p001 -1.2 1.2 FORMAT "%10.5"
 /begin ANNOTATION ANNOTATION_LABEL "Description (coming from AUTOSAR DESC field)"
  /begin ANNOTATION_TEXT "Velocity targets for start of Neutral actuation based on temperature, from negative engagement side with high aggression actuation.\r\n" /end ANNOTATION_TEXT
 /end ANNOTATION
 /begin AXIS_DESCR STD_AXIS NO_INPUT_QUANTITY RB_PT_PCT_SWC_GAC_CompuMethods_ident 3 -50. 200. FORMAT "%10.5" DEPOSIT ABSOLUTE /end AXIS_DESCR
/end CHARACTERISTIC
/begin CHARACTERISTIC GAC_CALIB.GAC_GracA.GAC_VELSGRACNSTARTGRNEGLOW "" CURVE 0x80611840 RB_PT_PCT_SWC_GAC_RecordLayouts_RL_Curve_sint16_3_sint16_3 2.4 RB_PT_PCT_SWC_GAC_CompuMethods_ratio_0p001 -1.2 1.2 FORMAT "%10.5"
 /begin ANNOTATION ANNOTATION_LABEL "Description (coming from AUTOSAR DESC field)"
  /begin ANNOTATION_TEXT "Velocity targets for start of Neutral actuation based on temperature, from negative engagement side with low aggression actuation.\r\n" /end ANNOTATION_TEXT
 /end ANNOTATION
 /begin AXIS_DESCR STD_AXIS NO_INPUT_QUANTITY RB_PT_PCT_SWC_GAC_CompuMethods_ident 3 -50. 200. FORMAT "%10.5" DEPOSIT ABSOLUTE /end AXIS_DESCR
/end CHARACTERISTIC
/begin CHARACTERISTIC GAC_CALIB.GAC_GracA.GAC_VELSGRACNSTARTGRNEGMAX "" CURVE 0x8061184E RB_PT_PCT_SWC_GAC_RecordLayouts_RL_Curve_sint16_3_sint16_3 2.4 RB_PT_PCT_SWC_GAC_CompuMethods_ratio_0p001 -1.2 1.2 FORMAT "%10.5"
 /begin ANNOTATION ANNOTATION_LABEL "Description (coming from AUTOSAR DESC field)"
  /begin ANNOTATION_TEXT "Velocity targets for start of Neutral actuation based on temperature, from negative engagement side with max aggression actuation.\r\n" /end ANNOTATION_TEXT
 /end ANNOTATION
 /begin AXIS_DESCR STD_AXIS NO_INPUT_QUANTITY RB_PT_PCT_SWC_GAC_CompuMethods_ident 3 -50. 200. FORMAT "%10.5" DEPOSIT ABSOLUTE /end AXIS_DESCR
/end CHARACTERISTIC
/begin CHARACTERISTIC GAC_CALIB.GAC_GracA.GAC_VELSGRACNSTARTGRNEGMED "" CURVE 0x8061185C RB_PT_PCT_SWC_GAC_RecordLayouts_RL_Curve_sint16_3_sint16_3 2.4 RB_PT_PCT_SWC_GAC_CompuMethods_ratio_0p001 -1.2 1.2 FORMAT "%10.5"
 /begin ANNOTATION ANNOTATION_LABEL "Description (coming from AUTOSAR DESC field)"
  /begin ANNOTATION_TEXT "Velocity targets for start of Neutral actuation based on temperature, from negative engagement side with med aggression actuation.\r\n" /end ANNOTATION_TEXT
 /end ANNOTATION
 /begin AXIS_DESCR STD_AXIS NO_INPUT_QUANTITY RB_PT_PCT_SWC_GAC_CompuMethods_ident 3 -50. 200. FORMAT "%10.5" DEPOSIT ABSOLUTE /end AXIS_DESCR
/end CHARACTERISTIC
/begin CHARACTERISTIC GAC_CALIB.GAC_GracA.GAC_VELSGRACNSTARTGRPOSHI "" CURVE 0x8061186A RB_PT_PCT_SWC_GAC_RecordLayouts_RL_Curve_sint16_3_sint16_3 2.4 RB_PT_PCT_SWC_GAC_CompuMethods_ratio_0p001 -1.2 1.2 FORMAT "%10.5"
 /begin ANNOTATION ANNOTATION_LABEL "Description (coming from AUTOSAR DESC field)"
  /begin ANNOTATION_TEXT "Velocity targets for start of Neutral actuation based on temperature, from positive engagement side with high aggression actuation.\r\n" /end ANNOTATION_TEXT
 /end ANNOTATION
 /begin AXIS_DESCR STD_AXIS NO_INPUT_QUANTITY RB_PT_PCT_SWC_GAC_CompuMethods_ident 3 -50. 200. FORMAT "%10.5" DEPOSIT ABSOLUTE /end AXIS_DESCR
/end CHARACTERISTIC
/begin CHARACTERISTIC GAC_CALIB.GAC_GracA.GAC_VELSGRACNSTARTGRPOSLOW "" CURVE 0x80611878 RB_PT_PCT_SWC_GAC_RecordLayouts_RL_Curve_sint16_3_sint16_3 2.4 RB_PT_PCT_SWC_GAC_CompuMethods_ratio_0p001 -1.2 1.2 FORMAT "%10.5"
 /begin ANNOTATION ANNOTATION_LABEL "Description (coming from AUTOSAR DESC field)"
  /begin ANNOTATION_TEXT "Velocity targets for start of Neutral actuation based on temperature, from positive engagement side with low aggression actuation.\r\n" /end ANNOTATION_TEXT
 /end ANNOTATION
 /begin AXIS_DESCR STD_AXIS NO_INPUT_QUANTITY RB_PT_PCT_SWC_GAC_CompuMethods_ident 3 -50. 200. FORMAT "%10.5" DEPOSIT ABSOLUTE /end AXIS_DESCR
/end CHARACTERISTIC
/begin CHARACTERISTIC GAC_CALIB.GAC_GracA.GAC_VELSGRACNSTARTGRPOSMAX "" CURVE 0x80611886 RB_PT_PCT_SWC_GAC_RecordLayouts_RL_Curve_sint16_3_sint16_3 2.4 RB_PT_PCT_SWC_GAC_CompuMethods_ratio_0p001 -1.2 1.2 FORMAT "%10.5"
 /begin ANNOTATION ANNOTATION_LABEL "Description (coming from AUTOSAR DESC field)"
  /begin ANNOTATION_TEXT "Velocity targets for start of Neutral actuation based on temperature, from positive engagement side with max aggression actuation.\r\n" /end ANNOTATION_TEXT
 /end ANNOTATION
 /begin AXIS_DESCR STD_AXIS NO_INPUT_QUANTITY RB_PT_PCT_SWC_GAC_CompuMethods_ident 3 -50. 200. FORMAT "%10.5" DEPOSIT ABSOLUTE /end AXIS_DESCR
/end CHARACTERISTIC
/begin CHARACTERISTIC GAC_CALIB.GAC_GracA.GAC_VELSGRACNSTARTGRPOSMED "" CURVE 0x80611894 RB_PT_PCT_SWC_GAC_RecordLayouts_RL_Curve_sint16_3_sint16_3 2.4 RB_PT_PCT_SWC_GAC_CompuMethods_ratio_0p001 -1.2 1.2 FORMAT "%10.5"
 /begin ANNOTATION ANNOTATION_LABEL "Description (coming from AUTOSAR DESC field)"
  /begin ANNOTATION_TEXT "Velocity targets for start of Neutral actuation based on temperature, from positive engagement side with medium aggression actuation.\r\n" /end ANNOTATION_TEXT
 /end ANNOTATION
 /begin AXIS_DESCR STD_AXIS NO_INPUT_QUANTITY RB_PT_PCT_SWC_GAC_CompuMethods_ident 3 -50. 200. FORMAT "%10.5" DEPOSIT ABSOLUTE /end AXIS_DESCR
/end CHARACTERISTIC
/begin CHARACTERISTIC GAC_CALIB.GAC_GracA.GAC_VELSGRACNSTOP "" CURVE 0x806118A2 RB_PT_PCT_SWC_GAC_RecordLayouts_RL_Curve_sint16_11_sint16_11 2.4 RB_PT_PCT_SWC_GAC_CompuMethods_ratio_0p001 -1.2 1.2 FORMAT "%10.5"
 /begin ANNOTATION ANNOTATION_LABEL "Description (coming from AUTOSAR DESC field)"
  /begin ANNOTATION_TEXT "Gear actuator velocity targets for NStop phase without temperature interpolation.\r\n" /end ANNOTATION_TEXT
 /end ANNOTATION
 /begin AXIS_DESCR STD_AXIS NO_INPUT_QUANTITY RB_PT_PCT_SWC_GAC_CompuMethods_ratio_0p001 11 -20. 20. FORMAT "%10.5" DEPOSIT ABSOLUTE /end AXIS_DESCR
/end CHARACTERISTIC
/begin CHARACTERISTIC GAC_CALIB.GAC_GracA.GAC_VELSGRACNSTOPINTRP "" MAP 0x806118D0 RB_PT_PCT_SWC_GAC_RecordLayouts_RL_Map_sint16_33_sint16_11_sint16_3 2.4 RB_PT_PCT_SWC_GAC_CompuMethods_ratio_0p001 -1.2 1.2 FORMAT "%10.5"
 /begin ANNOTATION ANNOTATION_LABEL "Description (coming from AUTOSAR DESC field)"
  /begin ANNOTATION_TEXT "Gear actuator velocity targets for NStop phase with temperature interpolation.\r\n" /end ANNOTATION_TEXT
 /end ANNOTATION
 /begin AXIS_DESCR STD_AXIS NO_INPUT_QUANTITY RB_PT_PCT_SWC_GAC_CompuMethods_ratio_0p001 11 -20. 20. FORMAT "%10.5" DEPOSIT ABSOLUTE /end AXIS_DESCR
 /begin AXIS_DESCR STD_AXIS NO_INPUT_QUANTITY RB_PT_PCT_SWC_GAC_CompuMethods_ident 3 -50. 200. FORMAT "%10.5" DEPOSIT ABSOLUTE /end AXIS_DESCR
/end CHARACTERISTIC
/begin CHARACTERISTIC GAC_CALIB.GAC_GracA.GAC_VELSRISEGBLK2 "" VAL_BLK 0x80610E90 DefaultValueRecordLayout_AUTOSAR_Platform_BaseTypes_uint16 1.2 RB_PT_PCT_SWC_GAC_CompuMethods_ratio_0p001 0.0 1.2 FORMAT "%10.5"
 /begin ANNOTATION ANNOTATION_LABEL "Description (coming from AUTOSAR DESC field)"
  /begin ANNOTATION_TEXT "Rise velocities for gear block 2 detection, for each actuation aggression\r\n" /end ANNOTATION_TEXT
 /end ANNOTATION
 MATRIX_DIM 4 1 1 /end CHARACTERISTIC
/begin CHARACTERISTIC GAC_CALIB.GAC_GracB.GAC_AREAPISTDEFAULT "" VALUE 0x80611968 DefaultValueRecordLayout_AUTOSAR_Platform_BaseTypes_uint16 0.01 RB_PT_PCT_SWC_GAC_CompuMethods_ratio_0p000001 0.0 0.01 FORMAT "%10.5"
 /begin ANNOTATION ANNOTATION_LABEL "Description (coming from AUTOSAR DESC field)" /begin ANNOTATION_TEXT "Default area of piston in calculations\r\n" /end ANNOTATION_TEXT /end ANNOTATION
/end CHARACTERISTIC
/begin CHARACTERISTIC GAC_CALIB.GAC_GracB.GAC_BlkrRlsCtrl.GAC_POSNGRACBLKRRLSEND "" VALUE 0x80611A28 DefaultValueRecordLayout_AUTOSAR_Platform_BaseTypes_uint16 20.0 RB_PT_PCT_SWC_GAC_CompuMethods_ratio_0p001 0.0 20. FORMAT "%10.5"
 /begin ANNOTATION ANNOTATION_LABEL "Description (coming from AUTOSAR DESC field)"
  /begin ANNOTATION_TEXT "Gear actuator position used for detecting blocker release end.\r\n" /end ANNOTATION_TEXT
 /end ANNOTATION
/end CHARACTERISTIC
/begin CHARACTERISTIC GAC_CALIB.GAC_GracB.GAC_BlkrRlsCtrl.GAC_PRESSBLKRRLSGRNEG "" VAL_BLK 0x80611A14 DefaultValueRecordLayout_AUTOSAR_Platform_BaseTypes_uint16 32.0 RB_PT_PCT_SWC_GAC_CompuMethods_ratio_0p001 0.0 32. FORMAT "%10.5"
 /begin ANNOTATION ANNOTATION_LABEL "Description (coming from AUTOSAR DESC field)"
  /begin ANNOTATION_TEXT "Pressures for blocker release for engaging negative gear.\r\n" /end ANNOTATION_TEXT
 /end ANNOTATION
 MATRIX_DIM 4 1 1 /end CHARACTERISTIC
/begin CHARACTERISTIC GAC_CALIB.GAC_GracB.GAC_BlkrRlsCtrl.GAC_PRESSBLKRRLSGRPOS "" VAL_BLK 0x80611A1C DefaultValueRecordLayout_AUTOSAR_Platform_BaseTypes_uint16 32.0 RB_PT_PCT_SWC_GAC_CompuMethods_ratio_0p001 0.0 32. FORMAT "%10.5"
 /begin ANNOTATION ANNOTATION_LABEL "Description (coming from AUTOSAR DESC field)"
  /begin ANNOTATION_TEXT "Pressures for blocker release for engaging positive gear.\r\n" /end ANNOTATION_TEXT
 /end ANNOTATION
 MATRIX_DIM 4 1 1 /end CHARACTERISTIC
/begin CHARACTERISTIC GAC_CALIB.GAC_GracB.GAC_BlkrRlsCtrl.GAC_PRESSMINBLKRRLS "" VAL_BLK 0x80611A24 DefaultValueRecordLayout_AUTOSAR_Platform_BaseTypes_uint16 32.0 RB_PT_PCT_SWC_GAC_CompuMethods_ratio_0p001 0.0 32. FORMAT "%10.5"
 /begin ANNOTATION ANNOTATION_LABEL "Description (coming from AUTOSAR DESC field)"
  /begin ANNOTATION_TEXT "Minimum pressure steps for blocker release engaging negative/positive gears.\r\n" /end ANNOTATION_TEXT
 /end ANNOTATION
 MATRIX_DIM 2 1 1 /end CHARACTERISTIC
/begin CHARACTERISTIC GAC_CALIB.GAC_GracB.GAC_BlkrRlsCtrl.GAC_PRESSSTEPBLKRLSSTATIC "" VALUE 0x80611A2A DefaultValueRecordLayout_AUTOSAR_Platform_BaseTypes_uint16 32.0 RB_PT_PCT_SWC_GAC_CompuMethods_ratio_0p001 0.0 32. FORMAT "%10.5"
 /begin ANNOTATION ANNOTATION_LABEL "Description (coming from AUTOSAR DESC field)"
  /begin ANNOTATION_TEXT "Minimum pressure step for blocker release for static shift.\r\n" /end ANNOTATION_TEXT
 /end ANNOTATION
/end CHARACTERISTIC
/begin CHARACTERISTIC GAC_CALIB.GAC_GracB.GAC_BOBFLGBYPASSSYNCVALID "" VALUE 0x806119F6 DefaultValueRecordLayout_AUTOSAR_Platform_BaseTypes_uint8 255.0 DefaultIdenticalCompu 0.0 255. FORMAT "%10.5"
 /begin ANNOTATION ANNOTATION_LABEL "Description (coming from AUTOSAR DESC field)" /begin ANNOTATION_TEXT "Bob flag to bypass valid sync check\r\n" /end ANNOTATION_TEXT /end ANNOTATION
/end CHARACTERISTIC
/begin CHARACTERISTIC GAC_CALIB.GAC_GracB.GAC_BRAKEPRESSVLOWAGGLIM "" VALUE 0x8061196A DefaultValueRecordLayout_AUTOSAR_Platform_BaseTypes_uint16 409.5 RB_PT_PCT_SWC_GAC_CompuMethods_ratio_0p1 0.0 409.5 FORMAT "%10.5"
 /begin ANNOTATION ANNOTATION_LABEL "Description (coming from AUTOSAR DESC field)"
  /begin ANNOTATION_TEXT "The brake pressure limit for the very low aggression to be commanded\r\n" /end ANNOTATION_TEXT
 /end ANNOTATION
/end CHARACTERISTIC
/begin CHARACTERISTIC GAC_CALIB.GAC_GracB.GAC_DIAPISTACTUATORLEFT "" VALUE 0x8061196C DefaultValueRecordLayout_AUTOSAR_Platform_BaseTypes_uint16 65.535 RB_PT_PCT_SWC_GAC_CompuMethods_ratio_0p001 0.0 65.535 FORMAT "%10.5"
 /begin ANNOTATION ANNOTATION_LABEL "Description (coming from AUTOSAR DESC field)" /begin ANNOTATION_TEXT "Diameter of the actuator piston - left\r\n" /end ANNOTATION_TEXT /end ANNOTATION
/end CHARACTERISTIC
/begin CHARACTERISTIC GAC_CALIB.GAC_GracB.GAC_DIAPISTACTUATORRIGHT "" VALUE 0x8061196E DefaultValueRecordLayout_AUTOSAR_Platform_BaseTypes_uint16 65.535 RB_PT_PCT_SWC_GAC_CompuMethods_ratio_0p001 0.0 65.535 FORMAT "%10.5"
 /begin ANNOTATION ANNOTATION_LABEL "Description (coming from AUTOSAR DESC field)" /begin ANNOTATION_TEXT "Diameter of the actuator piston - right\r\n" /end ANNOTATION_TEXT /end ANNOTATION
/end CHARACTERISTIC
/begin CHARACTERISTIC GAC_CALIB.GAC_GracB.GAC_DtntCtrl.GAC_FLGSAGGDTNTCTRLOK "" VAL_BLK 0x80611A34 DefaultValueRecordLayout_AUTOSAR_Platform_BaseTypes_boolean 255.0 AUTOSAR_Platform_CompuMethods_boolean 0.0 255. FORMAT "%10.5"
 /begin ANNOTATION ANNOTATION_LABEL "Description (coming from AUTOSAR DESC field)"
  /begin ANNOTATION_TEXT "Array of flags enabling detent control for each actuation aggression.\r\n" /end ANNOTATION_TEXT
 /end ANNOTATION
 MATRIX_DIM 4 1 1 /end CHARACTERISTIC
/begin CHARACTERISTIC GAC_CALIB.GAC_GracB.GAC_DtntCtrl.GAC_PRESSDTNTCTRLEOLGRNEG "" VALUE 0x80611A38 DefaultValueRecordLayout_AUTOSAR_Platform_BaseTypes_sint16 64.0 RB_PT_PCT_SWC_GAC_CompuMethods_ratio_0p001 -32. 32. FORMAT "%10.5"
 /begin ANNOTATION ANNOTATION_LABEL "Description (coming from AUTOSAR DESC field)"
  /begin ANNOTATION_TEXT "Pressure for detent control engaging negative gear, during EOL Neutral learn.\r\n" /end ANNOTATION_TEXT
 /end ANNOTATION
/end CHARACTERISTIC
/begin CHARACTERISTIC GAC_CALIB.GAC_GracB.GAC_DtntCtrl.GAC_PRESSDTNTCTRLEOLGRPOS "" VALUE 0x80611A3A DefaultValueRecordLayout_AUTOSAR_Platform_BaseTypes_sint16 64.0 RB_PT_PCT_SWC_GAC_CompuMethods_ratio_0p001 -32. 32. FORMAT "%10.5"
 /begin ANNOTATION ANNOTATION_LABEL "Description (coming from AUTOSAR DESC field)"
  /begin ANNOTATION_TEXT "Pressure for detent control engaging positive gear, during EOL Neutral learn.\r\n" /end ANNOTATION_TEXT
 /end ANNOTATION
/end CHARACTERISTIC
/begin CHARACTERISTIC GAC_CALIB.GAC_GracB.GAC_DtntCtrl.GAC_PRESSDTNTCTRLEVGRNEG "" MAP 0x80611A3C RB_PT_PCT_SWC_GAC_RecordLayouts_RL_Map_sint16_12_uint16_3_sint16_4 64.0 RB_PT_PCT_SWC_GAC_CompuMethods_ratio_0p001 -32. 32. FORMAT "%10.5"
 /begin ANNOTATION ANNOTATION_LABEL "Description (coming from AUTOSAR DESC field)"
  /begin ANNOTATION_TEXT "Detent pressure offset for negative gear engagements - static aggression\r\n" /end ANNOTATION_TEXT
 /end ANNOTATION
 /begin AXIS_DESCR STD_AXIS NO_INPUT_QUANTITY RB_PT_PCT_SWC_GAC_CompuMethods_ratio_0p001 3 0.0 40. FORMAT "%10.5" DEPOSIT ABSOLUTE /end AXIS_DESCR
 /begin AXIS_DESCR STD_AXIS NO_INPUT_QUANTITY RB_PT_PCT_SWC_GAC_CompuMethods_ident 4 -50. 200. FORMAT "%10.5" DEPOSIT ABSOLUTE /end AXIS_DESCR
/end CHARACTERISTIC
/begin CHARACTERISTIC GAC_CALIB.GAC_GracB.GAC_DtntCtrl.GAC_PRESSDTNTCTRLEVGRPOS "" MAP 0x80611A66 RB_PT_PCT_SWC_GAC_RecordLayouts_RL_Map_sint16_12_uint16_3_sint16_4 64.0 RB_PT_PCT_SWC_GAC_CompuMethods_ratio_0p001 -32. 32. FORMAT "%10.5"
 /begin ANNOTATION ANNOTATION_LABEL "Description (coming from AUTOSAR DESC field)"
  /begin ANNOTATION_TEXT "Detent pressure offset for positive gear engagements - static aggression\r\n" /end ANNOTATION_TEXT
 /end ANNOTATION
 /begin AXIS_DESCR STD_AXIS NO_INPUT_QUANTITY RB_PT_PCT_SWC_GAC_CompuMethods_ratio_0p001 3 0.0 40. FORMAT "%10.5" DEPOSIT ABSOLUTE /end AXIS_DESCR
 /begin AXIS_DESCR STD_AXIS NO_INPUT_QUANTITY RB_PT_PCT_SWC_GAC_CompuMethods_ident 4 -50. 200. FORMAT "%10.5" DEPOSIT ABSOLUTE /end AXIS_DESCR
/end CHARACTERISTIC
/begin CHARACTERISTIC GAC_CALIB.GAC_GracB.GAC_DtntCtrl.GAC_PRESSDTNTCTRLHIGRNEG "" MAP 0x80611A90 RB_PT_PCT_SWC_GAC_RecordLayouts_RL_Map_sint16_12_uint16_3_sint16_4 64.0 RB_PT_PCT_SWC_GAC_CompuMethods_ratio_0p001 -32. 32. FORMAT "%10.5"
 /begin ANNOTATION ANNOTATION_LABEL "Description (coming from AUTOSAR DESC field)"
  /begin ANNOTATION_TEXT "Detent pressure offset for negative gear engagements - high aggression\r\n" /end ANNOTATION_TEXT
 /end ANNOTATION
 /begin AXIS_DESCR STD_AXIS NO_INPUT_QUANTITY RB_PT_PCT_SWC_GAC_CompuMethods_ratio_0p001 3 0.0 40. FORMAT "%10.5" DEPOSIT ABSOLUTE /end AXIS_DESCR
 /begin AXIS_DESCR STD_AXIS NO_INPUT_QUANTITY RB_PT_PCT_SWC_GAC_CompuMethods_ident 4 -50. 200. FORMAT "%10.5" DEPOSIT ABSOLUTE /end AXIS_DESCR
/end CHARACTERISTIC
/begin CHARACTERISTIC GAC_CALIB.GAC_GracB.GAC_DtntCtrl.GAC_PRESSDTNTCTRLHIGRPOS "" MAP 0x80611ABA RB_PT_PCT_SWC_GAC_RecordLayouts_RL_Map_sint16_12_uint16_3_sint16_4 64.0 RB_PT_PCT_SWC_GAC_CompuMethods_ratio_0p001 -32. 32. FORMAT "%10.5"
 /begin ANNOTATION ANNOTATION_LABEL "Description (coming from AUTOSAR DESC field)"
  /begin ANNOTATION_TEXT "Detent pressure offset for positive gear engagements - high aggression\r\n" /end ANNOTATION_TEXT
 /end ANNOTATION
 /begin AXIS_DESCR STD_AXIS NO_INPUT_QUANTITY RB_PT_PCT_SWC_GAC_CompuMethods_ratio_0p001 3 0.0 40. FORMAT "%10.5" DEPOSIT ABSOLUTE /end AXIS_DESCR
 /begin AXIS_DESCR STD_AXIS NO_INPUT_QUANTITY RB_PT_PCT_SWC_GAC_CompuMethods_ident 4 -50. 200. FORMAT "%10.5" DEPOSIT ABSOLUTE /end AXIS_DESCR
/end CHARACTERISTIC
/begin CHARACTERISTIC GAC_CALIB.GAC_GracB.GAC_DtntCtrl.GAC_PRESSDTNTCTRLLOWGRNEG "" MAP 0x80611AE4 RB_PT_PCT_SWC_GAC_RecordLayouts_RL_Map_sint16_12_uint16_3_sint16_4 64.0 RB_PT_PCT_SWC_GAC_CompuMethods_ratio_0p001 -32. 32. FORMAT "%10.5"
 /begin ANNOTATION ANNOTATION_LABEL "Description (coming from AUTOSAR DESC field)"
  /begin ANNOTATION_TEXT "Detent pressure offset for negative gear engagements - low aggression\r\n" /end ANNOTATION_TEXT
 /end ANNOTATION
 /begin AXIS_DESCR STD_AXIS NO_INPUT_QUANTITY RB_PT_PCT_SWC_GAC_CompuMethods_ratio_0p001 3 0.0 40. FORMAT "%10.5" DEPOSIT ABSOLUTE /end AXIS_DESCR
 /begin AXIS_DESCR STD_AXIS NO_INPUT_QUANTITY RB_PT_PCT_SWC_GAC_CompuMethods_ident 4 -50. 200. FORMAT "%10.5" DEPOSIT ABSOLUTE /end AXIS_DESCR
/end CHARACTERISTIC
/begin CHARACTERISTIC GAC_CALIB.GAC_GracB.GAC_DtntCtrl.GAC_PRESSDTNTCTRLLOWGRPOS "" MAP 0x80611B0E RB_PT_PCT_SWC_GAC_RecordLayouts_RL_Map_sint16_12_uint16_3_sint16_4 64.0 RB_PT_PCT_SWC_GAC_CompuMethods_ratio_0p001 -32. 32. FORMAT "%10.5"
 /begin ANNOTATION ANNOTATION_LABEL "Description (coming from AUTOSAR DESC field)"
  /begin ANNOTATION_TEXT "Detent pressure offset for positive gear engagements - low aggression\r\n" /end ANNOTATION_TEXT
 /end ANNOTATION
 /begin AXIS_DESCR STD_AXIS NO_INPUT_QUANTITY RB_PT_PCT_SWC_GAC_CompuMethods_ratio_0p001 3 0.0 40. FORMAT "%10.5" DEPOSIT ABSOLUTE /end AXIS_DESCR
 /begin AXIS_DESCR STD_AXIS NO_INPUT_QUANTITY RB_PT_PCT_SWC_GAC_CompuMethods_ident 4 -50. 200. FORMAT "%10.5" DEPOSIT ABSOLUTE /end AXIS_DESCR
/end CHARACTERISTIC
/begin CHARACTERISTIC GAC_CALIB.GAC_GracB.GAC_DtntCtrl.GAC_PRESSDTNTCTRLMEDGRNEG "" MAP 0x80611B38 RB_PT_PCT_SWC_GAC_RecordLayouts_RL_Map_sint16_12_uint16_3_sint16_4 64.0 RB_PT_PCT_SWC_GAC_CompuMethods_ratio_0p001 -32. 32. FORMAT "%10.5"
 /begin ANNOTATION ANNOTATION_LABEL "Description (coming from AUTOSAR DESC field)"
  /begin ANNOTATION_TEXT "Detent pressure offset for negative gear engagements - medium aggression\r\n" /end ANNOTATION_TEXT
 /end ANNOTATION
 /begin AXIS_DESCR STD_AXIS NO_INPUT_QUANTITY RB_PT_PCT_SWC_GAC_CompuMethods_ratio_0p001 3 0.0 40. FORMAT "%10.5" DEPOSIT ABSOLUTE /end AXIS_DESCR
 /begin AXIS_DESCR STD_AXIS NO_INPUT_QUANTITY RB_PT_PCT_SWC_GAC_CompuMethods_ident 4 -50. 200. FORMAT "%10.5" DEPOSIT ABSOLUTE /end AXIS_DESCR
/end CHARACTERISTIC
/begin CHARACTERISTIC GAC_CALIB.GAC_GracB.GAC_DtntCtrl.GAC_PRESSDTNTCTRLMEDGRPOS "" MAP 0x80611B62 RB_PT_PCT_SWC_GAC_RecordLayouts_RL_Map_sint16_12_uint16_3_sint16_4 64.0 RB_PT_PCT_SWC_GAC_CompuMethods_ratio_0p001 -32. 32. FORMAT "%10.5"
 /begin ANNOTATION ANNOTATION_LABEL "Description (coming from AUTOSAR DESC field)"
  /begin ANNOTATION_TEXT "Detent pressure offset for positive gear engagements - medium aggression\r\n" /end ANNOTATION_TEXT
 /end ANNOTATION
 /begin AXIS_DESCR STD_AXIS NO_INPUT_QUANTITY RB_PT_PCT_SWC_GAC_CompuMethods_ratio_0p001 3 0.0 40. FORMAT "%10.5" DEPOSIT ABSOLUTE /end AXIS_DESCR
 /begin AXIS_DESCR STD_AXIS NO_INPUT_QUANTITY RB_PT_PCT_SWC_GAC_CompuMethods_ident 4 -50. 200. FORMAT "%10.5" DEPOSIT ABSOLUTE /end AXIS_DESCR
/end CHARACTERISTIC
/begin CHARACTERISTIC GAC_CALIB.GAC_GracB.GAC_DtntCtrl.GAC_PRESSDTNTCTRLSTATICGRNEG "" MAP 0x80611B8C RB_PT_PCT_SWC_GAC_RecordLayouts_RL_Map_sint16_12_uint16_3_sint16_4 64.0 RB_PT_PCT_SWC_GAC_CompuMethods_ratio_0p001 -32. 32. FORMAT "%10.5"
 /begin ANNOTATION ANNOTATION_LABEL "Description (coming from AUTOSAR DESC field)"
  /begin ANNOTATION_TEXT "Detent pressure offset for negative gear engagements - static aggression\r\n" /end ANNOTATION_TEXT
 /end ANNOTATION
 /begin AXIS_DESCR STD_AXIS NO_INPUT_QUANTITY RB_PT_PCT_SWC_GAC_CompuMethods_ratio_0p001 3 0.0 40. FORMAT "%10.5" DEPOSIT ABSOLUTE /end AXIS_DESCR
 /begin AXIS_DESCR STD_AXIS NO_INPUT_QUANTITY RB_PT_PCT_SWC_GAC_CompuMethods_ident 4 -50. 200. FORMAT "%10.5" DEPOSIT ABSOLUTE /end AXIS_DESCR
/end CHARACTERISTIC
/begin CHARACTERISTIC GAC_CALIB.GAC_GracB.GAC_DtntCtrl.GAC_PRESSDTNTCTRLSTATICGRPOS "" MAP 0x80611BB6 RB_PT_PCT_SWC_GAC_RecordLayouts_RL_Map_sint16_12_uint16_3_sint16_4 64.0 RB_PT_PCT_SWC_GAC_CompuMethods_ratio_0p001 -32. 32. FORMAT "%10.5"
 /begin ANNOTATION ANNOTATION_LABEL "Description (coming from AUTOSAR DESC field)"
  /begin ANNOTATION_TEXT "Detent pressure offset for positive gear engagements - static aggression\r\n" /end ANNOTATION_TEXT
 /end ANNOTATION
 /begin AXIS_DESCR STD_AXIS NO_INPUT_QUANTITY RB_PT_PCT_SWC_GAC_CompuMethods_ratio_0p001 3 0.0 40. FORMAT "%10.5" DEPOSIT ABSOLUTE /end AXIS_DESCR
 /begin AXIS_DESCR STD_AXIS NO_INPUT_QUANTITY RB_PT_PCT_SWC_GAC_CompuMethods_ident 4 -50. 200. FORMAT "%10.5" DEPOSIT ABSOLUTE /end AXIS_DESCR
/end CHARACTERISTIC
/begin CHARACTERISTIC GAC_CALIB.GAC_GracB.GAC_DtntCtrl.GAC_PRESSDTNTCTRLVLOWGRNEG "" MAP 0x80611BE0 RB_PT_PCT_SWC_GAC_RecordLayouts_RL_Map_sint16_12_uint16_3_sint16_4 64.0 RB_PT_PCT_SWC_GAC_CompuMethods_ratio_0p001 -32. 32. FORMAT "%10.5"
 /begin ANNOTATION ANNOTATION_LABEL "Description (coming from AUTOSAR DESC field)"
  /begin ANNOTATION_TEXT "Detent pressure offset for negative gear engagements - very low aggression\r\n" /end ANNOTATION_TEXT
 /end ANNOTATION
 /begin AXIS_DESCR STD_AXIS NO_INPUT_QUANTITY RB_PT_PCT_SWC_GAC_CompuMethods_ratio_0p001 3 0.0 40. FORMAT "%10.5" DEPOSIT ABSOLUTE /end AXIS_DESCR
 /begin AXIS_DESCR STD_AXIS NO_INPUT_QUANTITY RB_PT_PCT_SWC_GAC_CompuMethods_ident 4 -50. 200. FORMAT "%10.5" DEPOSIT ABSOLUTE /end AXIS_DESCR
/end CHARACTERISTIC
/begin CHARACTERISTIC GAC_CALIB.GAC_GracB.GAC_DtntCtrl.GAC_PRESSDTNTCTRLVLOWGRPOS "" MAP 0x80611C0A RB_PT_PCT_SWC_GAC_RecordLayouts_RL_Map_sint16_12_uint16_3_sint16_4 64.0 RB_PT_PCT_SWC_GAC_CompuMethods_ratio_0p001 -32. 32. FORMAT "%10.5"
 /begin ANNOTATION ANNOTATION_LABEL "Description (coming from AUTOSAR DESC field)"
  /begin ANNOTATION_TEXT "Detent pressure offset for positive gear engagements - very low aggression\r\n" /end ANNOTATION_TEXT
 /end ANNOTATION
 /begin AXIS_DESCR STD_AXIS NO_INPUT_QUANTITY RB_PT_PCT_SWC_GAC_CompuMethods_ratio_0p001 3 0.0 40. FORMAT "%10.5" DEPOSIT ABSOLUTE /end AXIS_DESCR
 /begin AXIS_DESCR STD_AXIS NO_INPUT_QUANTITY RB_PT_PCT_SWC_GAC_CompuMethods_ident 4 -50. 200. FORMAT "%10.5" DEPOSIT ABSOLUTE /end AXIS_DESCR
/end CHARACTERISTIC
/begin CHARACTERISTIC GAC_CALIB.GAC_GracB.GAC_DtntCtrl.GAC_VELSGRACDTNTCTRLLIM "" VAL_BLK 0x80611A2C DefaultValueRecordLayout_AUTOSAR_Platform_BaseTypes_uint16 1.2 RB_PT_PCT_SWC_GAC_CompuMethods_ratio_0p001 0.0 1.2 FORMAT "%10.5"
 /begin ANNOTATION ANNOTATION_LABEL "Description (coming from AUTOSAR DESC field)"
  /begin ANNOTATION_TEXT "Array of gear actuator velocities for each actuation aggression, used for limiting of detent control.\r\n" /end ANNOTATION_TEXT
 /end ANNOTATION
 MATRIX_DIM 4 1 1 /end CHARACTERISTIC
/begin CHARACTERISTIC GAC_CALIB.GAC_GracB.GAC_FCTFLWRIGHT "" VALUE 0x80611970 DefaultValueRecordLayout_AUTOSAR_Platform_BaseTypes_uint16 1.5 RB_PT_PCT_SWC_GAC_CompuMethods_ratio_0p001 0.0 1.5 FORMAT "%10.5"
 /begin ANNOTATION ANNOTATION_LABEL "Description (coming from AUTOSAR DESC field)"
  /begin ANNOTATION_TEXT "Factor for upscaling the flow demand due to piston area difference.\r\n" /end ANNOTATION_TEXT
 /end ANNOTATION
/end CHARACTERISTIC
/begin CHARACTERISTIC GAC_CALIB.GAC_GracB.GAC_FCTPRESSRIGHT "" VALUE 0x80611972 DefaultValueRecordLayout_AUTOSAR_Platform_BaseTypes_uint16 1.5 RB_PT_PCT_SWC_GAC_CompuMethods_ratio_0p001 0.0 1.5 FORMAT "%10.5"
 /begin ANNOTATION ANNOTATION_LABEL "Description (coming from AUTOSAR DESC field)"
  /begin ANNOTATION_TEXT "Factor for upscaling the flow demand due to piston area difference.\r\n" /end ANNOTATION_TEXT
 /end ANNOTATION
/end CHARACTERISTIC
/begin CHARACTERISTIC GAC_CALIB.GAC_GracB.GAC_FCTRONSYNCLRNDELTAADPT "" VALUE 0x806119F7 DefaultValueRecordLayout_AUTOSAR_Platform_BaseTypes_uint8 1.0 RB_PT_PCT_SWC_GAC_CompuMethods_ratio_0p01 0.0 1. FORMAT "%10.5"
 /begin ANNOTATION ANNOTATION_LABEL "Description (coming from AUTOSAR DESC field)" /begin ANNOTATION_TEXT "Factor to adapt the in gear position by\r\n" /end ANNOTATION_TEXT /end ANNOTATION
/end CHARACTERISTIC
/begin CHARACTERISTIC GAC_CALIB.GAC_GracB.GAC_FCTRRETRYINGRPOSMOD "" VALUE 0x80611974 DefaultValueRecordLayout_AUTOSAR_Platform_BaseTypes_sint16 40.0 RB_PT_PCT_SWC_GAC_CompuMethods_ratio_0p001 -20. 20. FORMAT "%10.5"
 /begin ANNOTATION ANNOTATION_LABEL "Description (coming from AUTOSAR DESC field)"
  /begin ANNOTATION_TEXT "The modification factor to the in gear position on retries\r\n" /end ANNOTATION_TEXT
 /end ANNOTATION
/end CHARACTERISTIC
/begin CHARACTERISTIC GAC_CALIB.GAC_GracB.GAC_FLGAGGEVENBL "" VALUE 0x806119F8 DefaultValueRecordLayout_AUTOSAR_Platform_BaseTypes_uint8 255.0 DefaultIdenticalCompu 0.0 255. FORMAT "%10.5"
 /begin ANNOTATION ANNOTATION_LABEL "Description (coming from AUTOSAR DESC field)"
  /begin ANNOTATION_TEXT "Flag to indicate if the EV mode aggression can be used\r\n" /end ANNOTATION_TEXT
 /end ANNOTATION
/end CHARACTERISTIC
/begin CHARACTERISTIC GAC_CALIB.GAC_GracB.GAC_FLGBOBADAPTPONEVERYSHIFT "" VALUE 0x806119F9 DefaultValueRecordLayout_AUTOSAR_Platform_BaseTypes_uint8 255.0 DefaultIdenticalCompu 0.0 255. FORMAT "%10.5"
 /begin ANNOTATION ANNOTATION_LABEL "Description (coming from AUTOSAR DESC field)"
  /begin ANNOTATION_TEXT "Trigger the logic to clear the adaptions and relearn them on every shift\r\n" /end ANNOTATION_TEXT
 /end ANNOTATION
/end CHARACTERISTIC
/begin CHARACTERISTIC GAC_CALIB.GAC_GracB.GAC_FLGDISABLEGBLK2ITERM "" VALUE 0x806119FA DefaultValueRecordLayout_AUTOSAR_Platform_BaseTypes_uint8 255.0 DefaultIdenticalCompu 0.0 255. FORMAT "%10.5"
 /begin ANNOTATION ANNOTATION_LABEL "Description (coming from AUTOSAR DESC field)" /begin ANNOTATION_TEXT "Flag to disable the i term during gear blocking 2\r\n" /end ANNOTATION_TEXT /end ANNOTATION
/end CHARACTERISTIC
/begin CHARACTERISTIC GAC_CALIB.GAC_GracB.GAC_FLGDISABLENEGDETECTION "" VALUE 0x806119FB DefaultValueRecordLayout_AUTOSAR_Platform_BaseTypes_uint8 255.0 DefaultIdenticalCompu 0.0 255. FORMAT "%10.5"
 /begin ANNOTATION ANNOTATION_LABEL "Description (coming from AUTOSAR DESC field)" /begin ANNOTATION_TEXT "Flag to disable negative gear detection\r\n" /end ANNOTATION_TEXT /end ANNOTATION
/end CHARACTERISTIC
/begin CHARACTERISTIC GAC_CALIB.GAC_GracB.GAC_FLGDISABLEPOSDETECTION "" VALUE 0x806119FC DefaultValueRecordLayout_AUTOSAR_Platform_BaseTypes_uint8 255.0 DefaultIdenticalCompu 0.0 255. FORMAT "%10.5"
 /begin ANNOTATION ANNOTATION_LABEL "Description (coming from AUTOSAR DESC field)" /begin ANNOTATION_TEXT "Flag to disable positive gear detection\r\n" /end ANNOTATION_TEXT /end ANNOTATION
/end CHARACTERISTIC
/begin CHARACTERISTIC GAC_CALIB.GAC_GracB.GAC_FLGDISABLESLIPCHECK "" VALUE 0x806119FD DefaultValueRecordLayout_AUTOSAR_Platform_BaseTypes_uint8 255.0 DefaultIdenticalCompu 0.0 255. FORMAT "%10.5"
 /begin ANNOTATION ANNOTATION_LABEL "Description (coming from AUTOSAR DESC field)"
  /begin ANNOTATION_TEXT "Flag to disable slip checking for the end of synchronisation\r\n" /end ANNOTATION_TEXT
 /end ANNOTATION
/end CHARACTERISTIC
/begin CHARACTERISTIC GAC_CALIB.GAC_GracB.GAC_FLGENBLBENDCOMPSYNCPOS "" VALUE 0x806119FE DefaultValueRecordLayout_AUTOSAR_Platform_BaseTypes_uint8 255.0 DefaultIdenticalCompu 0.0 255. FORMAT "%10.5"
 /begin ANNOTATION ANNOTATION_LABEL "Description (coming from AUTOSAR DESC field)" /begin ANNOTATION_TEXT "flag to enable synchroniser bending compensation\r\n" /end ANNOTATION_TEXT /end ANNOTATION
/end CHARACTERISTIC
/begin CHARACTERISTIC GAC_CALIB.GAC_GracB.GAC_FLGENBLCALCFLWTGT "" VALUE 0x806119FF DefaultValueRecordLayout_AUTOSAR_Platform_BaseTypes_uint8 255.0 DefaultIdenticalCompu 0.0 255. FORMAT "%10.5"
 /begin ANNOTATION ANNOTATION_LABEL "Description (coming from AUTOSAR DESC field)" /begin ANNOTATION_TEXT "Flag to activate calculated flow target\r\n" /end ANNOTATION_TEXT /end ANNOTATION
/end CHARACTERISTIC
/begin CHARACTERISTIC GAC_CALIB.GAC_GracB.GAC_FLGENBLNBANDMODIFY "" VALUE 0x80611A00 DefaultValueRecordLayout_AUTOSAR_Platform_BaseTypes_uint8 255.0 DefaultIdenticalCompu 0.0 255. FORMAT "%10.5"
 /begin ANNOTATION ANNOTATION_LABEL "Description (coming from AUTOSAR DESC field)"
  /begin ANNOTATION_TEXT "Flag to allow the neutral window to be modified for gear floating cases\r\n" /end ANNOTATION_TEXT
 /end ANNOTATION
/end CHARACTERISTIC
/begin CHARACTERISTIC GAC_CALIB.GAC_GracB.GAC_FLGENBLNEUTRALCLOSEOUT "" VALUE 0x80611A01 DefaultValueRecordLayout_AUTOSAR_Platform_BaseTypes_uint8 255.0 DefaultIdenticalCompu 0.0 255. FORMAT "%10.5"
 /begin ANNOTATION ANNOTATION_LABEL "Description (coming from AUTOSAR DESC field)"
  /begin ANNOTATION_TEXT "Flag to enable I term to close out small errors in neutral\r\n" /end ANNOTATION_TEXT
 /end ANNOTATION
/end CHARACTERISTIC
/begin CHARACTERISTIC GAC_CALIB.GAC_GracB.GAC_FLGENBLPRESSANDHOLD "" VALUE 0x80611A02 DefaultValueRecordLayout_AUTOSAR_Platform_BaseTypes_uint8 255.0 DefaultIdenticalCompu 0.0 255. FORMAT "%10.5"
 /begin ANNOTATION ANNOTATION_LABEL "Description (coming from AUTOSAR DESC field)" /begin ANNOTATION_TEXT "Flag to enable press and hold functionality\r\n" /end ANNOTATION_TEXT /end ANNOTATION
/end CHARACTERISTIC
/begin CHARACTERISTIC GAC_CALIB.GAC_GracB.GAC_FLGENBLPRESSCONTROLDISABLE "" VALUE 0x80611A03 DefaultValueRecordLayout_AUTOSAR_Platform_BaseTypes_uint8 255.0 DefaultIdenticalCompu 0.0 255. FORMAT "%10.5"
 /begin ANNOTATION ANNOTATION_LABEL "Description (coming from AUTOSAR DESC field)"
  /begin ANNOTATION_TEXT "Flag to disable the pressure control terms (pressure i, p, and velocity i) terms from impacting the EOL position learn\r\n" /end ANNOTATION_TEXT
 /end ANNOTATION
/end CHARACTERISTIC
/begin CHARACTERISTIC GAC_CALIB.GAC_GracB.GAC_FLGENBLPRESSINTONEUTRAL "" VALUE 0x80611A04 DefaultValueRecordLayout_AUTOSAR_Platform_BaseTypes_uint8 255.0 DefaultIdenticalCompu 0.0 255. FORMAT "%10.5"
 /begin ANNOTATION ANNOTATION_LABEL "Description (coming from AUTOSAR DESC field)" /begin ANNOTATION_TEXT "Flag to enable press and hold functionality\r\n" /end ANNOTATION_TEXT /end ANNOTATION
/end CHARACTERISTIC
/begin CHARACTERISTIC GAC_CALIB.GAC_GracB.GAC_FLGENBLVLOWAGG "" VALUE 0x80611A05 DefaultValueRecordLayout_AUTOSAR_Platform_BaseTypes_uint8 255.0 DefaultIdenticalCompu 0.0 255. FORMAT "%10.5"
 /begin ANNOTATION ANNOTATION_LABEL "Description (coming from AUTOSAR DESC field)" /begin ANNOTATION_TEXT "Flag to enable very low aggression\r\n" /end ANNOTATION_TEXT /end ANNOTATION
/end CHARACTERISTIC
/begin CHARACTERISTIC GAC_CALIB.GAC_GracB.GAC_FLGEVMODEAGGVERYLOW "" VALUE 0x80611A06 DefaultValueRecordLayout_AUTOSAR_Platform_BaseTypes_uint8 255.0 DefaultIdenticalCompu 0.0 255. FORMAT "%10.5"
 /begin ANNOTATION ANNOTATION_LABEL "Description (coming from AUTOSAR DESC field)" /begin ANNOTATION_TEXT "flag to allow the very low aggression for EV mode\r\n" /end ANNOTATION_TEXT /end ANNOTATION
/end CHARACTERISTIC
/begin CHARACTERISTIC GAC_CALIB.GAC_GracB.GAC_FLGEVSYNCAGAINSTDRAGENBL "" VALUE 0x80611A07 DefaultValueRecordLayout_AUTOSAR_Platform_BaseTypes_uint8 255.0 DefaultIdenticalCompu 0.0 255. FORMAT "%10.5"
 /begin ANNOTATION ANNOTATION_LABEL "Description (coming from AUTOSAR DESC field)"
  /begin ANNOTATION_TEXT "Flag to enable the strategy to only synchronise against the drag\r\n" /end ANNOTATION_TEXT
 /end ANNOTATION
/end CHARACTERISTIC
/begin CHARACTERISTIC GAC_CALIB.GAC_GracB.GAC_FLGGBLK0MINTGTSYNC "" VALUE 0x80611A08 DefaultValueRecordLayout_AUTOSAR_Platform_BaseTypes_uint8 255.0 DefaultIdenticalCompu 0.0 255. FORMAT "%10.5"
 /begin ANNOTATION ANNOTATION_LABEL "Description (coming from AUTOSAR DESC field)"
  /begin ANNOTATION_TEXT "flag to enable the strategy to have the gblk 0 time at least as large as the target time to synchronise the shaft\r\n" /end ANNOTATION_TEXT
 /end ANNOTATION
/end CHARACTERISTIC
/begin CHARACTERISTIC GAC_CALIB.GAC_GracB.GAC_FLGLIMITENDPRESSTOSYNCPRESS "" VALUE 0x80611A09 DefaultValueRecordLayout_AUTOSAR_Platform_BaseTypes_uint8 255.0 DefaultIdenticalCompu 0.0 255. FORMAT "%10.5"
 /begin ANNOTATION ANNOTATION_LABEL "Description (coming from AUTOSAR DESC field)"
  /begin ANNOTATION_TEXT "limit the minimum pressure in the free flight phase to the max pressure during the synchronisation phase\r\n" /end ANNOTATION_TEXT
 /end ANNOTATION
/end CHARACTERISTIC
/begin CHARACTERISTIC GAC_CALIB.GAC_GracB.GAC_FLGMOVINGMUSTBEINRANGE "" VALUE 0x80611A0A DefaultValueRecordLayout_AUTOSAR_Platform_BaseTypes_uint8 255.0 DefaultIdenticalCompu 0.0 255. FORMAT "%10.5"
 /begin ANNOTATION ANNOTATION_LABEL "Description (coming from AUTOSAR DESC field)" /begin ANNOTATION_TEXT "Moving detected must be in position range\r\n" /end ANNOTATION_TEXT /end ANNOTATION
/end CHARACTERISTIC
/begin CHARACTERISTIC GAC_CALIB.GAC_GracB.GAC_FLGNOPOSPOSNFROMN "" VALUE 0x80611A0B DefaultValueRecordLayout_AUTOSAR_Platform_BaseTypes_boolean 255.0 AUTOSAR_Platform_CompuMethods_boolean 0.0 255. FORMAT "%10.5"
 /begin ANNOTATION ANNOTATION_LABEL "Description (coming from AUTOSAR DESC field)"
  /begin ANNOTATION_TEXT "Flag inhibiting entry to positive position states, once in Neutral.\r\n" /end ANNOTATION_TEXT
 /end ANNOTATION
/end CHARACTERISTIC
/begin CHARACTERISTIC GAC_CALIB.GAC_GracB.GAC_FLGNOTMPCONDUPDATE "" VALUE 0x80611A0C DefaultValueRecordLayout_AUTOSAR_Platform_BaseTypes_boolean 255.0 AUTOSAR_Platform_CompuMethods_boolean 0.0 255. FORMAT "%10.5"
 /begin ANNOTATION ANNOTATION_LABEL "Description (coming from AUTOSAR DESC field)"
  /begin ANNOTATION_TEXT "Flag enabling continuous update of slow tasks without depending on temperature change condition.\r\n" /end ANNOTATION_TEXT
 /end ANNOTATION
/end CHARACTERISTIC
/begin CHARACTERISTIC GAC_CALIB.GAC_GracB.GAC_FLGNSTOPITERMRESETMAXTMR "" VALUE 0x80611A0D DefaultValueRecordLayout_AUTOSAR_Platform_BaseTypes_uint8 255.0 DefaultIdenticalCompu 0.0 255. FORMAT "%10.5"
 /begin ANNOTATION ANNOTATION_LABEL "Description (coming from AUTOSAR DESC field)"
  /begin ANNOTATION_TEXT "Flag to activate a maximum timer for the N stop I term reset\r\n" /end ANNOTATION_TEXT
 /end ANNOTATION
/end CHARACTERISTIC
/begin CHARACTERISTIC GAC_CALIB.GAC_GracB.GAC_FLGPVSCONFIG "" VALUE 0x80611A0E DefaultValueRecordLayout_AUTOSAR_Platform_BaseTypes_uint8 255.0 DefaultIdenticalCompu 0.0 255. FORMAT "%10.5"
 /begin ANNOTATION ANNOTATION_LABEL "Description (coming from AUTOSAR DESC field)"
  /begin ANNOTATION_TEXT "Flag to indicate whether or not the transmission is a PVS transmission\r\n" /end ANNOTATION_TEXT
 /end ANNOTATION
/end CHARACTERISTIC
/begin CHARACTERISTIC GAC_CALIB.GAC_GracB.GAC_FLGRESETGBLCKPRESSWHENMOVING "" VALUE 0x80611A0F DefaultValueRecordLayout_AUTOSAR_Platform_BaseTypes_uint8 255.0 DefaultIdenticalCompu 0.0 255. FORMAT "%10.5"
 /begin ANNOTATION ANNOTATION_LABEL "Description (coming from AUTOSAR DESC field)"
  /begin ANNOTATION_TEXT "Flag to reset the additional pressure from the gear block 3 pressure ramp once the synchro is moving\r\n" /end ANNOTATION_TEXT
 /end ANNOTATION
/end CHARACTERISTIC
/begin CHARACTERISTIC GAC_CALIB.GAC_GracB.GAC_FLGRESETITERMONSYNC "" VALUE 0x80611A10 DefaultValueRecordLayout_AUTOSAR_Platform_BaseTypes_uint8 255.0 DefaultIdenticalCompu 0.0 255. FORMAT "%10.5"
 /begin ANNOTATION ANNOTATION_LABEL "Description (coming from AUTOSAR DESC field)" /begin ANNOTATION_TEXT "Flag to reset the I term when on the synchro cone\r\n" /end ANNOTATION_TEXT /end ANNOTATION
/end CHARACTERISTIC
/begin CHARACTERISTIC GAC_CALIB.GAC_GracB.GAC_FLGSTATICADAPTENBL "" VALUE 0x80611A11 DefaultValueRecordLayout_AUTOSAR_Platform_BaseTypes_uint8 255.0 DefaultIdenticalCompu 0.0 255. FORMAT "%10.5"
 /begin ANNOTATION ANNOTATION_LABEL "Description (coming from AUTOSAR DESC field)" /begin ANNOTATION_TEXT "Allow static adaptions\r\n" /end ANNOTATION_TEXT /end ANNOTATION
/end CHARACTERISTIC
/begin CHARACTERISTIC GAC_CALIB.GAC_GracB.GAC_FLGUSELEARNEDSYNCPOS "" VALUE 0x80611A12 DefaultValueRecordLayout_AUTOSAR_Platform_BaseTypes_uint8 255.0 DefaultIdenticalCompu 0.0 255. FORMAT "%10.5"
 /begin ANNOTATION ANNOTATION_LABEL "Description (coming from AUTOSAR DESC field)"
  /begin ANNOTATION_TEXT "Flag to indicate the use of the learned on synchro position when determining synchronisation end\r\n" /end ANNOTATION_TEXT
 /end ANNOTATION
/end CHARACTERISTIC
/begin CHARACTERISTIC GAC_CALIB.GAC_GracB.GAC_FLGUSENSTOPERROR "" VALUE 0x80611A13 DefaultValueRecordLayout_AUTOSAR_Platform_BaseTypes_uint8 255.0 DefaultIdenticalCompu 0.0 255. FORMAT "%10.5"
 /begin ANNOTATION ANNOTATION_LABEL "Description (coming from AUTOSAR DESC field)" /begin ANNOTATION_TEXT "Flag to use N stop error instead of main error term\r\n" /end ANNOTATION_TEXT /end ANNOTATION
/end CHARACTERISTIC
/begin CHARACTERISTIC GAC_CALIB.GAC_GracB.GAC_FLOWMINITERMCLOSEOUT "" VALUE 0x80611976 DefaultValueRecordLayout_AUTOSAR_Platform_BaseTypes_sint16 64.0 RB_PT_PCT_SWC_GAC_CompuMethods_ratio_0p001 -32. 32. FORMAT "%10.5"
 /begin ANNOTATION ANNOTATION_LABEL "Description (coming from AUTOSAR DESC field)" /begin ANNOTATION_TEXT "minimum synchro flow to enable neutral close out\r\n" /end ANNOTATION_TEXT /end ANNOTATION
/end CHARACTERISTIC
/begin CHARACTERISTIC GAC_CALIB.GAC_GracB.GAC_FLWGHOLDBCKLIM "" VALUE 0x80611978 DefaultValueRecordLayout_AUTOSAR_Platform_BaseTypes_sint16 64.0 RB_PT_PCT_SWC_GAC_CompuMethods_ratio_0p001 -32. 32. FORMAT "%10.5"
 /begin ANNOTATION ANNOTATION_LABEL "Description (coming from AUTOSAR DESC field)" /begin ANNOTATION_TEXT "Flow limit used for GHold active.\r\n" /end ANNOTATION_TEXT /end ANNOTATION
/end CHARACTERISTIC
/begin CHARACTERISTIC GAC_CALIB.GAC_GracB.GAC_FLWMINGBLCK3 "" VALUE 0x8061197A DefaultValueRecordLayout_AUTOSAR_Platform_BaseTypes_sint16 64.0 RB_PT_PCT_SWC_GAC_CompuMethods_ratio_0p001 -32. 32. FORMAT "%10.5"
 /begin ANNOTATION ANNOTATION_LABEL "Description (coming from AUTOSAR DESC field)" /begin ANNOTATION_TEXT "minimum flow to allow gear block 3 strategy\r\n" /end ANNOTATION_TEXT /end ANNOTATION
/end CHARACTERISTIC
/begin CHARACTERISTIC GAC_CALIB.GAC_GracB.GAC_FLWSFFVELCTRLNOSYNCABS "" CURVE 0x80611DBE RB_PT_PCT_SWC_GAC_RecordLayouts_RL_Curve_uint16_4_uint16_4 32.0 RB_PT_PCT_SWC_GAC_CompuMethods_ratio_0p001 0.0 32. FORMAT "%10.5"
 /begin ANNOTATION ANNOTATION_LABEL "Description (coming from AUTOSAR DESC field)"
  /begin ANNOTATION_TEXT "Unsigned feedforward flow gains for velocity control before the synchro phase or Neutral actuation.\r\n" /end ANNOTATION_TEXT
 /end ANNOTATION
 /begin AXIS_DESCR STD_AXIS NO_INPUT_QUANTITY RB_PT_PCT_SWC_GAC_CompuMethods_ratio_0p001 4 0.0 1.2 FORMAT "%10.5" DEPOSIT ABSOLUTE /end AXIS_DESCR
/end CHARACTERISTIC
/begin CHARACTERISTIC GAC_CALIB.GAC_GracB.GAC_FLWSFFVELCTRLSYNCABS "" CURVE 0x80611DD0 RB_PT_PCT_SWC_GAC_RecordLayouts_RL_Curve_uint16_4_uint16_4 32.0 RB_PT_PCT_SWC_GAC_CompuMethods_ratio_0p001 0.0 32. FORMAT "%10.5"
 /begin ANNOTATION ANNOTATION_LABEL "Description (coming from AUTOSAR DESC field)"
  /begin ANNOTATION_TEXT "Unsigned feedforward flow gains for velocity control after the synchro phase.\r\n" /end ANNOTATION_TEXT
 /end ANNOTATION
 /begin AXIS_DESCR STD_AXIS NO_INPUT_QUANTITY RB_PT_PCT_SWC_GAC_CompuMethods_ratio_0p001 4 0.0 1.2 FORMAT "%10.5" DEPOSIT ABSOLUTE /end AXIS_DESCR
/end CHARACTERISTIC
/begin CHARACTERISTIC GAC_CALIB.GAC_GracB.GAC_FLWSIVELCTRLNOSYNC "" CURVE 0x80611DE2 RB_PT_PCT_SWC_GAC_RecordLayouts_RL_Curve_sint16_7_sint16_7 64.0 RB_PT_PCT_SWC_GAC_CompuMethods_ratio_0p001 -32. 32. FORMAT "%10.5"
 /begin ANNOTATION ANNOTATION_LABEL "Description (coming from AUTOSAR DESC field)"
  /begin ANNOTATION_TEXT "Integral flow gains for velocity control before the synchro phase.\r\n" /end ANNOTATION_TEXT
 /end ANNOTATION
 /begin AXIS_DESCR STD_AXIS NO_INPUT_QUANTITY RB_PT_PCT_SWC_GAC_CompuMethods_ratio_0p001 7 -1.2 1.2 FORMAT "%10.5" DEPOSIT ABSOLUTE /end AXIS_DESCR
/end CHARACTERISTIC
/begin CHARACTERISTIC GAC_CALIB.GAC_GracB.GAC_FLWSIVELCTRLSYNC "" CURVE 0x80611E00 RB_PT_PCT_SWC_GAC_RecordLayouts_RL_Curve_sint16_7_sint16_7 64.0 RB_PT_PCT_SWC_GAC_CompuMethods_ratio_0p001 -32. 32. FORMAT "%10.5"
 /begin ANNOTATION ANNOTATION_LABEL "Description (coming from AUTOSAR DESC field)"
  /begin ANNOTATION_TEXT "Integral flow gains for velocity control after the synchro phase.\r\n" /end ANNOTATION_TEXT
 /end ANNOTATION
 /begin AXIS_DESCR STD_AXIS NO_INPUT_QUANTITY RB_PT_PCT_SWC_GAC_CompuMethods_ratio_0p001 7 -1.2 1.2 FORMAT "%10.5" DEPOSIT ABSOLUTE /end AXIS_DESCR
/end CHARACTERISTIC
/begin CHARACTERISTIC GAC_CALIB.GAC_GracB.GAC_FLWSNHOLD "" CURVE 0x80611E1E RB_PT_PCT_SWC_GAC_RecordLayouts_RL_Curve_sint16_4_uint16_4 64.0 RB_PT_PCT_SWC_GAC_CompuMethods_ratio_0p001 -32. 32. FORMAT "%10.5"
 /begin ANNOTATION ANNOTATION_LABEL "Description (coming from AUTOSAR DESC field)"
  /begin ANNOTATION_TEXT "Proportional flow gains for velocity (position) control in NHold or drain phase after actuation to Neutral.\r\n" /end ANNOTATION_TEXT
 /end ANNOTATION
 /begin AXIS_DESCR STD_AXIS NO_INPUT_QUANTITY RB_PT_PCT_SWC_GAC_CompuMethods_ratio_0p001 4 0.0 20. FORMAT "%10.5" DEPOSIT ABSOLUTE /end AXIS_DESCR
/end CHARACTERISTIC
/begin CHARACTERISTIC GAC_CALIB.GAC_GracB.GAC_FLWSPVELCTRLGHOLD "" CURVE 0x80611E30 RB_PT_PCT_SWC_GAC_RecordLayouts_RL_Curve_sint16_7_sint16_7 64.0 RB_PT_PCT_SWC_GAC_CompuMethods_ratio_0p001 -32. 32. FORMAT "%10.5"
 /begin ANNOTATION ANNOTATION_LABEL "Description (coming from AUTOSAR DESC field)"
  /begin ANNOTATION_TEXT "Proportional flow gains for velocity (position) control in the GHold phase.\r\n" /end ANNOTATION_TEXT
 /end ANNOTATION
 /begin AXIS_DESCR STD_AXIS NO_INPUT_QUANTITY RB_PT_PCT_SWC_GAC_CompuMethods_ratio_0p001 7 -2. 2. FORMAT "%10.5" DEPOSIT ABSOLUTE /end AXIS_DESCR
/end CHARACTERISTIC
/begin CHARACTERISTIC GAC_CALIB.GAC_GracB.GAC_FLWSPVELCTRLGHOLDRULE26 "" CURVE 0x80611E4E RB_PT_PCT_SWC_GAC_RecordLayouts_RL_Curve_sint16_7_sint16_7 64.0 RB_PT_PCT_SWC_GAC_CompuMethods_ratio_0p001 -32. 32. FORMAT "%10.5"
 /begin ANNOTATION ANNOTATION_LABEL "Description (coming from AUTOSAR DESC field)"
  /begin ANNOTATION_TEXT "Proportional flow gains for velocity (position) control in the GHold phase.\r\n" /end ANNOTATION_TEXT
 /end ANNOTATION
 /begin AXIS_DESCR STD_AXIS NO_INPUT_QUANTITY RB_PT_PCT_SWC_GAC_CompuMethods_ratio_0p001 7 -2. 2. FORMAT "%10.5" DEPOSIT ABSOLUTE /end AXIS_DESCR
/end CHARACTERISTIC
/begin CHARACTERISTIC GAC_CALIB.GAC_GracB.GAC_FLWSPVELCTRLNSTOP "" MAP 0x80611E6C RB_PT_PCT_SWC_GAC_RecordLayouts_RL_Map_sint16_27_sint16_9_sint16_3 64.0 RB_PT_PCT_SWC_GAC_CompuMethods_ratio_0p001 -32. 32. FORMAT "%10.5"
 /begin ANNOTATION ANNOTATION_LABEL "Description (coming from AUTOSAR DESC field)"
  /begin ANNOTATION_TEXT "Proportional flow gains for velocity control in the NStop phase.\r\n" /end ANNOTATION_TEXT
 /end ANNOTATION
 /begin AXIS_DESCR STD_AXIS NO_INPUT_QUANTITY RB_PT_PCT_SWC_GAC_CompuMethods_ratio_0p001 9 -1.2 1.2 FORMAT "%10.5" DEPOSIT ABSOLUTE /end AXIS_DESCR
 /begin AXIS_DESCR STD_AXIS NO_INPUT_QUANTITY RB_PT_PCT_SWC_GAC_CompuMethods_ident 3 -50. 200. FORMAT "%10.5" DEPOSIT ABSOLUTE /end AXIS_DESCR
/end CHARACTERISTIC
/begin CHARACTERISTIC GAC_CALIB.GAC_GracB.GAC_FLWSVLVSTUCKDEM "" VAL_BLK 0x80611954 DefaultValueRecordLayout_AUTOSAR_Platform_BaseTypes_sint16 64.0 RB_PT_PCT_SWC_GAC_CompuMethods_ratio_0p001 -32. 32. FORMAT "%10.5"
 /begin ANNOTATION ANNOTATION_LABEL "Description (coming from AUTOSAR DESC field)"
  /begin ANNOTATION_TEXT "Flow demands requested by the valve stuck diagnostic and failure handling..\r\n" /end ANNOTATION_TEXT
 /end ANNOTATION
 MATRIX_DIM 3 1 1 /end CHARACTERISTIC
/begin CHARACTERISTIC GAC_CALIB.GAC_GracB.GAC_GracPosnInitTmr.LIB_DT "" VALUE 0x80611C34 DefaultValueRecordLayout_AUTOSAR_Platform_BaseTypes_uint16 65.535 RB_PT_PCT_SWC_GAC_CompuMethods_ratio_0p001 0.0 65.535 FORMAT "%10.5"
 /begin ANNOTATION ANNOTATION_LABEL "Description (coming from AUTOSAR DESC field)" /begin ANNOTATION_TEXT "Timer decrement value.\r\n" /end ANNOTATION_TEXT /end ANNOTATION
/end CHARACTERISTIC
/begin CHARACTERISTIC GAC_CALIB.GAC_GracB.GAC_IDDIAGENBLSHIFT "" VALUE 0x8061195C DefaultValueRecordLayout_AUTOSAR_Platform_BaseTypes_uint32 4194304.0 RB_PT_PCT_SWC_GAC_CompuMethods_ident 0.0 4194304. FORMAT "%10.5"
 /begin ANNOTATION ANNOTATION_LABEL "Description (coming from AUTOSAR DESC field)"
  /begin ANNOTATION_TEXT "multiplication factor to shift the bits for each actuator\r\n" /end ANNOTATION_TEXT
 /end ANNOTATION
/end CHARACTERISTIC
/begin CHARACTERISTIC GAC_CALIB.GAC_GracB.GAC_InGearLearn.GAC_FCTRINGEARLRNDELTAADPT "" VALUE 0x80611C3E DefaultValueRecordLayout_AUTOSAR_Platform_BaseTypes_uint8 1.0 RB_PT_PCT_SWC_GAC_CompuMethods_ratio_0p01 0.0 1. FORMAT "%10.5"
 /begin ANNOTATION ANNOTATION_LABEL "Description (coming from AUTOSAR DESC field)"
  /begin ANNOTATION_TEXT "percentage factor of the delta that is added to the learned in gear position\r\n" /end ANNOTATION_TEXT
 /end ANNOTATION
/end CHARACTERISTIC
/begin CHARACTERISTIC GAC_CALIB.GAC_GracB.GAC_InGearLearn.GAC_FCTRINGEARLRNDELTAADPTNOSTORE "" VALUE 0x80611C3F DefaultValueRecordLayout_AUTOSAR_Platform_BaseTypes_uint8 1.0 RB_PT_PCT_SWC_GAC_CompuMethods_ratio_0p01 0.0 1. FORMAT "%10.5"
 /begin ANNOTATION ANNOTATION_LABEL "Description (coming from AUTOSAR DESC field)"
  /begin ANNOTATION_TEXT "percentage factor of the delta that is added to the learned in gear position\r\n" /end ANNOTATION_TEXT
 /end ANNOTATION
/end CHARACTERISTIC
/begin CHARACTERISTIC GAC_CALIB.GAC_GracB.GAC_InGearLearn.GAC_FLGCHECKNOFSTDURINGINGRLEARN "" VALUE 0x80611C40 DefaultValueRecordLayout_AUTOSAR_Platform_BaseTypes_uint8 255.0 DefaultIdenticalCompu 0.0 255. FORMAT "%10.5"
 /begin ANNOTATION ANNOTATION_LABEL "Description (coming from AUTOSAR DESC field)"
  /begin ANNOTATION_TEXT "Flag to enable/disable checking neutral offset during in gear learn\r\n" /end ANNOTATION_TEXT
 /end ANNOTATION
/end CHARACTERISTIC
/begin CHARACTERISTIC GAC_CALIB.GAC_GracB.GAC_InGearLearn.GAC_FLGCHECKNOFSTDURINGUDSEXPORT "" VALUE 0x80611C41 DefaultValueRecordLayout_AUTOSAR_Platform_BaseTypes_uint8 255.0 DefaultIdenticalCompu 0.0 255. FORMAT "%10.5"
 /begin ANNOTATION ANNOTATION_LABEL "Description (coming from AUTOSAR DESC field)"
  /begin ANNOTATION_TEXT "Flag to enable/disable checking neutral offset during in gear learn - UDS version\r\n" /end ANNOTATION_TEXT
 /end ANNOTATION
/end CHARACTERISTIC
/begin CHARACTERISTIC GAC_CALIB.GAC_GracB.GAC_InGearLearn.GAC_FLGFORCEINGRLEARNCHECK "" VALUE 0x80611C42 DefaultValueRecordLayout_AUTOSAR_Platform_BaseTypes_uint8 255.0 DefaultIdenticalCompu 0.0 255. FORMAT "%10.5"
 /begin ANNOTATION ANNOTATION_LABEL "Description (coming from AUTOSAR DESC field)"
  /begin ANNOTATION_TEXT "Flag to force the in gear position learn check and write to NV\r\n" /end ANNOTATION_TEXT
 /end ANNOTATION
/end CHARACTERISTIC
/begin CHARACTERISTIC GAC_CALIB.GAC_GracB.GAC_InGearLearn.GAC_FLGRESETINGEARPOSIFADAPTBAD "" VALUE 0x80611C43 DefaultValueRecordLayout_AUTOSAR_Platform_BaseTypes_uint8 255.0 DefaultIdenticalCompu 0.0 255. FORMAT "%10.5"
 /begin ANNOTATION ANNOTATION_LABEL "Description (coming from AUTOSAR DESC field)"
  /begin ANNOTATION_TEXT "Flag to enable value reset if the adaption if the in gear learned position is bad\r\n" /end ANNOTATION_TEXT
 /end ANNOTATION
/end CHARACTERISTIC
/begin CHARACTERISTIC GAC_CALIB.GAC_GracB.GAC_InGearLearn.GAC_FLGRESETINVALIDLEARN "" VALUE 0x80611C44 DefaultValueRecordLayout_AUTOSAR_Platform_BaseTypes_uint8 255.0 DefaultIdenticalCompu 0.0 255. FORMAT "%10.5"
 /begin ANNOTATION ANNOTATION_LABEL "Description (coming from AUTOSAR DESC field)"
  /begin ANNOTATION_TEXT "Flag to enable value reset if any learn if the in gear learned position is bad\r\n" /end ANNOTATION_TEXT
 /end ANNOTATION
/end CHARACTERISTIC
/begin CHARACTERISTIC GAC_CALIB.GAC_GracB.GAC_InGearLearn.GAC_FLGUSEORIGINGRLEARN "" VALUE 0x80611C45 DefaultValueRecordLayout_AUTOSAR_Platform_BaseTypes_uint8 255.0 DefaultIdenticalCompu 0.0 255. FORMAT "%10.5"
 /begin ANNOTATION ANNOTATION_LABEL "Description (coming from AUTOSAR DESC field)" /begin ANNOTATION_TEXT "Flag to enable/ disable old in gear learn method\r\n" /end ANNOTATION_TEXT /end ANNOTATION
/end CHARACTERISTIC
/begin CHARACTERISTIC GAC_CALIB.GAC_GracB.GAC_InGearLearn.GAC_IDINGEARLEARNUDSVALUE "" VALUE 0x80611C46 DefaultValueRecordLayout_AUTOSAR_Platform_BaseTypes_uint8 255.0 RB_PT_PCT_SWC_GAC_CompuMethods_ident 0.0 255. FORMAT "%10.5"
 /begin ANNOTATION ANNOTATION_LABEL "Description (coming from AUTOSAR DESC field)"
  /begin ANNOTATION_TEXT "Switch case input to switch learned value sent out over UDS\r\n" /end ANNOTATION_TEXT
 /end ANNOTATION
/end CHARACTERISTIC
/begin CHARACTERISTIC GAC_CALIB.GAC_GracB.GAC_InGearLearn.GAC_IDSYNCHRODIRNOTPOSSIBLE "" VALUE 0x80611C47 DefaultValueRecordLayout_AUTOSAR_Platform_BaseTypes_uint8 255.0 RB_PT_PCT_SWC_GAC_CompuMethods_ident 0.0 255. FORMAT "%10.5"
 /begin ANNOTATION ANNOTATION_LABEL "Description (coming from AUTOSAR DESC field)"
  /begin ANNOTATION_TEXT "ID to indicate that the synchroniser position direction is not possible (1=left not possible, 2=right not possible)\r\n" /end ANNOTATION_TEXT
 /end ANNOTATION
/end CHARACTERISTIC
/begin CHARACTERISTIC GAC_CALIB.GAC_GracB.GAC_InGearLearn.GAC_POSNLESSINGRLRNNEG "" VALUE 0x80611C36 DefaultValueRecordLayout_AUTOSAR_Platform_BaseTypes_uint16 2.0 RB_PT_PCT_SWC_GAC_CompuMethods_ratio_0p001 0.0 2. FORMAT "%10.5"
 /begin ANNOTATION ANNOTATION_LABEL "Description (coming from AUTOSAR DESC field)"
  /begin ANNOTATION_TEXT "Position margin removed for calculation of the learnt in negative gear position.\r\n" /end ANNOTATION_TEXT
 /end ANNOTATION
/end CHARACTERISTIC
/begin CHARACTERISTIC GAC_CALIB.GAC_GracB.GAC_InGearLearn.GAC_POSNLESSINGRLRNPOS "" VALUE 0x80611C38 DefaultValueRecordLayout_AUTOSAR_Platform_BaseTypes_uint16 2.0 RB_PT_PCT_SWC_GAC_CompuMethods_ratio_0p001 0.0 2. FORMAT "%10.5"
 /begin ANNOTATION ANNOTATION_LABEL "Description (coming from AUTOSAR DESC field)"
  /begin ANNOTATION_TEXT "Position margin removed for calculation of the learnt in positive gear position.\r\n" /end ANNOTATION_TEXT
 /end ANNOTATION
/end CHARACTERISTIC
/begin CHARACTERISTIC GAC_CALIB.GAC_GracB.GAC_InGearLearn.GAC_POSNMAXINGRLRN "" VALUE 0x80611C3A DefaultValueRecordLayout_AUTOSAR_Platform_BaseTypes_sint16 40.0 RB_PT_PCT_SWC_GAC_CompuMethods_ratio_0p001 -20. 20. FORMAT "%10.5"
 /begin ANNOTATION ANNOTATION_LABEL "Description (coming from AUTOSAR DESC field)" /begin ANNOTATION_TEXT "Maximum allowed position for in gear learn.\r\n" /end ANNOTATION_TEXT /end ANNOTATION
/end CHARACTERISTIC
/begin CHARACTERISTIC GAC_CALIB.GAC_GracB.GAC_InGearLearn.GAC_POSNMININGRLRN "" VALUE 0x80611C3C DefaultValueRecordLayout_AUTOSAR_Platform_BaseTypes_sint16 40.0 RB_PT_PCT_SWC_GAC_CompuMethods_ratio_0p001 -20. 20. FORMAT "%10.5"
 /begin ANNOTATION ANNOTATION_LABEL "Description (coming from AUTOSAR DESC field)" /begin ANNOTATION_TEXT "Minimum allowed position for in gear learn.\r\n" /end ANNOTATION_TEXT /end ANNOTATION
/end CHARACTERISTIC
/begin CHARACTERISTIC GAC_CALIB.GAC_GracB.GAC_InGearLearnTrig.GAC_BOBFLGFORCEINGEARLEARN "" VALUE 0x80611C50 DefaultValueRecordLayout_AUTOSAR_Platform_BaseTypes_uint8 255.0 DefaultIdenticalCompu 0.0 255. FORMAT "%10.5"
 /begin ANNOTATION ANNOTATION_LABEL "Description (coming from AUTOSAR DESC field)" /begin ANNOTATION_TEXT "Flag to force in gear position learn\r\n" /end ANNOTATION_TEXT /end ANNOTATION
/end CHARACTERISTIC
/begin CHARACTERISTIC GAC_CALIB.GAC_GracB.GAC_InGearLearnTrig.GAC_CNTTRIGADPINGRPOS "" VALUE 0x80611C51 DefaultValueRecordLayout_AUTOSAR_Platform_BaseTypes_uint8 10.0 RB_PT_PCT_SWC_GAC_CompuMethods_ident 0.0 10. FORMAT "%10.5"
 /begin ANNOTATION ANNOTATION_LABEL "Description (coming from AUTOSAR DESC field)"
  /begin ANNOTATION_TEXT "Counter value used to trigger the request for in positive gear learn.\r\n" /end ANNOTATION_TEXT
 /end ANNOTATION
/end CHARACTERISTIC
/begin CHARACTERISTIC GAC_CALIB.GAC_GracB.GAC_InGearLearnTrig.GAC_CNTTRIGAPPINGRNEG "" VALUE 0x80611C52 DefaultValueRecordLayout_AUTOSAR_Platform_BaseTypes_uint8 10.0 RB_PT_PCT_SWC_GAC_CompuMethods_ident 0.0 10. FORMAT "%10.5"
 /begin ANNOTATION ANNOTATION_LABEL "Description (coming from AUTOSAR DESC field)"
  /begin ANNOTATION_TEXT "Counter value used to trigger the request for in negative gear learn.\r\n" /end ANNOTATION_TEXT
 /end ANNOTATION
/end CHARACTERISTIC
/begin CHARACTERISTIC GAC_CALIB.GAC_GracB.GAC_InGearLearnTrig.GAC_FLGSADPINGRNEGAGGOK "" VAL_BLK 0x80611C48 DefaultValueRecordLayout_AUTOSAR_Platform_BaseTypes_boolean 255.0 AUTOSAR_Platform_CompuMethods_boolean 0.0 255. FORMAT "%10.5"
 /begin ANNOTATION ANNOTATION_LABEL "Description (coming from AUTOSAR DESC field)"
  /begin ANNOTATION_TEXT "Array of flags indicating in negative gear learn allowed, for each actuation aggression.\r\n" /end ANNOTATION_TEXT
 /end ANNOTATION
 MATRIX_DIM 4 1 1 /end CHARACTERISTIC
/begin CHARACTERISTIC GAC_CALIB.GAC_GracB.GAC_InGearLearnTrig.GAC_FLGSADPINGRPOSAGGOK "" VAL_BLK 0x80611C4C DefaultValueRecordLayout_AUTOSAR_Platform_BaseTypes_boolean 255.0 AUTOSAR_Platform_CompuMethods_boolean 0.0 255. FORMAT "%10.5"
 /begin ANNOTATION ANNOTATION_LABEL "Description (coming from AUTOSAR DESC field)"
  /begin ANNOTATION_TEXT "Array of flags indicating in positive gear learn allowed, for each actuation aggression.\r\n" /end ANNOTATION_TEXT
 /end ANNOTATION
 MATRIX_DIM 4 1 1 /end CHARACTERISTIC
/begin CHARACTERISTIC GAC_CALIB.GAC_GracB.GAC_InGrDebTmr.LIB_DT "" VALUE 0x80611C54 DefaultValueRecordLayout_AUTOSAR_Platform_BaseTypes_uint16 65.535 RB_PT_PCT_SWC_GAC_CompuMethods_ratio_0p001 0.0 65.535 FORMAT "%10.5"
 /begin ANNOTATION ANNOTATION_LABEL "Description (coming from AUTOSAR DESC field)" /begin ANNOTATION_TEXT "Timer decrement value.\r\n" /end ANNOTATION_TEXT /end ANNOTATION
/end CHARACTERISTIC
/begin CHARACTERISTIC GAC_CALIB.GAC_GracB.GAC_InGrPressToEndStopTmr.LIB_DT "" VALUE 0x80611C56 DefaultValueRecordLayout_AUTOSAR_Platform_BaseTypes_uint16 65.535 RB_PT_PCT_SWC_GAC_CompuMethods_ratio_0p001 0.0 65.535 FORMAT "%10.5"
 /begin ANNOTATION ANNOTATION_LABEL "Description (coming from AUTOSAR DESC field)" /begin ANNOTATION_TEXT "Timer decrement value.\r\n" /end ANNOTATION_TEXT /end ANNOTATION
/end CHARACTERISTIC
/begin CHARACTERISTIC GAC_CALIB.GAC_GracB.GAC_InNDebTmr.LIB_DT "" VALUE 0x80611C58 DefaultValueRecordLayout_AUTOSAR_Platform_BaseTypes_uint16 65.535 RB_PT_PCT_SWC_GAC_CompuMethods_ratio_0p001 0.0 65.535 FORMAT "%10.5"
 /begin ANNOTATION ANNOTATION_LABEL "Description (coming from AUTOSAR DESC field)" /begin ANNOTATION_TEXT "Timer decrement value.\r\n" /end ANNOTATION_TEXT /end ANNOTATION
/end CHARACTERISTIC
/begin CHARACTERISTIC GAC_CALIB.GAC_GracB.GAC_POSNADPPUSHINGR "" VALUE 0x8061197C DefaultValueRecordLayout_AUTOSAR_Platform_BaseTypes_uint16 100.0 RB_PT_PCT_SWC_GAC_CompuMethods_ident 0.0 100. FORMAT "%10.5"
 /begin ANNOTATION ANNOTATION_LABEL "Description (coming from AUTOSAR DESC field)"
  /begin ANNOTATION_TEXT "Gear actuator position used for adaptation 'push in gear'.\r\n" /end ANNOTATION_TEXT
 /end ANNOTATION
/end CHARACTERISTIC
/begin CHARACTERISTIC GAC_CALIB.GAC_GracB.GAC_POSNGRACCLOSEOUTTHRESH "" VALUE 0x8061197E DefaultValueRecordLayout_AUTOSAR_Platform_BaseTypes_uint16 20.0 RB_PT_PCT_SWC_GAC_CompuMethods_ratio_0p001 0.0 20. FORMAT "%10.5"
 /begin ANNOTATION ANNOTATION_LABEL "Description (coming from AUTOSAR DESC field)"
  /begin ANNOTATION_TEXT "Maximum absolute synchroniser position for the neutral close out to activate\r\n" /end ANNOTATION_TEXT
 /end ANNOTATION
/end CHARACTERISTIC
/begin CHARACTERISTIC GAC_CALIB.GAC_GracB.GAC_POSNGRACFAILPUSHINGR "" VALUE 0x80611980 DefaultValueRecordLayout_AUTOSAR_Platform_BaseTypes_uint16 100.0 RB_PT_PCT_SWC_GAC_CompuMethods_ident 0.0 100. FORMAT "%10.5"
 /begin ANNOTATION ANNOTATION_LABEL "Description (coming from AUTOSAR DESC field)"
  /begin ANNOTATION_TEXT "Gear actuator position used for 'fail push in gear' active.\r\n" /end ANNOTATION_TEXT
 /end ANNOTATION
/end CHARACTERISTIC
/begin CHARACTERISTIC GAC_CALIB.GAC_GracB.GAC_POSNGRACNSTOPRESETI "" VALUE 0x80611982 DefaultValueRecordLayout_AUTOSAR_Platform_BaseTypes_uint16 20.0 RB_PT_PCT_SWC_GAC_CompuMethods_ratio_0p001 0.0 20. FORMAT "%10.5"
 /begin ANNOTATION ANNOTATION_LABEL "Description (coming from AUTOSAR DESC field)"
  /begin ANNOTATION_TEXT "Gear actuator position used for resetting the I term during NStop phase.\r\n" /end ANNOTATION_TEXT
 /end ANNOTATION
/end CHARACTERISTIC
/begin CHARACTERISTIC GAC_CALIB.GAC_GracB.GAC_POSNGRACSYNCDEFAULT "" VALUE 0x80611984 DefaultValueRecordLayout_AUTOSAR_Platform_BaseTypes_sint16 40.0 RB_PT_PCT_SWC_GAC_CompuMethods_ratio_0p001 -20. 20. FORMAT "%10.5"
 /begin ANNOTATION ANNOTATION_LABEL "Description (coming from AUTOSAR DESC field)"
  /begin ANNOTATION_TEXT "Gear actuator limit position used for synchronisation end detection.\r\n" /end ANNOTATION_TEXT
 /end ANNOTATION
/end CHARACTERISTIC
/begin CHARACTERISTIC GAC_CALIB.GAC_GracB.GAC_POSNGRACSYNCEXITMIN "" VALUE 0x80611986 DefaultValueRecordLayout_AUTOSAR_Platform_BaseTypes_sint16 40.0 RB_PT_PCT_SWC_GAC_CompuMethods_ratio_0p001 -20. 20. FORMAT "%10.5"
 /begin ANNOTATION ANNOTATION_LABEL "Description (coming from AUTOSAR DESC field)"
  /begin ANNOTATION_TEXT "Gear actuator low position used for synchronisation start detection on the positive gear.\r\n" /end ANNOTATION_TEXT
 /end ANNOTATION
/end CHARACTERISTIC
/begin CHARACTERISTIC GAC_CALIB.GAC_GracB.GAC_POSNGRACSYNCHIGR "" VALUE 0x80611988 DefaultValueRecordLayout_AUTOSAR_Platform_BaseTypes_sint16 40.0 RB_PT_PCT_SWC_GAC_CompuMethods_ratio_0p001 -20. 20. FORMAT "%10.5"
 /begin ANNOTATION ANNOTATION_LABEL "Description (coming from AUTOSAR DESC field)"
  /begin ANNOTATION_TEXT "Gear actuator high position used for synchronisation start detection on the positive gear.\r\n" /end ANNOTATION_TEXT
 /end ANNOTATION
/end CHARACTERISTIC
/begin CHARACTERISTIC GAC_CALIB.GAC_GracB.GAC_POSNGRACSYNCLOWGR "" VALUE 0x8061198A DefaultValueRecordLayout_AUTOSAR_Platform_BaseTypes_sint16 40.0 RB_PT_PCT_SWC_GAC_CompuMethods_ratio_0p001 -20. 20. FORMAT "%10.5"
 /begin ANNOTATION ANNOTATION_LABEL "Description (coming from AUTOSAR DESC field)"
  /begin ANNOTATION_TEXT "Gear actuator low position used for synchronisation start detection on the positive gear.\r\n" /end ANNOTATION_TEXT
 /end ANNOTATION
/end CHARACTERISTIC
/begin CHARACTERISTIC GAC_CALIB.GAC_GracB.GAC_POSNMAXINGRLRN "" VALUE 0x8061198C DefaultValueRecordLayout_AUTOSAR_Platform_BaseTypes_sint16 40.0 RB_PT_PCT_SWC_GAC_CompuMethods_ratio_0p001 -20. 20. FORMAT "%10.5"
 /begin ANNOTATION ANNOTATION_LABEL "Description (coming from AUTOSAR DESC field)" /begin ANNOTATION_TEXT "Maximum allowed position for in negative gear learn.\r\n" /end ANNOTATION_TEXT /end ANNOTATION
/end CHARACTERISTIC
/begin CHARACTERISTIC GAC_CALIB.GAC_GracB.GAC_POSNMAXMODNBAND "" VALUE 0x8061198E DefaultValueRecordLayout_AUTOSAR_Platform_BaseTypes_sint16 40.0 RB_PT_PCT_SWC_GAC_CompuMethods_ratio_0p001 -20. 20. FORMAT "%10.5"
 /begin ANNOTATION ANNOTATION_LABEL "Description (coming from AUTOSAR DESC field)"
  /begin ANNOTATION_TEXT "Maximum allowed position that GAC can modify the neutral offset band for drifting actuators\r\n" /end ANNOTATION_TEXT
 /end ANNOTATION
/end CHARACTERISTIC
/begin CHARACTERISTIC GAC_CALIB.GAC_GracB.GAC_POSNNMODIFY "" VALUE 0x80611990 DefaultValueRecordLayout_AUTOSAR_Platform_BaseTypes_sint16 40.0 RB_PT_PCT_SWC_GAC_CompuMethods_ratio_0p001 -20. 20. FORMAT "%10.5"
 /begin ANNOTATION ANNOTATION_LABEL "Description (coming from AUTOSAR DESC field)" /begin ANNOTATION_TEXT "Position offset for the neutral window detection\r\n" /end ANNOTATION_TEXT /end ANNOTATION
/end CHARACTERISTIC
/begin CHARACTERISTIC GAC_CALIB.GAC_GracB.GAC_POSNOFFSETGHOLD "" VALUE 0x80611992 DefaultValueRecordLayout_AUTOSAR_Platform_BaseTypes_sint16 40.0 RB_PT_PCT_SWC_GAC_CompuMethods_ratio_0p001 -20. 20. FORMAT "%10.5"
 /begin ANNOTATION ANNOTATION_LABEL "Description (coming from AUTOSAR DESC field)"
  /begin ANNOTATION_TEXT "Position tolerance used for gear hold phase target position.\r\n" /end ANNOTATION_TEXT
 /end ANNOTATION
/end CHARACTERISTIC
/begin CHARACTERISTIC GAC_CALIB.GAC_GracB.GAC_POSNSFRKBENDGRNEG "" CURVE 0x80611EBE RB_PT_PCT_SWC_GAC_RecordLayouts_RL_Curve_sint16_6_uint16_6 4.0 RB_PT_PCT_SWC_GAC_CompuMethods_ratio_0p001 -2. 2. FORMAT "%10.5"
 /begin ANNOTATION ANNOTATION_LABEL "Description (coming from AUTOSAR DESC field)"
  /begin ANNOTATION_TEXT "map for pressure to fork bend in the negative direction\r\n" /end ANNOTATION_TEXT
 /end ANNOTATION
 /begin AXIS_DESCR STD_AXIS NO_INPUT_QUANTITY RB_PT_PCT_SWC_GAC_CompuMethods_ratio_0p001 6 0.0 32. FORMAT "%10.5" DEPOSIT ABSOLUTE /end AXIS_DESCR
/end CHARACTERISTIC
/begin CHARACTERISTIC GAC_CALIB.GAC_GracB.GAC_POSNSFRKBENDGRPOS "" CURVE 0x80611ED8 RB_PT_PCT_SWC_GAC_RecordLayouts_RL_Curve_sint16_6_uint16_6 4.0 RB_PT_PCT_SWC_GAC_CompuMethods_ratio_0p001 -2. 2. FORMAT "%10.5"
 /begin ANNOTATION ANNOTATION_LABEL "Description (coming from AUTOSAR DESC field)"
  /begin ANNOTATION_TEXT "map for pressure to fork bend in the positive direction\r\n" /end ANNOTATION_TEXT
 /end ANNOTATION
 /begin AXIS_DESCR STD_AXIS NO_INPUT_QUANTITY RB_PT_PCT_SWC_GAC_CompuMethods_ratio_0p001 6 0.0 32. FORMAT "%10.5" DEPOSIT ABSOLUTE /end AXIS_DESCR
/end CHARACTERISTIC
/begin CHARACTERISTIC GAC_CALIB.GAC_GracB.GAC_POSNSTRIGNSTOPGRNEG "" CURVE 0x80611EF2 RB_PT_PCT_SWC_GAC_RecordLayouts_RL_Curve_sint16_4_sint16_4 40.0 RB_PT_PCT_SWC_GAC_CompuMethods_ratio_0p001 -20. 20. FORMAT "%10.5"
 /begin ANNOTATION ANNOTATION_LABEL "Description (coming from AUTOSAR DESC field)"
  /begin ANNOTATION_TEXT "Actuator position which NStop phase is activated - negative gear case.\r\n" /end ANNOTATION_TEXT
 /end ANNOTATION
 /begin AXIS_DESCR STD_AXIS NO_INPUT_QUANTITY RB_PT_PCT_SWC_GAC_CompuMethods_ident 4 -50. 200. FORMAT "%10.5" DEPOSIT ABSOLUTE /end AXIS_DESCR
/end CHARACTERISTIC
/begin CHARACTERISTIC GAC_CALIB.GAC_GracB.GAC_POSNSTRIGNSTOPGRPOS "" CURVE 0x80611F04 RB_PT_PCT_SWC_GAC_RecordLayouts_RL_Curve_sint16_4_sint16_4 40.0 RB_PT_PCT_SWC_GAC_CompuMethods_ratio_0p001 -20. 20. FORMAT "%10.5"
 /begin ANNOTATION ANNOTATION_LABEL "Description (coming from AUTOSAR DESC field)"
  /begin ANNOTATION_TEXT "Actuator position which NStop phase is activated - positive gear case.\r\n" /end ANNOTATION_TEXT
 /end ANNOTATION
 /begin AXIS_DESCR STD_AXIS NO_INPUT_QUANTITY RB_PT_PCT_SWC_GAC_CompuMethods_ident 4 -50. 200. FORMAT "%10.5" DEPOSIT ABSOLUTE /end AXIS_DESCR
/end CHARACTERISTIC
/begin CHARACTERISTIC GAC_CALIB.GAC_GracB.GAC_POSNSYNCFORCEEND "" VALUE 0x80611994 DefaultValueRecordLayout_AUTOSAR_Platform_BaseTypes_uint16 20.0 RB_PT_PCT_SWC_GAC_CompuMethods_ratio_0p001 0.0 20. FORMAT "%10.5"
 /begin ANNOTATION ANNOTATION_LABEL "Description (coming from AUTOSAR DESC field)"
  /begin ANNOTATION_TEXT "Position that the synchronisation phase is forced to end\r\n" /end ANNOTATION_TEXT
 /end ANNOTATION
/end CHARACTERISTIC
/begin CHARACTERISTIC GAC_CALIB.GAC_GracB.GAC_POSNTOLEXITNEOLDONE "" VALUE 0x80611996 DefaultValueRecordLayout_AUTOSAR_Platform_BaseTypes_sint16 40.0 RB_PT_PCT_SWC_GAC_CompuMethods_ratio_0p001 -20. 20. FORMAT "%10.5"
 /begin ANNOTATION ANNOTATION_LABEL "Description (coming from AUTOSAR DESC field)"
  /begin ANNOTATION_TEXT "Neutral position tolerance when EOL Neutral learn has completed.\r\n" /end ANNOTATION_TEXT
 /end ANNOTATION
/end CHARACTERISTIC
/begin CHARACTERISTIC GAC_CALIB.GAC_GracB.GAC_POSNTOLGHOLD "" VALUE 0x80611998 DefaultValueRecordLayout_AUTOSAR_Platform_BaseTypes_uint16 5.0 RB_PT_PCT_SWC_GAC_CompuMethods_ratio_0p001 0.0 5. FORMAT "%10.5"
 /begin ANNOTATION ANNOTATION_LABEL "Description (coming from AUTOSAR DESC field)"
  /begin ANNOTATION_TEXT "Position tolerance used for gear hold phase target position.\r\n" /end ANNOTATION_TEXT
 /end ANNOTATION
/end CHARACTERISTIC
/begin CHARACTERISTIC GAC_CALIB.GAC_GracB.GAC_POSNTOLINNEOLDONE "" VALUE 0x8061199A DefaultValueRecordLayout_AUTOSAR_Platform_BaseTypes_sint16 40.0 RB_PT_PCT_SWC_GAC_CompuMethods_ratio_0p001 -20. 20. FORMAT "%10.5"
 /begin ANNOTATION ANNOTATION_LABEL "Description (coming from AUTOSAR DESC field)"
  /begin ANNOTATION_TEXT "Neutral position tolerance when EOL Neutral learn has completed.\r\n" /end ANNOTATION_TEXT
 /end ANNOTATION
/end CHARACTERISTIC
/begin CHARACTERISTIC GAC_CALIB.GAC_GracB.GAC_POSNTRIGNSTOPDFLT "" VALUE 0x8061199C DefaultValueRecordLayout_AUTOSAR_Platform_BaseTypes_sint16 40.0 RB_PT_PCT_SWC_GAC_CompuMethods_ratio_0p001 -20. 20. FORMAT "%10.5"
 /begin ANNOTATION ANNOTATION_LABEL "Description (coming from AUTOSAR DESC field)"
  /begin ANNOTATION_TEXT "Actuator position which NStop phase is activated - default value.\r\n" /end ANNOTATION_TEXT
 /end ANNOTATION
/end CHARACTERISTIC
/begin CHARACTERISTIC GAC_CALIB.GAC_GracB.GAC_PPPULSETMC "" VALUE 0x8061199E DefaultValueRecordLayout_AUTOSAR_Platform_BaseTypes_sint16 200.0 RB_PT_PCT_SWC_GAC_CompuMethods_ident -100. 100. FORMAT "%10.5"
 /begin ANNOTATION ANNOTATION_LABEL "Description (coming from AUTOSAR DESC field)"
  /begin ANNOTATION_TEXT "pP valve pressure pulse time linear function - intercept value.\r\n" /end ANNOTATION_TEXT
 /end ANNOTATION
/end CHARACTERISTIC
/begin CHARACTERISTIC GAC_CALIB.GAC_GracB.GAC_PPPULSETMM "" VALUE 0x806119A0 DefaultValueRecordLayout_AUTOSAR_Platform_BaseTypes_sint16 2.0 RB_PT_PCT_SWC_GAC_CompuMethods_ratio_0p01 -1. 1. FORMAT "%10.5"
 /begin ANNOTATION ANNOTATION_LABEL "Description (coming from AUTOSAR DESC field)"
  /begin ANNOTATION_TEXT "pP valve pressure pulse time linear function - gradient value.\r\n" /end ANNOTATION_TEXT
 /end ANNOTATION
/end CHARACTERISTIC
/begin CHARACTERISTIC GAC_CALIB.GAC_GracB.GAC_PRESSADDGBLKTMOUT "" VALUE 0x806119A2 DefaultValueRecordLayout_AUTOSAR_Platform_BaseTypes_uint16 32.0 RB_PT_PCT_SWC_GAC_CompuMethods_ratio_0p001 0.0 32. FORMAT "%10.5"
 /begin ANNOTATION ANNOTATION_LABEL "Description (coming from AUTOSAR DESC field)" /begin ANNOTATION_TEXT "Pressure step added for gear block timeout.\r\n" /end ANNOTATION_TEXT /end ANNOTATION
/end CHARACTERISTIC
/begin CHARACTERISTIC GAC_CALIB.GAC_GracB.GAC_PRESSFFVELCTRLNOSYNC "" MAP 0x80611F16 RB_PT_PCT_SWC_GAC_RecordLayouts_RL_Map_uint16_12_uint16_6_sint16_2 32.0 RB_PT_PCT_SWC_GAC_CompuMethods_ratio_0p001 0.0 32. FORMAT "%10.5"
 /begin ANNOTATION ANNOTATION_LABEL "Description (coming from AUTOSAR DESC field)"
  /begin ANNOTATION_TEXT "Feedforward pressure gains for velocity control before the synchro phase or Neutral actuation.\r\n" /end ANNOTATION_TEXT
 /end ANNOTATION
 /begin AXIS_DESCR STD_AXIS NO_INPUT_QUANTITY RB_PT_PCT_SWC_GAC_CompuMethods_ratio_0p001 6 0.0 1.2 FORMAT "%10.5" DEPOSIT ABSOLUTE /end AXIS_DESCR
 /begin AXIS_DESCR STD_AXIS NO_INPUT_QUANTITY RB_PT_PCT_SWC_GAC_CompuMethods_ident 2 -50. 200. FORMAT "%10.5" DEPOSIT ABSOLUTE /end AXIS_DESCR
/end CHARACTERISTIC
/begin CHARACTERISTIC GAC_CALIB.GAC_GracB.GAC_PRESSFFVELCTRLNOSYNC2 "" CURVE 0x80611F42 RB_PT_PCT_SWC_GAC_RecordLayouts_RL_Curve_uint16_5_uint16_5 32.0 RB_PT_PCT_SWC_GAC_CompuMethods_ratio_0p001 0.0 32. FORMAT "%10.5"
 /begin ANNOTATION ANNOTATION_LABEL "Description (coming from AUTOSAR DESC field)"
  /begin ANNOTATION_TEXT "Feedforward pressure gains for velocity control before the synchro phase or Neutral actuation.\r\n" /end ANNOTATION_TEXT
 /end ANNOTATION
 /begin AXIS_DESCR STD_AXIS NO_INPUT_QUANTITY RB_PT_PCT_SWC_GAC_CompuMethods_ratio_0p001 5 0.0 1.2 FORMAT "%10.5" DEPOSIT ABSOLUTE /end AXIS_DESCR
/end CHARACTERISTIC
/begin CHARACTERISTIC GAC_CALIB.GAC_GracB.GAC_PRESSFFVELCTRLSYNC "" MAP 0x80611F58 RB_PT_PCT_SWC_GAC_RecordLayouts_RL_Map_uint16_10_uint16_5_sint16_2 32.0 RB_PT_PCT_SWC_GAC_CompuMethods_ratio_0p001 0.0 32. FORMAT "%10.5"
 /begin ANNOTATION ANNOTATION_LABEL "Description (coming from AUTOSAR DESC field)"
  /begin ANNOTATION_TEXT "Feedforward pressure gains for velocity control after the synchro phase.\r\n" /end ANNOTATION_TEXT
 /end ANNOTATION
 /begin AXIS_DESCR STD_AXIS NO_INPUT_QUANTITY RB_PT_PCT_SWC_GAC_CompuMethods_ratio_0p001 5 0.0 1.2 FORMAT "%10.5" DEPOSIT ABSOLUTE /end AXIS_DESCR
 /begin AXIS_DESCR STD_AXIS NO_INPUT_QUANTITY RB_PT_PCT_SWC_GAC_CompuMethods_ident 2 -50. 200. FORMAT "%10.5" DEPOSIT ABSOLUTE /end AXIS_DESCR
/end CHARACTERISTIC
/begin CHARACTERISTIC GAC_CALIB.GAC_GracB.GAC_PRESSFFVELCTRLSYNC2 "" CURVE 0x80611F7E RB_PT_PCT_SWC_GAC_RecordLayouts_RL_Curve_uint16_4_uint16_4 32.0 RB_PT_PCT_SWC_GAC_CompuMethods_ratio_0p001 0.0 32. FORMAT "%10.5"
 /begin ANNOTATION ANNOTATION_LABEL "Description (coming from AUTOSAR DESC field)"
  /begin ANNOTATION_TEXT "Feedforward pressure gains for velocity control after the synchro phase.\r\n" /end ANNOTATION_TEXT
 /end ANNOTATION
 /begin AXIS_DESCR STD_AXIS NO_INPUT_QUANTITY RB_PT_PCT_SWC_GAC_CompuMethods_ratio_0p001 4 0.0 1.2 FORMAT "%10.5" DEPOSIT ABSOLUTE /end AXIS_DESCR
/end CHARACTERISTIC
/begin CHARACTERISTIC GAC_CALIB.GAC_GracB.GAC_PRESSGHOLDACTV "" VALUE 0x806119A4 DefaultValueRecordLayout_AUTOSAR_Platform_BaseTypes_uint16 32.0 RB_PT_PCT_SWC_GAC_CompuMethods_ratio_0p001 0.0 32. FORMAT "%10.5"
 /begin ANNOTATION ANNOTATION_LABEL "Description (coming from AUTOSAR DESC field)" /begin ANNOTATION_TEXT "Pressure request for GHold active.\r\n" /end ANNOTATION_TEXT /end ANNOTATION
/end CHARACTERISTIC
/begin CHARACTERISTIC GAC_CALIB.GAC_GracB.GAC_PRESSGHOLDACTVNOADAPTION "" VALUE 0x806119A6 DefaultValueRecordLayout_AUTOSAR_Platform_BaseTypes_uint16 32.0 RB_PT_PCT_SWC_GAC_CompuMethods_ratio_0p001 0.0 32. FORMAT "%10.5"
 /begin ANNOTATION ANNOTATION_LABEL "Description (coming from AUTOSAR DESC field)" /begin ANNOTATION_TEXT "Pressure request for GHold active.\r\n" /end ANNOTATION_TEXT /end ANNOTATION
/end CHARACTERISTIC
/begin CHARACTERISTIC GAC_CALIB.GAC_GracB.GAC_PRESSGHOLDACTVNOOTHERSHIFT "" VALUE 0x806119A8 DefaultValueRecordLayout_AUTOSAR_Platform_BaseTypes_uint16 32.0 RB_PT_PCT_SWC_GAC_CompuMethods_ratio_0p001 0.0 32. FORMAT "%10.5"
 /begin ANNOTATION ANNOTATION_LABEL "Description (coming from AUTOSAR DESC field)" /begin ANNOTATION_TEXT "Pressure request for GHold active.\r\n" /end ANNOTATION_TEXT /end ANNOTATION
/end CHARACTERISTIC
/begin CHARACTERISTIC GAC_CALIB.GAC_GracB.GAC_PRESSGHOLDACTVRULE26 "" VALUE 0x806119AA DefaultValueRecordLayout_AUTOSAR_Platform_BaseTypes_uint16 32.0 RB_PT_PCT_SWC_GAC_CompuMethods_ratio_0p001 0.0 32. FORMAT "%10.5"
 /begin ANNOTATION ANNOTATION_LABEL "Description (coming from AUTOSAR DESC field)" /begin ANNOTATION_TEXT "Pressure request for GHold active.\r\n" /end ANNOTATION_TEXT /end ANNOTATION
/end CHARACTERISTIC
/begin CHARACTERISTIC GAC_CALIB.GAC_GracB.GAC_PRESSGHOLDACTVSTATIC "" VALUE 0x806119AC DefaultValueRecordLayout_AUTOSAR_Platform_BaseTypes_uint16 32.0 RB_PT_PCT_SWC_GAC_CompuMethods_ratio_0p001 0.0 32. FORMAT "%10.5"
 /begin ANNOTATION ANNOTATION_LABEL "Description (coming from AUTOSAR DESC field)" /begin ANNOTATION_TEXT "Pressure request for GHold active static cases\r\n" /end ANNOTATION_TEXT /end ANNOTATION
/end CHARACTERISTIC
/begin CHARACTERISTIC GAC_CALIB.GAC_GracB.GAC_PRESSIVELCTRL "" CURVE 0x80611F90 RB_PT_PCT_SWC_GAC_RecordLayouts_RL_Curve_sint16_7_sint16_7 64.0 RB_PT_PCT_SWC_GAC_CompuMethods_ratio_0p001 -32. 32. FORMAT "%10.5"
 /begin ANNOTATION ANNOTATION_LABEL "Description (coming from AUTOSAR DESC field)" /begin ANNOTATION_TEXT "Integral pressure gains for velocity control.\r\n" /end ANNOTATION_TEXT /end ANNOTATION
 /begin AXIS_DESCR STD_AXIS NO_INPUT_QUANTITY RB_PT_PCT_SWC_GAC_CompuMethods_ratio_0p001 7 -1.2 1.2 FORMAT "%10.5" DEPOSIT ABSOLUTE /end AXIS_DESCR
/end CHARACTERISTIC
/begin CHARACTERISTIC GAC_CALIB.GAC_GracB.GAC_PRESSIVELCTRLGBLOCK2 "" CURVE 0x80611FAE RB_PT_PCT_SWC_GAC_RecordLayouts_RL_Curve_sint16_7_sint16_7 64.0 RB_PT_PCT_SWC_GAC_CompuMethods_ratio_0p001 -32. 32. FORMAT "%10.5"
 /begin ANNOTATION ANNOTATION_LABEL "Description (coming from AUTOSAR DESC field)" /begin ANNOTATION_TEXT "Integral pressure gains for velocity control.\r\n" /end ANNOTATION_TEXT /end ANNOTATION
 /begin AXIS_DESCR STD_AXIS NO_INPUT_QUANTITY RB_PT_PCT_SWC_GAC_CompuMethods_ratio_0p001 7 -1.2 1.2 FORMAT "%10.5" DEPOSIT ABSOLUTE /end AXIS_DESCR
/end CHARACTERISTIC
/begin CHARACTERISTIC GAC_CALIB.GAC_GracB.GAC_PRESSIVELCTRLGBLOCK3 "" CURVE 0x80611FCC RB_PT_PCT_SWC_GAC_RecordLayouts_RL_Curve_sint16_4_sint16_4 64.0 RB_PT_PCT_SWC_GAC_CompuMethods_ratio_0p001 -32. 32. FORMAT "%10.5"
 /begin ANNOTATION ANNOTATION_LABEL "Description (coming from AUTOSAR DESC field)" /begin ANNOTATION_TEXT "Integral pressure gains for velocity control.\r\n" /end ANNOTATION_TEXT /end ANNOTATION
 /begin AXIS_DESCR STD_AXIS NO_INPUT_QUANTITY RB_PT_PCT_SWC_GAC_CompuMethods_ratio_0p001 4 -1.2 1.2 FORMAT "%10.5" DEPOSIT ABSOLUTE /end AXIS_DESCR
/end CHARACTERISTIC
/begin CHARACTERISTIC GAC_CALIB.GAC_GracB.GAC_PRESSMINEVPOSTSYNC "" VALUE 0x806119AE DefaultValueRecordLayout_AUTOSAR_Platform_BaseTypes_uint16 32.0 RB_PT_PCT_SWC_GAC_CompuMethods_ratio_0p001 0.0 32. FORMAT "%10.5"
 /begin ANNOTATION ANNOTATION_LABEL "Description (coming from AUTOSAR DESC field)" /begin ANNOTATION_TEXT "Minimum pressure demand during velocity control.\r\n" /end ANNOTATION_TEXT /end ANNOTATION
/end CHARACTERISTIC
/begin CHARACTERISTIC GAC_CALIB.GAC_GracB.GAC_PRESSMINVELCTRLDEM "" VALUE 0x806119B0 DefaultValueRecordLayout_AUTOSAR_Platform_BaseTypes_uint16 32.0 RB_PT_PCT_SWC_GAC_CompuMethods_ratio_0p001 0.0 32. FORMAT "%10.5"
 /begin ANNOTATION ANNOTATION_LABEL "Description (coming from AUTOSAR DESC field)" /begin ANNOTATION_TEXT "Minimum pressure demand during velocity control.\r\n" /end ANNOTATION_TEXT /end ANNOTATION
/end CHARACTERISTIC
/begin CHARACTERISTIC GAC_CALIB.GAC_GracB.GAC_PRESSMINVELCTRLDEMMAP "" CURVE 0x80611FDE RB_PT_PCT_SWC_GAC_RecordLayouts_RL_Curve_uint16_4_sint16_4 32.0 RB_PT_PCT_SWC_GAC_CompuMethods_ratio_0p001 0.0 32. FORMAT "%10.5"
 /begin ANNOTATION ANNOTATION_LABEL "Description (coming from AUTOSAR DESC field)"
  /begin ANNOTATION_TEXT "Minimum pressure demand during velocity control based on temperature\r\n" /end ANNOTATION_TEXT
 /end ANNOTATION
 /begin AXIS_DESCR STD_AXIS NO_INPUT_QUANTITY RB_PT_PCT_SWC_GAC_CompuMethods_ident 4 -50. 200. FORMAT "%10.5" DEPOSIT ABSOLUTE /end AXIS_DESCR
/end CHARACTERISTIC
/begin CHARACTERISTIC GAC_CALIB.GAC_GracB.GAC_PRESSONFLWVELCTRLNOSYNC "" MAP 0x80611FF0 RB_PT_PCT_SWC_GAC_RecordLayouts_RL_Map_uint16_10_uint16_5_sint16_2 32.0 RB_PT_PCT_SWC_GAC_CompuMethods_ratio_0p001 0.0 32. FORMAT "%10.5"
 /begin ANNOTATION ANNOTATION_LABEL "Description (coming from AUTOSAR DESC field)"
  /begin ANNOTATION_TEXT "Flow based pressure gains for velocity control before the synchro phase.\r\n" /end ANNOTATION_TEXT
 /end ANNOTATION
 /begin AXIS_DESCR STD_AXIS NO_INPUT_QUANTITY RB_PT_PCT_SWC_GAC_CompuMethods_ratio_0p001 5 0.0 32. FORMAT "%10.5" DEPOSIT ABSOLUTE /end AXIS_DESCR
 /begin AXIS_DESCR STD_AXIS NO_INPUT_QUANTITY RB_PT_PCT_SWC_GAC_CompuMethods_ident 2 -50. 200. FORMAT "%10.5" DEPOSIT ABSOLUTE /end AXIS_DESCR
/end CHARACTERISTIC
/begin CHARACTERISTIC GAC_CALIB.GAC_GracB.GAC_PRESSONFLWVELCTRLNOSYNC2 "" CURVE 0x80612016 RB_PT_PCT_SWC_GAC_RecordLayouts_RL_Curve_uint16_3_uint16_3 32.0 RB_PT_PCT_SWC_GAC_CompuMethods_ratio_0p001 0.0 32. FORMAT "%10.5"
 /begin ANNOTATION ANNOTATION_LABEL "Description (coming from AUTOSAR DESC field)"
  /begin ANNOTATION_TEXT "Flow based pressure gains for velocity control before the synchro phase.\r\n" /end ANNOTATION_TEXT
 /end ANNOTATION
 /begin AXIS_DESCR STD_AXIS NO_INPUT_QUANTITY RB_PT_PCT_SWC_GAC_CompuMethods_ratio_0p001 3 0.0 32. FORMAT "%10.5" DEPOSIT ABSOLUTE /end AXIS_DESCR
/end CHARACTERISTIC
/begin CHARACTERISTIC GAC_CALIB.GAC_GracB.GAC_PRESSONFLWVELCTRLSYNC "" CURVE 0x80612024 RB_PT_PCT_SWC_GAC_RecordLayouts_RL_Curve_uint16_5_uint16_5 32.0 RB_PT_PCT_SWC_GAC_CompuMethods_ratio_0p001 0.0 32. FORMAT "%10.5"
 /begin ANNOTATION ANNOTATION_LABEL "Description (coming from AUTOSAR DESC field)"
  /begin ANNOTATION_TEXT "Flow based pressure gains for velocity control after the synchro phase.\r\n" /end ANNOTATION_TEXT
 /end ANNOTATION
 /begin AXIS_DESCR STD_AXIS NO_INPUT_QUANTITY RB_PT_PCT_SWC_GAC_CompuMethods_ratio_0p001 5 0.0 32. FORMAT "%10.5" DEPOSIT ABSOLUTE /end AXIS_DESCR
/end CHARACTERISTIC
/begin CHARACTERISTIC GAC_CALIB.GAC_GracB.GAC_PRESSPVLVPULSE "" VALUE 0x806119B2 DefaultValueRecordLayout_AUTOSAR_Platform_BaseTypes_uint16 32.0 RB_PT_PCT_SWC_GAC_CompuMethods_ratio_0p001 0.0 32. FORMAT "%10.5"
 /begin ANNOTATION ANNOTATION_LABEL "Description (coming from AUTOSAR DESC field)" /begin ANNOTATION_TEXT "Pressure request for pressure valve pulse phase.\r\n" /end ANNOTATION_TEXT /end ANNOTATION
/end CHARACTERISTIC
/begin CHARACTERISTIC GAC_CALIB.GAC_GracB.GAC_PRESSPVLVPULSEDRAIN "" VALUE 0x806119B4 DefaultValueRecordLayout_AUTOSAR_Platform_BaseTypes_uint16 32.0 RB_PT_PCT_SWC_GAC_CompuMethods_ratio_0p001 0.0 32. FORMAT "%10.5"
 /begin ANNOTATION ANNOTATION_LABEL "Description (coming from AUTOSAR DESC field)"
  /begin ANNOTATION_TEXT "Pressure request for pressure valve pulse if drain phase not yet completed.\r\n" /end ANNOTATION_TEXT
 /end ANNOTATION
/end CHARACTERISTIC
/begin CHARACTERISTIC GAC_CALIB.GAC_GracB.GAC_PRESSSYNCENDEVMAX "" VALUE 0x806119B6 DefaultValueRecordLayout_AUTOSAR_Platform_BaseTypes_uint16 32.0 RB_PT_PCT_SWC_GAC_CompuMethods_ratio_0p001 0.0 32. FORMAT "%10.5"
 /begin ANNOTATION ANNOTATION_LABEL "Description (coming from AUTOSAR DESC field)"
  /begin ANNOTATION_TEXT "Max pressure to hand over into the sync end phase in EV mode\r\n" /end ANNOTATION_TEXT
 /end ANNOTATION
/end CHARACTERISTIC
/begin CHARACTERISTIC GAC_CALIB.GAC_GracB.GAC_PVlvPulseTmr.LIB_DT "" VALUE 0x80611C5A DefaultValueRecordLayout_AUTOSAR_Platform_BaseTypes_uint16 65.535 RB_PT_PCT_SWC_GAC_CompuMethods_ratio_0p001 0.0 65.535 FORMAT "%10.5"
 /begin ANNOTATION ANNOTATION_LABEL "Description (coming from AUTOSAR DESC field)" /begin ANNOTATION_TEXT "Timer decrement value.\r\n" /end ANNOTATION_TEXT /end ANNOTATION
/end CHARACTERISTIC
/begin CHARACTERISTIC GAC_CALIB.GAC_GracB.GAC_ROCSPDSYNCSLIPTGTMAX "" VALUE 0x80611960 DefaultValueRecordLayout_AUTOSAR_Platform_BaseTypes_uint32 100000.0 RB_PT_PCT_SWC_GAC_CompuMethods_ratio_10p0 0.0 100000. FORMAT "%10.5"
 /begin ANNOTATION ANNOTATION_LABEL "Description (coming from AUTOSAR DESC field)"
  /begin ANNOTATION_TEXT "Maximum limit for target rate of change of synchro slip.\r\n" /end ANNOTATION_TEXT
 /end ANNOTATION
/end CHARACTERISTIC
/begin CHARACTERISTIC GAC_CALIB.GAC_GracB.GAC_ROCSPDSYNCSLIPTGTMIN "" VALUE 0x80611964 DefaultValueRecordLayout_AUTOSAR_Platform_BaseTypes_uint32 100000.0 RB_PT_PCT_SWC_GAC_CompuMethods_ratio_10p0 0.0 100000. FORMAT "%10.5"
 /begin ANNOTATION ANNOTATION_LABEL "Description (coming from AUTOSAR DESC field)"
  /begin ANNOTATION_TEXT "Minimum limit for target rate of change of synchro slip.\r\n" /end ANNOTATION_TEXT
 /end ANNOTATION
/end CHARACTERISTIC
/begin CHARACTERISTIC GAC_CALIB.GAC_GracB.GAC_ROCSYNCSLIPGRPOS "" VALUE 0x806119B8 DefaultValueRecordLayout_AUTOSAR_Platform_BaseTypes_sint16 655350.0 RB_PT_PCT_SWC_GAC_CompuMethods_ratio_10p0 -327680. 327670. FORMAT "%10.5"
 /begin ANNOTATION ANNOTATION_LABEL "Description (coming from AUTOSAR DESC field)"
  /begin ANNOTATION_TEXT "Rate of change of synchro slip used for synchro start detection on the positive gear.\r\n" /end ANNOTATION_TEXT
 /end ANNOTATION
/end CHARACTERISTIC
/begin CHARACTERISTIC GAC_CALIB.GAC_GracB.GAC_SPDSLIPSYNCFORGBLK0 "" VALUE 0x806119BA DefaultValueRecordLayout_AUTOSAR_Platform_BaseTypes_sint16 40000.0 RB_PT_PCT_SWC_GAC_CompuMethods_ident -20000. 20000. FORMAT "%10.5"
 /begin ANNOTATION ANNOTATION_LABEL "Description (coming from AUTOSAR DESC field)"
  /begin ANNOTATION_TEXT "Initial synchroniser slip used for allowing synchoniser start detection.\r\n" /end ANNOTATION_TEXT
 /end ANNOTATION
/end CHARACTERISTIC
/begin CHARACTERISTIC GAC_CALIB.GAC_GracB.GAC_SPDSLIPSYNCFORONSYNC "" VALUE 0x806119BC DefaultValueRecordLayout_AUTOSAR_Platform_BaseTypes_sint16 40000.0 RB_PT_PCT_SWC_GAC_CompuMethods_ident -20000. 20000. FORMAT "%10.5"
 /begin ANNOTATION ANNOTATION_LABEL "Description (coming from AUTOSAR DESC field)"
  /begin ANNOTATION_TEXT "Initial synchroniser slip used for allowing synchoniser start detection.\r\n" /end ANNOTATION_TEXT
 /end ANNOTATION
/end CHARACTERISTIC
/begin CHARACTERISTIC GAC_CALIB.GAC_GracB.GAC_SPDSSLIPSYNCEND "" CURVE 0x8061203A RB_PT_PCT_SWC_GAC_RecordLayouts_RL_Curve_uint16_5_sint16_5 20000.0 RB_PT_PCT_SWC_GAC_CompuMethods_ident 0.0 20000. FORMAT "%10.5"
 /begin ANNOTATION ANNOTATION_LABEL "Description (coming from AUTOSAR DESC field)"
  /begin ANNOTATION_TEXT "Synchro slip speed thresholds for detection of synchronisation end, based on transmission output speed.\r\n" /end ANNOTATION_TEXT
 /end ANNOTATION
 /begin AXIS_DESCR STD_AXIS NO_INPUT_QUANTITY RB_PT_PCT_SWC_GAC_CompuMethods_ident 5 -20000. 20000. FORMAT "%10.5" DEPOSIT ABSOLUTE /end AXIS_DESCR
/end CHARACTERISTIC
/begin CHARACTERISTIC GAC_CALIB.GAC_GracB.GAC_SPEEDSLIPTHRESHAGAINSTDRAG "" VALUE 0x806119BE DefaultValueRecordLayout_AUTOSAR_Platform_BaseTypes_sint16 40000.0 RB_PT_PCT_SWC_GAC_CompuMethods_ident -20000. 20000. FORMAT "%10.5"
 /begin ANNOTATION ANNOTATION_LABEL "Description (coming from AUTOSAR DESC field)"
  /begin ANNOTATION_TEXT "slip speed required to complete synchronise against drag strategy\r\n" /end ANNOTATION_TEXT
 /end ANNOTATION
/end CHARACTERISTIC
/begin CHARACTERISTIC GAC_CALIB.GAC_GracB.GAC_SyncAgainstDragTmr.LIB_DT "" VALUE 0x80611C5C DefaultValueRecordLayout_AUTOSAR_Platform_BaseTypes_uint16 65.535 RB_PT_PCT_SWC_GAC_CompuMethods_ratio_0p001 0.0 65.535 FORMAT "%10.5"
 /begin ANNOTATION ANNOTATION_LABEL "Description (coming from AUTOSAR DESC field)" /begin ANNOTATION_TEXT "Timer decrement value.\r\n" /end ANNOTATION_TEXT /end ANNOTATION
/end CHARACTERISTIC
/begin CHARACTERISTIC GAC_CALIB.GAC_GracB.GAC_SyncCtrl.GAC_FCTSYNCPRESSBLEND "" CURVE 0x80611CBC RB_PT_PCT_SWC_GAC_RecordLayouts_RL_Curve_uint8_6_uint8_6 1.0 RB_PT_PCT_SWC_GAC_CompuMethods_ratio_0p01 0.0 1. FORMAT "%10.5"
 /begin ANNOTATION ANNOTATION_LABEL "Description (coming from AUTOSAR DESC field)"
  /begin ANNOTATION_TEXT "Pressure blending multiplication factor as a function of synchronisation progression\r\n" /end ANNOTATION_TEXT
 /end ANNOTATION
 /begin AXIS_DESCR STD_AXIS NO_INPUT_QUANTITY RB_PT_PCT_SWC_GAC_CompuMethods_ratio_0p01 6 0.0 1. FORMAT "%10.5" DEPOSIT ABSOLUTE /end AXIS_DESCR
/end CHARACTERISTIC
/begin CHARACTERISTIC GAC_CALIB.GAC_GracB.GAC_SyncCtrl.GAC_FLGENBLBLK0HIRAMP "" VALUE 0x80611CB2 DefaultValueRecordLayout_AUTOSAR_Platform_BaseTypes_uint8 255.0 DefaultIdenticalCompu 0.0 255. FORMAT "%10.5"
 /begin ANNOTATION ANNOTATION_LABEL "Description (coming from AUTOSAR DESC field)"
  /begin ANNOTATION_TEXT "enable/disable flag for ramping the pressure aggressively when gear blocking type 0 occurs\r\n" /end ANNOTATION_TEXT
 /end ANNOTATION
/end CHARACTERISTIC
/begin CHARACTERISTIC GAC_CALIB.GAC_GracB.GAC_SyncCtrl.GAC_FLGENBLCALCSYNCPRESSTGT "" VALUE 0x80611CB3 DefaultValueRecordLayout_AUTOSAR_Platform_BaseTypes_uint8 255.0 DefaultIdenticalCompu 0.0 255. FORMAT "%10.5"
 /begin ANNOTATION ANNOTATION_LABEL "Description (coming from AUTOSAR DESC field)" /begin ANNOTATION_TEXT "flag to enable calculated pressure target\r\n" /end ANNOTATION_TEXT /end ANNOTATION
/end CHARACTERISTIC
/begin CHARACTERISTIC GAC_CALIB.GAC_GracB.GAC_SyncCtrl.GAC_FLGENBLPRESSURESHUNT "" VALUE 0x80611CB4 DefaultValueRecordLayout_AUTOSAR_Platform_BaseTypes_uint8 255.0 DefaultIdenticalCompu 0.0 255. FORMAT "%10.5"
 /begin ANNOTATION ANNOTATION_LABEL "Description (coming from AUTOSAR DESC field)" /begin ANNOTATION_TEXT "flag to enable pressure shunt feature\r\n" /end ANNOTATION_TEXT /end ANNOTATION
/end CHARACTERISTIC
/begin CHARACTERISTIC GAC_CALIB.GAC_GracB.GAC_SyncCtrl.GAC_FLGENBLPRESSURESHUNT1STATTEMPT "" VALUE 0x80611CB5 DefaultValueRecordLayout_AUTOSAR_Platform_BaseTypes_uint8 255.0 DefaultIdenticalCompu 0.0 255. FORMAT "%10.5"
 /begin ANNOTATION ANNOTATION_LABEL "Description (coming from AUTOSAR DESC field)"
  /begin ANNOTATION_TEXT "flag to enable pressure shunt feature at the first engagement attempt\r\n" /end ANNOTATION_TEXT
 /end ANNOTATION
/end CHARACTERISTIC
/begin CHARACTERISTIC GAC_CALIB.GAC_GracB.GAC_SyncCtrl.GAC_FLGEVMODEGBLK0ENBL "" VALUE 0x80611CB6 DefaultValueRecordLayout_AUTOSAR_Platform_BaseTypes_uint8 255.0 DefaultIdenticalCompu 0.0 255. FORMAT "%10.5"
 /begin ANNOTATION ANNOTATION_LABEL "Description (coming from AUTOSAR DESC field)" /begin ANNOTATION_TEXT "Flag to enable EV mode gblock 0 pressure spike\r\n" /end ANNOTATION_TEXT /end ANNOTATION
/end CHARACTERISTIC
/begin CHARACTERISTIC GAC_CALIB.GAC_GracB.GAC_SyncCtrl.GAC_FLGLATCHSYNCBLENDUNTILEND "" VALUE 0x80611CB7 DefaultValueRecordLayout_AUTOSAR_Platform_BaseTypes_uint8 255.0 DefaultIdenticalCompu 0.0 255. FORMAT "%10.5"
 /begin ANNOTATION ANNOTATION_LABEL "Description (coming from AUTOSAR DESC field)" /begin ANNOTATION_TEXT "latch the synchronisation blend until end\r\n" /end ANNOTATION_TEXT /end ANNOTATION
/end CHARACTERISTIC
/begin CHARACTERISTIC GAC_CALIB.GAC_GracB.GAC_SyncCtrl.GAC_FLGSSTEPTOMAXFRKPEAK1STATTEMPT "" VAL_BLK 0x80611C8E DefaultValueRecordLayout_AUTOSAR_Platform_BaseTypes_uint8 255.0 DefaultIdenticalCompu 0.0 255. FORMAT "%10.5"
 /begin ANNOTATION ANNOTATION_LABEL "Description (coming from AUTOSAR DESC field)"
  /begin ANNOTATION_TEXT "allow the pressure command to go from the lower to the higher pressure limit based on aggression command\r\n" /end ANNOTATION_TEXT
 /end ANNOTATION
 MATRIX_DIM 5 1 1 /end CHARACTERISTIC
/begin CHARACTERISTIC GAC_CALIB.GAC_GracB.GAC_SyncCtrl.GAC_FLWSSYNCCTRLTGT "" VAL_BLK 0x80611C5E DefaultValueRecordLayout_AUTOSAR_Platform_BaseTypes_sint16 64.0 RB_PT_PCT_SWC_GAC_CompuMethods_ratio_0p001 -32. 32. FORMAT "%10.5"
 /begin ANNOTATION ANNOTATION_LABEL "Description (coming from AUTOSAR DESC field)"
  /begin ANNOTATION_TEXT "Flow targets for synchro control for each actuation aggression.\r\n" /end ANNOTATION_TEXT
 /end ANNOTATION
 MATRIX_DIM 4 1 1 /end CHARACTERISTIC
/begin CHARACTERISTIC GAC_CALIB.GAC_GracB.GAC_SyncCtrl.GAC_FLWSYNCCTRLVLOWTGT "" VALUE 0x80611C94 DefaultValueRecordLayout_AUTOSAR_Platform_BaseTypes_sint16 64.0 RB_PT_PCT_SWC_GAC_CompuMethods_ratio_0p001 -32. 32. FORMAT "%10.5"
 /begin ANNOTATION ANNOTATION_LABEL "Description (coming from AUTOSAR DESC field)"
  /begin ANNOTATION_TEXT "Flow target for synchro control for very low aggression actuation.\r\n" /end ANNOTATION_TEXT
 /end ANNOTATION
/end CHARACTERISTIC
/begin CHARACTERISTIC GAC_CALIB.GAC_GracB.GAC_SyncCtrl.GAC_PRESSIADDGBLOCK "" VALUE 0x80611C96 DefaultValueRecordLayout_AUTOSAR_Platform_BaseTypes_sint16 64.0 RB_PT_PCT_SWC_GAC_CompuMethods_ratio_0p001 -32. 32. FORMAT "%10.5"
 /begin ANNOTATION ANNOTATION_LABEL "Description (coming from AUTOSAR DESC field)"
  /begin ANNOTATION_TEXT "Additive integral pressure term for synchro control when gear blocking type 0 occurs\r\n" /end ANNOTATION_TEXT
 /end ANNOTATION
/end CHARACTERISTIC
/begin CHARACTERISTIC GAC_CALIB.GAC_GracB.GAC_SyncCtrl.GAC_PRESSIADDNOSLIP "" VALUE 0x80611C98 DefaultValueRecordLayout_AUTOSAR_Platform_BaseTypes_sint16 64.0 RB_PT_PCT_SWC_GAC_CompuMethods_ratio_0p001 -32. 32. FORMAT "%10.5"
 /begin ANNOTATION ANNOTATION_LABEL "Description (coming from AUTOSAR DESC field)"
  /begin ANNOTATION_TEXT "Additive integral pressure term for synchro control when syncrhro slip is negligible\r\n" /end ANNOTATION_TEXT
 /end ANNOTATION
/end CHARACTERISTIC
/begin CHARACTERISTIC GAC_CALIB.GAC_GracB.GAC_SyncCtrl.GAC_PRESSIADDSYNCHIGRNEG "" CURVE 0x80611CCA RB_PT_PCT_SWC_GAC_RecordLayouts_RL_Curve_sint16_5_uint16_5 64.0 RB_PT_PCT_SWC_GAC_CompuMethods_ratio_0p001 -32. 32. FORMAT "%10.5"
 /begin ANNOTATION ANNOTATION_LABEL "Description (coming from AUTOSAR DESC field)"
  /begin ANNOTATION_TEXT "Additive integral pressure term for synchro control engaging to negative gear with high aggression actuation.\r\n" /end ANNOTATION_TEXT
 /end ANNOTATION
 /begin AXIS_DESCR STD_AXIS NO_INPUT_QUANTITY RB_PT_PCT_SWC_GAC_CompuMethods_ratio_10p0 5 0.0 100000. FORMAT "%10.5" DEPOSIT ABSOLUTE /end AXIS_DESCR
/end CHARACTERISTIC
/begin CHARACTERISTIC GAC_CALIB.GAC_GracB.GAC_SyncCtrl.GAC_PRESSIADDSYNCHIGRPOS "" CURVE 0x80611CE0 RB_PT_PCT_SWC_GAC_RecordLayouts_RL_Curve_sint16_5_uint16_5 64.0 RB_PT_PCT_SWC_GAC_CompuMethods_ratio_0p001 -32. 32. FORMAT "%10.5"
 /begin ANNOTATION ANNOTATION_LABEL "Description (coming from AUTOSAR DESC field)"
  /begin ANNOTATION_TEXT "Additive integral pressure term for synchro control engaging to positive gear with high aggression actuation.\r\n" /end ANNOTATION_TEXT
 /end ANNOTATION
 /begin AXIS_DESCR STD_AXIS NO_INPUT_QUANTITY RB_PT_PCT_SWC_GAC_CompuMethods_ratio_10p0 5 0.0 100000. FORMAT "%10.5" DEPOSIT ABSOLUTE /end AXIS_DESCR
/end CHARACTERISTIC
/begin CHARACTERISTIC GAC_CALIB.GAC_GracB.GAC_SyncCtrl.GAC_PRESSIADDSYNCLIM "" VALUE 0x80611C9A DefaultValueRecordLayout_AUTOSAR_Platform_BaseTypes_sint16 64.0 RB_PT_PCT_SWC_GAC_CompuMethods_ratio_0p001 -32. 32. FORMAT "%10.5"
 /begin ANNOTATION ANNOTATION_LABEL "Description (coming from AUTOSAR DESC field)"
  /begin ANNOTATION_TEXT "Limited additive integral pressure term when rate of change of sync slip not ok for sync control.\r\n" /end ANNOTATION_TEXT
 /end ANNOTATION
/end CHARACTERISTIC
/begin CHARACTERISTIC GAC_CALIB.GAC_GracB.GAC_SyncCtrl.GAC_PRESSIADDSYNCLOWGRNEG "" CURVE 0x80611CF6 RB_PT_PCT_SWC_GAC_RecordLayouts_RL_Curve_sint16_5_uint16_5 64.0 RB_PT_PCT_SWC_GAC_CompuMethods_ratio_0p001 -32. 32. FORMAT "%10.5"
 /begin ANNOTATION ANNOTATION_LABEL "Description (coming from AUTOSAR DESC field)"
  /begin ANNOTATION_TEXT "Additive integral pressure term for synchro control engaging to negative gear with low aggression actuation.\r\n" /end ANNOTATION_TEXT
 /end ANNOTATION
 /begin AXIS_DESCR STD_AXIS NO_INPUT_QUANTITY RB_PT_PCT_SWC_GAC_CompuMethods_ratio_10p0 5 0.0 100000. FORMAT "%10.5" DEPOSIT ABSOLUTE /end AXIS_DESCR
/end CHARACTERISTIC
/begin CHARACTERISTIC GAC_CALIB.GAC_GracB.GAC_SyncCtrl.GAC_PRESSIADDSYNCLOWGRPOS "" CURVE 0x80611D0C RB_PT_PCT_SWC_GAC_RecordLayouts_RL_Curve_sint16_5_uint16_5 64.0 RB_PT_PCT_SWC_GAC_CompuMethods_ratio_0p001 -32. 32. FORMAT "%10.5"
 /begin ANNOTATION ANNOTATION_LABEL "Description (coming from AUTOSAR DESC field)"
  /begin ANNOTATION_TEXT "Additive integral pressure term for synchro control engaging to positive gear with low aggression actuation.\r\n" /end ANNOTATION_TEXT
 /end ANNOTATION
 /begin AXIS_DESCR STD_AXIS NO_INPUT_QUANTITY RB_PT_PCT_SWC_GAC_CompuMethods_ratio_10p0 5 0.0 100000. FORMAT "%10.5" DEPOSIT ABSOLUTE /end AXIS_DESCR
/end CHARACTERISTIC
/begin CHARACTERISTIC GAC_CALIB.GAC_GracB.GAC_SyncCtrl.GAC_PRESSIADDSYNCMEDGRNEG "" CURVE 0x80611D22 RB_PT_PCT_SWC_GAC_RecordLayouts_RL_Curve_sint16_5_uint16_5 64.0 RB_PT_PCT_SWC_GAC_CompuMethods_ratio_0p001 -32. 32. FORMAT "%10.5"
 /begin ANNOTATION ANNOTATION_LABEL "Description (coming from AUTOSAR DESC field)"
  /begin ANNOTATION_TEXT "Additive integral pressure term for synchro control engaging to negative gear with medium aggression actuation.\r\n" /end ANNOTATION_TEXT
 /end ANNOTATION
 /begin AXIS_DESCR STD_AXIS NO_INPUT_QUANTITY RB_PT_PCT_SWC_GAC_CompuMethods_ratio_10p0 5 0.0 100000. FORMAT "%10.5" DEPOSIT ABSOLUTE /end AXIS_DESCR
/end CHARACTERISTIC
/begin CHARACTERISTIC GAC_CALIB.GAC_GracB.GAC_SyncCtrl.GAC_PRESSIADDSYNCMEDGRPOS "" CURVE 0x80611D38 RB_PT_PCT_SWC_GAC_RecordLayouts_RL_Curve_sint16_5_uint16_5 64.0 RB_PT_PCT_SWC_GAC_CompuMethods_ratio_0p001 -32. 32. FORMAT "%10.5"
 /begin ANNOTATION ANNOTATION_LABEL "Description (coming from AUTOSAR DESC field)"
  /begin ANNOTATION_TEXT "Additive integral pressure term for synchro control engaging to positive gear with mediium aggression actuation.\r\n" /end ANNOTATION_TEXT
 /end ANNOTATION
 /begin AXIS_DESCR STD_AXIS NO_INPUT_QUANTITY RB_PT_PCT_SWC_GAC_CompuMethods_ratio_10p0 5 0.0 100000. FORMAT "%10.5" DEPOSIT ABSOLUTE /end AXIS_DESCR
/end CHARACTERISTIC
/begin CHARACTERISTIC GAC_CALIB.GAC_GracB.GAC_SyncCtrl.GAC_PRESSIADDSYNCSLIPUDEF "" VALUE 0x80611C9C DefaultValueRecordLayout_AUTOSAR_Platform_BaseTypes_sint16 64.0 RB_PT_PCT_SWC_GAC_CompuMethods_ratio_0p001 -32. 32. FORMAT "%10.5"
 /begin ANNOTATION ANNOTATION_LABEL "Description (coming from AUTOSAR DESC field)"
  /begin ANNOTATION_TEXT "Additive integral pressure term for synchro control when syncrhro slip is unknown.\r\n" /end ANNOTATION_TEXT
 /end ANNOTATION
/end CHARACTERISTIC
/begin CHARACTERISTIC GAC_CALIB.GAC_GracB.GAC_SyncCtrl.GAC_PRESSLIMSSYNCIGRNEG "" VAL_BLK 0x80611C66 DefaultValueRecordLayout_AUTOSAR_Platform_BaseTypes_sint16 64.0 RB_PT_PCT_SWC_GAC_CompuMethods_ratio_0p001 -32. 32. FORMAT "%10.5"
 /begin ANNOTATION ANNOTATION_LABEL "Description (coming from AUTOSAR DESC field)"
  /begin ANNOTATION_TEXT "Integral pressure addition limit for synchro control engaging negative gear, for each actuation aggression.\r\n" /end ANNOTATION_TEXT
 /end ANNOTATION
 MATRIX_DIM 4 1 1 /end CHARACTERISTIC
/begin CHARACTERISTIC GAC_CALIB.GAC_GracB.GAC_SyncCtrl.GAC_PRESSLIMSSYNCIGRPOS "" VAL_BLK 0x80611C6E DefaultValueRecordLayout_AUTOSAR_Platform_BaseTypes_sint16 64.0 RB_PT_PCT_SWC_GAC_CompuMethods_ratio_0p001 -32. 32. FORMAT "%10.5"
 /begin ANNOTATION ANNOTATION_LABEL "Description (coming from AUTOSAR DESC field)"
  /begin ANNOTATION_TEXT "Integral pressure addition limit for synchro control engaging positive gear, for each actuation aggression.\r\n" /end ANNOTATION_TEXT
 /end ANNOTATION
 MATRIX_DIM 4 1 1 /end CHARACTERISTIC
/begin CHARACTERISTIC GAC_CALIB.GAC_GracB.GAC_SyncCtrl.GAC_PRESSLIMSYNCHIMAP "" CURVE 0x80611D4E RB_PT_PCT_SWC_GAC_RecordLayouts_RL_Curve_uint16_4_sint16_4 32.0 RB_PT_PCT_SWC_GAC_CompuMethods_ratio_0p001 0.0 32. FORMAT "%10.5"
 /begin ANNOTATION ANNOTATION_LABEL "Description (coming from AUTOSAR DESC field)"
  /begin ANNOTATION_TEXT "Limit for the static pressure engagements based on temperature - high aggression\r\n" /end ANNOTATION_TEXT
 /end ANNOTATION
 /begin AXIS_DESCR STD_AXIS NO_INPUT_QUANTITY RB_PT_PCT_SWC_GAC_CompuMethods_ident 4 -50. 200. FORMAT "%10.5" DEPOSIT ABSOLUTE /end AXIS_DESCR
/end CHARACTERISTIC
/begin CHARACTERISTIC GAC_CALIB.GAC_GracB.GAC_SyncCtrl.GAC_PRESSLIMSYNCLOWMAP "" CURVE 0x80611D60 RB_PT_PCT_SWC_GAC_RecordLayouts_RL_Curve_uint16_4_sint16_4 32.0 RB_PT_PCT_SWC_GAC_CompuMethods_ratio_0p001 0.0 32. FORMAT "%10.5"
 /begin ANNOTATION ANNOTATION_LABEL "Description (coming from AUTOSAR DESC field)"
  /begin ANNOTATION_TEXT "Limit for the static pressure engagements based on temperature- low aggression\r\n" /end ANNOTATION_TEXT
 /end ANNOTATION
 /begin AXIS_DESCR STD_AXIS NO_INPUT_QUANTITY RB_PT_PCT_SWC_GAC_CompuMethods_ident 4 -50. 200. FORMAT "%10.5" DEPOSIT ABSOLUTE /end AXIS_DESCR
/end CHARACTERISTIC
/begin CHARACTERISTIC GAC_CALIB.GAC_GracB.GAC_SyncCtrl.GAC_PRESSLIMSYNCMEDMAP "" CURVE 0x80611D72 RB_PT_PCT_SWC_GAC_RecordLayouts_RL_Curve_uint16_4_sint16_4 32.0 RB_PT_PCT_SWC_GAC_CompuMethods_ratio_0p001 0.0 32. FORMAT "%10.5"
 /begin ANNOTATION ANNOTATION_LABEL "Description (coming from AUTOSAR DESC field)"
  /begin ANNOTATION_TEXT "Limit for the static pressure engagements based on temperature - medium aggression\r\n" /end ANNOTATION_TEXT
 /end ANNOTATION
 /begin AXIS_DESCR STD_AXIS NO_INPUT_QUANTITY RB_PT_PCT_SWC_GAC_CompuMethods_ident 4 -50. 200. FORMAT "%10.5" DEPOSIT ABSOLUTE /end AXIS_DESCR
/end CHARACTERISTIC
/begin CHARACTERISTIC GAC_CALIB.GAC_GracB.GAC_SyncCtrl.GAC_PRESSLIMSYNCSTATICMAP "" CURVE 0x80611D84 RB_PT_PCT_SWC_GAC_RecordLayouts_RL_Curve_uint16_4_sint16_4 32.0 RB_PT_PCT_SWC_GAC_CompuMethods_ratio_0p001 0.0 32. FORMAT "%10.5"
 /begin ANNOTATION ANNOTATION_LABEL "Description (coming from AUTOSAR DESC field)"
  /begin ANNOTATION_TEXT "Limit for the static pressure engagements based on temperature - static aggression\r\n" /end ANNOTATION_TEXT
 /end ANNOTATION
 /begin AXIS_DESCR STD_AXIS NO_INPUT_QUANTITY RB_PT_PCT_SWC_GAC_CompuMethods_ident 4 -50. 200. FORMAT "%10.5" DEPOSIT ABSOLUTE /end AXIS_DESCR
/end CHARACTERISTIC
/begin CHARACTERISTIC GAC_CALIB.GAC_GracB.GAC_SyncCtrl.GAC_PRESSLIMSYNCVLOWMAP "" CURVE 0x80611D96 RB_PT_PCT_SWC_GAC_RecordLayouts_RL_Curve_uint16_4_sint16_4 32.0 RB_PT_PCT_SWC_GAC_CompuMethods_ratio_0p001 0.0 32. FORMAT "%10.5"
 /begin ANNOTATION ANNOTATION_LABEL "Description (coming from AUTOSAR DESC field)"
  /begin ANNOTATION_TEXT "Limit for the static pressure engagements based on temperature - very low aggression\r\n" /end ANNOTATION_TEXT
 /end ANNOTATION
 /begin AXIS_DESCR STD_AXIS NO_INPUT_QUANTITY RB_PT_PCT_SWC_GAC_CompuMethods_ident 4 -50. 200. FORMAT "%10.5" DEPOSIT ABSOLUTE /end AXIS_DESCR
/end CHARACTERISTIC
/begin CHARACTERISTIC GAC_CALIB.GAC_GracB.GAC_SyncCtrl.GAC_PRESSSHUNTCUT "" VALUE 0x80611C9E DefaultValueRecordLayout_AUTOSAR_Platform_BaseTypes_sint16 64.0 RB_PT_PCT_SWC_GAC_CompuMethods_ratio_0p001 -32. 32. FORMAT "%10.5"
 /begin ANNOTATION ANNOTATION_LABEL "Description (coming from AUTOSAR DESC field)"
  /begin ANNOTATION_TEXT "Pressure demand when the shunt pressure cut is active\r\n" /end ANNOTATION_TEXT
 /end ANNOTATION
/end CHARACTERISTIC
/begin CHARACTERISTIC GAC_CALIB.GAC_GracB.GAC_SyncCtrl.GAC_PRESSSYNCBLENDMAX "" VALUE 0x80611CA0 DefaultValueRecordLayout_AUTOSAR_Platform_BaseTypes_uint16 32.0 RB_PT_PCT_SWC_GAC_CompuMethods_ratio_0p001 0.0 32. FORMAT "%10.5"
 /begin ANNOTATION ANNOTATION_LABEL "Description (coming from AUTOSAR DESC field)"
  /begin ANNOTATION_TEXT "Limited additive integral pressure term when rate of change of sync slip not ok for sync control.\r\n" /end ANNOTATION_TEXT
 /end ANNOTATION
/end CHARACTERISTIC
/begin CHARACTERISTIC GAC_CALIB.GAC_GracB.GAC_SyncCtrl.GAC_ROCSPDSYNCSLIPOK "" VALUE 0x80611CA2 DefaultValueRecordLayout_AUTOSAR_Platform_BaseTypes_sint16 655350.0 RB_PT_PCT_SWC_GAC_CompuMethods_ratio_10p0 -327680. 327670. FORMAT "%10.5"
 /begin ANNOTATION ANNOTATION_LABEL "Description (coming from AUTOSAR DESC field)"
  /begin ANNOTATION_TEXT "Rate of change of synchro slip for detection of sync control ok.\r\n" /end ANNOTATION_TEXT
 /end ANNOTATION
/end CHARACTERISTIC
/begin CHARACTERISTIC GAC_CALIB.GAC_GracB.GAC_SyncCtrl.GAC_SPDTHRESHHOLDITERM "" VALUE 0x80611CA4 DefaultValueRecordLayout_AUTOSAR_Platform_BaseTypes_sint16 40000.0 RB_PT_PCT_SWC_GAC_CompuMethods_ident -20000. 20000. FORMAT "%10.5"
 /begin ANNOTATION ANNOTATION_LABEL "Description (coming from AUTOSAR DESC field)"
  /begin ANNOTATION_TEXT "speed threshold below which, the I term is not allowed to increase\r\n" /end ANNOTATION_TEXT
 /end ANNOTATION
/end CHARACTERISTIC
/begin CHARACTERISTIC GAC_CALIB.GAC_GracB.GAC_SyncCtrl.GAC_SPEEDSLIPMAXFORPRESSUREINC "" VALUE 0x80611CA6 DefaultValueRecordLayout_AUTOSAR_Platform_BaseTypes_sint16 40000.0 RB_PT_PCT_SWC_GAC_CompuMethods_ident -20000. 20000. FORMAT "%10.5"
 /begin ANNOTATION ANNOTATION_LABEL "Description (coming from AUTOSAR DESC field)"
  /begin ANNOTATION_TEXT "slip speed limit to step to the retry pressure on the first attempt\r\n" /end ANNOTATION_TEXT
 /end ANNOTATION
/end CHARACTERISTIC
/begin CHARACTERISTIC GAC_CALIB.GAC_GracB.GAC_SyncCtrl.GAC_SYNCCTRLFLOWTC "" VALUE 0x80611CA8 DefaultValueRecordLayout_AUTOSAR_Platform_BaseTypes_uint16 0.999 RB_PT_PCT_SWC_GAC_CompuMethods_ratio_0p001 0.001 1. FORMAT "%10.5"
 /begin ANNOTATION ANNOTATION_LABEL "Description (coming from AUTOSAR DESC field)" /begin ANNOTATION_TEXT "Synchro control flow demand time constant.\r\n" /end ANNOTATION_TEXT /end ANNOTATION
/end CHARACTERISTIC
/begin CHARACTERISTIC GAC_CALIB.GAC_GracB.GAC_SyncCtrl.GAC_SYNCCTRLPRESSMINMAP "" CURVE 0x80611DA8 RB_PT_PCT_SWC_GAC_RecordLayouts_RL_Curve_uint16_4_sint16_4 32.0 RB_PT_PCT_SWC_GAC_CompuMethods_ratio_0p001 0.0 32. FORMAT "%10.5"
 /begin ANNOTATION ANNOTATION_LABEL "Description (coming from AUTOSAR DESC field)"
  /begin ANNOTATION_TEXT "Synchronisation pressure minimum based on temperature\r\n" /end ANNOTATION_TEXT
 /end ANNOTATION
 /begin AXIS_DESCR STD_AXIS NO_INPUT_QUANTITY RB_PT_PCT_SWC_GAC_CompuMethods_ident 4 -50. 200. FORMAT "%10.5" DEPOSIT ABSOLUTE /end AXIS_DESCR
/end CHARACTERISTIC
/begin CHARACTERISTIC GAC_CALIB.GAC_GracB.GAC_SyncCtrl.GAC_TEMPMAXPRESSURESHUNTOKAY "" VALUE 0x80611CAA DefaultValueRecordLayout_AUTOSAR_Platform_BaseTypes_sint16 250.0 RB_PT_PCT_SWC_GAC_CompuMethods_ident -50. 200. FORMAT "%10.5"
 /begin ANNOTATION ANNOTATION_LABEL "Description (coming from AUTOSAR DESC field)" /begin ANNOTATION_TEXT "Maximum temperature to enable the pressure shunt\r\n" /end ANNOTATION_TEXT /end ANNOTATION
/end CHARACTERISTIC
/begin CHARACTERISTIC GAC_CALIB.GAC_GracB.GAC_SyncCtrl.GAC_TEMPMINPRESSURESHUNTOKAY "" VALUE 0x80611CAC DefaultValueRecordLayout_AUTOSAR_Platform_BaseTypes_sint16 250.0 RB_PT_PCT_SWC_GAC_CompuMethods_ident -50. 200. FORMAT "%10.5"
 /begin ANNOTATION ANNOTATION_LABEL "Description (coming from AUTOSAR DESC field)" /begin ANNOTATION_TEXT "Minimum temperature to enable the pressure shunt\r\n" /end ANNOTATION_TEXT /end ANNOTATION
/end CHARACTERISTIC
/begin CHARACTERISTIC GAC_CALIB.GAC_GracB.GAC_SyncCtrl.GAC_TMMAXPRESSURESHUNT "" VALUE 0x80611CAE DefaultValueRecordLayout_AUTOSAR_Platform_BaseTypes_uint16 65.535 RB_PT_PCT_SWC_GAC_CompuMethods_ratio_0p001 0.0 65.535 FORMAT "%10.5"
 /begin ANNOTATION ANNOTATION_LABEL "Description (coming from AUTOSAR DESC field)" /begin ANNOTATION_TEXT "Maximum time the pressure shunt can operate for\r\n" /end ANNOTATION_TEXT /end ANNOTATION
/end CHARACTERISTIC
/begin CHARACTERISTIC GAC_CALIB.GAC_GracB.GAC_SyncCtrl.GAC_TmrPressureShunt.LIB_DT "" VALUE 0x80611CB8 DefaultValueRecordLayout_AUTOSAR_Platform_BaseTypes_uint16 65.535 RB_PT_PCT_SWC_GAC_CompuMethods_ratio_0p001 0.0 65.535 FORMAT "%10.5"
 /begin ANNOTATION ANNOTATION_LABEL "Description (coming from AUTOSAR DESC field)" /begin ANNOTATION_TEXT "Timer decrement value.\r\n" /end ANNOTATION_TEXT /end ANNOTATION
/end CHARACTERISTIC
/begin CHARACTERISTIC GAC_CALIB.GAC_GracB.GAC_SyncCtrl.GAC_TMSDEBGRACSLOWSYNCOK "" VAL_BLK 0x80611C76 DefaultValueRecordLayout_AUTOSAR_Platform_BaseTypes_uint16 65.535 RB_PT_PCT_SWC_GAC_CompuMethods_ratio_0p001 0.0 65.535 FORMAT "%10.5"
 /begin ANNOTATION ANNOTATION_LABEL "Description (coming from AUTOSAR DESC field)"
  /begin ANNOTATION_TEXT "Debounce times for detecting slow enough for synchro control, for each actuation aggression.\r\n" /end ANNOTATION_TEXT
 /end ANNOTATION
 MATRIX_DIM 4 1 1 /end CHARACTERISTIC
/begin CHARACTERISTIC GAC_CALIB.GAC_GracB.GAC_SyncCtrl.GAC_TMSDEBROCSLIPFORSYNC "" VAL_BLK 0x80611C7E DefaultValueRecordLayout_AUTOSAR_Platform_BaseTypes_uint16 65.535 RB_PT_PCT_SWC_GAC_CompuMethods_ratio_0p001 0.0 65.535 FORMAT "%10.5"
 /begin ANNOTATION ANNOTATION_LABEL "Description (coming from AUTOSAR DESC field)"
  /begin ANNOTATION_TEXT "Debounce times for detecting rate of change of slip ok for synchro control, for each actuation aggression.\r\n" /end ANNOTATION_TEXT
 /end ANNOTATION
 MATRIX_DIM 4 1 1 /end CHARACTERISTIC
/begin CHARACTERISTIC GAC_CALIB.GAC_GracB.GAC_SyncCtrl.GAC_TMSHUNTPRESSURECUT "" VALUE 0x80611CB0 DefaultValueRecordLayout_AUTOSAR_Platform_BaseTypes_uint16 65.535 RB_PT_PCT_SWC_GAC_CompuMethods_ratio_0p001 0.0 65.535 FORMAT "%10.5"
 /begin ANNOTATION ANNOTATION_LABEL "Description (coming from AUTOSAR DESC field)" /begin ANNOTATION_TEXT "Maximum time the shunt pressure cut can occur for\r\n" /end ANNOTATION_TEXT /end ANNOTATION
/end CHARACTERISTIC
/begin CHARACTERISTIC GAC_CALIB.GAC_GracB.GAC_SyncCtrl.GAC_VELSGRACSLOWABS "" VAL_BLK 0x80611C86 DefaultValueRecordLayout_AUTOSAR_Platform_BaseTypes_uint16 1.2 RB_PT_PCT_SWC_GAC_CompuMethods_ratio_0p001 0.0 1.2 FORMAT "%10.5"
 /begin ANNOTATION ANNOTATION_LABEL "Description (coming from AUTOSAR DESC field)"
  /begin ANNOTATION_TEXT "Unsigned gear actuator velocities for detecting slow enough for synchro control, for each actuation aggression.\r\n" /end ANNOTATION_TEXT
 /end ANNOTATION
 MATRIX_DIM 4 1 1 /end CHARACTERISTIC
/begin CHARACTERISTIC GAC_CALIB.GAC_GracB.GAC_SyncCtrl.LIB_CountUpTimer.LIB_DT "" VALUE 0x80611CBA DefaultValueRecordLayout_AUTOSAR_Platform_BaseTypes_uint16 65.535 RB_PT_PCT_SWC_GAC_CompuMethods_ratio_0p001 0.0 65.535 FORMAT "%10.5"
 /begin ANNOTATION ANNOTATION_LABEL "Description (coming from AUTOSAR DESC field)" /begin ANNOTATION_TEXT "Timer decrement value.\r\n" /end ANNOTATION_TEXT /end ANNOTATION
/end CHARACTERISTIC
/begin CHARACTERISTIC GAC_CALIB.GAC_GracB.GAC_TIMEMAXWAITUNTILAGAINSTDRAG "" VALUE 0x806119C0 DefaultValueRecordLayout_AUTOSAR_Platform_BaseTypes_uint16 65.535 RB_PT_PCT_SWC_GAC_CompuMethods_ratio_0p001 0.0 65.535 FORMAT "%10.5"
 /begin ANNOTATION ANNOTATION_LABEL "Description (coming from AUTOSAR DESC field)"
  /begin ANNOTATION_TEXT "Max time to wait for the synchronisation to be against drag before engagements commence\r\n" /end ANNOTATION_TEXT
 /end ANNOTATION
/end CHARACTERISTIC
/begin CHARACTERISTIC GAC_CALIB.GAC_GracB.GAC_TMDEBFORCEONSYNC "" VALUE 0x806119C2 DefaultValueRecordLayout_AUTOSAR_Platform_BaseTypes_uint16 65.535 RB_PT_PCT_SWC_GAC_CompuMethods_ratio_0p001 0.0 65.535 FORMAT "%10.5"
 /begin ANNOTATION ANNOTATION_LABEL "Description (coming from AUTOSAR DESC field)"
  /begin ANNOTATION_TEXT "Debounce time for detecting force sychronisation start.\r\n" /end ANNOTATION_TEXT
 /end ANNOTATION
/end CHARACTERISTIC
/begin CHARACTERISTIC GAC_CALIB.GAC_GracB.GAC_TMDEBFORCEONSYNCEV "" VALUE 0x806119C4 DefaultValueRecordLayout_AUTOSAR_Platform_BaseTypes_uint16 65.535 RB_PT_PCT_SWC_GAC_CompuMethods_ratio_0p001 0.0 65.535 FORMAT "%10.5"
 /begin ANNOTATION ANNOTATION_LABEL "Description (coming from AUTOSAR DESC field)"
  /begin ANNOTATION_TEXT "Debounce time for detecting force sychronisation start.\r\n" /end ANNOTATION_TEXT
 /end ANNOTATION
/end CHARACTERISTIC
/begin CHARACTERISTIC GAC_CALIB.GAC_GracB.GAC_TMDEBGBLK0EVMODE "" CURVE 0x80612050 RB_PT_PCT_SWC_GAC_RecordLayouts_RL_Curve_uint16_4_sint16_4 65.535 RB_PT_PCT_SWC_GAC_CompuMethods_ratio_0p001 0.0 65.535 FORMAT "%10.5"
 /begin ANNOTATION ANNOTATION_LABEL "Description (coming from AUTOSAR DESC field)"
  /begin ANNOTATION_TEXT "Debounce time to be stuck on the synchroniser - variable with temperature\r\n" /end ANNOTATION_TEXT
 /end ANNOTATION
 /begin AXIS_DESCR STD_AXIS NO_INPUT_QUANTITY RB_PT_PCT_SWC_GAC_CompuMethods_ident 4 -50. 200. FORMAT "%10.5" DEPOSIT ABSOLUTE /end AXIS_DESCR
/end CHARACTERISTIC
/begin CHARACTERISTIC GAC_CALIB.GAC_GracB.GAC_TMFAILPUSHINGR "" VALUE 0x806119C6 DefaultValueRecordLayout_AUTOSAR_Platform_BaseTypes_uint16 10.0 RB_PT_PCT_SWC_GAC_CompuMethods_ratio_0p001 0.0 10. FORMAT "%10.5"
 /begin ANNOTATION ANNOTATION_LABEL "Description (coming from AUTOSAR DESC field)" /begin ANNOTATION_TEXT "Time used for detecting 'fail push in gear'.\r\n" /end ANNOTATION_TEXT /end ANNOTATION
/end CHARACTERISTIC
/begin CHARACTERISTIC GAC_CALIB.GAC_GracB.GAC_TMHOLDFLWISYNCEND "" VALUE 0x806119C8 DefaultValueRecordLayout_AUTOSAR_Platform_BaseTypes_uint16 65.535 RB_PT_PCT_SWC_GAC_CompuMethods_ratio_0p001 0.0 65.535 FORMAT "%10.5"
 /begin ANNOTATION ANNOTATION_LABEL "Description (coming from AUTOSAR DESC field)"
  /begin ANNOTATION_TEXT "Time to hold the integral flow term for velocity control upon synchronisation end detected.\r\n" /end ANNOTATION_TEXT
 /end ANNOTATION
/end CHARACTERISTIC
/begin CHARACTERISTIC GAC_CALIB.GAC_GracB.GAC_TMHOLDFLWITOSYNC "" VALUE 0x806119CA DefaultValueRecordLayout_AUTOSAR_Platform_BaseTypes_uint16 65.535 RB_PT_PCT_SWC_GAC_CompuMethods_ratio_0p001 0.0 65.535 FORMAT "%10.5"
 /begin ANNOTATION ANNOTATION_LABEL "Description (coming from AUTOSAR DESC field)"
  /begin ANNOTATION_TEXT "Time to hold the integral flow term for velocity control upon actuation to gear from Neutral.\r\n" /end ANNOTATION_TEXT
 /end ANNOTATION
/end CHARACTERISTIC
/begin CHARACTERISTIC GAC_CALIB.GAC_GracB.GAC_TMHOLDFLWITOSYNCHIAGG "" VALUE 0x806119CC DefaultValueRecordLayout_AUTOSAR_Platform_BaseTypes_uint16 65.535 RB_PT_PCT_SWC_GAC_CompuMethods_ratio_0p001 0.0 65.535 FORMAT "%10.5"
 /begin ANNOTATION ANNOTATION_LABEL "Description (coming from AUTOSAR DESC field)"
  /begin ANNOTATION_TEXT "Time to hold the integral flow term for velocity control upon actuation to gear from Neutral - high aggression actuation.\r\n" /end ANNOTATION_TEXT
 /end ANNOTATION
/end CHARACTERISTIC
/begin CHARACTERISTIC GAC_CALIB.GAC_GracB.GAC_TMHOLDFLWITOSYNCLOW "" VALUE 0x806119CE DefaultValueRecordLayout_AUTOSAR_Platform_BaseTypes_uint16 65.535 RB_PT_PCT_SWC_GAC_CompuMethods_ratio_0p001 0.0 65.535 FORMAT "%10.5"
 /begin ANNOTATION ANNOTATION_LABEL "Description (coming from AUTOSAR DESC field)"
  /begin ANNOTATION_TEXT "Time to hold the integral flow term for velocity control upon actuation to gear from Neutral - low hold time.\r\n" /end ANNOTATION_TEXT
 /end ANNOTATION
/end CHARACTERISTIC
/begin CHARACTERISTIC GAC_CALIB.GAC_GracB.GAC_TMINITINNNOFLOAT "" VALUE 0x806119D0 DefaultValueRecordLayout_AUTOSAR_Platform_BaseTypes_uint16 65.535 RB_PT_PCT_SWC_GAC_CompuMethods_ratio_0p001 0.0 65.535 FORMAT "%10.5"
 /begin ANNOTATION ANNOTATION_LABEL "Description (coming from AUTOSAR DESC field)"
  /begin ANNOTATION_TEXT "Time to determine that the gear is not floating out of neutral\r\n" /end ANNOTATION_TEXT
 /end ANNOTATION
/end CHARACTERISTIC
/begin CHARACTERISTIC GAC_CALIB.GAC_GracB.GAC_TMMAXNSTOPITERMRESET "" VALUE 0x806119D2 DefaultValueRecordLayout_AUTOSAR_Platform_BaseTypes_uint16 65.535 RB_PT_PCT_SWC_GAC_CompuMethods_ratio_0p001 0.0 65.535 FORMAT "%10.5"
 /begin ANNOTATION ANNOTATION_LABEL "Description (coming from AUTOSAR DESC field)"
  /begin ANNOTATION_TEXT "Maximum time for the I term reset to be active for when the N stop condition is active\r\n" /end ANNOTATION_TEXT
 /end ANNOTATION
/end CHARACTERISTIC
/begin CHARACTERISTIC GAC_CALIB.GAC_GracB.GAC_TMPINTRPNSTOPVELTGT "" VALUE 0x806119D4 DefaultValueRecordLayout_AUTOSAR_Platform_BaseTypes_sint16 250.0 RB_PT_PCT_SWC_GAC_CompuMethods_ident -50. 200. FORMAT "%10.5"
 /begin ANNOTATION ANNOTATION_LABEL "Description (coming from AUTOSAR DESC field)"
  /begin ANNOTATION_TEXT "Temperature used for assessing interpolation of the NStop velocity target.\r\n" /end ANNOTATION_TEXT
 /end ANNOTATION
/end CHARACTERISTIC
/begin CHARACTERISTIC GAC_CALIB.GAC_GracB.GAC_TMPINTRPVELCTRLPRESSFF "" VALUE 0x806119D6 DefaultValueRecordLayout_AUTOSAR_Platform_BaseTypes_sint16 250.0 RB_PT_PCT_SWC_GAC_CompuMethods_ident -50. 200. FORMAT "%10.5"
 /begin ANNOTATION ANNOTATION_LABEL "Description (coming from AUTOSAR DESC field)"
  /begin ANNOTATION_TEXT "Temperature used for assessing interpolation of the velocity control feedforward pressure term.\r\n" /end ANNOTATION_TEXT
 /end ANNOTATION
/end CHARACTERISTIC
/begin CHARACTERISTIC GAC_CALIB.GAC_GracB.GAC_TMPINTRPVELCTRLPRESSONFLW "" VALUE 0x806119D8 DefaultValueRecordLayout_AUTOSAR_Platform_BaseTypes_sint16 250.0 RB_PT_PCT_SWC_GAC_CompuMethods_ident -50. 200. FORMAT "%10.5"
 /begin ANNOTATION ANNOTATION_LABEL "Description (coming from AUTOSAR DESC field)"
  /begin ANNOTATION_TEXT "Temperature used for assessing interpolation of the velocity control flow based pressure term.\r\n" /end ANNOTATION_TEXT
 /end ANNOTATION
/end CHARACTERISTIC
/begin CHARACTERISTIC GAC_CALIB.GAC_GracB.GAC_TMPRESSENDSTOP "" VALUE 0x806119DA DefaultValueRecordLayout_AUTOSAR_Platform_BaseTypes_uint16 65.535 RB_PT_PCT_SWC_GAC_CompuMethods_ratio_0p001 0.0 65.535 FORMAT "%10.5"
 /begin ANNOTATION ANNOTATION_LABEL "Description (coming from AUTOSAR DESC field)" /begin ANNOTATION_TEXT "Synchronisation time target for static shifts7\r\n" /end ANNOTATION_TEXT /end ANNOTATION
/end CHARACTERISTIC
/begin CHARACTERISTIC GAC_CALIB.GAC_GracB.GAC_TMPRESSENDSTOPSYNCF "" VALUE 0x806119DC DefaultValueRecordLayout_AUTOSAR_Platform_BaseTypes_uint16 65.535 RB_PT_PCT_SWC_GAC_CompuMethods_ratio_0p001 0.0 65.535 FORMAT "%10.5"
 /begin ANNOTATION ANNOTATION_LABEL "Description (coming from AUTOSAR DESC field)" /begin ANNOTATION_TEXT "Synchronisation time target for static shifts7\r\n" /end ANNOTATION_TEXT /end ANNOTATION
/end CHARACTERISTIC
/begin CHARACTERISTIC GAC_CALIB.GAC_GracB.GAC_TMPVLVNOPULSE "" VALUE 0x806119DE DefaultValueRecordLayout_AUTOSAR_Platform_BaseTypes_uint16 65.535 RB_PT_PCT_SWC_GAC_CompuMethods_ratio_0p001 0.0 65.535 FORMAT "%10.5"
 /begin ANNOTATION ANNOTATION_LABEL "Description (coming from AUTOSAR DESC field)"
  /begin ANNOTATION_TEXT "Time for which no pulse is allowed on the pressure valve.\r\n" /end ANNOTATION_TEXT
 /end ANNOTATION
/end CHARACTERISTIC
/begin CHARACTERISTIC GAC_CALIB.GAC_GracB.GAC_TmrInNState.LIB_DT "" VALUE 0x80611DBA DefaultValueRecordLayout_AUTOSAR_Platform_BaseTypes_uint16 65.535 RB_PT_PCT_SWC_GAC_CompuMethods_ratio_0p001 0.0 65.535 FORMAT "%10.5"
 /begin ANNOTATION ANNOTATION_LABEL "Description (coming from AUTOSAR DESC field)" /begin ANNOTATION_TEXT "Timer decrement value.\r\n" /end ANNOTATION_TEXT /end ANNOTATION
/end CHARACTERISTIC
/begin CHARACTERISTIC GAC_CALIB.GAC_GracB.GAC_TmrNStopITermReset.LIB_DT "" VALUE 0x80611DBC DefaultValueRecordLayout_AUTOSAR_Platform_BaseTypes_uint16 65.535 RB_PT_PCT_SWC_GAC_CompuMethods_ratio_0p001 0.0 65.535 FORMAT "%10.5"
 /begin ANNOTATION ANNOTATION_LABEL "Description (coming from AUTOSAR DESC field)" /begin ANNOTATION_TEXT "Timer decrement value.\r\n" /end ANNOTATION_TEXT /end ANNOTATION
/end CHARACTERISTIC
/begin CHARACTERISTIC GAC_CALIB.GAC_GracB.GAC_TMSHOLDFLWIVELCTRLN "" CURVE 0x80612062 RB_PT_PCT_SWC_GAC_RecordLayouts_RL_Curve_uint16_2_sint16_2 65.535 RB_PT_PCT_SWC_GAC_CompuMethods_ratio_0p001 0.0 65.535 FORMAT "%10.5"
 /begin ANNOTATION ANNOTATION_LABEL "Description (coming from AUTOSAR DESC field)"
  /begin ANNOTATION_TEXT "Times used for the hold of the integral flow term for velocity control Neutral actuation.\r\n" /end ANNOTATION_TEXT
 /end ANNOTATION
 /begin AXIS_DESCR STD_AXIS NO_INPUT_QUANTITY RB_PT_PCT_SWC_GAC_CompuMethods_ident 2 -50. 200. FORMAT "%10.5" DEPOSIT ABSOLUTE /end AXIS_DESCR
/end CHARACTERISTIC
/begin CHARACTERISTIC GAC_CALIB.GAC_GracB.GAC_TMSSYNCTGT "" VAL_BLK 0x80611934 DefaultValueRecordLayout_AUTOSAR_Platform_BaseTypes_uint16 65.535 RB_PT_PCT_SWC_GAC_CompuMethods_ratio_0p001 0.0 65.535 FORMAT "%10.5"
 /begin ANNOTATION ANNOTATION_LABEL "Description (coming from AUTOSAR DESC field)"
  /begin ANNOTATION_TEXT "Array of times indicating the target synchronisation time for positive/negative gear and actuation aggression.\r\n" /end ANNOTATION_TEXT
 /end ANNOTATION
 MATRIX_DIM 4 2 1 /end CHARACTERISTIC
/begin CHARACTERISTIC GAC_CALIB.GAC_GracB.GAC_TMSSYNCTGTCLOW "" VALUE 0x806119E0 DefaultValueRecordLayout_AUTOSAR_Platform_BaseTypes_uint16 65.535 RB_PT_PCT_SWC_GAC_CompuMethods_ratio_0p001 0.0 65.535 FORMAT "%10.5"
 /begin ANNOTATION ANNOTATION_LABEL "Description (coming from AUTOSAR DESC field)" /begin ANNOTATION_TEXT "Synchronisation time target for static shifts7\r\n" /end ANNOTATION_TEXT /end ANNOTATION
/end CHARACTERISTIC
/begin CHARACTERISTIC GAC_CALIB.GAC_GracB.GAC_TMSSYNCTGTCLOW1STGR "" VALUE 0x806119E2 DefaultValueRecordLayout_AUTOSAR_Platform_BaseTypes_uint16 65.535 RB_PT_PCT_SWC_GAC_CompuMethods_ratio_0p001 0.0 65.535 FORMAT "%10.5"
 /begin ANNOTATION ANNOTATION_LABEL "Description (coming from AUTOSAR DESC field)" /begin ANNOTATION_TEXT "Synchronisation time target for static shifts7\r\n" /end ANNOTATION_TEXT /end ANNOTATION
/end CHARACTERISTIC
/begin CHARACTERISTIC GAC_CALIB.GAC_GracB.GAC_TMSSYNCTGTDR "" VALUE 0x806119E4 DefaultValueRecordLayout_AUTOSAR_Platform_BaseTypes_uint16 65.535 RB_PT_PCT_SWC_GAC_CompuMethods_ratio_0p001 0.0 65.535 FORMAT "%10.5"
 /begin ANNOTATION ANNOTATION_LABEL "Description (coming from AUTOSAR DESC field)" /begin ANNOTATION_TEXT "Synchronisation time target for static shifts7\r\n" /end ANNOTATION_TEXT /end ANNOTATION
/end CHARACTERISTIC
/begin CHARACTERISTIC GAC_CALIB.GAC_GracB.GAC_TMSSYNCTGTSTATIC "" VALUE 0x806119E6 DefaultValueRecordLayout_AUTOSAR_Platform_BaseTypes_uint16 65.535 RB_PT_PCT_SWC_GAC_CompuMethods_ratio_0p001 0.0 65.535 FORMAT "%10.5"
 /begin ANNOTATION ANNOTATION_LABEL "Description (coming from AUTOSAR DESC field)" /begin ANNOTATION_TEXT "Synchronisation time target for static shifts7\r\n" /end ANNOTATION_TEXT /end ANNOTATION
/end CHARACTERISTIC
/begin CHARACTERISTIC GAC_CALIB.GAC_GracB.GAC_VELGRACADPPUSHINGRNEGTGT "" VALUE 0x806119E8 DefaultValueRecordLayout_AUTOSAR_Platform_BaseTypes_sint16 2.4 RB_PT_PCT_SWC_GAC_CompuMethods_ratio_0p001 -1.2 1.2 FORMAT "%10.5"
 /begin ANNOTATION ANNOTATION_LABEL "Description (coming from AUTOSAR DESC field)"
  /begin ANNOTATION_TEXT "Velocity target for the gear actuator during adaptation 'push in (negative) gear' active.\r\n" /end ANNOTATION_TEXT
 /end ANNOTATION
/end CHARACTERISTIC
/begin CHARACTERISTIC GAC_CALIB.GAC_GracB.GAC_VELGRACADPPUSHINGRPOSTGT "" VALUE 0x806119EA DefaultValueRecordLayout_AUTOSAR_Platform_BaseTypes_sint16 2.4 RB_PT_PCT_SWC_GAC_CompuMethods_ratio_0p001 -1.2 1.2 FORMAT "%10.5"
 /begin ANNOTATION ANNOTATION_LABEL "Description (coming from AUTOSAR DESC field)"
  /begin ANNOTATION_TEXT "Velocity target for the gear actuator during adaptation 'push in (positive) gear' active.\r\n" /end ANNOTATION_TEXT
 /end ANNOTATION
/end CHARACTERISTIC
/begin CHARACTERISTIC GAC_CALIB.GAC_GracB.GAC_VELGRACFAILPUSHINGR "" VALUE 0x806119EC DefaultValueRecordLayout_AUTOSAR_Platform_BaseTypes_sint16 2.4 RB_PT_PCT_SWC_GAC_CompuMethods_ratio_0p001 -1.2 1.2 FORMAT "%10.5"
 /begin ANNOTATION ANNOTATION_LABEL "Description (coming from AUTOSAR DESC field)"
  /begin ANNOTATION_TEXT "Velocity target for the gear actuator during 'fail push in gear' active.\r\n" /end ANNOTATION_TEXT
 /end ANNOTATION
/end CHARACTERISTIC
/begin CHARACTERISTIC GAC_CALIB.GAC_GracB.GAC_VELGRACMOVING "" VALUE 0x806119EE DefaultValueRecordLayout_AUTOSAR_Platform_BaseTypes_sint16 0.6 RB_PT_PCT_SWC_GAC_CompuMethods_ratio_0p0001 -0.3 0.3 FORMAT "%10.5"
 /begin ANNOTATION ANNOTATION_LABEL "Description (coming from AUTOSAR DESC field)"
  /begin ANNOTATION_TEXT "Gear actuator velocity used for detecting synchronisation start on the positive gear.\r\n" /end ANNOTATION_TEXT
 /end ANNOTATION
/end CHARACTERISTIC
/begin CHARACTERISTIC GAC_CALIB.GAC_GracB.GAC_VELGRACMOVINGENDSYNC "" CURVE 0x8061206C RB_PT_PCT_SWC_GAC_RecordLayouts_RL_Curve_sint16_4_uint16_4 0.6 RB_PT_PCT_SWC_GAC_CompuMethods_ratio_0p0001 -0.3 0.3 FORMAT "%10.5"
 /begin ANNOTATION ANNOTATION_LABEL "Description (coming from AUTOSAR DESC field)"
  /begin ANNOTATION_TEXT "velocity exit condition as a function of synchro position\r\n" /end ANNOTATION_TEXT
 /end ANNOTATION
 /begin AXIS_DESCR STD_AXIS NO_INPUT_QUANTITY RB_PT_PCT_SWC_GAC_CompuMethods_ratio_0p001 4 0.0 20. FORMAT "%10.5" DEPOSIT ABSOLUTE /end AXIS_DESCR
/end CHARACTERISTIC
/begin CHARACTERISTIC GAC_CALIB.GAC_GracB.GAC_VELGRACNSTOPRESETI "" VALUE 0x806119F0 DefaultValueRecordLayout_AUTOSAR_Platform_BaseTypes_uint16 1.2 RB_PT_PCT_SWC_GAC_CompuMethods_ratio_0p001 0.0 1.2 FORMAT "%10.5"
 /begin ANNOTATION ANNOTATION_LABEL "Description (coming from AUTOSAR DESC field)"
  /begin ANNOTATION_TEXT "Gear actuator velocity used for resetting the I term during NStop phase.\r\n" /end ANNOTATION_TEXT
 /end ANNOTATION
/end CHARACTERISTIC
/begin CHARACTERISTIC GAC_CALIB.GAC_GracB.GAC_VELGRACSTOPPED "" VALUE 0x806119F2 DefaultValueRecordLayout_AUTOSAR_Platform_BaseTypes_sint16 0.6 RB_PT_PCT_SWC_GAC_CompuMethods_ratio_0p0001 -0.3 0.3 FORMAT "%10.5"
 /begin ANNOTATION ANNOTATION_LABEL "Description (coming from AUTOSAR DESC field)"
  /begin ANNOTATION_TEXT "Gear actuator velocity used for detecting if the synchro has stopped\r\n" /end ANNOTATION_TEXT
 /end ANNOTATION
/end CHARACTERISTIC
/begin CHARACTERISTIC GAC_CALIB.GAC_GracB.GAC_VELGRACTHRESHNEUTRALCLOSEOUT "" VALUE 0x806119F4 DefaultValueRecordLayout_AUTOSAR_Platform_BaseTypes_sint16 2.4 RB_PT_PCT_SWC_GAC_CompuMethods_ratio_0p001 -1.2 1.2 FORMAT "%10.5"
 /begin ANNOTATION ANNOTATION_LABEL "Description (coming from AUTOSAR DESC field)"
  /begin ANNOTATION_TEXT "Velocity target for the gear actuator during 'fail push in gear' active.\r\n" /end ANNOTATION_TEXT
 /end ANNOTATION
/end CHARACTERISTIC
/begin CHARACTERISTIC GAC_CALIB.GAC_GracB.GAC_VELSDROPGBLK2 "" VAL_BLK 0x80611944 DefaultValueRecordLayout_AUTOSAR_Platform_BaseTypes_uint16 1.2 RB_PT_PCT_SWC_GAC_CompuMethods_ratio_0p001 0.0 1.2 FORMAT "%10.5"
 /begin ANNOTATION ANNOTATION_LABEL "Description (coming from AUTOSAR DESC field)"
  /begin ANNOTATION_TEXT "Drop velocities for gear block 2 detection, for each actuation aggression\r\n" /end ANNOTATION_TEXT
 /end ANNOTATION
 MATRIX_DIM 4 1 1 /end CHARACTERISTIC
/begin CHARACTERISTIC GAC_CALIB.GAC_GracB.GAC_VELSGRACGRNEGEVSYNCTGT "" CURVE 0x8061207E RB_PT_PCT_SWC_GAC_RecordLayouts_RL_Curve_sint16_4_sint16_4 2.4 RB_PT_PCT_SWC_GAC_CompuMethods_ratio_0p001 -1.2 1.2 FORMAT "%10.5"
 /begin ANNOTATION ANNOTATION_LABEL "Description (coming from AUTOSAR DESC field)"
  /begin ANNOTATION_TEXT "Gear actuator velocity targets for engaging negative gear in low aggression post-synchro phase.\r\n" /end ANNOTATION_TEXT
 /end ANNOTATION
 /begin AXIS_DESCR STD_AXIS NO_INPUT_QUANTITY RB_PT_PCT_SWC_GAC_CompuMethods_ident 4 -100. 100. FORMAT "%10.5" DEPOSIT ABSOLUTE /end AXIS_DESCR
/end CHARACTERISTIC
/begin CHARACTERISTIC GAC_CALIB.GAC_GracB.GAC_VELSGRACGRNEGEVTGT "" CURVE 0x80612090 RB_PT_PCT_SWC_GAC_RecordLayouts_RL_Curve_sint16_8_sint16_8 2.4 RB_PT_PCT_SWC_GAC_CompuMethods_ratio_0p001 -1.2 1.2 FORMAT "%10.5"
 /begin ANNOTATION ANNOTATION_LABEL "Description (coming from AUTOSAR DESC field)"
  /begin ANNOTATION_TEXT "Gear actuator velocity targets for engaging negative gear in low aggression pre-synchro phase.\r\n" /end ANNOTATION_TEXT
 /end ANNOTATION
 /begin AXIS_DESCR STD_AXIS NO_INPUT_QUANTITY RB_PT_PCT_SWC_GAC_CompuMethods_ident 8 -100. 100. FORMAT "%10.5" DEPOSIT ABSOLUTE /end AXIS_DESCR
/end CHARACTERISTIC
/begin CHARACTERISTIC GAC_CALIB.GAC_GracB.GAC_VELSGRACGRNEGHISYNCTGT "" CURVE 0x806120B2 RB_PT_PCT_SWC_GAC_RecordLayouts_RL_Curve_sint16_4_sint16_4 2.4 RB_PT_PCT_SWC_GAC_CompuMethods_ratio_0p001 -1.2 1.2 FORMAT "%10.5"
 /begin ANNOTATION ANNOTATION_LABEL "Description (coming from AUTOSAR DESC field)"
  /begin ANNOTATION_TEXT "Gear actuator velocity targets for engaging negative gear in high aggression post-synchro phase.\r\n" /end ANNOTATION_TEXT
 /end ANNOTATION
 /begin AXIS_DESCR STD_AXIS NO_INPUT_QUANTITY RB_PT_PCT_SWC_GAC_CompuMethods_ident 4 -100. 100. FORMAT "%10.5" DEPOSIT ABSOLUTE /end AXIS_DESCR
/end CHARACTERISTIC
/begin CHARACTERISTIC GAC_CALIB.GAC_GracB.GAC_VELSGRACGRNEGHITGT "" CURVE 0x806120C4 RB_PT_PCT_SWC_GAC_RecordLayouts_RL_Curve_sint16_8_sint16_8 2.4 RB_PT_PCT_SWC_GAC_CompuMethods_ratio_0p001 -1.2 1.2 FORMAT "%10.5"
 /begin ANNOTATION ANNOTATION_LABEL "Description (coming from AUTOSAR DESC field)"
  /begin ANNOTATION_TEXT "Gear actuator velocity targets for engaging negative gear in high aggression pre-synchro phase.\r\n" /end ANNOTATION_TEXT
 /end ANNOTATION
 /begin AXIS_DESCR STD_AXIS NO_INPUT_QUANTITY RB_PT_PCT_SWC_GAC_CompuMethods_ident 8 -100. 100. FORMAT "%10.5" DEPOSIT ABSOLUTE /end AXIS_DESCR
/end CHARACTERISTIC
/begin CHARACTERISTIC GAC_CALIB.GAC_GracB.GAC_VELSGRACGRNEGLOWSYNCTGT "" CURVE 0x806120E6 RB_PT_PCT_SWC_GAC_RecordLayouts_RL_Curve_sint16_4_sint16_4 2.4 RB_PT_PCT_SWC_GAC_CompuMethods_ratio_0p001 -1.2 1.2 FORMAT "%10.5"
 /begin ANNOTATION ANNOTATION_LABEL "Description (coming from AUTOSAR DESC field)"
  /begin ANNOTATION_TEXT "Gear actuator velocity targets for engaging negative gear in low aggression post-synchro phase.\r\n" /end ANNOTATION_TEXT
 /end ANNOTATION
 /begin AXIS_DESCR STD_AXIS NO_INPUT_QUANTITY RB_PT_PCT_SWC_GAC_CompuMethods_ident 4 -100. 100. FORMAT "%10.5" DEPOSIT ABSOLUTE /end AXIS_DESCR
/end CHARACTERISTIC
/begin CHARACTERISTIC GAC_CALIB.GAC_GracB.GAC_VELSGRACGRNEGLOWTGT "" CURVE 0x806120F8 RB_PT_PCT_SWC_GAC_RecordLayouts_RL_Curve_sint16_8_sint16_8 2.4 RB_PT_PCT_SWC_GAC_CompuMethods_ratio_0p001 -1.2 1.2 FORMAT "%10.5"
 /begin ANNOTATION ANNOTATION_LABEL "Description (coming from AUTOSAR DESC field)"
  /begin ANNOTATION_TEXT "Gear actuator velocity targets for engaging negative gear in low aggression pre-synchro phase.\r\n" /end ANNOTATION_TEXT
 /end ANNOTATION
 /begin AXIS_DESCR STD_AXIS NO_INPUT_QUANTITY RB_PT_PCT_SWC_GAC_CompuMethods_ident 8 -100. 100. FORMAT "%10.5" DEPOSIT ABSOLUTE /end AXIS_DESCR
/end CHARACTERISTIC
/begin CHARACTERISTIC GAC_CALIB.GAC_GracB.GAC_VELSGRACGRNEGMEDSYNCTGT "" CURVE 0x8061211A RB_PT_PCT_SWC_GAC_RecordLayouts_RL_Curve_sint16_4_sint16_4 2.4 RB_PT_PCT_SWC_GAC_CompuMethods_ratio_0p001 -1.2 1.2 FORMAT "%10.5"
 /begin ANNOTATION ANNOTATION_LABEL "Description (coming from AUTOSAR DESC field)"
  /begin ANNOTATION_TEXT "Gear actuator velocity targets for engaging negative gear in medium aggression post-synchro phase.\r\n" /end ANNOTATION_TEXT
 /end ANNOTATION
 /begin AXIS_DESCR STD_AXIS NO_INPUT_QUANTITY RB_PT_PCT_SWC_GAC_CompuMethods_ident 4 -100. 100. FORMAT "%10.5" DEPOSIT ABSOLUTE /end AXIS_DESCR
/end CHARACTERISTIC
/begin CHARACTERISTIC GAC_CALIB.GAC_GracB.GAC_VELSGRACGRNEGMEDTGT "" CURVE 0x8061212C RB_PT_PCT_SWC_GAC_RecordLayouts_RL_Curve_sint16_8_sint16_8 2.4 RB_PT_PCT_SWC_GAC_CompuMethods_ratio_0p001 -1.2 1.2 FORMAT "%10.5"
 /begin ANNOTATION ANNOTATION_LABEL "Description (coming from AUTOSAR DESC field)"
  /begin ANNOTATION_TEXT "Gear actuator velocity targets for engaging negative gear in medium aggression pre-synchro phase.\r\n" /end ANNOTATION_TEXT
 /end ANNOTATION
 /begin AXIS_DESCR STD_AXIS NO_INPUT_QUANTITY RB_PT_PCT_SWC_GAC_CompuMethods_ident 8 -100. 100. FORMAT "%10.5" DEPOSIT ABSOLUTE /end AXIS_DESCR
/end CHARACTERISTIC
/begin CHARACTERISTIC GAC_CALIB.GAC_GracB.GAC_VELSGRACGRNEGSTATICSYNCTGT "" CURVE 0x8061214E RB_PT_PCT_SWC_GAC_RecordLayouts_RL_Curve_sint16_4_sint16_4 2.4 RB_PT_PCT_SWC_GAC_CompuMethods_ratio_0p001 -1.2 1.2 FORMAT "%10.5"
 /begin ANNOTATION ANNOTATION_LABEL "Description (coming from AUTOSAR DESC field)"
  /begin ANNOTATION_TEXT "Gear actuator velocity targets for engaging negative gear in low aggression post-synchro phase.\r\n" /end ANNOTATION_TEXT
 /end ANNOTATION
 /begin AXIS_DESCR STD_AXIS NO_INPUT_QUANTITY RB_PT_PCT_SWC_GAC_CompuMethods_ident 4 -100. 100. FORMAT "%10.5" DEPOSIT ABSOLUTE /end AXIS_DESCR
/end CHARACTERISTIC
/begin CHARACTERISTIC GAC_CALIB.GAC_GracB.GAC_VELSGRACGRNEGSTATICTGT "" CURVE 0x80612160 RB_PT_PCT_SWC_GAC_RecordLayouts_RL_Curve_sint16_8_sint16_8 2.4 RB_PT_PCT_SWC_GAC_CompuMethods_ratio_0p001 -1.2 1.2 FORMAT "%10.5"
 /begin ANNOTATION ANNOTATION_LABEL "Description (coming from AUTOSAR DESC field)"
  /begin ANNOTATION_TEXT "Gear actuator velocity targets for engaging negative gear in low aggression pre-synchro phase.\r\n" /end ANNOTATION_TEXT
 /end ANNOTATION
 /begin AXIS_DESCR STD_AXIS NO_INPUT_QUANTITY RB_PT_PCT_SWC_GAC_CompuMethods_ident 8 -100. 100. FORMAT "%10.5" DEPOSIT ABSOLUTE /end AXIS_DESCR
/end CHARACTERISTIC
/begin CHARACTERISTIC GAC_CALIB.GAC_GracB.GAC_VELSGRACGRNEGVLOWSYNCTGT "" CURVE 0x80612182 RB_PT_PCT_SWC_GAC_RecordLayouts_RL_Curve_sint16_4_sint16_4 2.4 RB_PT_PCT_SWC_GAC_CompuMethods_ratio_0p001 -1.2 1.2 FORMAT "%10.5"
 /begin ANNOTATION ANNOTATION_LABEL "Description (coming from AUTOSAR DESC field)"
  /begin ANNOTATION_TEXT "Gear actuator velocity targets for engaging negative gear in low aggression post-synchro phase.\r\n" /end ANNOTATION_TEXT
 /end ANNOTATION
 /begin AXIS_DESCR STD_AXIS NO_INPUT_QUANTITY RB_PT_PCT_SWC_GAC_CompuMethods_ident 4 -100. 100. FORMAT "%10.5" DEPOSIT ABSOLUTE /end AXIS_DESCR
/end CHARACTERISTIC
/begin CHARACTERISTIC GAC_CALIB.GAC_GracB.GAC_VELSGRACGRNEGVLOWTGT "" CURVE 0x80612194 RB_PT_PCT_SWC_GAC_RecordLayouts_RL_Curve_sint16_8_sint16_8 2.4 RB_PT_PCT_SWC_GAC_CompuMethods_ratio_0p001 -1.2 1.2 FORMAT "%10.5"
 /begin ANNOTATION ANNOTATION_LABEL "Description (coming from AUTOSAR DESC field)"
  /begin ANNOTATION_TEXT "Gear actuator velocity targets for engaging negative gear in low aggression pre-synchro phase.\r\n" /end ANNOTATION_TEXT
 /end ANNOTATION
 /begin AXIS_DESCR STD_AXIS NO_INPUT_QUANTITY RB_PT_PCT_SWC_GAC_CompuMethods_ident 8 -100. 100. FORMAT "%10.5" DEPOSIT ABSOLUTE /end AXIS_DESCR
/end CHARACTERISTIC
/begin CHARACTERISTIC GAC_CALIB.GAC_GracB.GAC_VELSGRACGRPOSEVSYNCTGT "" CURVE 0x806121B6 RB_PT_PCT_SWC_GAC_RecordLayouts_RL_Curve_sint16_4_sint16_4 2.4 RB_PT_PCT_SWC_GAC_CompuMethods_ratio_0p001 -1.2 1.2 FORMAT "%10.5"
 /begin ANNOTATION ANNOTATION_LABEL "Description (coming from AUTOSAR DESC field)"
  /begin ANNOTATION_TEXT "Gear actuator velocity targets for engaging positive gear in low aggression post-synchro phase.\r\n" /end ANNOTATION_TEXT
 /end ANNOTATION
 /begin AXIS_DESCR STD_AXIS NO_INPUT_QUANTITY RB_PT_PCT_SWC_GAC_CompuMethods_ident 4 -100. 100. FORMAT "%10.5" DEPOSIT ABSOLUTE /end AXIS_DESCR
/end CHARACTERISTIC
/begin CHARACTERISTIC GAC_CALIB.GAC_GracB.GAC_VELSGRACGRPOSEVTGT "" CURVE 0x806121C8 RB_PT_PCT_SWC_GAC_RecordLayouts_RL_Curve_sint16_8_sint16_8 2.4 RB_PT_PCT_SWC_GAC_CompuMethods_ratio_0p001 -1.2 1.2 FORMAT "%10.5"
 /begin ANNOTATION ANNOTATION_LABEL "Description (coming from AUTOSAR DESC field)"
  /begin ANNOTATION_TEXT "Gear actuator velocity targets for engaging positive gear in low aggression pre-synchro phase.\r\n" /end ANNOTATION_TEXT
 /end ANNOTATION
 /begin AXIS_DESCR STD_AXIS NO_INPUT_QUANTITY RB_PT_PCT_SWC_GAC_CompuMethods_ident 8 -100. 100. FORMAT "%10.5" DEPOSIT ABSOLUTE /end AXIS_DESCR
/end CHARACTERISTIC
/begin CHARACTERISTIC GAC_CALIB.GAC_GracB.GAC_VELSGRACGRPOSHISYNCTGT "" CURVE 0x806121EA RB_PT_PCT_SWC_GAC_RecordLayouts_RL_Curve_sint16_4_sint16_4 2.4 RB_PT_PCT_SWC_GAC_CompuMethods_ratio_0p001 -1.2 1.2 FORMAT "%10.5"
 /begin ANNOTATION ANNOTATION_LABEL "Description (coming from AUTOSAR DESC field)"
  /begin ANNOTATION_TEXT "Gear actuator velocity targets for engaging positive gear in high aggression post-synchro phase.\r\n" /end ANNOTATION_TEXT
 /end ANNOTATION
 /begin AXIS_DESCR STD_AXIS NO_INPUT_QUANTITY RB_PT_PCT_SWC_GAC_CompuMethods_ident 4 -100. 100. FORMAT "%10.5" DEPOSIT ABSOLUTE /end AXIS_DESCR
/end CHARACTERISTIC
/begin CHARACTERISTIC GAC_CALIB.GAC_GracB.GAC_VELSGRACGRPOSHITGT "" CURVE 0x806121FC RB_PT_PCT_SWC_GAC_RecordLayouts_RL_Curve_sint16_8_sint16_8 2.4 RB_PT_PCT_SWC_GAC_CompuMethods_ratio_0p001 -1.2 1.2 FORMAT "%10.5"
 /begin ANNOTATION ANNOTATION_LABEL "Description (coming from AUTOSAR DESC field)"
  /begin ANNOTATION_TEXT "Gear actuator velocity targets for engaging positive gear in high aggression pre-synchro phase.\r\n" /end ANNOTATION_TEXT
 /end ANNOTATION
 /begin AXIS_DESCR STD_AXIS NO_INPUT_QUANTITY RB_PT_PCT_SWC_GAC_CompuMethods_ident 8 -100. 100. FORMAT "%10.5" DEPOSIT ABSOLUTE /end AXIS_DESCR
/end CHARACTERISTIC
/begin CHARACTERISTIC GAC_CALIB.GAC_GracB.GAC_VELSGRACGRPOSLOWSYNCTGT "" CURVE 0x8061221E RB_PT_PCT_SWC_GAC_RecordLayouts_RL_Curve_sint16_4_sint16_4 2.4 RB_PT_PCT_SWC_GAC_CompuMethods_ratio_0p001 -1.2 1.2 FORMAT "%10.5"
 /begin ANNOTATION ANNOTATION_LABEL "Description (coming from AUTOSAR DESC field)"
  /begin ANNOTATION_TEXT "Gear actuator velocity targets for engaging positive gear in low aggression post-synchro phase.\r\n" /end ANNOTATION_TEXT
 /end ANNOTATION
 /begin AXIS_DESCR STD_AXIS NO_INPUT_QUANTITY RB_PT_PCT_SWC_GAC_CompuMethods_ident 4 -100. 100. FORMAT "%10.5" DEPOSIT ABSOLUTE /end AXIS_DESCR
/end CHARACTERISTIC
/begin CHARACTERISTIC GAC_CALIB.GAC_GracB.GAC_VELSGRACGRPOSLOWTGT "" CURVE 0x80612230 RB_PT_PCT_SWC_GAC_RecordLayouts_RL_Curve_sint16_8_sint16_8 2.4 RB_PT_PCT_SWC_GAC_CompuMethods_ratio_0p001 -1.2 1.2 FORMAT "%10.5"
 /begin ANNOTATION ANNOTATION_LABEL "Description (coming from AUTOSAR DESC field)"
  /begin ANNOTATION_TEXT "Gear actuator velocity targets for engaging positive gear in low aggression pre-synchro phase.\r\n" /end ANNOTATION_TEXT
 /end ANNOTATION
 /begin AXIS_DESCR STD_AXIS NO_INPUT_QUANTITY RB_PT_PCT_SWC_GAC_CompuMethods_ident 8 -100. 100. FORMAT "%10.5" DEPOSIT ABSOLUTE /end AXIS_DESCR
/end CHARACTERISTIC
/begin CHARACTERISTIC GAC_CALIB.GAC_GracB.GAC_VELSGRACGRPOSMEDSYNCTGT "" CURVE 0x80612252 RB_PT_PCT_SWC_GAC_RecordLayouts_RL_Curve_sint16_4_sint16_4 2.4 RB_PT_PCT_SWC_GAC_CompuMethods_ratio_0p001 -1.2 1.2 FORMAT "%10.5"
 /begin ANNOTATION ANNOTATION_LABEL "Description (coming from AUTOSAR DESC field)"
  /begin ANNOTATION_TEXT "Gear actuator velocity targets for engaging positive gear in medium aggression post-synchro phase.\r\n" /end ANNOTATION_TEXT
 /end ANNOTATION
 /begin AXIS_DESCR STD_AXIS NO_INPUT_QUANTITY RB_PT_PCT_SWC_GAC_CompuMethods_ident 4 -100. 100. FORMAT "%10.5" DEPOSIT ABSOLUTE /end AXIS_DESCR
/end CHARACTERISTIC
/begin CHARACTERISTIC GAC_CALIB.GAC_GracB.GAC_VELSGRACGRPOSMEDTGT "" CURVE 0x80612264 RB_PT_PCT_SWC_GAC_RecordLayouts_RL_Curve_sint16_8_sint16_8 2.4 RB_PT_PCT_SWC_GAC_CompuMethods_ratio_0p001 -1.2 1.2 FORMAT "%10.5"
 /begin ANNOTATION ANNOTATION_LABEL "Description (coming from AUTOSAR DESC field)"
  /begin ANNOTATION_TEXT "Gear actuator velocity targets for engaging positive gear in medium aggression pre-synchro phase.\r\n" /end ANNOTATION_TEXT
 /end ANNOTATION
 /begin AXIS_DESCR STD_AXIS NO_INPUT_QUANTITY RB_PT_PCT_SWC_GAC_CompuMethods_ident 8 -100. 100. FORMAT "%10.5" DEPOSIT ABSOLUTE /end AXIS_DESCR
/end CHARACTERISTIC
/begin CHARACTERISTIC GAC_CALIB.GAC_GracB.GAC_VELSGRACGRPOSSTATICSYNCTGT "" CURVE 0x80612286 RB_PT_PCT_SWC_GAC_RecordLayouts_RL_Curve_sint16_4_sint16_4 2.4 RB_PT_PCT_SWC_GAC_CompuMethods_ratio_0p001 -1.2 1.2 FORMAT "%10.5"
 /begin ANNOTATION ANNOTATION_LABEL "Description (coming from AUTOSAR DESC field)"
  /begin ANNOTATION_TEXT "Gear actuator velocity targets for engaging positive gear in low aggression post-synchro phase.\r\n" /end ANNOTATION_TEXT
 /end ANNOTATION
 /begin AXIS_DESCR STD_AXIS NO_INPUT_QUANTITY RB_PT_PCT_SWC_GAC_CompuMethods_ident 4 -100. 100. FORMAT "%10.5" DEPOSIT ABSOLUTE /end AXIS_DESCR
/end CHARACTERISTIC
/begin CHARACTERISTIC GAC_CALIB.GAC_GracB.GAC_VELSGRACGRPOSSTATICTGT "" CURVE 0x80612298 RB_PT_PCT_SWC_GAC_RecordLayouts_RL_Curve_sint16_8_sint16_8 2.4 RB_PT_PCT_SWC_GAC_CompuMethods_ratio_0p001 -1.2 1.2 FORMAT "%10.5"
 /begin ANNOTATION ANNOTATION_LABEL "Description (coming from AUTOSAR DESC field)"
  /begin ANNOTATION_TEXT "Gear actuator velocity targets for engaging positive gear in low aggression pre-synchro phase.\r\n" /end ANNOTATION_TEXT
 /end ANNOTATION
 /begin AXIS_DESCR STD_AXIS NO_INPUT_QUANTITY RB_PT_PCT_SWC_GAC_CompuMethods_ident 8 -100. 100. FORMAT "%10.5" DEPOSIT ABSOLUTE /end AXIS_DESCR
/end CHARACTERISTIC
/begin CHARACTERISTIC GAC_CALIB.GAC_GracB.GAC_VELSGRACGRPOSVLOWSYNCTGT "" CURVE 0x806122BA RB_PT_PCT_SWC_GAC_RecordLayouts_RL_Curve_sint16_4_sint16_4 2.4 RB_PT_PCT_SWC_GAC_CompuMethods_ratio_0p001 -1.2 1.2 FORMAT "%10.5"
 /begin ANNOTATION ANNOTATION_LABEL "Description (coming from AUTOSAR DESC field)"
  /begin ANNOTATION_TEXT "Gear actuator velocity targets for engaging positive gear in low aggression post-synchro phase.\r\n" /end ANNOTATION_TEXT
 /end ANNOTATION
 /begin AXIS_DESCR STD_AXIS NO_INPUT_QUANTITY RB_PT_PCT_SWC_GAC_CompuMethods_ident 4 -100. 100. FORMAT "%10.5" DEPOSIT ABSOLUTE /end AXIS_DESCR
/end CHARACTERISTIC
/begin CHARACTERISTIC GAC_CALIB.GAC_GracB.GAC_VELSGRACGRPOSVLOWTGT "" CURVE 0x806122CC RB_PT_PCT_SWC_GAC_RecordLayouts_RL_Curve_sint16_8_sint16_8 2.4 RB_PT_PCT_SWC_GAC_CompuMethods_ratio_0p001 -1.2 1.2 FORMAT "%10.5"
 /begin ANNOTATION ANNOTATION_LABEL "Description (coming from AUTOSAR DESC field)"
  /begin ANNOTATION_TEXT "Gear actuator velocity targets for engaging positive gear in low aggression pre-synchro phase.\r\n" /end ANNOTATION_TEXT
 /end ANNOTATION
 /begin AXIS_DESCR STD_AXIS NO_INPUT_QUANTITY RB_PT_PCT_SWC_GAC_CompuMethods_ident 8 -100. 100. FORMAT "%10.5" DEPOSIT ABSOLUTE /end AXIS_DESCR
/end CHARACTERISTIC
/begin CHARACTERISTIC GAC_CALIB.GAC_GracB.GAC_VELSGRACNSTARTGRNEGHI "" CURVE 0x806122EE RB_PT_PCT_SWC_GAC_RecordLayouts_RL_Curve_sint16_3_sint16_3 2.4 RB_PT_PCT_SWC_GAC_CompuMethods_ratio_0p001 -1.2 1.2 FORMAT "%10.5"
 /begin ANNOTATION ANNOTATION_LABEL "Description (coming from AUTOSAR DESC field)"
  /begin ANNOTATION_TEXT "Velocity targets for start of Neutral actuation based on temperature, from negative engagement side with high aggression actuation.\r\n" /end ANNOTATION_TEXT
 /end ANNOTATION
 /begin AXIS_DESCR STD_AXIS NO_INPUT_QUANTITY RB_PT_PCT_SWC_GAC_CompuMethods_ident 3 -50. 200. FORMAT "%10.5" DEPOSIT ABSOLUTE /end AXIS_DESCR
/end CHARACTERISTIC
/begin CHARACTERISTIC GAC_CALIB.GAC_GracB.GAC_VELSGRACNSTARTGRNEGLOW "" CURVE 0x806122FC RB_PT_PCT_SWC_GAC_RecordLayouts_RL_Curve_sint16_3_sint16_3 2.4 RB_PT_PCT_SWC_GAC_CompuMethods_ratio_0p001 -1.2 1.2 FORMAT "%10.5"
 /begin ANNOTATION ANNOTATION_LABEL "Description (coming from AUTOSAR DESC field)"
  /begin ANNOTATION_TEXT "Velocity targets for start of Neutral actuation based on temperature, from negative engagement side with low aggression actuation.\r\n" /end ANNOTATION_TEXT
 /end ANNOTATION
 /begin AXIS_DESCR STD_AXIS NO_INPUT_QUANTITY RB_PT_PCT_SWC_GAC_CompuMethods_ident 3 -50. 200. FORMAT "%10.5" DEPOSIT ABSOLUTE /end AXIS_DESCR
/end CHARACTERISTIC
/begin CHARACTERISTIC GAC_CALIB.GAC_GracB.GAC_VELSGRACNSTARTGRNEGMAX "" CURVE 0x8061230A RB_PT_PCT_SWC_GAC_RecordLayouts_RL_Curve_sint16_3_sint16_3 2.4 RB_PT_PCT_SWC_GAC_CompuMethods_ratio_0p001 -1.2 1.2 FORMAT "%10.5"
 /begin ANNOTATION ANNOTATION_LABEL "Description (coming from AUTOSAR DESC field)"
  /begin ANNOTATION_TEXT "Velocity targets for start of Neutral actuation based on temperature, from negative engagement side with max aggression actuation.\r\n" /end ANNOTATION_TEXT
 /end ANNOTATION
 /begin AXIS_DESCR STD_AXIS NO_INPUT_QUANTITY RB_PT_PCT_SWC_GAC_CompuMethods_ident 3 -50. 200. FORMAT "%10.5" DEPOSIT ABSOLUTE /end AXIS_DESCR
/end CHARACTERISTIC
/begin CHARACTERISTIC GAC_CALIB.GAC_GracB.GAC_VELSGRACNSTARTGRNEGMED "" CURVE 0x80612318 RB_PT_PCT_SWC_GAC_RecordLayouts_RL_Curve_sint16_3_sint16_3 2.4 RB_PT_PCT_SWC_GAC_CompuMethods_ratio_0p001 -1.2 1.2 FORMAT "%10.5"
 /begin ANNOTATION ANNOTATION_LABEL "Description (coming from AUTOSAR DESC field)"
  /begin ANNOTATION_TEXT "Velocity targets for start of Neutral actuation based on temperature, from negative engagement side with med aggression actuation.\r\n" /end ANNOTATION_TEXT
 /end ANNOTATION
 /begin AXIS_DESCR STD_AXIS NO_INPUT_QUANTITY RB_PT_PCT_SWC_GAC_CompuMethods_ident 3 -50. 200. FORMAT "%10.5" DEPOSIT ABSOLUTE /end AXIS_DESCR
/end CHARACTERISTIC
/begin CHARACTERISTIC GAC_CALIB.GAC_GracB.GAC_VELSGRACNSTARTGRPOSHI "" CURVE 0x80612326 RB_PT_PCT_SWC_GAC_RecordLayouts_RL_Curve_sint16_3_sint16_3 2.4 RB_PT_PCT_SWC_GAC_CompuMethods_ratio_0p001 -1.2 1.2 FORMAT "%10.5"
 /begin ANNOTATION ANNOTATION_LABEL "Description (coming from AUTOSAR DESC field)"
  /begin ANNOTATION_TEXT "Velocity targets for start of Neutral actuation based on temperature, from positive engagement side with high aggression actuation.\r\n" /end ANNOTATION_TEXT
 /end ANNOTATION
 /begin AXIS_DESCR STD_AXIS NO_INPUT_QUANTITY RB_PT_PCT_SWC_GAC_CompuMethods_ident 3 -50. 200. FORMAT "%10.5" DEPOSIT ABSOLUTE /end AXIS_DESCR
/end CHARACTERISTIC
/begin CHARACTERISTIC GAC_CALIB.GAC_GracB.GAC_VELSGRACNSTARTGRPOSLOW "" CURVE 0x80612334 RB_PT_PCT_SWC_GAC_RecordLayouts_RL_Curve_sint16_3_sint16_3 2.4 RB_PT_PCT_SWC_GAC_CompuMethods_ratio_0p001 -1.2 1.2 FORMAT "%10.5"
 /begin ANNOTATION ANNOTATION_LABEL "Description (coming from AUTOSAR DESC field)"
  /begin ANNOTATION_TEXT "Velocity targets for start of Neutral actuation based on temperature, from positive engagement side with low aggression actuation.\r\n" /end ANNOTATION_TEXT
 /end ANNOTATION
 /begin AXIS_DESCR STD_AXIS NO_INPUT_QUANTITY RB_PT_PCT_SWC_GAC_CompuMethods_ident 3 -50. 200. FORMAT "%10.5" DEPOSIT ABSOLUTE /end AXIS_DESCR
/end CHARACTERISTIC
/begin CHARACTERISTIC GAC_CALIB.GAC_GracB.GAC_VELSGRACNSTARTGRPOSMAX "" CURVE 0x80612342 RB_PT_PCT_SWC_GAC_RecordLayouts_RL_Curve_sint16_3_sint16_3 2.4 RB_PT_PCT_SWC_GAC_CompuMethods_ratio_0p001 -1.2 1.2 FORMAT "%10.5"
 /begin ANNOTATION ANNOTATION_LABEL "Description (coming from AUTOSAR DESC field)"
  /begin ANNOTATION_TEXT "Velocity targets for start of Neutral actuation based on temperature, from positive engagement side with max aggression actuation.\r\n" /end ANNOTATION_TEXT
 /end ANNOTATION
 /begin AXIS_DESCR STD_AXIS NO_INPUT_QUANTITY RB_PT_PCT_SWC_GAC_CompuMethods_ident 3 -50. 200. FORMAT "%10.5" DEPOSIT ABSOLUTE /end AXIS_DESCR
/end CHARACTERISTIC
/begin CHARACTERISTIC GAC_CALIB.GAC_GracB.GAC_VELSGRACNSTARTGRPOSMED "" CURVE 0x80612350 RB_PT_PCT_SWC_GAC_RecordLayouts_RL_Curve_sint16_3_sint16_3 2.4 RB_PT_PCT_SWC_GAC_CompuMethods_ratio_0p001 -1.2 1.2 FORMAT "%10.5"
 /begin ANNOTATION ANNOTATION_LABEL "Description (coming from AUTOSAR DESC field)"
  /begin ANNOTATION_TEXT "Velocity targets for start of Neutral actuation based on temperature, from positive engagement side with medium aggression actuation.\r\n" /end ANNOTATION_TEXT
 /end ANNOTATION
 /begin AXIS_DESCR STD_AXIS NO_INPUT_QUANTITY RB_PT_PCT_SWC_GAC_CompuMethods_ident 3 -50. 200. FORMAT "%10.5" DEPOSIT ABSOLUTE /end AXIS_DESCR
/end CHARACTERISTIC
/begin CHARACTERISTIC GAC_CALIB.GAC_GracB.GAC_VELSGRACNSTOP "" CURVE 0x8061235E RB_PT_PCT_SWC_GAC_RecordLayouts_RL_Curve_sint16_11_sint16_11 2.4 RB_PT_PCT_SWC_GAC_CompuMethods_ratio_0p001 -1.2 1.2 FORMAT "%10.5"
 /begin ANNOTATION ANNOTATION_LABEL "Description (coming from AUTOSAR DESC field)"
  /begin ANNOTATION_TEXT "Gear actuator velocity targets for NStop phase without temperature interpolation.\r\n" /end ANNOTATION_TEXT
 /end ANNOTATION
 /begin AXIS_DESCR STD_AXIS NO_INPUT_QUANTITY RB_PT_PCT_SWC_GAC_CompuMethods_ratio_0p001 11 -20. 20. FORMAT "%10.5" DEPOSIT ABSOLUTE /end AXIS_DESCR
/end CHARACTERISTIC
/begin CHARACTERISTIC GAC_CALIB.GAC_GracB.GAC_VELSGRACNSTOPINTRP "" MAP 0x8061238C RB_PT_PCT_SWC_GAC_RecordLayouts_RL_Map_sint16_33_sint16_11_sint16_3 2.4 RB_PT_PCT_SWC_GAC_CompuMethods_ratio_0p001 -1.2 1.2 FORMAT "%10.5"
 /begin ANNOTATION ANNOTATION_LABEL "Description (coming from AUTOSAR DESC field)"
  /begin ANNOTATION_TEXT "Gear actuator velocity targets for NStop phase with temperature interpolation.\r\n" /end ANNOTATION_TEXT
 /end ANNOTATION
 /begin AXIS_DESCR STD_AXIS NO_INPUT_QUANTITY RB_PT_PCT_SWC_GAC_CompuMethods_ratio_0p001 11 -20. 20. FORMAT "%10.5" DEPOSIT ABSOLUTE /end AXIS_DESCR
 /begin AXIS_DESCR STD_AXIS NO_INPUT_QUANTITY RB_PT_PCT_SWC_GAC_CompuMethods_ident 3 -50. 200. FORMAT "%10.5" DEPOSIT ABSOLUTE /end AXIS_DESCR
/end CHARACTERISTIC
/begin CHARACTERISTIC GAC_CALIB.GAC_GracB.GAC_VELSRISEGBLK2 "" VAL_BLK 0x8061194C DefaultValueRecordLayout_AUTOSAR_Platform_BaseTypes_uint16 1.2 RB_PT_PCT_SWC_GAC_CompuMethods_ratio_0p001 0.0 1.2 FORMAT "%10.5"
 /begin ANNOTATION ANNOTATION_LABEL "Description (coming from AUTOSAR DESC field)"
  /begin ANNOTATION_TEXT "Rise velocities for gear block 2 detection, for each actuation aggression\r\n" /end ANNOTATION_TEXT
 /end ANNOTATION
 MATRIX_DIM 4 1 1 /end CHARACTERISTIC
/begin CHARACTERISTIC GAC_CALIB.GAC_GracC.GAC_AREAPISTDEFAULT "" VALUE 0x80612424 DefaultValueRecordLayout_AUTOSAR_Platform_BaseTypes_uint16 0.01 RB_PT_PCT_SWC_GAC_CompuMethods_ratio_0p000001 0.0 0.01 FORMAT "%10.5"
 /begin ANNOTATION ANNOTATION_LABEL "Description (coming from AUTOSAR DESC field)" /begin ANNOTATION_TEXT "Default area of piston in calculations\r\n" /end ANNOTATION_TEXT /end ANNOTATION
/end CHARACTERISTIC
/begin CHARACTERISTIC GAC_CALIB.GAC_GracC.GAC_BlkrRlsCtrl.GAC_POSNGRACBLKRRLSEND "" VALUE 0x806124E4 DefaultValueRecordLayout_AUTOSAR_Platform_BaseTypes_uint16 20.0 RB_PT_PCT_SWC_GAC_CompuMethods_ratio_0p001 0.0 20. FORMAT "%10.5"
 /begin ANNOTATION ANNOTATION_LABEL "Description (coming from AUTOSAR DESC field)"
  /begin ANNOTATION_TEXT "Gear actuator position used for detecting blocker release end.\r\n" /end ANNOTATION_TEXT
 /end ANNOTATION
/end CHARACTERISTIC
/begin CHARACTERISTIC GAC_CALIB.GAC_GracC.GAC_BlkrRlsCtrl.GAC_PRESSBLKRRLSGRNEG "" VAL_BLK 0x806124D0 DefaultValueRecordLayout_AUTOSAR_Platform_BaseTypes_uint16 32.0 RB_PT_PCT_SWC_GAC_CompuMethods_ratio_0p001 0.0 32. FORMAT "%10.5"
 /begin ANNOTATION ANNOTATION_LABEL "Description (coming from AUTOSAR DESC field)"
  /begin ANNOTATION_TEXT "Pressures for blocker release for engaging negative gear.\r\n" /end ANNOTATION_TEXT
 /end ANNOTATION
 MATRIX_DIM 4 1 1 /end CHARACTERISTIC
/begin CHARACTERISTIC GAC_CALIB.GAC_GracC.GAC_BlkrRlsCtrl.GAC_PRESSBLKRRLSGRPOS "" VAL_BLK 0x806124D8 DefaultValueRecordLayout_AUTOSAR_Platform_BaseTypes_uint16 32.0 RB_PT_PCT_SWC_GAC_CompuMethods_ratio_0p001 0.0 32. FORMAT "%10.5"
 /begin ANNOTATION ANNOTATION_LABEL "Description (coming from AUTOSAR DESC field)"
  /begin ANNOTATION_TEXT "Pressures for blocker release for engaging positive gear.\r\n" /end ANNOTATION_TEXT
 /end ANNOTATION
 MATRIX_DIM 4 1 1 /end CHARACTERISTIC
/begin CHARACTERISTIC GAC_CALIB.GAC_GracC.GAC_BlkrRlsCtrl.GAC_PRESSMINBLKRRLS "" VAL_BLK 0x806124E0 DefaultValueRecordLayout_AUTOSAR_Platform_BaseTypes_uint16 32.0 RB_PT_PCT_SWC_GAC_CompuMethods_ratio_0p001 0.0 32. FORMAT "%10.5"
 /begin ANNOTATION ANNOTATION_LABEL "Description (coming from AUTOSAR DESC field)"
  /begin ANNOTATION_TEXT "Minimum pressure steps for blocker release engaging negative/positive gears.\r\n" /end ANNOTATION_TEXT
 /end ANNOTATION
 MATRIX_DIM 2 1 1 /end CHARACTERISTIC
/begin CHARACTERISTIC GAC_CALIB.GAC_GracC.GAC_BlkrRlsCtrl.GAC_PRESSSTEPBLKRLSSTATIC "" VALUE 0x806124E6 DefaultValueRecordLayout_AUTOSAR_Platform_BaseTypes_uint16 32.0 RB_PT_PCT_SWC_GAC_CompuMethods_ratio_0p001 0.0 32. FORMAT "%10.5"
 /begin ANNOTATION ANNOTATION_LABEL "Description (coming from AUTOSAR DESC field)"
  /begin ANNOTATION_TEXT "Minimum pressure step for blocker release for static shift.\r\n" /end ANNOTATION_TEXT
 /end ANNOTATION
/end CHARACTERISTIC
/begin CHARACTERISTIC GAC_CALIB.GAC_GracC.GAC_BOBFLGBYPASSSYNCVALID "" VALUE 0x806124B2 DefaultValueRecordLayout_AUTOSAR_Platform_BaseTypes_uint8 255.0 DefaultIdenticalCompu 0.0 255. FORMAT "%10.5"
 /begin ANNOTATION ANNOTATION_LABEL "Description (coming from AUTOSAR DESC field)" /begin ANNOTATION_TEXT "Bob flag to bypass valid sync check\r\n" /end ANNOTATION_TEXT /end ANNOTATION
/end CHARACTERISTIC
/begin CHARACTERISTIC GAC_CALIB.GAC_GracC.GAC_BRAKEPRESSVLOWAGGLIM "" VALUE 0x80612426 DefaultValueRecordLayout_AUTOSAR_Platform_BaseTypes_uint16 409.5 RB_PT_PCT_SWC_GAC_CompuMethods_ratio_0p1 0.0 409.5 FORMAT "%10.5"
 /begin ANNOTATION ANNOTATION_LABEL "Description (coming from AUTOSAR DESC field)"
  /begin ANNOTATION_TEXT "The brake pressure limit for the very low aggression to be commanded\r\n" /end ANNOTATION_TEXT
 /end ANNOTATION
/end CHARACTERISTIC
/begin CHARACTERISTIC GAC_CALIB.GAC_GracC.GAC_DIAPISTACTUATORLEFT "" VALUE 0x80612428 DefaultValueRecordLayout_AUTOSAR_Platform_BaseTypes_uint16 65.535 RB_PT_PCT_SWC_GAC_CompuMethods_ratio_0p001 0.0 65.535 FORMAT "%10.5"
 /begin ANNOTATION ANNOTATION_LABEL "Description (coming from AUTOSAR DESC field)" /begin ANNOTATION_TEXT "Diameter of the actuator piston - left\r\n" /end ANNOTATION_TEXT /end ANNOTATION
/end CHARACTERISTIC
/begin CHARACTERISTIC GAC_CALIB.GAC_GracC.GAC_DIAPISTACTUATORRIGHT "" VALUE 0x8061242A DefaultValueRecordLayout_AUTOSAR_Platform_BaseTypes_uint16 65.535 RB_PT_PCT_SWC_GAC_CompuMethods_ratio_0p001 0.0 65.535 FORMAT "%10.5"
 /begin ANNOTATION ANNOTATION_LABEL "Description (coming from AUTOSAR DESC field)" /begin ANNOTATION_TEXT "Diameter of the actuator piston - right\r\n" /end ANNOTATION_TEXT /end ANNOTATION
/end CHARACTERISTIC
/begin CHARACTERISTIC GAC_CALIB.GAC_GracC.GAC_DtntCtrl.GAC_FLGSAGGDTNTCTRLOK "" VAL_BLK 0x806124F0 DefaultValueRecordLayout_AUTOSAR_Platform_BaseTypes_boolean 255.0 AUTOSAR_Platform_CompuMethods_boolean 0.0 255. FORMAT "%10.5"
 /begin ANNOTATION ANNOTATION_LABEL "Description (coming from AUTOSAR DESC field)"
  /begin ANNOTATION_TEXT "Array of flags enabling detent control for each actuation aggression.\r\n" /end ANNOTATION_TEXT
 /end ANNOTATION
 MATRIX_DIM 4 1 1 /end CHARACTERISTIC
/begin CHARACTERISTIC GAC_CALIB.GAC_GracC.GAC_DtntCtrl.GAC_PRESSDTNTCTRLEOLGRNEG "" VALUE 0x806124F4 DefaultValueRecordLayout_AUTOSAR_Platform_BaseTypes_sint16 64.0 RB_PT_PCT_SWC_GAC_CompuMethods_ratio_0p001 -32. 32. FORMAT "%10.5"
 /begin ANNOTATION ANNOTATION_LABEL "Description (coming from AUTOSAR DESC field)"
  /begin ANNOTATION_TEXT "Pressure for detent control engaging negative gear, during EOL Neutral learn.\r\n" /end ANNOTATION_TEXT
 /end ANNOTATION
/end CHARACTERISTIC
/begin CHARACTERISTIC GAC_CALIB.GAC_GracC.GAC_DtntCtrl.GAC_PRESSDTNTCTRLEOLGRPOS "" VALUE 0x806124F6 DefaultValueRecordLayout_AUTOSAR_Platform_BaseTypes_sint16 64.0 RB_PT_PCT_SWC_GAC_CompuMethods_ratio_0p001 -32. 32. FORMAT "%10.5"
 /begin ANNOTATION ANNOTATION_LABEL "Description (coming from AUTOSAR DESC field)"
  /begin ANNOTATION_TEXT "Pressure for detent control engaging positive gear, during EOL Neutral learn.\r\n" /end ANNOTATION_TEXT
 /end ANNOTATION
/end CHARACTERISTIC
/begin CHARACTERISTIC GAC_CALIB.GAC_GracC.GAC_DtntCtrl.GAC_PRESSDTNTCTRLEVGRNEG "" MAP 0x806124F8 RB_PT_PCT_SWC_GAC_RecordLayouts_RL_Map_sint16_12_uint16_3_sint16_4 64.0 RB_PT_PCT_SWC_GAC_CompuMethods_ratio_0p001 -32. 32. FORMAT "%10.5"
 /begin ANNOTATION ANNOTATION_LABEL "Description (coming from AUTOSAR DESC field)"
  /begin ANNOTATION_TEXT "Detent pressure offset for negative gear engagements - static aggression\r\n" /end ANNOTATION_TEXT
 /end ANNOTATION
 /begin AXIS_DESCR STD_AXIS NO_INPUT_QUANTITY RB_PT_PCT_SWC_GAC_CompuMethods_ratio_0p001 3 0.0 40. FORMAT "%10.5" DEPOSIT ABSOLUTE /end AXIS_DESCR
 /begin AXIS_DESCR STD_AXIS NO_INPUT_QUANTITY RB_PT_PCT_SWC_GAC_CompuMethods_ident 4 -50. 200. FORMAT "%10.5" DEPOSIT ABSOLUTE /end AXIS_DESCR
/end CHARACTERISTIC
/begin CHARACTERISTIC GAC_CALIB.GAC_GracC.GAC_DtntCtrl.GAC_PRESSDTNTCTRLEVGRPOS "" MAP 0x80612522 RB_PT_PCT_SWC_GAC_RecordLayouts_RL_Map_sint16_12_uint16_3_sint16_4 64.0 RB_PT_PCT_SWC_GAC_CompuMethods_ratio_0p001 -32. 32. FORMAT "%10.5"
 /begin ANNOTATION ANNOTATION_LABEL "Description (coming from AUTOSAR DESC field)"
  /begin ANNOTATION_TEXT "Detent pressure offset for positive gear engagements - static aggression\r\n" /end ANNOTATION_TEXT
 /end ANNOTATION
 /begin AXIS_DESCR STD_AXIS NO_INPUT_QUANTITY RB_PT_PCT_SWC_GAC_CompuMethods_ratio_0p001 3 0.0 40. FORMAT "%10.5" DEPOSIT ABSOLUTE /end AXIS_DESCR
 /begin AXIS_DESCR STD_AXIS NO_INPUT_QUANTITY RB_PT_PCT_SWC_GAC_CompuMethods_ident 4 -50. 200. FORMAT "%10.5" DEPOSIT ABSOLUTE /end AXIS_DESCR
/end CHARACTERISTIC
/begin CHARACTERISTIC GAC_CALIB.GAC_GracC.GAC_DtntCtrl.GAC_PRESSDTNTCTRLHIGRNEG "" MAP 0x8061254C RB_PT_PCT_SWC_GAC_RecordLayouts_RL_Map_sint16_12_uint16_3_sint16_4 64.0 RB_PT_PCT_SWC_GAC_CompuMethods_ratio_0p001 -32. 32. FORMAT "%10.5"
 /begin ANNOTATION ANNOTATION_LABEL "Description (coming from AUTOSAR DESC field)"
  /begin ANNOTATION_TEXT "Detent pressure offset for negative gear engagements - high aggression\r\n" /end ANNOTATION_TEXT
 /end ANNOTATION
 /begin AXIS_DESCR STD_AXIS NO_INPUT_QUANTITY RB_PT_PCT_SWC_GAC_CompuMethods_ratio_0p001 3 0.0 40. FORMAT "%10.5" DEPOSIT ABSOLUTE /end AXIS_DESCR
 /begin AXIS_DESCR STD_AXIS NO_INPUT_QUANTITY RB_PT_PCT_SWC_GAC_CompuMethods_ident 4 -50. 200. FORMAT "%10.5" DEPOSIT ABSOLUTE /end AXIS_DESCR
/end CHARACTERISTIC
/begin CHARACTERISTIC GAC_CALIB.GAC_GracC.GAC_DtntCtrl.GAC_PRESSDTNTCTRLHIGRPOS "" MAP 0x80612576 RB_PT_PCT_SWC_GAC_RecordLayouts_RL_Map_sint16_12_uint16_3_sint16_4 64.0 RB_PT_PCT_SWC_GAC_CompuMethods_ratio_0p001 -32. 32. FORMAT "%10.5"
 /begin ANNOTATION ANNOTATION_LABEL "Description (coming from AUTOSAR DESC field)"
  /begin ANNOTATION_TEXT "Detent pressure offset for positive gear engagements - high aggression\r\n" /end ANNOTATION_TEXT
 /end ANNOTATION
 /begin AXIS_DESCR STD_AXIS NO_INPUT_QUANTITY RB_PT_PCT_SWC_GAC_CompuMethods_ratio_0p001 3 0.0 40. FORMAT "%10.5" DEPOSIT ABSOLUTE /end AXIS_DESCR
 /begin AXIS_DESCR STD_AXIS NO_INPUT_QUANTITY RB_PT_PCT_SWC_GAC_CompuMethods_ident 4 -50. 200. FORMAT "%10.5" DEPOSIT ABSOLUTE /end AXIS_DESCR
/end CHARACTERISTIC
/begin CHARACTERISTIC GAC_CALIB.GAC_GracC.GAC_DtntCtrl.GAC_PRESSDTNTCTRLLOWGRNEG "" MAP 0x806125A0 RB_PT_PCT_SWC_GAC_RecordLayouts_RL_Map_sint16_12_uint16_3_sint16_4 64.0 RB_PT_PCT_SWC_GAC_CompuMethods_ratio_0p001 -32. 32. FORMAT "%10.5"
 /begin ANNOTATION ANNOTATION_LABEL "Description (coming from AUTOSAR DESC field)"
  /begin ANNOTATION_TEXT "Detent pressure offset for negative gear engagements - low aggression\r\n" /end ANNOTATION_TEXT
 /end ANNOTATION
 /begin AXIS_DESCR STD_AXIS NO_INPUT_QUANTITY RB_PT_PCT_SWC_GAC_CompuMethods_ratio_0p001 3 0.0 40. FORMAT "%10.5" DEPOSIT ABSOLUTE /end AXIS_DESCR
 /begin AXIS_DESCR STD_AXIS NO_INPUT_QUANTITY RB_PT_PCT_SWC_GAC_CompuMethods_ident 4 -50. 200. FORMAT "%10.5" DEPOSIT ABSOLUTE /end AXIS_DESCR
/end CHARACTERISTIC
/begin CHARACTERISTIC GAC_CALIB.GAC_GracC.GAC_DtntCtrl.GAC_PRESSDTNTCTRLLOWGRPOS "" MAP 0x806125CA RB_PT_PCT_SWC_GAC_RecordLayouts_RL_Map_sint16_12_uint16_3_sint16_4 64.0 RB_PT_PCT_SWC_GAC_CompuMethods_ratio_0p001 -32. 32. FORMAT "%10.5"
 /begin ANNOTATION ANNOTATION_LABEL "Description (coming from AUTOSAR DESC field)"
  /begin ANNOTATION_TEXT "Detent pressure offset for positive gear engagements - low aggression\r\n" /end ANNOTATION_TEXT
 /end ANNOTATION
 /begin AXIS_DESCR STD_AXIS NO_INPUT_QUANTITY RB_PT_PCT_SWC_GAC_CompuMethods_ratio_0p001 3 0.0 40. FORMAT "%10.5" DEPOSIT ABSOLUTE /end AXIS_DESCR
 /begin AXIS_DESCR STD_AXIS NO_INPUT_QUANTITY RB_PT_PCT_SWC_GAC_CompuMethods_ident 4 -50. 200. FORMAT "%10.5" DEPOSIT ABSOLUTE /end AXIS_DESCR
/end CHARACTERISTIC
/begin CHARACTERISTIC GAC_CALIB.GAC_GracC.GAC_DtntCtrl.GAC_PRESSDTNTCTRLMEDGRNEG "" MAP 0x806125F4 RB_PT_PCT_SWC_GAC_RecordLayouts_RL_Map_sint16_12_uint16_3_sint16_4 64.0 RB_PT_PCT_SWC_GAC_CompuMethods_ratio_0p001 -32. 32. FORMAT "%10.5"
 /begin ANNOTATION ANNOTATION_LABEL "Description (coming from AUTOSAR DESC field)"
  /begin ANNOTATION_TEXT "Detent pressure offset for negative gear engagements - medium aggression\r\n" /end ANNOTATION_TEXT
 /end ANNOTATION
 /begin AXIS_DESCR STD_AXIS NO_INPUT_QUANTITY RB_PT_PCT_SWC_GAC_CompuMethods_ratio_0p001 3 0.0 40. FORMAT "%10.5" DEPOSIT ABSOLUTE /end AXIS_DESCR
 /begin AXIS_DESCR STD_AXIS NO_INPUT_QUANTITY RB_PT_PCT_SWC_GAC_CompuMethods_ident 4 -50. 200. FORMAT "%10.5" DEPOSIT ABSOLUTE /end AXIS_DESCR
/end CHARACTERISTIC
/begin CHARACTERISTIC GAC_CALIB.GAC_GracC.GAC_DtntCtrl.GAC_PRESSDTNTCTRLMEDGRPOS "" MAP 0x8061261E RB_PT_PCT_SWC_GAC_RecordLayouts_RL_Map_sint16_12_uint16_3_sint16_4 64.0 RB_PT_PCT_SWC_GAC_CompuMethods_ratio_0p001 -32. 32. FORMAT "%10.5"
 /begin ANNOTATION ANNOTATION_LABEL "Description (coming from AUTOSAR DESC field)"
  /begin ANNOTATION_TEXT "Detent pressure offset for positive gear engagements - medium aggression\r\n" /end ANNOTATION_TEXT
 /end ANNOTATION
 /begin AXIS_DESCR STD_AXIS NO_INPUT_QUANTITY RB_PT_PCT_SWC_GAC_CompuMethods_ratio_0p001 3 0.0 40. FORMAT "%10.5" DEPOSIT ABSOLUTE /end AXIS_DESCR
 /begin AXIS_DESCR STD_AXIS NO_INPUT_QUANTITY RB_PT_PCT_SWC_GAC_CompuMethods_ident 4 -50. 200. FORMAT "%10.5" DEPOSIT ABSOLUTE /end AXIS_DESCR
/end CHARACTERISTIC
/begin CHARACTERISTIC GAC_CALIB.GAC_GracC.GAC_DtntCtrl.GAC_PRESSDTNTCTRLSTATICGRNEG "" MAP 0x80612648 RB_PT_PCT_SWC_GAC_RecordLayouts_RL_Map_sint16_12_uint16_3_sint16_4 64.0 RB_PT_PCT_SWC_GAC_CompuMethods_ratio_0p001 -32. 32. FORMAT "%10.5"
 /begin ANNOTATION ANNOTATION_LABEL "Description (coming from AUTOSAR DESC field)"
  /begin ANNOTATION_TEXT "Detent pressure offset for negative gear engagements - static aggression\r\n" /end ANNOTATION_TEXT
 /end ANNOTATION
 /begin AXIS_DESCR STD_AXIS NO_INPUT_QUANTITY RB_PT_PCT_SWC_GAC_CompuMethods_ratio_0p001 3 0.0 40. FORMAT "%10.5" DEPOSIT ABSOLUTE /end AXIS_DESCR
 /begin AXIS_DESCR STD_AXIS NO_INPUT_QUANTITY RB_PT_PCT_SWC_GAC_CompuMethods_ident 4 -50. 200. FORMAT "%10.5" DEPOSIT ABSOLUTE /end AXIS_DESCR
/end CHARACTERISTIC
/begin CHARACTERISTIC GAC_CALIB.GAC_GracC.GAC_DtntCtrl.GAC_PRESSDTNTCTRLSTATICGRPOS "" MAP 0x80612672 RB_PT_PCT_SWC_GAC_RecordLayouts_RL_Map_sint16_12_uint16_3_sint16_4 64.0 RB_PT_PCT_SWC_GAC_CompuMethods_ratio_0p001 -32. 32. FORMAT "%10.5"
 /begin ANNOTATION ANNOTATION_LABEL "Description (coming from AUTOSAR DESC field)"
  /begin ANNOTATION_TEXT "Detent pressure offset for positive gear engagements - static aggression\r\n" /end ANNOTATION_TEXT
 /end ANNOTATION
 /begin AXIS_DESCR STD_AXIS NO_INPUT_QUANTITY RB_PT_PCT_SWC_GAC_CompuMethods_ratio_0p001 3 0.0 40. FORMAT "%10.5" DEPOSIT ABSOLUTE /end AXIS_DESCR
 /begin AXIS_DESCR STD_AXIS NO_INPUT_QUANTITY RB_PT_PCT_SWC_GAC_CompuMethods_ident 4 -50. 200. FORMAT "%10.5" DEPOSIT ABSOLUTE /end AXIS_DESCR
/end CHARACTERISTIC
/begin CHARACTERISTIC GAC_CALIB.GAC_GracC.GAC_DtntCtrl.GAC_PRESSDTNTCTRLVLOWGRNEG "" MAP 0x8061269C RB_PT_PCT_SWC_GAC_RecordLayouts_RL_Map_sint16_12_uint16_3_sint16_4 64.0 RB_PT_PCT_SWC_GAC_CompuMethods_ratio_0p001 -32. 32. FORMAT "%10.5"
 /begin ANNOTATION ANNOTATION_LABEL "Description (coming from AUTOSAR DESC field)"
  /begin ANNOTATION_TEXT "Detent pressure offset for negative gear engagements - very low aggression\r\n" /end ANNOTATION_TEXT
 /end ANNOTATION
 /begin AXIS_DESCR STD_AXIS NO_INPUT_QUANTITY RB_PT_PCT_SWC_GAC_CompuMethods_ratio_0p001 3 0.0 40. FORMAT "%10.5" DEPOSIT ABSOLUTE /end AXIS_DESCR
 /begin AXIS_DESCR STD_AXIS NO_INPUT_QUANTITY RB_PT_PCT_SWC_GAC_CompuMethods_ident 4 -50. 200. FORMAT "%10.5" DEPOSIT ABSOLUTE /end AXIS_DESCR
/end CHARACTERISTIC
/begin CHARACTERISTIC GAC_CALIB.GAC_GracC.GAC_DtntCtrl.GAC_PRESSDTNTCTRLVLOWGRPOS "" MAP 0x806126C6 RB_PT_PCT_SWC_GAC_RecordLayouts_RL_Map_sint16_12_uint16_3_sint16_4 64.0 RB_PT_PCT_SWC_GAC_CompuMethods_ratio_0p001 -32. 32. FORMAT "%10.5"
 /begin ANNOTATION ANNOTATION_LABEL "Description (coming from AUTOSAR DESC field)"
  /begin ANNOTATION_TEXT "Detent pressure offset for positive gear engagements - very low aggression\r\n" /end ANNOTATION_TEXT
 /end ANNOTATION
 /begin AXIS_DESCR STD_AXIS NO_INPUT_QUANTITY RB_PT_PCT_SWC_GAC_CompuMethods_ratio_0p001 3 0.0 40. FORMAT "%10.5" DEPOSIT ABSOLUTE /end AXIS_DESCR
 /begin AXIS_DESCR STD_AXIS NO_INPUT_QUANTITY RB_PT_PCT_SWC_GAC_CompuMethods_ident 4 -50. 200. FORMAT "%10.5" DEPOSIT ABSOLUTE /end AXIS_DESCR
/end CHARACTERISTIC
/begin CHARACTERISTIC GAC_CALIB.GAC_GracC.GAC_DtntCtrl.GAC_VELSGRACDTNTCTRLLIM "" VAL_BLK 0x806124E8 DefaultValueRecordLayout_AUTOSAR_Platform_BaseTypes_uint16 1.2 RB_PT_PCT_SWC_GAC_CompuMethods_ratio_0p001 0.0 1.2 FORMAT "%10.5"
 /begin ANNOTATION ANNOTATION_LABEL "Description (coming from AUTOSAR DESC field)"
  /begin ANNOTATION_TEXT "Array of gear actuator velocities for each actuation aggression, used for limiting of detent control.\r\n" /end ANNOTATION_TEXT
 /end ANNOTATION
 MATRIX_DIM 4 1 1 /end CHARACTERISTIC
/begin CHARACTERISTIC GAC_CALIB.GAC_GracC.GAC_FCTFLWRIGHT "" VALUE 0x8061242C DefaultValueRecordLayout_AUTOSAR_Platform_BaseTypes_uint16 1.5 RB_PT_PCT_SWC_GAC_CompuMethods_ratio_0p001 0.0 1.5 FORMAT "%10.5"
 /begin ANNOTATION ANNOTATION_LABEL "Description (coming from AUTOSAR DESC field)"
  /begin ANNOTATION_TEXT "Factor for upscaling the flow demand due to piston area difference.\r\n" /end ANNOTATION_TEXT
 /end ANNOTATION
/end CHARACTERISTIC
/begin CHARACTERISTIC GAC_CALIB.GAC_GracC.GAC_FCTPRESSRIGHT "" VALUE 0x8061242E DefaultValueRecordLayout_AUTOSAR_Platform_BaseTypes_uint16 1.5 RB_PT_PCT_SWC_GAC_CompuMethods_ratio_0p001 0.0 1.5 FORMAT "%10.5"
 /begin ANNOTATION ANNOTATION_LABEL "Description (coming from AUTOSAR DESC field)"
  /begin ANNOTATION_TEXT "Factor for upscaling the flow demand due to piston area difference.\r\n" /end ANNOTATION_TEXT
 /end ANNOTATION
/end CHARACTERISTIC
/begin CHARACTERISTIC GAC_CALIB.GAC_GracC.GAC_FCTRONSYNCLRNDELTAADPT "" VALUE 0x806124B3 DefaultValueRecordLayout_AUTOSAR_Platform_BaseTypes_uint8 1.0 RB_PT_PCT_SWC_GAC_CompuMethods_ratio_0p01 0.0 1. FORMAT "%10.5"
 /begin ANNOTATION ANNOTATION_LABEL "Description (coming from AUTOSAR DESC field)" /begin ANNOTATION_TEXT "Factor to adapt the in gear position by\r\n" /end ANNOTATION_TEXT /end ANNOTATION
/end CHARACTERISTIC
/begin CHARACTERISTIC GAC_CALIB.GAC_GracC.GAC_FCTRRETRYINGRPOSMOD "" VALUE 0x80612430 DefaultValueRecordLayout_AUTOSAR_Platform_BaseTypes_sint16 40.0 RB_PT_PCT_SWC_GAC_CompuMethods_ratio_0p001 -20. 20. FORMAT "%10.5"
 /begin ANNOTATION ANNOTATION_LABEL "Description (coming from AUTOSAR DESC field)"
  /begin ANNOTATION_TEXT "The modification factor to the in gear position on retries\r\n" /end ANNOTATION_TEXT
 /end ANNOTATION
/end CHARACTERISTIC
/begin CHARACTERISTIC GAC_CALIB.GAC_GracC.GAC_FLGAGGEVENBL "" VALUE 0x806124B4 DefaultValueRecordLayout_AUTOSAR_Platform_BaseTypes_uint8 255.0 DefaultIdenticalCompu 0.0 255. FORMAT "%10.5"
 /begin ANNOTATION ANNOTATION_LABEL "Description (coming from AUTOSAR DESC field)"
  /begin ANNOTATION_TEXT "Flag to indicate if the EV mode aggression can be used\r\n" /end ANNOTATION_TEXT
 /end ANNOTATION
/end CHARACTERISTIC
/begin CHARACTERISTIC GAC_CALIB.GAC_GracC.GAC_FLGBOBADAPTPONEVERYSHIFT "" VALUE 0x806124B5 DefaultValueRecordLayout_AUTOSAR_Platform_BaseTypes_uint8 255.0 DefaultIdenticalCompu 0.0 255. FORMAT "%10.5"
 /begin ANNOTATION ANNOTATION_LABEL "Description (coming from AUTOSAR DESC field)"
  /begin ANNOTATION_TEXT "Trigger the logic to clear the adaptions and relearn them on every shift\r\n" /end ANNOTATION_TEXT
 /end ANNOTATION
/end CHARACTERISTIC
/begin CHARACTERISTIC GAC_CALIB.GAC_GracC.GAC_FLGDISABLEGBLK2ITERM "" VALUE 0x806124B6 DefaultValueRecordLayout_AUTOSAR_Platform_BaseTypes_uint8 255.0 DefaultIdenticalCompu 0.0 255. FORMAT "%10.5"
 /begin ANNOTATION ANNOTATION_LABEL "Description (coming from AUTOSAR DESC field)" /begin ANNOTATION_TEXT "Flag to disable the i term during gear blocking 2\r\n" /end ANNOTATION_TEXT /end ANNOTATION
/end CHARACTERISTIC
/begin CHARACTERISTIC GAC_CALIB.GAC_GracC.GAC_FLGDISABLENEGDETECTION "" VALUE 0x806124B7 DefaultValueRecordLayout_AUTOSAR_Platform_BaseTypes_uint8 255.0 DefaultIdenticalCompu 0.0 255. FORMAT "%10.5"
 /begin ANNOTATION ANNOTATION_LABEL "Description (coming from AUTOSAR DESC field)" /begin ANNOTATION_TEXT "Flag to disable negative gear detection\r\n" /end ANNOTATION_TEXT /end ANNOTATION
/end CHARACTERISTIC
/begin CHARACTERISTIC GAC_CALIB.GAC_GracC.GAC_FLGDISABLEPOSDETECTION "" VALUE 0x806124B8 DefaultValueRecordLayout_AUTOSAR_Platform_BaseTypes_uint8 255.0 DefaultIdenticalCompu 0.0 255. FORMAT "%10.5"
 /begin ANNOTATION ANNOTATION_LABEL "Description (coming from AUTOSAR DESC field)" /begin ANNOTATION_TEXT "Flag to disable positive gear detection\r\n" /end ANNOTATION_TEXT /end ANNOTATION
/end CHARACTERISTIC
/begin CHARACTERISTIC GAC_CALIB.GAC_GracC.GAC_FLGDISABLESLIPCHECK "" VALUE 0x806124B9 DefaultValueRecordLayout_AUTOSAR_Platform_BaseTypes_uint8 255.0 DefaultIdenticalCompu 0.0 255. FORMAT "%10.5"
 /begin ANNOTATION ANNOTATION_LABEL "Description (coming from AUTOSAR DESC field)"
  /begin ANNOTATION_TEXT "Flag to disable slip checking for the end of synchronisation\r\n" /end ANNOTATION_TEXT
 /end ANNOTATION
/end CHARACTERISTIC
/begin CHARACTERISTIC GAC_CALIB.GAC_GracC.GAC_FLGENBLBENDCOMPSYNCPOS "" VALUE 0x806124BA DefaultValueRecordLayout_AUTOSAR_Platform_BaseTypes_uint8 255.0 DefaultIdenticalCompu 0.0 255. FORMAT "%10.5"
 /begin ANNOTATION ANNOTATION_LABEL "Description (coming from AUTOSAR DESC field)" /begin ANNOTATION_TEXT "flag to enable synchroniser bending compensation\r\n" /end ANNOTATION_TEXT /end ANNOTATION
/end CHARACTERISTIC
/begin CHARACTERISTIC GAC_CALIB.GAC_GracC.GAC_FLGENBLCALCFLWTGT "" VALUE 0x806124BB DefaultValueRecordLayout_AUTOSAR_Platform_BaseTypes_uint8 255.0 DefaultIdenticalCompu 0.0 255. FORMAT "%10.5"
 /begin ANNOTATION ANNOTATION_LABEL "Description (coming from AUTOSAR DESC field)" /begin ANNOTATION_TEXT "Flag to activate calculated flow target\r\n" /end ANNOTATION_TEXT /end ANNOTATION
/end CHARACTERISTIC
/begin CHARACTERISTIC GAC_CALIB.GAC_GracC.GAC_FLGENBLNBANDMODIFY "" VALUE 0x806124BC DefaultValueRecordLayout_AUTOSAR_Platform_BaseTypes_uint8 255.0 DefaultIdenticalCompu 0.0 255. FORMAT "%10.5"
 /begin ANNOTATION ANNOTATION_LABEL "Description (coming from AUTOSAR DESC field)"
  /begin ANNOTATION_TEXT "Flag to allow the neutral window to be modified for gear floating cases\r\n" /end ANNOTATION_TEXT
 /end ANNOTATION
/end CHARACTERISTIC
/begin CHARACTERISTIC GAC_CALIB.GAC_GracC.GAC_FLGENBLNEUTRALCLOSEOUT "" VALUE 0x806124BD DefaultValueRecordLayout_AUTOSAR_Platform_BaseTypes_uint8 255.0 DefaultIdenticalCompu 0.0 255. FORMAT "%10.5"
 /begin ANNOTATION ANNOTATION_LABEL "Description (coming from AUTOSAR DESC field)"
  /begin ANNOTATION_TEXT "Flag to enable I term to close out small errors in neutral\r\n" /end ANNOTATION_TEXT
 /end ANNOTATION
/end CHARACTERISTIC
/begin CHARACTERISTIC GAC_CALIB.GAC_GracC.GAC_FLGENBLPRESSANDHOLD "" VALUE 0x806124BE DefaultValueRecordLayout_AUTOSAR_Platform_BaseTypes_uint8 255.0 DefaultIdenticalCompu 0.0 255. FORMAT "%10.5"
 /begin ANNOTATION ANNOTATION_LABEL "Description (coming from AUTOSAR DESC field)" /begin ANNOTATION_TEXT "Flag to enable press and hold functionality\r\n" /end ANNOTATION_TEXT /end ANNOTATION
/end CHARACTERISTIC
/begin CHARACTERISTIC GAC_CALIB.GAC_GracC.GAC_FLGENBLPRESSCONTROLDISABLE "" VALUE 0x806124BF DefaultValueRecordLayout_AUTOSAR_Platform_BaseTypes_uint8 255.0 DefaultIdenticalCompu 0.0 255. FORMAT "%10.5"
 /begin ANNOTATION ANNOTATION_LABEL "Description (coming from AUTOSAR DESC field)"
  /begin ANNOTATION_TEXT "Flag to disable the pressure control terms (pressure i, p, and velocity i) terms from impacting the EOL position learn\r\n" /end ANNOTATION_TEXT
 /end ANNOTATION
/end CHARACTERISTIC
/begin CHARACTERISTIC GAC_CALIB.GAC_GracC.GAC_FLGENBLPRESSINTONEUTRAL "" VALUE 0x806124C0 DefaultValueRecordLayout_AUTOSAR_Platform_BaseTypes_uint8 255.0 DefaultIdenticalCompu 0.0 255. FORMAT "%10.5"
 /begin ANNOTATION ANNOTATION_LABEL "Description (coming from AUTOSAR DESC field)" /begin ANNOTATION_TEXT "Flag to enable press and hold functionality\r\n" /end ANNOTATION_TEXT /end ANNOTATION
/end CHARACTERISTIC
/begin CHARACTERISTIC GAC_CALIB.GAC_GracC.GAC_FLGENBLVLOWAGG "" VALUE 0x806124C1 DefaultValueRecordLayout_AUTOSAR_Platform_BaseTypes_uint8 255.0 DefaultIdenticalCompu 0.0 255. FORMAT "%10.5"
 /begin ANNOTATION ANNOTATION_LABEL "Description (coming from AUTOSAR DESC field)" /begin ANNOTATION_TEXT "Flag to enable very low aggression\r\n" /end ANNOTATION_TEXT /end ANNOTATION
/end CHARACTERISTIC
/begin CHARACTERISTIC GAC_CALIB.GAC_GracC.GAC_FLGEVMODEAGGVERYLOW "" VALUE 0x806124C2 DefaultValueRecordLayout_AUTOSAR_Platform_BaseTypes_uint8 255.0 DefaultIdenticalCompu 0.0 255. FORMAT "%10.5"
 /begin ANNOTATION ANNOTATION_LABEL "Description (coming from AUTOSAR DESC field)" /begin ANNOTATION_TEXT "flag to allow the very low aggression for EV mode\r\n" /end ANNOTATION_TEXT /end ANNOTATION
/end CHARACTERISTIC
/begin CHARACTERISTIC GAC_CALIB.GAC_GracC.GAC_FLGEVSYNCAGAINSTDRAGENBL "" VALUE 0x806124C3 DefaultValueRecordLayout_AUTOSAR_Platform_BaseTypes_uint8 255.0 DefaultIdenticalCompu 0.0 255. FORMAT "%10.5"
 /begin ANNOTATION ANNOTATION_LABEL "Description (coming from AUTOSAR DESC field)"
  /begin ANNOTATION_TEXT "Flag to enable the strategy to only synchronise against the drag\r\n" /end ANNOTATION_TEXT
 /end ANNOTATION
/end CHARACTERISTIC
/begin CHARACTERISTIC GAC_CALIB.GAC_GracC.GAC_FLGGBLK0MINTGTSYNC "" VALUE 0x806124C4 DefaultValueRecordLayout_AUTOSAR_Platform_BaseTypes_uint8 255.0 DefaultIdenticalCompu 0.0 255. FORMAT "%10.5"
 /begin ANNOTATION ANNOTATION_LABEL "Description (coming from AUTOSAR DESC field)"
  /begin ANNOTATION_TEXT "flag to enable the strategy to have the gblk 0 time at least as large as the target time to synchronise the shaft\r\n" /end ANNOTATION_TEXT
 /end ANNOTATION
/end CHARACTERISTIC
/begin CHARACTERISTIC GAC_CALIB.GAC_GracC.GAC_FLGLIMITENDPRESSTOSYNCPRESS "" VALUE 0x806124C5 DefaultValueRecordLayout_AUTOSAR_Platform_BaseTypes_uint8 255.0 DefaultIdenticalCompu 0.0 255. FORMAT "%10.5"
 /begin ANNOTATION ANNOTATION_LABEL "Description (coming from AUTOSAR DESC field)"
  /begin ANNOTATION_TEXT "limit the minimum pressure in the free flight phase to the max pressure during the synchronisation phase\r\n" /end ANNOTATION_TEXT
 /end ANNOTATION
/end CHARACTERISTIC
/begin CHARACTERISTIC GAC_CALIB.GAC_GracC.GAC_FLGMOVINGMUSTBEINRANGE "" VALUE 0x806124C6 DefaultValueRecordLayout_AUTOSAR_Platform_BaseTypes_uint8 255.0 DefaultIdenticalCompu 0.0 255. FORMAT "%10.5"
 /begin ANNOTATION ANNOTATION_LABEL "Description (coming from AUTOSAR DESC field)" /begin ANNOTATION_TEXT "Moving detected must be in position range\r\n" /end ANNOTATION_TEXT /end ANNOTATION
/end CHARACTERISTIC
/begin CHARACTERISTIC GAC_CALIB.GAC_GracC.GAC_FLGNOPOSPOSNFROMN "" VALUE 0x806124C7 DefaultValueRecordLayout_AUTOSAR_Platform_BaseTypes_boolean 255.0 AUTOSAR_Platform_CompuMethods_boolean 0.0 255. FORMAT "%10.5"
 /begin ANNOTATION ANNOTATION_LABEL "Description (coming from AUTOSAR DESC field)"
  /begin ANNOTATION_TEXT "Flag inhibiting entry to positive position states, once in Neutral.\r\n" /end ANNOTATION_TEXT
 /end ANNOTATION
/end CHARACTERISTIC
/begin CHARACTERISTIC GAC_CALIB.GAC_GracC.GAC_FLGNOTMPCONDUPDATE "" VALUE 0x806124C8 DefaultValueRecordLayout_AUTOSAR_Platform_BaseTypes_boolean 255.0 AUTOSAR_Platform_CompuMethods_boolean 0.0 255. FORMAT "%10.5"
 /begin ANNOTATION ANNOTATION_LABEL "Description (coming from AUTOSAR DESC field)"
  /begin ANNOTATION_TEXT "Flag enabling continuous update of slow tasks without depending on temperature change condition.\r\n" /end ANNOTATION_TEXT
 /end ANNOTATION
/end CHARACTERISTIC
/begin CHARACTERISTIC GAC_CALIB.GAC_GracC.GAC_FLGNSTOPITERMRESETMAXTMR "" VALUE 0x806124C9 DefaultValueRecordLayout_AUTOSAR_Platform_BaseTypes_uint8 255.0 DefaultIdenticalCompu 0.0 255. FORMAT "%10.5"
 /begin ANNOTATION ANNOTATION_LABEL "Description (coming from AUTOSAR DESC field)"
  /begin ANNOTATION_TEXT "Flag to activate a maximum timer for the N stop I term reset\r\n" /end ANNOTATION_TEXT
 /end ANNOTATION
/end CHARACTERISTIC
/begin CHARACTERISTIC GAC_CALIB.GAC_GracC.GAC_FLGPVSCONFIG "" VALUE 0x806124CA DefaultValueRecordLayout_AUTOSAR_Platform_BaseTypes_uint8 255.0 DefaultIdenticalCompu 0.0 255. FORMAT "%10.5"
 /begin ANNOTATION ANNOTATION_LABEL "Description (coming from AUTOSAR DESC field)"
  /begin ANNOTATION_TEXT "Flag to indicate whether or not the transmission is a PVS transmission\r\n" /end ANNOTATION_TEXT
 /end ANNOTATION
/end CHARACTERISTIC
/begin CHARACTERISTIC GAC_CALIB.GAC_GracC.GAC_FLGRESETGBLCKPRESSWHENMOVING "" VALUE 0x806124CB DefaultValueRecordLayout_AUTOSAR_Platform_BaseTypes_uint8 255.0 DefaultIdenticalCompu 0.0 255. FORMAT "%10.5"
 /begin ANNOTATION ANNOTATION_LABEL "Description (coming from AUTOSAR DESC field)"
  /begin ANNOTATION_TEXT "Flag to reset the additional pressure from the gear block 3 pressure ramp once the synchro is moving\r\n" /end ANNOTATION_TEXT
 /end ANNOTATION
/end CHARACTERISTIC
/begin CHARACTERISTIC GAC_CALIB.GAC_GracC.GAC_FLGRESETITERMONSYNC "" VALUE 0x806124CC DefaultValueRecordLayout_AUTOSAR_Platform_BaseTypes_uint8 255.0 DefaultIdenticalCompu 0.0 255. FORMAT "%10.5"
 /begin ANNOTATION ANNOTATION_LABEL "Description (coming from AUTOSAR DESC field)" /begin ANNOTATION_TEXT "Flag to reset the I term when on the synchro cone\r\n" /end ANNOTATION_TEXT /end ANNOTATION
/end CHARACTERISTIC
/begin CHARACTERISTIC GAC_CALIB.GAC_GracC.GAC_FLGSTATICADAPTENBL "" VALUE 0x806124CD DefaultValueRecordLayout_AUTOSAR_Platform_BaseTypes_uint8 255.0 DefaultIdenticalCompu 0.0 255. FORMAT "%10.5"
 /begin ANNOTATION ANNOTATION_LABEL "Description (coming from AUTOSAR DESC field)" /begin ANNOTATION_TEXT "Allow static adaptions\r\n" /end ANNOTATION_TEXT /end ANNOTATION
/end CHARACTERISTIC
/begin CHARACTERISTIC GAC_CALIB.GAC_GracC.GAC_FLGUSELEARNEDSYNCPOS "" VALUE 0x806124CE DefaultValueRecordLayout_AUTOSAR_Platform_BaseTypes_uint8 255.0 DefaultIdenticalCompu 0.0 255. FORMAT "%10.5"
 /begin ANNOTATION ANNOTATION_LABEL "Description (coming from AUTOSAR DESC field)"
  /begin ANNOTATION_TEXT "Flag to indicate the use of the learned on synchro position when determining synchronisation end\r\n" /end ANNOTATION_TEXT
 /end ANNOTATION
/end CHARACTERISTIC
/begin CHARACTERISTIC GAC_CALIB.GAC_GracC.GAC_FLGUSENSTOPERROR "" VALUE 0x806124CF DefaultValueRecordLayout_AUTOSAR_Platform_BaseTypes_uint8 255.0 DefaultIdenticalCompu 0.0 255. FORMAT "%10.5"
 /begin ANNOTATION ANNOTATION_LABEL "Description (coming from AUTOSAR DESC field)" /begin ANNOTATION_TEXT "Flag to use N stop error instead of main error term\r\n" /end ANNOTATION_TEXT /end ANNOTATION
/end CHARACTERISTIC
/begin CHARACTERISTIC GAC_CALIB.GAC_GracC.GAC_FLOWMINITERMCLOSEOUT "" VALUE 0x80612432 DefaultValueRecordLayout_AUTOSAR_Platform_BaseTypes_sint16 64.0 RB_PT_PCT_SWC_GAC_CompuMethods_ratio_0p001 -32. 32. FORMAT "%10.5"
 /begin ANNOTATION ANNOTATION_LABEL "Description (coming from AUTOSAR DESC field)" /begin ANNOTATION_TEXT "minimum synchro flow to enable neutral close out\r\n" /end ANNOTATION_TEXT /end ANNOTATION
/end CHARACTERISTIC
/begin CHARACTERISTIC GAC_CALIB.GAC_GracC.GAC_FLWGHOLDBCKLIM "" VALUE 0x80612434 DefaultValueRecordLayout_AUTOSAR_Platform_BaseTypes_sint16 64.0 RB_PT_PCT_SWC_GAC_CompuMethods_ratio_0p001 -32. 32. FORMAT "%10.5"
 /begin ANNOTATION ANNOTATION_LABEL "Description (coming from AUTOSAR DESC field)" /begin ANNOTATION_TEXT "Flow limit used for GHold active.\r\n" /end ANNOTATION_TEXT /end ANNOTATION
/end CHARACTERISTIC
/begin CHARACTERISTIC GAC_CALIB.GAC_GracC.GAC_FLWMINGBLCK3 "" VALUE 0x80612436 DefaultValueRecordLayout_AUTOSAR_Platform_BaseTypes_sint16 64.0 RB_PT_PCT_SWC_GAC_CompuMethods_ratio_0p001 -32. 32. FORMAT "%10.5"
 /begin ANNOTATION ANNOTATION_LABEL "Description (coming from AUTOSAR DESC field)" /begin ANNOTATION_TEXT "minimum flow to allow gear block 3 strategy\r\n" /end ANNOTATION_TEXT /end ANNOTATION
/end CHARACTERISTIC
/begin CHARACTERISTIC GAC_CALIB.GAC_GracC.GAC_FLWSFFVELCTRLNOSYNCABS "" CURVE 0x8061287A RB_PT_PCT_SWC_GAC_RecordLayouts_RL_Curve_uint16_4_uint16_4 32.0 RB_PT_PCT_SWC_GAC_CompuMethods_ratio_0p001 0.0 32. FORMAT "%10.5"
 /begin ANNOTATION ANNOTATION_LABEL "Description (coming from AUTOSAR DESC field)"
  /begin ANNOTATION_TEXT "Unsigned feedforward flow gains for velocity control before the synchro phase or Neutral actuation.\r\n" /end ANNOTATION_TEXT
 /end ANNOTATION
 /begin AXIS_DESCR STD_AXIS NO_INPUT_QUANTITY RB_PT_PCT_SWC_GAC_CompuMethods_ratio_0p001 4 0.0 1.2 FORMAT "%10.5" DEPOSIT ABSOLUTE /end AXIS_DESCR
/end CHARACTERISTIC
/begin CHARACTERISTIC GAC_CALIB.GAC_GracC.GAC_FLWSFFVELCTRLSYNCABS "" CURVE 0x8061288C RB_PT_PCT_SWC_GAC_RecordLayouts_RL_Curve_uint16_4_uint16_4 32.0 RB_PT_PCT_SWC_GAC_CompuMethods_ratio_0p001 0.0 32. FORMAT "%10.5"
 /begin ANNOTATION ANNOTATION_LABEL "Description (coming from AUTOSAR DESC field)"
  /begin ANNOTATION_TEXT "Unsigned feedforward flow gains for velocity control after the synchro phase.\r\n" /end ANNOTATION_TEXT
 /end ANNOTATION
 /begin AXIS_DESCR STD_AXIS NO_INPUT_QUANTITY RB_PT_PCT_SWC_GAC_CompuMethods_ratio_0p001 4 0.0 1.2 FORMAT "%10.5" DEPOSIT ABSOLUTE /end AXIS_DESCR
/end CHARACTERISTIC
/begin CHARACTERISTIC GAC_CALIB.GAC_GracC.GAC_FLWSIVELCTRLNOSYNC "" CURVE 0x8061289E RB_PT_PCT_SWC_GAC_RecordLayouts_RL_Curve_sint16_7_sint16_7 64.0 RB_PT_PCT_SWC_GAC_CompuMethods_ratio_0p001 -32. 32. FORMAT "%10.5"
 /begin ANNOTATION ANNOTATION_LABEL "Description (coming from AUTOSAR DESC field)"
  /begin ANNOTATION_TEXT "Integral flow gains for velocity control before the synchro phase.\r\n" /end ANNOTATION_TEXT
 /end ANNOTATION
 /begin AXIS_DESCR STD_AXIS NO_INPUT_QUANTITY RB_PT_PCT_SWC_GAC_CompuMethods_ratio_0p001 7 -1.2 1.2 FORMAT "%10.5" DEPOSIT ABSOLUTE /end AXIS_DESCR
/end CHARACTERISTIC
/begin CHARACTERISTIC GAC_CALIB.GAC_GracC.GAC_FLWSIVELCTRLSYNC "" CURVE 0x806128BC RB_PT_PCT_SWC_GAC_RecordLayouts_RL_Curve_sint16_7_sint16_7 64.0 RB_PT_PCT_SWC_GAC_CompuMethods_ratio_0p001 -32. 32. FORMAT "%10.5"
 /begin ANNOTATION ANNOTATION_LABEL "Description (coming from AUTOSAR DESC field)"
  /begin ANNOTATION_TEXT "Integral flow gains for velocity control after the synchro phase.\r\n" /end ANNOTATION_TEXT
 /end ANNOTATION
 /begin AXIS_DESCR STD_AXIS NO_INPUT_QUANTITY RB_PT_PCT_SWC_GAC_CompuMethods_ratio_0p001 7 -1.2 1.2 FORMAT "%10.5" DEPOSIT ABSOLUTE /end AXIS_DESCR
/end CHARACTERISTIC
/begin CHARACTERISTIC GAC_CALIB.GAC_GracC.GAC_FLWSNHOLD "" CURVE 0x806128DA RB_PT_PCT_SWC_GAC_RecordLayouts_RL_Curve_sint16_4_uint16_4 64.0 RB_PT_PCT_SWC_GAC_CompuMethods_ratio_0p001 -32. 32. FORMAT "%10.5"
 /begin ANNOTATION ANNOTATION_LABEL "Description (coming from AUTOSAR DESC field)"
  /begin ANNOTATION_TEXT "Proportional flow gains for velocity (position) control in NHold or drain phase after actuation to Neutral.\r\n" /end ANNOTATION_TEXT
 /end ANNOTATION
 /begin AXIS_DESCR STD_AXIS NO_INPUT_QUANTITY RB_PT_PCT_SWC_GAC_CompuMethods_ratio_0p001 4 0.0 20. FORMAT "%10.5" DEPOSIT ABSOLUTE /end AXIS_DESCR
/end CHARACTERISTIC
/begin CHARACTERISTIC GAC_CALIB.GAC_GracC.GAC_FLWSPVELCTRLGHOLD "" CURVE 0x806128EC RB_PT_PCT_SWC_GAC_RecordLayouts_RL_Curve_sint16_7_sint16_7 64.0 RB_PT_PCT_SWC_GAC_CompuMethods_ratio_0p001 -32. 32. FORMAT "%10.5"
 /begin ANNOTATION ANNOTATION_LABEL "Description (coming from AUTOSAR DESC field)"
  /begin ANNOTATION_TEXT "Proportional flow gains for velocity (position) control in the GHold phase.\r\n" /end ANNOTATION_TEXT
 /end ANNOTATION
 /begin AXIS_DESCR STD_AXIS NO_INPUT_QUANTITY RB_PT_PCT_SWC_GAC_CompuMethods_ratio_0p001 7 -2. 2. FORMAT "%10.5" DEPOSIT ABSOLUTE /end AXIS_DESCR
/end CHARACTERISTIC
/begin CHARACTERISTIC GAC_CALIB.GAC_GracC.GAC_FLWSPVELCTRLGHOLDRULE26 "" CURVE 0x8061290A RB_PT_PCT_SWC_GAC_RecordLayouts_RL_Curve_sint16_7_sint16_7 64.0 RB_PT_PCT_SWC_GAC_CompuMethods_ratio_0p001 -32. 32. FORMAT "%10.5"
 /begin ANNOTATION ANNOTATION_LABEL "Description (coming from AUTOSAR DESC field)"
  /begin ANNOTATION_TEXT "Proportional flow gains for velocity (position) control in the GHold phase.\r\n" /end ANNOTATION_TEXT
 /end ANNOTATION
 /begin AXIS_DESCR STD_AXIS NO_INPUT_QUANTITY RB_PT_PCT_SWC_GAC_CompuMethods_ratio_0p001 7 -2. 2. FORMAT "%10.5" DEPOSIT ABSOLUTE /end AXIS_DESCR
/end CHARACTERISTIC
/begin CHARACTERISTIC GAC_CALIB.GAC_GracC.GAC_FLWSPVELCTRLNSTOP "" MAP 0x80612928 RB_PT_PCT_SWC_GAC_RecordLayouts_RL_Map_sint16_27_sint16_9_sint16_3 64.0 RB_PT_PCT_SWC_GAC_CompuMethods_ratio_0p001 -32. 32. FORMAT "%10.5"
 /begin ANNOTATION ANNOTATION_LABEL "Description (coming from AUTOSAR DESC field)"
  /begin ANNOTATION_TEXT "Proportional flow gains for velocity control in the NStop phase.\r\n" /end ANNOTATION_TEXT
 /end ANNOTATION
 /begin AXIS_DESCR STD_AXIS NO_INPUT_QUANTITY RB_PT_PCT_SWC_GAC_CompuMethods_ratio_0p001 9 -1.2 1.2 FORMAT "%10.5" DEPOSIT ABSOLUTE /end AXIS_DESCR
 /begin AXIS_DESCR STD_AXIS NO_INPUT_QUANTITY RB_PT_PCT_SWC_GAC_CompuMethods_ident 3 -50. 200. FORMAT "%10.5" DEPOSIT ABSOLUTE /end AXIS_DESCR
/end CHARACTERISTIC
/begin CHARACTERISTIC GAC_CALIB.GAC_GracC.GAC_FLWSVLVSTUCKDEM "" VAL_BLK 0x80612410 DefaultValueRecordLayout_AUTOSAR_Platform_BaseTypes_sint16 64.0 RB_PT_PCT_SWC_GAC_CompuMethods_ratio_0p001 -32. 32. FORMAT "%10.5"
 /begin ANNOTATION ANNOTATION_LABEL "Description (coming from AUTOSAR DESC field)"
  /begin ANNOTATION_TEXT "Flow demands requested by the valve stuck diagnostic and failure handling..\r\n" /end ANNOTATION_TEXT
 /end ANNOTATION
 MATRIX_DIM 3 1 1 /end CHARACTERISTIC
/begin CHARACTERISTIC GAC_CALIB.GAC_GracC.GAC_GracPosnInitTmr.LIB_DT "" VALUE 0x806126F0 DefaultValueRecordLayout_AUTOSAR_Platform_BaseTypes_uint16 65.535 RB_PT_PCT_SWC_GAC_CompuMethods_ratio_0p001 0.0 65.535 FORMAT "%10.5"
 /begin ANNOTATION ANNOTATION_LABEL "Description (coming from AUTOSAR DESC field)" /begin ANNOTATION_TEXT "Timer decrement value.\r\n" /end ANNOTATION_TEXT /end ANNOTATION
/end CHARACTERISTIC
/begin CHARACTERISTIC GAC_CALIB.GAC_GracC.GAC_IDDIAGENBLSHIFT "" VALUE 0x80612418 DefaultValueRecordLayout_AUTOSAR_Platform_BaseTypes_uint32 4194304.0 RB_PT_PCT_SWC_GAC_CompuMethods_ident 0.0 4194304. FORMAT "%10.5"
 /begin ANNOTATION ANNOTATION_LABEL "Description (coming from AUTOSAR DESC field)"
  /begin ANNOTATION_TEXT "multiplication factor to shift the bits for each actuator\r\n" /end ANNOTATION_TEXT
 /end ANNOTATION
/end CHARACTERISTIC
/begin CHARACTERISTIC GAC_CALIB.GAC_GracC.GAC_InGearLearn.GAC_FCTRINGEARLRNDELTAADPT "" VALUE 0x806126FA DefaultValueRecordLayout_AUTOSAR_Platform_BaseTypes_uint8 1.0 RB_PT_PCT_SWC_GAC_CompuMethods_ratio_0p01 0.0 1. FORMAT "%10.5"
 /begin ANNOTATION ANNOTATION_LABEL "Description (coming from AUTOSAR DESC field)"
  /begin ANNOTATION_TEXT "percentage factor of the delta that is added to the learned in gear position\r\n" /end ANNOTATION_TEXT
 /end ANNOTATION
/end CHARACTERISTIC
/begin CHARACTERISTIC GAC_CALIB.GAC_GracC.GAC_InGearLearn.GAC_FCTRINGEARLRNDELTAADPTNOSTORE "" VALUE 0x806126FB DefaultValueRecordLayout_AUTOSAR_Platform_BaseTypes_uint8 1.0 RB_PT_PCT_SWC_GAC_CompuMethods_ratio_0p01 0.0 1. FORMAT "%10.5"
 /begin ANNOTATION ANNOTATION_LABEL "Description (coming from AUTOSAR DESC field)"
  /begin ANNOTATION_TEXT "percentage factor of the delta that is added to the learned in gear position\r\n" /end ANNOTATION_TEXT
 /end ANNOTATION
/end CHARACTERISTIC
/begin CHARACTERISTIC GAC_CALIB.GAC_GracC.GAC_InGearLearn.GAC_FLGCHECKNOFSTDURINGINGRLEARN "" VALUE 0x806126FC DefaultValueRecordLayout_AUTOSAR_Platform_BaseTypes_uint8 255.0 DefaultIdenticalCompu 0.0 255. FORMAT "%10.5"
 /begin ANNOTATION ANNOTATION_LABEL "Description (coming from AUTOSAR DESC field)"
  /begin ANNOTATION_TEXT "Flag to enable/disable checking neutral offset during in gear learn\r\n" /end ANNOTATION_TEXT
 /end ANNOTATION
/end CHARACTERISTIC
/begin CHARACTERISTIC GAC_CALIB.GAC_GracC.GAC_InGearLearn.GAC_FLGCHECKNOFSTDURINGUDSEXPORT "" VALUE 0x806126FD DefaultValueRecordLayout_AUTOSAR_Platform_BaseTypes_uint8 255.0 DefaultIdenticalCompu 0.0 255. FORMAT "%10.5"
 /begin ANNOTATION ANNOTATION_LABEL "Description (coming from AUTOSAR DESC field)"
  /begin ANNOTATION_TEXT "Flag to enable/disable checking neutral offset during in gear learn - UDS version\r\n" /end ANNOTATION_TEXT
 /end ANNOTATION
/end CHARACTERISTIC
/begin CHARACTERISTIC GAC_CALIB.GAC_GracC.GAC_InGearLearn.GAC_FLGFORCEINGRLEARNCHECK "" VALUE 0x806126FE DefaultValueRecordLayout_AUTOSAR_Platform_BaseTypes_uint8 255.0 DefaultIdenticalCompu 0.0 255. FORMAT "%10.5"
 /begin ANNOTATION ANNOTATION_LABEL "Description (coming from AUTOSAR DESC field)"
  /begin ANNOTATION_TEXT "Flag to force the in gear position learn check and write to NV\r\n" /end ANNOTATION_TEXT
 /end ANNOTATION
/end CHARACTERISTIC
/begin CHARACTERISTIC GAC_CALIB.GAC_GracC.GAC_InGearLearn.GAC_FLGRESETINGEARPOSIFADAPTBAD "" VALUE 0x806126FF DefaultValueRecordLayout_AUTOSAR_Platform_BaseTypes_uint8 255.0 DefaultIdenticalCompu 0.0 255. FORMAT "%10.5"
 /begin ANNOTATION ANNOTATION_LABEL "Description (coming from AUTOSAR DESC field)"
  /begin ANNOTATION_TEXT "Flag to enable value reset if the adaption if the in gear learned position is bad\r\n" /end ANNOTATION_TEXT
 /end ANNOTATION
/end CHARACTERISTIC
/begin CHARACTERISTIC GAC_CALIB.GAC_GracC.GAC_InGearLearn.GAC_FLGRESETINVALIDLEARN "" VALUE 0x80612700 DefaultValueRecordLayout_AUTOSAR_Platform_BaseTypes_uint8 255.0 DefaultIdenticalCompu 0.0 255. FORMAT "%10.5"
 /begin ANNOTATION ANNOTATION_LABEL "Description (coming from AUTOSAR DESC field)"
  /begin ANNOTATION_TEXT "Flag to enable value reset if any learn if the in gear learned position is bad\r\n" /end ANNOTATION_TEXT
 /end ANNOTATION
/end CHARACTERISTIC
/begin CHARACTERISTIC GAC_CALIB.GAC_GracC.GAC_InGearLearn.GAC_FLGUSEORIGINGRLEARN "" VALUE 0x80612701 DefaultValueRecordLayout_AUTOSAR_Platform_BaseTypes_uint8 255.0 DefaultIdenticalCompu 0.0 255. FORMAT "%10.5"
 /begin ANNOTATION ANNOTATION_LABEL "Description (coming from AUTOSAR DESC field)" /begin ANNOTATION_TEXT "Flag to enable/ disable old in gear learn method\r\n" /end ANNOTATION_TEXT /end ANNOTATION
/end CHARACTERISTIC
/begin CHARACTERISTIC GAC_CALIB.GAC_GracC.GAC_InGearLearn.GAC_IDINGEARLEARNUDSVALUE "" VALUE 0x80612702 DefaultValueRecordLayout_AUTOSAR_Platform_BaseTypes_uint8 255.0 RB_PT_PCT_SWC_GAC_CompuMethods_ident 0.0 255. FORMAT "%10.5"
 /begin ANNOTATION ANNOTATION_LABEL "Description (coming from AUTOSAR DESC field)"
  /begin ANNOTATION_TEXT "Switch case input to switch learned value sent out over UDS\r\n" /end ANNOTATION_TEXT
 /end ANNOTATION
/end CHARACTERISTIC
/begin CHARACTERISTIC GAC_CALIB.GAC_GracC.GAC_InGearLearn.GAC_IDSYNCHRODIRNOTPOSSIBLE "" VALUE 0x80612703 DefaultValueRecordLayout_AUTOSAR_Platform_BaseTypes_uint8 255.0 RB_PT_PCT_SWC_GAC_CompuMethods_ident 0.0 255. FORMAT "%10.5"
 /begin ANNOTATION ANNOTATION_LABEL "Description (coming from AUTOSAR DESC field)"
  /begin ANNOTATION_TEXT "ID to indicate that the synchroniser position direction is not possible (1=left not possible, 2=right not possible)\r\n" /end ANNOTATION_TEXT
 /end ANNOTATION
/end CHARACTERISTIC
/begin CHARACTERISTIC GAC_CALIB.GAC_GracC.GAC_InGearLearn.GAC_POSNLESSINGRLRNNEG "" VALUE 0x806126F2 DefaultValueRecordLayout_AUTOSAR_Platform_BaseTypes_uint16 2.0 RB_PT_PCT_SWC_GAC_CompuMethods_ratio_0p001 0.0 2. FORMAT "%10.5"
 /begin ANNOTATION ANNOTATION_LABEL "Description (coming from AUTOSAR DESC field)"
  /begin ANNOTATION_TEXT "Position margin removed for calculation of the learnt in negative gear position.\r\n" /end ANNOTATION_TEXT
 /end ANNOTATION
/end CHARACTERISTIC
/begin CHARACTERISTIC GAC_CALIB.GAC_GracC.GAC_InGearLearn.GAC_POSNLESSINGRLRNPOS "" VALUE 0x806126F4 DefaultValueRecordLayout_AUTOSAR_Platform_BaseTypes_uint16 2.0 RB_PT_PCT_SWC_GAC_CompuMethods_ratio_0p001 0.0 2. FORMAT "%10.5"
 /begin ANNOTATION ANNOTATION_LABEL "Description (coming from AUTOSAR DESC field)"
  /begin ANNOTATION_TEXT "Position margin removed for calculation of the learnt in positive gear position.\r\n" /end ANNOTATION_TEXT
 /end ANNOTATION
/end CHARACTERISTIC
/end MODULE
/end PROJECT
