ASAP2_VERSION 1 60
/begin PROJECT LB74x_TCU "5201C621"
/begin HEADER "" VERSION "5201C621" PROJECT_NO LB74x_TCU /end HEADER
/begin MODULE DIM ""
/begin MOD_COMMON "" BYTE_ORDER MSB_LAST ALIGNMENT_BYTE 1 ALIGNMENT_WORD 2 ALIGNMENT_LONG 4 ALIGNMENT_INT64 4 ALIGNMENT_FLOAT32_IEEE 4 ALIGNMENT_FLOAT64_IEEE 4 DATA_SIZE 32 /end MOD_COMMON
/begin CHARACTERISTIC GAC_CALIB.GAC_COEFMVLVNOMOVETM "" VALUE 0x80610C84 DefaultValueRecordLayout_AUTOSAR_Platform_BaseTypes_sint16 2.0 RB_PT_PCT_SWC_GAC_CompuMethods_ratio_0p0001 -1. 1. FORMAT "%10.5"
 /begin ANNOTATION ANNOTATION_LABEL "Description (coming from AUTOSAR DESC field)" /begin ANNOTATION_TEXT "M coefficient for actuator no move diagnostic time.\r\n" /end ANNOTATION_TEXT /end ANNOTATION
/end CHARACTERISTIC
/begin CHARACTERISTIC GAC_CALIB.GAC_CURMAXNULLFLWVLV "" VALUE 0x80610C86 DefaultValueRecordLayout_AUTOSAR_Platform_BaseTypes_uint16 5000.0 RB_PT_PCT_SWC_GAC_CompuMethods_ident 0.0 5000. FORMAT "%10.5"
 /begin ANNOTATION ANNOTATION_LABEL "Description (coming from AUTOSAR DESC field)"
  /begin ANNOTATION_TEXT "Maximum allowed EOL learnt flow valve centre position.\r\n" /end ANNOTATION_TEXT
 /end ANNOTATION
/end CHARACTERISTIC
/begin CHARACTERISTIC GAC_CALIB.GAC_CURMINNULLFLWVLV "" VALUE 0x80610C88 DefaultValueRecordLayout_AUTOSAR_Platform_BaseTypes_uint16 5000.0 RB_PT_PCT_SWC_GAC_CompuMethods_ident 0.0 5000. FORMAT "%10.5"
 /begin ANNOTATION ANNOTATION_LABEL "Description (coming from AUTOSAR DESC field)"
  /begin ANNOTATION_TEXT "Minimum allowed EOL learnt flow valve centre position.\r\n" /end ANNOTATION_TEXT
 /end ANNOTATION
/end CHARACTERISTIC
/begin CHARACTERISTIC GAC_CALIB.GAC_CURNULLFLWVLVBOBGRAC0 "" VALUE 0x80610C8A DefaultValueRecordLayout_AUTOSAR_Platform_BaseTypes_uint16 5000.0 RB_PT_PCT_SWC_GAC_CompuMethods_ident 0.0 5000. FORMAT "%10.5"
 /begin ANNOTATION ANNOTATION_LABEL "Description (coming from AUTOSAR DESC field)"
  /begin ANNOTATION_TEXT "Centre position current for this valve, manually set EOL value.\r\n" /end ANNOTATION_TEXT
 /end ANNOTATION
/end CHARACTERISTIC
/begin CHARACTERISTIC GAC_CALIB.GAC_CURNULLFLWVLVBOBGRAC1 "" VALUE 0x80610C8C DefaultValueRecordLayout_AUTOSAR_Platform_BaseTypes_uint16 5000.0 RB_PT_PCT_SWC_GAC_CompuMethods_ident 0.0 5000. FORMAT "%10.5"
 /begin ANNOTATION ANNOTATION_LABEL "Description (coming from AUTOSAR DESC field)"
  /begin ANNOTATION_TEXT "Centre position current for this valve, manually set EOL value.\r\n" /end ANNOTATION_TEXT
 /end ANNOTATION
/end CHARACTERISTIC
/begin CHARACTERISTIC GAC_CALIB.GAC_CURNULLFLWVLVBOBGRAC2 "" VALUE 0x80610C8E DefaultValueRecordLayout_AUTOSAR_Platform_BaseTypes_uint16 5000.0 RB_PT_PCT_SWC_GAC_CompuMethods_ident 0.0 5000. FORMAT "%10.5"
 /begin ANNOTATION ANNOTATION_LABEL "Description (coming from AUTOSAR DESC field)"
  /begin ANNOTATION_TEXT "Centre position current for this valve, manually set EOL value.\r\n" /end ANNOTATION_TEXT
 /end ANNOTATION
/end CHARACTERISTIC
/begin CHARACTERISTIC GAC_CALIB.GAC_CURNULLFLWVLVBOBGRAC3 "" VALUE 0x80610C90 DefaultValueRecordLayout_AUTOSAR_Platform_BaseTypes_uint16 5000.0 RB_PT_PCT_SWC_GAC_CompuMethods_ident 0.0 5000. FORMAT "%10.5"
 /begin ANNOTATION ANNOTATION_LABEL "Description (coming from AUTOSAR DESC field)"
  /begin ANNOTATION_TEXT "Centre position current for this valve, manually set EOL value.\r\n" /end ANNOTATION_TEXT
 /end ANNOTATION
/end CHARACTERISTIC
/begin CHARACTERISTIC GAC_CALIB.GAC_CURNULLFLWVLVBOBGRAC4 "" VALUE 0x80610C92 DefaultValueRecordLayout_AUTOSAR_Platform_BaseTypes_uint16 5000.0 RB_PT_PCT_SWC_GAC_CompuMethods_ident 0.0 5000. FORMAT "%10.5"
 /begin ANNOTATION ANNOTATION_LABEL "Description (coming from AUTOSAR DESC field)"
  /begin ANNOTATION_TEXT "Centre position current for this valve, manually set EOL value.\r\n" /end ANNOTATION_TEXT
 /end ANNOTATION
/end CHARACTERISTIC
/begin CHARACTERISTIC GAC_CALIB.GAC_CURNULLFLWVLVBOBPLAC "" VALUE 0x80610C94 DefaultValueRecordLayout_AUTOSAR_Platform_BaseTypes_uint16 5000.0 RB_PT_PCT_SWC_GAC_CompuMethods_ident 0.0 5000. FORMAT "%10.5"
 /begin ANNOTATION ANNOTATION_LABEL "Description (coming from AUTOSAR DESC field)"
  /begin ANNOTATION_TEXT "Centre position current for this valve, manually set EOL value.\r\n" /end ANNOTATION_TEXT
 /end ANNOTATION
/end CHARACTERISTIC
/begin CHARACTERISTIC GAC_CALIB.GAC_CURNULLFLWVLVPRELRN "" VALUE 0x80610C96 DefaultValueRecordLayout_AUTOSAR_Platform_BaseTypes_uint16 5000.0 RB_PT_PCT_SWC_GAC_CompuMethods_ident 0.0 5000. FORMAT "%10.5"
 /begin ANNOTATION ANNOTATION_LABEL "Description (coming from AUTOSAR DESC field)"
  /begin ANNOTATION_TEXT "Flow valve centre position current, before it is learnt.\r\n" /end ANNOTATION_TEXT
 /end ANNOTATION
/end CHARACTERISTIC
/begin CHARACTERISTIC GAC_CALIB.GAC_CURPVLVEOLNULLLRN "" VALUE 0x80610C98 DefaultValueRecordLayout_AUTOSAR_Platform_BaseTypes_uint16 5000.0 RB_PT_PCT_SWC_GAC_CompuMethods_ident 0.0 5000. FORMAT "%10.5"
 /begin ANNOTATION ANNOTATION_LABEL "Description (coming from AUTOSAR DESC field)"
  /begin ANNOTATION_TEXT "Current command for the VGP valve during the null learn\r\n" /end ANNOTATION_TEXT
 /end ANNOTATION
/end CHARACTERISTIC
/begin CHARACTERISTIC GAC_CALIB.GAC_EOLNullLearnA.GAC_CURMAXFLWVLVCTRL "" VALUE 0x80610D7E DefaultValueRecordLayout_AUTOSAR_Platform_BaseTypes_uint16 5000.0 RB_PT_PCT_SWC_GAC_CompuMethods_ident 0.0 5000. FORMAT "%10.5"
 /begin ANNOTATION ANNOTATION_LABEL "Description (coming from AUTOSAR DESC field)"
  /begin ANNOTATION_TEXT "Maximum current required for flow valve control during Null learn.\r\n" /end ANNOTATION_TEXT
 /end ANNOTATION
/end CHARACTERISTIC
/begin CHARACTERISTIC GAC_CALIB.GAC_EOLNullLearnA.GAC_CURMINFLWVLVCTRL "" VALUE 0x80610D80 DefaultValueRecordLayout_AUTOSAR_Platform_BaseTypes_uint16 5000.0 RB_PT_PCT_SWC_GAC_CompuMethods_ident 0.0 5000. FORMAT "%10.5"
 /begin ANNOTATION ANNOTATION_LABEL "Description (coming from AUTOSAR DESC field)"
  /begin ANNOTATION_TEXT "Minimum current required for flow valve control during Null learn.\r\n" /end ANNOTATION_TEXT
 /end ANNOTATION
/end CHARACTERISTIC
/begin CHARACTERISTIC GAC_CALIB.GAC_EOLNullLearnA.GAC_CURNULLINIT "" VALUE 0x80610D82 DefaultValueRecordLayout_AUTOSAR_Platform_BaseTypes_uint16 5000.0 RB_PT_PCT_SWC_GAC_CompuMethods_ident 0.0 5000. FORMAT "%10.5"
 /begin ANNOTATION ANNOTATION_LABEL "Description (coming from AUTOSAR DESC field)"
  /begin ANNOTATION_TEXT "Centre position valve current - reset/initialised value.\r\n" /end ANNOTATION_TEXT
 /end ANNOTATION
/end CHARACTERISTIC
/begin CHARACTERISTIC GAC_CALIB.GAC_EOLNullLearnA.GAC_MAXNULLPOSITION "" VALUE 0x80610D84 DefaultValueRecordLayout_AUTOSAR_Platform_BaseTypes_uint16 5000.0 RB_PT_PCT_SWC_GAC_CompuMethods_ident 0.0 5000. FORMAT "%10.5"
 /begin ANNOTATION ANNOTATION_LABEL "Description (coming from AUTOSAR DESC field)"
  /begin ANNOTATION_TEXT "Maximum allowed null adaption control current request.\r\n" /end ANNOTATION_TEXT
 /end ANNOTATION
/end CHARACTERISTIC
/begin CHARACTERISTIC GAC_CALIB.GAC_EOLNullLearnA.GAC_MINNULLPOSITION "" VALUE 0x80610D86 DefaultValueRecordLayout_AUTOSAR_Platform_BaseTypes_uint16 5000.0 RB_PT_PCT_SWC_GAC_CompuMethods_ident 0.0 5000. FORMAT "%10.5"
 /begin ANNOTATION ANNOTATION_LABEL "Description (coming from AUTOSAR DESC field)"
  /begin ANNOTATION_TEXT "Minimum allowed null adaption control current request.\r\n" /end ANNOTATION_TEXT
 /end ANNOTATION
/end CHARACTERISTIC
/begin CHARACTERISTIC GAC_CALIB.GAC_EOLNullLearnA.GAC_MINNULLPOSITIONSTABLETIME "" VALUE 0x80610D88 DefaultValueRecordLayout_AUTOSAR_Platform_BaseTypes_uint16 60.0 RB_PT_PCT_SWC_GAC_CompuMethods_ratio_0p001 0.0 60. FORMAT "%10.5"
 /begin ANNOTATION ANNOTATION_LABEL "Description (coming from AUTOSAR DESC field)"
  /begin ANNOTATION_TEXT "Time above which Neutral stabilisation is considered achieved.\r\n" /end ANNOTATION_TEXT
 /end ANNOTATION
/end CHARACTERISTIC
/begin CHARACTERISTIC GAC_CALIB.GAC_EOLNullLearnA.GAC_MINNULLPOSNDETECTRUNTIME "" VALUE 0x80610D8A DefaultValueRecordLayout_AUTOSAR_Platform_BaseTypes_uint16 60.0 RB_PT_PCT_SWC_GAC_CompuMethods_ratio_0p001 0.0 60. FORMAT "%10.5"
 /begin ANNOTATION ANNOTATION_LABEL "Description (coming from AUTOSAR DESC field)" /begin ANNOTATION_TEXT "Time above which null adaption shall be aborted.\r\n" /end ANNOTATION_TEXT /end ANNOTATION
/end CHARACTERISTIC
/begin CHARACTERISTIC GAC_CALIB.GAC_EOLNullLearnA.GAC_NULLPOSITIONOFFSETTGT "" VALUE 0x80610D8C DefaultValueRecordLayout_AUTOSAR_Platform_BaseTypes_uint16 32.0 RB_PT_PCT_SWC_GAC_CompuMethods_ratio_0p001 0.0 32. FORMAT "%10.5"
 /begin ANNOTATION ANNOTATION_LABEL "Description (coming from AUTOSAR DESC field)"
  /begin ANNOTATION_TEXT "Actuator position beyond which finding lower/upper null point is considered achieved.\r\n" /end ANNOTATION_TEXT
 /end ANNOTATION
/end CHARACTERISTIC
/begin CHARACTERISTIC GAC_CALIB.GAC_EOLNullLearnA.GAC_NULLTGTACHIEVEDTHRES "" VALUE 0x80610D8E DefaultValueRecordLayout_AUTOSAR_Platform_BaseTypes_uint16 32.0 RB_PT_PCT_SWC_GAC_CompuMethods_ratio_0p001 0.0 32. FORMAT "%10.5"
 /begin ANNOTATION ANNOTATION_LABEL "Description (coming from AUTOSAR DESC field)"
  /begin ANNOTATION_TEXT "Actuator position tolerance for considering Neutral Stabilisation assessment.\r\n" /end ANNOTATION_TEXT
 /end ANNOTATION
/end CHARACTERISTIC
/begin CHARACTERISTIC GAC_CALIB.GAC_EOLNullLearnA.GAC_RAMPRATECURRENT "" VALUE 0x80610D94 DefaultValueRecordLayout_AUTOSAR_Platform_BaseTypes_uint8 250.0 RB_PT_PCT_SWC_GAC_CompuMethods_ident 0.0 250. FORMAT "%10.5"
 /begin ANNOTATION ANNOTATION_LABEL "Description (coming from AUTOSAR DESC field)"
  /begin ANNOTATION_TEXT "Current increment during finding of the upper/lower null points.\r\n" /end ANNOTATION_TEXT
 /end ANNOTATION
/end CHARACTERISTIC
/begin CHARACTERISTIC GAC_CALIB.GAC_EOLNullLearnA.GAC_TGTNULLADAPTIGAIN "" VALUE 0x80610D90 DefaultValueRecordLayout_AUTOSAR_Platform_BaseTypes_sint16 10.0 RB_PT_PCT_SWC_GAC_CompuMethods_Ratio_0p001__3 -5. 5. FORMAT "%10.5"
 /begin ANNOTATION ANNOTATION_LABEL "Description (coming from AUTOSAR DESC field)" /begin ANNOTATION_TEXT "Null adapt neutral stabilisation control I gain.\r\n" /end ANNOTATION_TEXT /end ANNOTATION
/end CHARACTERISTIC
/begin CHARACTERISTIC GAC_CALIB.GAC_EOLNullLearnA.GAC_TGTNULLADAPTPGAIN "" VALUE 0x80610D92 DefaultValueRecordLayout_AUTOSAR_Platform_BaseTypes_sint16 10000.0 RB_PT_PCT_SWC_GAC_CompuMethods_ident -5000. 5000. FORMAT "%10.5"
 /begin ANNOTATION ANNOTATION_LABEL "Description (coming from AUTOSAR DESC field)" /begin ANNOTATION_TEXT "Null adapt neutral stabilisation control P gain.\r\n" /end ANNOTATION_TEXT /end ANNOTATION
/end CHARACTERISTIC
/begin CHARACTERISTIC GAC_CALIB.GAC_EOLNullLearnB.GAC_CURMAXFLWVLVCTRL "" VALUE 0x80610D96 DefaultValueRecordLayout_AUTOSAR_Platform_BaseTypes_uint16 5000.0 RB_PT_PCT_SWC_GAC_CompuMethods_ident 0.0 5000. FORMAT "%10.5"
 /begin ANNOTATION ANNOTATION_LABEL "Description (coming from AUTOSAR DESC field)"
  /begin ANNOTATION_TEXT "Maximum current required for flow valve control during Null learn.\r\n" /end ANNOTATION_TEXT
 /end ANNOTATION
/end CHARACTERISTIC
/begin CHARACTERISTIC GAC_CALIB.GAC_EOLNullLearnB.GAC_CURMINFLWVLVCTRL "" VALUE 0x80610D98 DefaultValueRecordLayout_AUTOSAR_Platform_BaseTypes_uint16 5000.0 RB_PT_PCT_SWC_GAC_CompuMethods_ident 0.0 5000. FORMAT "%10.5"
 /begin ANNOTATION ANNOTATION_LABEL "Description (coming from AUTOSAR DESC field)"
  /begin ANNOTATION_TEXT "Minimum current required for flow valve control during Null learn.\r\n" /end ANNOTATION_TEXT
 /end ANNOTATION
/end CHARACTERISTIC
/begin CHARACTERISTIC GAC_CALIB.GAC_EOLNullLearnB.GAC_CURNULLINIT "" VALUE 0x80610D9A DefaultValueRecordLayout_AUTOSAR_Platform_BaseTypes_uint16 5000.0 RB_PT_PCT_SWC_GAC_CompuMethods_ident 0.0 5000. FORMAT "%10.5"
 /begin ANNOTATION ANNOTATION_LABEL "Description (coming from AUTOSAR DESC field)"
  /begin ANNOTATION_TEXT "Centre position valve current - reset/initialised value.\r\n" /end ANNOTATION_TEXT
 /end ANNOTATION
/end CHARACTERISTIC
/begin CHARACTERISTIC GAC_CALIB.GAC_EOLNullLearnB.GAC_MAXNULLPOSITION "" VALUE 0x80610D9C DefaultValueRecordLayout_AUTOSAR_Platform_BaseTypes_uint16 5000.0 RB_PT_PCT_SWC_GAC_CompuMethods_ident 0.0 5000. FORMAT "%10.5"
 /begin ANNOTATION ANNOTATION_LABEL "Description (coming from AUTOSAR DESC field)"
  /begin ANNOTATION_TEXT "Maximum allowed null adaption control current request.\r\n" /end ANNOTATION_TEXT
 /end ANNOTATION
/end CHARACTERISTIC
/begin CHARACTERISTIC GAC_CALIB.GAC_EOLNullLearnB.GAC_MINNULLPOSITION "" VALUE 0x80610D9E DefaultValueRecordLayout_AUTOSAR_Platform_BaseTypes_uint16 5000.0 RB_PT_PCT_SWC_GAC_CompuMethods_ident 0.0 5000. FORMAT "%10.5"
 /begin ANNOTATION ANNOTATION_LABEL "Description (coming from AUTOSAR DESC field)"
  /begin ANNOTATION_TEXT "Minimum allowed null adaption control current request.\r\n" /end ANNOTATION_TEXT
 /end ANNOTATION
/end CHARACTERISTIC
/begin CHARACTERISTIC GAC_CALIB.GAC_EOLNullLearnB.GAC_MINNULLPOSITIONSTABLETIME "" VALUE 0x80610DA0 DefaultValueRecordLayout_AUTOSAR_Platform_BaseTypes_uint16 60.0 RB_PT_PCT_SWC_GAC_CompuMethods_ratio_0p001 0.0 60. FORMAT "%10.5"
 /begin ANNOTATION ANNOTATION_LABEL "Description (coming from AUTOSAR DESC field)"
  /begin ANNOTATION_TEXT "Time above which Neutral stabilisation is considered achieved.\r\n" /end ANNOTATION_TEXT
 /end ANNOTATION
/end CHARACTERISTIC
/begin CHARACTERISTIC GAC_CALIB.GAC_EOLNullLearnB.GAC_MINNULLPOSNDETECTRUNTIME "" VALUE 0x80610DA2 DefaultValueRecordLayout_AUTOSAR_Platform_BaseTypes_uint16 60.0 RB_PT_PCT_SWC_GAC_CompuMethods_ratio_0p001 0.0 60. FORMAT "%10.5"
 /begin ANNOTATION ANNOTATION_LABEL "Description (coming from AUTOSAR DESC field)" /begin ANNOTATION_TEXT "Time above which null adaption shall be aborted.\r\n" /end ANNOTATION_TEXT /end ANNOTATION
/end CHARACTERISTIC
/begin CHARACTERISTIC GAC_CALIB.GAC_EOLNullLearnB.GAC_NULLPOSITIONOFFSETTGT "" VALUE 0x80610DA4 DefaultValueRecordLayout_AUTOSAR_Platform_BaseTypes_uint16 32.0 RB_PT_PCT_SWC_GAC_CompuMethods_ratio_0p001 0.0 32. FORMAT "%10.5"
 /begin ANNOTATION ANNOTATION_LABEL "Description (coming from AUTOSAR DESC field)"
  /begin ANNOTATION_TEXT "Actuator position beyond which finding lower/upper null point is considered achieved.\r\n" /end ANNOTATION_TEXT
 /end ANNOTATION
/end CHARACTERISTIC
/begin CHARACTERISTIC GAC_CALIB.GAC_EOLNullLearnB.GAC_NULLTGTACHIEVEDTHRES "" VALUE 0x80610DA6 DefaultValueRecordLayout_AUTOSAR_Platform_BaseTypes_uint16 32.0 RB_PT_PCT_SWC_GAC_CompuMethods_ratio_0p001 0.0 32. FORMAT "%10.5"
 /begin ANNOTATION ANNOTATION_LABEL "Description (coming from AUTOSAR DESC field)"
  /begin ANNOTATION_TEXT "Actuator position tolerance for considering Neutral Stabilisation assessment.\r\n" /end ANNOTATION_TEXT
 /end ANNOTATION
/end CHARACTERISTIC
/begin CHARACTERISTIC GAC_CALIB.GAC_EOLNullLearnB.GAC_RAMPRATECURRENT "" VALUE 0x80610DAC DefaultValueRecordLayout_AUTOSAR_Platform_BaseTypes_uint8 250.0 RB_PT_PCT_SWC_GAC_CompuMethods_ident 0.0 250. FORMAT "%10.5"
 /begin ANNOTATION ANNOTATION_LABEL "Description (coming from AUTOSAR DESC field)"
  /begin ANNOTATION_TEXT "Current increment during finding of the upper/lower null points.\r\n" /end ANNOTATION_TEXT
 /end ANNOTATION
/end CHARACTERISTIC
/begin CHARACTERISTIC GAC_CALIB.GAC_EOLNullLearnB.GAC_TGTNULLADAPTIGAIN "" VALUE 0x80610DA8 DefaultValueRecordLayout_AUTOSAR_Platform_BaseTypes_sint16 10.0 RB_PT_PCT_SWC_GAC_CompuMethods_Ratio_0p001__3 -5. 5. FORMAT "%10.5"
 /begin ANNOTATION ANNOTATION_LABEL "Description (coming from AUTOSAR DESC field)" /begin ANNOTATION_TEXT "Null adapt neutral stabilisation control I gain.\r\n" /end ANNOTATION_TEXT /end ANNOTATION
/end CHARACTERISTIC
/begin CHARACTERISTIC GAC_CALIB.GAC_EOLNullLearnB.GAC_TGTNULLADAPTPGAIN "" VALUE 0x80610DAA DefaultValueRecordLayout_AUTOSAR_Platform_BaseTypes_sint16 10000.0 RB_PT_PCT_SWC_GAC_CompuMethods_ident -5000. 5000. FORMAT "%10.5"
 /begin ANNOTATION ANNOTATION_LABEL "Description (coming from AUTOSAR DESC field)" /begin ANNOTATION_TEXT "Null adapt neutral stabilisation control P gain.\r\n" /end ANNOTATION_TEXT /end ANNOTATION
/end CHARACTERISTIC
/begin CHARACTERISTIC GAC_CALIB.GAC_EOLNullLearnC.GAC_CURMAXFLWVLVCTRL "" VALUE 0x80610DAE DefaultValueRecordLayout_AUTOSAR_Platform_BaseTypes_uint16 5000.0 RB_PT_PCT_SWC_GAC_CompuMethods_ident 0.0 5000. FORMAT "%10.5"
 /begin ANNOTATION ANNOTATION_LABEL "Description (coming from AUTOSAR DESC field)"
  /begin ANNOTATION_TEXT "Maximum current required for flow valve control during Null learn.\r\n" /end ANNOTATION_TEXT
 /end ANNOTATION
/end CHARACTERISTIC
/begin CHARACTERISTIC GAC_CALIB.GAC_EOLNullLearnC.GAC_CURMINFLWVLVCTRL "" VALUE 0x80610DB0 DefaultValueRecordLayout_AUTOSAR_Platform_BaseTypes_uint16 5000.0 RB_PT_PCT_SWC_GAC_CompuMethods_ident 0.0 5000. FORMAT "%10.5"
 /begin ANNOTATION ANNOTATION_LABEL "Description (coming from AUTOSAR DESC field)"
  /begin ANNOTATION_TEXT "Minimum current required for flow valve control during Null learn.\r\n" /end ANNOTATION_TEXT
 /end ANNOTATION
/end CHARACTERISTIC
/begin CHARACTERISTIC GAC_CALIB.GAC_EOLNullLearnC.GAC_CURNULLINIT "" VALUE 0x80610DB2 DefaultValueRecordLayout_AUTOSAR_Platform_BaseTypes_uint16 5000.0 RB_PT_PCT_SWC_GAC_CompuMethods_ident 0.0 5000. FORMAT "%10.5"
 /begin ANNOTATION ANNOTATION_LABEL "Description (coming from AUTOSAR DESC field)"
  /begin ANNOTATION_TEXT "Centre position valve current - reset/initialised value.\r\n" /end ANNOTATION_TEXT
 /end ANNOTATION
/end CHARACTERISTIC
/begin CHARACTERISTIC GAC_CALIB.GAC_EOLNullLearnC.GAC_MAXNULLPOSITION "" VALUE 0x80610DB4 DefaultValueRecordLayout_AUTOSAR_Platform_BaseTypes_uint16 5000.0 RB_PT_PCT_SWC_GAC_CompuMethods_ident 0.0 5000. FORMAT "%10.5"
 /begin ANNOTATION ANNOTATION_LABEL "Description (coming from AUTOSAR DESC field)"
  /begin ANNOTATION_TEXT "Maximum allowed null adaption control current request.\r\n" /end ANNOTATION_TEXT
 /end ANNOTATION
/end CHARACTERISTIC
/begin CHARACTERISTIC GAC_CALIB.GAC_EOLNullLearnC.GAC_MINNULLPOSITION "" VALUE 0x80610DB6 DefaultValueRecordLayout_AUTOSAR_Platform_BaseTypes_uint16 5000.0 RB_PT_PCT_SWC_GAC_CompuMethods_ident 0.0 5000. FORMAT "%10.5"
 /begin ANNOTATION ANNOTATION_LABEL "Description (coming from AUTOSAR DESC field)"
  /begin ANNOTATION_TEXT "Minimum allowed null adaption control current request.\r\n" /end ANNOTATION_TEXT
 /end ANNOTATION
/end CHARACTERISTIC
/begin CHARACTERISTIC GAC_CALIB.GAC_EOLNullLearnC.GAC_MINNULLPOSITIONSTABLETIME "" VALUE 0x80610DB8 DefaultValueRecordLayout_AUTOSAR_Platform_BaseTypes_uint16 60.0 RB_PT_PCT_SWC_GAC_CompuMethods_ratio_0p001 0.0 60. FORMAT "%10.5"
 /begin ANNOTATION ANNOTATION_LABEL "Description (coming from AUTOSAR DESC field)"
  /begin ANNOTATION_TEXT "Time above which Neutral stabilisation is considered achieved.\r\n" /end ANNOTATION_TEXT
 /end ANNOTATION
/end CHARACTERISTIC
/begin CHARACTERISTIC GAC_CALIB.GAC_EOLNullLearnC.GAC_MINNULLPOSNDETECTRUNTIME "" VALUE 0x80610DBA DefaultValueRecordLayout_AUTOSAR_Platform_BaseTypes_uint16 60.0 RB_PT_PCT_SWC_GAC_CompuMethods_ratio_0p001 0.0 60. FORMAT "%10.5"
 /begin ANNOTATION ANNOTATION_LABEL "Description (coming from AUTOSAR DESC field)" /begin ANNOTATION_TEXT "Time above which null adaption shall be aborted.\r\n" /end ANNOTATION_TEXT /end ANNOTATION
/end CHARACTERISTIC
/begin CHARACTERISTIC GAC_CALIB.GAC_EOLNullLearnC.GAC_NULLPOSITIONOFFSETTGT "" VALUE 0x80610DBC DefaultValueRecordLayout_AUTOSAR_Platform_BaseTypes_uint16 32.0 RB_PT_PCT_SWC_GAC_CompuMethods_ratio_0p001 0.0 32. FORMAT "%10.5"
 /begin ANNOTATION ANNOTATION_LABEL "Description (coming from AUTOSAR DESC field)"
  /begin ANNOTATION_TEXT "Actuator position beyond which finding lower/upper null point is considered achieved.\r\n" /end ANNOTATION_TEXT
 /end ANNOTATION
/end CHARACTERISTIC
/begin CHARACTERISTIC GAC_CALIB.GAC_EOLNullLearnC.GAC_NULLTGTACHIEVEDTHRES "" VALUE 0x80610DBE DefaultValueRecordLayout_AUTOSAR_Platform_BaseTypes_uint16 32.0 RB_PT_PCT_SWC_GAC_CompuMethods_ratio_0p001 0.0 32. FORMAT "%10.5"
 /begin ANNOTATION ANNOTATION_LABEL "Description (coming from AUTOSAR DESC field)"
  /begin ANNOTATION_TEXT "Actuator position tolerance for considering Neutral Stabilisation assessment.\r\n" /end ANNOTATION_TEXT
 /end ANNOTATION
/end CHARACTERISTIC
/begin CHARACTERISTIC GAC_CALIB.GAC_EOLNullLearnC.GAC_RAMPRATECURRENT "" VALUE 0x80610DC4 DefaultValueRecordLayout_AUTOSAR_Platform_BaseTypes_uint8 250.0 RB_PT_PCT_SWC_GAC_CompuMethods_ident 0.0 250. FORMAT "%10.5"
 /begin ANNOTATION ANNOTATION_LABEL "Description (coming from AUTOSAR DESC field)"
  /begin ANNOTATION_TEXT "Current increment during finding of the upper/lower null points.\r\n" /end ANNOTATION_TEXT
 /end ANNOTATION
/end CHARACTERISTIC
/begin CHARACTERISTIC GAC_CALIB.GAC_EOLNullLearnC.GAC_TGTNULLADAPTIGAIN "" VALUE 0x80610DC0 DefaultValueRecordLayout_AUTOSAR_Platform_BaseTypes_sint16 10.0 RB_PT_PCT_SWC_GAC_CompuMethods_Ratio_0p001__3 -5. 5. FORMAT "%10.5"
 /begin ANNOTATION ANNOTATION_LABEL "Description (coming from AUTOSAR DESC field)" /begin ANNOTATION_TEXT "Null adapt neutral stabilisation control I gain.\r\n" /end ANNOTATION_TEXT /end ANNOTATION
/end CHARACTERISTIC
/begin CHARACTERISTIC GAC_CALIB.GAC_EOLNullLearnC.GAC_TGTNULLADAPTPGAIN "" VALUE 0x80610DC2 DefaultValueRecordLayout_AUTOSAR_Platform_BaseTypes_sint16 10000.0 RB_PT_PCT_SWC_GAC_CompuMethods_ident -5000. 5000. FORMAT "%10.5"
 /begin ANNOTATION ANNOTATION_LABEL "Description (coming from AUTOSAR DESC field)" /begin ANNOTATION_TEXT "Null adapt neutral stabilisation control P gain.\r\n" /end ANNOTATION_TEXT /end ANNOTATION
/end CHARACTERISTIC
/begin CHARACTERISTIC GAC_CALIB.GAC_EOLNullLearnD.GAC_CURMAXFLWVLVCTRL "" VALUE 0x80610DC6 DefaultValueRecordLayout_AUTOSAR_Platform_BaseTypes_uint16 5000.0 RB_PT_PCT_SWC_GAC_CompuMethods_ident 0.0 5000. FORMAT "%10.5"
 /begin ANNOTATION ANNOTATION_LABEL "Description (coming from AUTOSAR DESC field)"
  /begin ANNOTATION_TEXT "Maximum current required for flow valve control during Null learn.\r\n" /end ANNOTATION_TEXT
 /end ANNOTATION
/end CHARACTERISTIC
/begin CHARACTERISTIC GAC_CALIB.GAC_EOLNullLearnD.GAC_CURMINFLWVLVCTRL "" VALUE 0x80610DC8 DefaultValueRecordLayout_AUTOSAR_Platform_BaseTypes_uint16 5000.0 RB_PT_PCT_SWC_GAC_CompuMethods_ident 0.0 5000. FORMAT "%10.5"
 /begin ANNOTATION ANNOTATION_LABEL "Description (coming from AUTOSAR DESC field)"
  /begin ANNOTATION_TEXT "Minimum current required for flow valve control during Null learn.\r\n" /end ANNOTATION_TEXT
 /end ANNOTATION
/end CHARACTERISTIC
/begin CHARACTERISTIC GAC_CALIB.GAC_EOLNullLearnD.GAC_CURNULLINIT "" VALUE 0x80610DCA DefaultValueRecordLayout_AUTOSAR_Platform_BaseTypes_uint16 5000.0 RB_PT_PCT_SWC_GAC_CompuMethods_ident 0.0 5000. FORMAT "%10.5"
 /begin ANNOTATION ANNOTATION_LABEL "Description (coming from AUTOSAR DESC field)"
  /begin ANNOTATION_TEXT "Centre position valve current - reset/initialised value.\r\n" /end ANNOTATION_TEXT
 /end ANNOTATION
/end CHARACTERISTIC
/begin CHARACTERISTIC GAC_CALIB.GAC_EOLNullLearnD.GAC_MAXNULLPOSITION "" VALUE 0x80610DCC DefaultValueRecordLayout_AUTOSAR_Platform_BaseTypes_uint16 5000.0 RB_PT_PCT_SWC_GAC_CompuMethods_ident 0.0 5000. FORMAT "%10.5"
 /begin ANNOTATION ANNOTATION_LABEL "Description (coming from AUTOSAR DESC field)"
  /begin ANNOTATION_TEXT "Maximum allowed null adaption control current request.\r\n" /end ANNOTATION_TEXT
 /end ANNOTATION
/end CHARACTERISTIC
/begin CHARACTERISTIC GAC_CALIB.GAC_EOLNullLearnD.GAC_MINNULLPOSITION "" VALUE 0x80610DCE DefaultValueRecordLayout_AUTOSAR_Platform_BaseTypes_uint16 5000.0 RB_PT_PCT_SWC_GAC_CompuMethods_ident 0.0 5000. FORMAT "%10.5"
 /begin ANNOTATION ANNOTATION_LABEL "Description (coming from AUTOSAR DESC field)"
  /begin ANNOTATION_TEXT "Minimum allowed null adaption control current request.\r\n" /end ANNOTATION_TEXT
 /end ANNOTATION
/end CHARACTERISTIC
/begin CHARACTERISTIC GAC_CALIB.GAC_EOLNullLearnD.GAC_MINNULLPOSITIONSTABLETIME "" VALUE 0x80610DD0 DefaultValueRecordLayout_AUTOSAR_Platform_BaseTypes_uint16 60.0 RB_PT_PCT_SWC_GAC_CompuMethods_ratio_0p001 0.0 60. FORMAT "%10.5"
 /begin ANNOTATION ANNOTATION_LABEL "Description (coming from AUTOSAR DESC field)"
  /begin ANNOTATION_TEXT "Time above which Neutral stabilisation is considered achieved.\r\n" /end ANNOTATION_TEXT
 /end ANNOTATION
/end CHARACTERISTIC
/begin CHARACTERISTIC GAC_CALIB.GAC_EOLNullLearnD.GAC_MINNULLPOSNDETECTRUNTIME "" VALUE 0x80610DD2 DefaultValueRecordLayout_AUTOSAR_Platform_BaseTypes_uint16 60.0 RB_PT_PCT_SWC_GAC_CompuMethods_ratio_0p001 0.0 60. FORMAT "%10.5"
 /begin ANNOTATION ANNOTATION_LABEL "Description (coming from AUTOSAR DESC field)" /begin ANNOTATION_TEXT "Time above which null adaption shall be aborted.\r\n" /end ANNOTATION_TEXT /end ANNOTATION
/end CHARACTERISTIC
/begin CHARACTERISTIC GAC_CALIB.GAC_EOLNullLearnD.GAC_NULLPOSITIONOFFSETTGT "" VALUE 0x80610DD4 DefaultValueRecordLayout_AUTOSAR_Platform_BaseTypes_uint16 32.0 RB_PT_PCT_SWC_GAC_CompuMethods_ratio_0p001 0.0 32. FORMAT "%10.5"
 /begin ANNOTATION ANNOTATION_LABEL "Description (coming from AUTOSAR DESC field)"
  /begin ANNOTATION_TEXT "Actuator position beyond which finding lower/upper null point is considered achieved.\r\n" /end ANNOTATION_TEXT
 /end ANNOTATION
/end CHARACTERISTIC
/begin CHARACTERISTIC GAC_CALIB.GAC_EOLNullLearnD.GAC_NULLTGTACHIEVEDTHRES "" VALUE 0x80610DD6 DefaultValueRecordLayout_AUTOSAR_Platform_BaseTypes_uint16 32.0 RB_PT_PCT_SWC_GAC_CompuMethods_ratio_0p001 0.0 32. FORMAT "%10.5"
 /begin ANNOTATION ANNOTATION_LABEL "Description (coming from AUTOSAR DESC field)"
  /begin ANNOTATION_TEXT "Actuator position tolerance for considering Neutral Stabilisation assessment.\r\n" /end ANNOTATION_TEXT
 /end ANNOTATION
/end CHARACTERISTIC
/begin CHARACTERISTIC GAC_CALIB.GAC_EOLNullLearnD.GAC_RAMPRATECURRENT "" VALUE 0x80610DDC DefaultValueRecordLayout_AUTOSAR_Platform_BaseTypes_uint8 250.0 RB_PT_PCT_SWC_GAC_CompuMethods_ident 0.0 250. FORMAT "%10.5"
 /begin ANNOTATION ANNOTATION_LABEL "Description (coming from AUTOSAR DESC field)"
  /begin ANNOTATION_TEXT "Current increment during finding of the upper/lower null points.\r\n" /end ANNOTATION_TEXT
 /end ANNOTATION
/end CHARACTERISTIC
/begin CHARACTERISTIC GAC_CALIB.GAC_EOLNullLearnD.GAC_TGTNULLADAPTIGAIN "" VALUE 0x80610DD8 DefaultValueRecordLayout_AUTOSAR_Platform_BaseTypes_sint16 10.0 RB_PT_PCT_SWC_GAC_CompuMethods_Ratio_0p001__3 -5. 5. FORMAT "%10.5"
 /begin ANNOTATION ANNOTATION_LABEL "Description (coming from AUTOSAR DESC field)" /begin ANNOTATION_TEXT "Null adapt neutral stabilisation control I gain.\r\n" /end ANNOTATION_TEXT /end ANNOTATION
/end CHARACTERISTIC
/begin CHARACTERISTIC GAC_CALIB.GAC_EOLNullLearnD.GAC_TGTNULLADAPTPGAIN "" VALUE 0x80610DDA DefaultValueRecordLayout_AUTOSAR_Platform_BaseTypes_sint16 10000.0 RB_PT_PCT_SWC_GAC_CompuMethods_ident -5000. 5000. FORMAT "%10.5"
 /begin ANNOTATION ANNOTATION_LABEL "Description (coming from AUTOSAR DESC field)" /begin ANNOTATION_TEXT "Null adapt neutral stabilisation control P gain.\r\n" /end ANNOTATION_TEXT /end ANNOTATION
/end CHARACTERISTIC
/begin CHARACTERISTIC GAC_CALIB.GAC_EOLNullLearnF.GAC_CURMAXFLWVLVCTRL "" VALUE 0x80610DDE DefaultValueRecordLayout_AUTOSAR_Platform_BaseTypes_uint16 5000.0 RB_PT_PCT_SWC_GAC_CompuMethods_ident 0.0 5000. FORMAT "%10.5"
 /begin ANNOTATION ANNOTATION_LABEL "Description (coming from AUTOSAR DESC field)"
  /begin ANNOTATION_TEXT "Maximum current required for flow valve control during Null learn.\r\n" /end ANNOTATION_TEXT
 /end ANNOTATION
/end CHARACTERISTIC
/begin CHARACTERISTIC GAC_CALIB.GAC_EOLNullLearnF.GAC_CURMINFLWVLVCTRL "" VALUE 0x80610DE0 DefaultValueRecordLayout_AUTOSAR_Platform_BaseTypes_uint16 5000.0 RB_PT_PCT_SWC_GAC_CompuMethods_ident 0.0 5000. FORMAT "%10.5"
 /begin ANNOTATION ANNOTATION_LABEL "Description (coming from AUTOSAR DESC field)"
  /begin ANNOTATION_TEXT "Minimum current required for flow valve control during Null learn.\r\n" /end ANNOTATION_TEXT
 /end ANNOTATION
/end CHARACTERISTIC
/begin CHARACTERISTIC GAC_CALIB.GAC_EOLNullLearnF.GAC_CURNULLINIT "" VALUE 0x80610DE2 DefaultValueRecordLayout_AUTOSAR_Platform_BaseTypes_uint16 5000.0 RB_PT_PCT_SWC_GAC_CompuMethods_ident 0.0 5000. FORMAT "%10.5"
 /begin ANNOTATION ANNOTATION_LABEL "Description (coming from AUTOSAR DESC field)"
  /begin ANNOTATION_TEXT "Centre position valve current - reset/initialised value.\r\n" /end ANNOTATION_TEXT
 /end ANNOTATION
/end CHARACTERISTIC
/begin CHARACTERISTIC GAC_CALIB.GAC_EOLNullLearnF.GAC_MAXNULLPOSITION "" VALUE 0x80610DE4 DefaultValueRecordLayout_AUTOSAR_Platform_BaseTypes_uint16 5000.0 RB_PT_PCT_SWC_GAC_CompuMethods_ident 0.0 5000. FORMAT "%10.5"
 /begin ANNOTATION ANNOTATION_LABEL "Description (coming from AUTOSAR DESC field)"
  /begin ANNOTATION_TEXT "Maximum allowed null adaption control current request.\r\n" /end ANNOTATION_TEXT
 /end ANNOTATION
/end CHARACTERISTIC
/begin CHARACTERISTIC GAC_CALIB.GAC_EOLNullLearnF.GAC_MINNULLPOSITION "" VALUE 0x80610DE6 DefaultValueRecordLayout_AUTOSAR_Platform_BaseTypes_uint16 5000.0 RB_PT_PCT_SWC_GAC_CompuMethods_ident 0.0 5000. FORMAT "%10.5"
 /begin ANNOTATION ANNOTATION_LABEL "Description (coming from AUTOSAR DESC field)"
  /begin ANNOTATION_TEXT "Minimum allowed null adaption control current request.\r\n" /end ANNOTATION_TEXT
 /end ANNOTATION
/end CHARACTERISTIC
/begin CHARACTERISTIC GAC_CALIB.GAC_EOLNullLearnF.GAC_MINNULLPOSITIONSTABLETIME "" VALUE 0x80610DE8 DefaultValueRecordLayout_AUTOSAR_Platform_BaseTypes_uint16 60.0 RB_PT_PCT_SWC_GAC_CompuMethods_ratio_0p001 0.0 60. FORMAT "%10.5"
 /begin ANNOTATION ANNOTATION_LABEL "Description (coming from AUTOSAR DESC field)"
  /begin ANNOTATION_TEXT "Time above which Neutral stabilisation is considered achieved.\r\n" /end ANNOTATION_TEXT
 /end ANNOTATION
/end CHARACTERISTIC
/begin CHARACTERISTIC GAC_CALIB.GAC_EOLNullLearnF.GAC_MINNULLPOSNDETECTRUNTIME "" VALUE 0x80610DEA DefaultValueRecordLayout_AUTOSAR_Platform_BaseTypes_uint16 60.0 RB_PT_PCT_SWC_GAC_CompuMethods_ratio_0p001 0.0 60. FORMAT "%10.5"
 /begin ANNOTATION ANNOTATION_LABEL "Description (coming from AUTOSAR DESC field)" /begin ANNOTATION_TEXT "Time above which null adaption shall be aborted.\r\n" /end ANNOTATION_TEXT /end ANNOTATION
/end CHARACTERISTIC
/begin CHARACTERISTIC GAC_CALIB.GAC_EOLNullLearnF.GAC_NULLPOSITIONOFFSETTGT "" VALUE 0x80610DEC DefaultValueRecordLayout_AUTOSAR_Platform_BaseTypes_uint16 32.0 RB_PT_PCT_SWC_GAC_CompuMethods_ratio_0p001 0.0 32. FORMAT "%10.5"
 /begin ANNOTATION ANNOTATION_LABEL "Description (coming from AUTOSAR DESC field)"
  /begin ANNOTATION_TEXT "Actuator position beyond which finding lower/upper null point is considered achieved.\r\n" /end ANNOTATION_TEXT
 /end ANNOTATION
/end CHARACTERISTIC
/begin CHARACTERISTIC GAC_CALIB.GAC_EOLNullLearnF.GAC_NULLTGTACHIEVEDTHRES "" VALUE 0x80610DEE DefaultValueRecordLayout_AUTOSAR_Platform_BaseTypes_uint16 32.0 RB_PT_PCT_SWC_GAC_CompuMethods_ratio_0p001 0.0 32. FORMAT "%10.5"
 /begin ANNOTATION ANNOTATION_LABEL "Description (coming from AUTOSAR DESC field)"
  /begin ANNOTATION_TEXT "Actuator position tolerance for considering Neutral Stabilisation assessment.\r\n" /end ANNOTATION_TEXT
 /end ANNOTATION
/end CHARACTERISTIC
/begin CHARACTERISTIC GAC_CALIB.GAC_EOLNullLearnF.GAC_RAMPRATECURRENT "" VALUE 0x80610DF4 DefaultValueRecordLayout_AUTOSAR_Platform_BaseTypes_uint8 250.0 RB_PT_PCT_SWC_GAC_CompuMethods_ident 0.0 250. FORMAT "%10.5"
 /begin ANNOTATION ANNOTATION_LABEL "Description (coming from AUTOSAR DESC field)"
  /begin ANNOTATION_TEXT "Current increment during finding of the upper/lower null points.\r\n" /end ANNOTATION_TEXT
 /end ANNOTATION
/end CHARACTERISTIC
/begin CHARACTERISTIC GAC_CALIB.GAC_EOLNullLearnF.GAC_TGTNULLADAPTIGAIN "" VALUE 0x80610DF0 DefaultValueRecordLayout_AUTOSAR_Platform_BaseTypes_sint16 10.0 RB_PT_PCT_SWC_GAC_CompuMethods_Ratio_0p001__3 -5. 5. FORMAT "%10.5"
 /begin ANNOTATION ANNOTATION_LABEL "Description (coming from AUTOSAR DESC field)" /begin ANNOTATION_TEXT "Null adapt neutral stabilisation control I gain.\r\n" /end ANNOTATION_TEXT /end ANNOTATION
/end CHARACTERISTIC
/begin CHARACTERISTIC GAC_CALIB.GAC_EOLNullLearnF.GAC_TGTNULLADAPTPGAIN "" VALUE 0x80610DF2 DefaultValueRecordLayout_AUTOSAR_Platform_BaseTypes_sint16 10000.0 RB_PT_PCT_SWC_GAC_CompuMethods_ident -5000. 5000. FORMAT "%10.5"
 /begin ANNOTATION ANNOTATION_LABEL "Description (coming from AUTOSAR DESC field)" /begin ANNOTATION_TEXT "Null adapt neutral stabilisation control P gain.\r\n" /end ANNOTATION_TEXT /end ANNOTATION
/end CHARACTERISTIC
/begin CHARACTERISTIC GAC_CALIB.GAC_EOLNullLearnPrk.GAC_CURMAXFLWVLVCTRL "" VALUE 0x80610DF6 DefaultValueRecordLayout_AUTOSAR_Platform_BaseTypes_uint16 5000.0 RB_PT_PCT_SWC_GAC_CompuMethods_ident 0.0 5000. FORMAT "%10.5"
 /begin ANNOTATION ANNOTATION_LABEL "Description (coming from AUTOSAR DESC field)"
  /begin ANNOTATION_TEXT "Maximum current required for flow valve control during Null learn.\r\n" /end ANNOTATION_TEXT
 /end ANNOTATION
/end CHARACTERISTIC
/begin CHARACTERISTIC GAC_CALIB.GAC_EOLNullLearnPrk.GAC_CURMINFLWVLVCTRL "" VALUE 0x80610DF8 DefaultValueRecordLayout_AUTOSAR_Platform_BaseTypes_uint16 5000.0 RB_PT_PCT_SWC_GAC_CompuMethods_ident 0.0 5000. FORMAT "%10.5"
 /begin ANNOTATION ANNOTATION_LABEL "Description (coming from AUTOSAR DESC field)"
  /begin ANNOTATION_TEXT "Minimum current required for flow valve control during Null learn.\r\n" /end ANNOTATION_TEXT
 /end ANNOTATION
/end CHARACTERISTIC
/begin CHARACTERISTIC GAC_CALIB.GAC_EOLNullLearnPrk.GAC_CURNULLINIT "" VALUE 0x80610DFA DefaultValueRecordLayout_AUTOSAR_Platform_BaseTypes_uint16 5000.0 RB_PT_PCT_SWC_GAC_CompuMethods_ident 0.0 5000. FORMAT "%10.5"
 /begin ANNOTATION ANNOTATION_LABEL "Description (coming from AUTOSAR DESC field)"
  /begin ANNOTATION_TEXT "Centre position valve current - reset/initialised value.\r\n" /end ANNOTATION_TEXT
 /end ANNOTATION
/end CHARACTERISTIC
/begin CHARACTERISTIC GAC_CALIB.GAC_EOLNullLearnPrk.GAC_MAXNULLPOSITION "" VALUE 0x80610DFC DefaultValueRecordLayout_AUTOSAR_Platform_BaseTypes_uint16 5000.0 RB_PT_PCT_SWC_GAC_CompuMethods_ident 0.0 5000. FORMAT "%10.5"
 /begin ANNOTATION ANNOTATION_LABEL "Description (coming from AUTOSAR DESC field)"
  /begin ANNOTATION_TEXT "Maximum allowed null adaption control current request.\r\n" /end ANNOTATION_TEXT
 /end ANNOTATION
/end CHARACTERISTIC
/begin CHARACTERISTIC GAC_CALIB.GAC_EOLNullLearnPrk.GAC_MINNULLPOSITION "" VALUE 0x80610DFE DefaultValueRecordLayout_AUTOSAR_Platform_BaseTypes_uint16 5000.0 RB_PT_PCT_SWC_GAC_CompuMethods_ident 0.0 5000. FORMAT "%10.5"
 /begin ANNOTATION ANNOTATION_LABEL "Description (coming from AUTOSAR DESC field)"
  /begin ANNOTATION_TEXT "Minimum allowed null adaption control current request.\r\n" /end ANNOTATION_TEXT
 /end ANNOTATION
/end CHARACTERISTIC
/begin CHARACTERISTIC GAC_CALIB.GAC_EOLNullLearnPrk.GAC_MINNULLPOSITIONSTABLETIME "" VALUE 0x80610E00 DefaultValueRecordLayout_AUTOSAR_Platform_BaseTypes_uint16 60.0 RB_PT_PCT_SWC_GAC_CompuMethods_ratio_0p001 0.0 60. FORMAT "%10.5"
 /begin ANNOTATION ANNOTATION_LABEL "Description (coming from AUTOSAR DESC field)"
  /begin ANNOTATION_TEXT "Time above which Neutral stabilisation is considered achieved.\r\n" /end ANNOTATION_TEXT
 /end ANNOTATION
/end CHARACTERISTIC
/begin CHARACTERISTIC GAC_CALIB.GAC_EOLNullLearnPrk.GAC_MINNULLPOSNDETECTRUNTIME "" VALUE 0x80610E02 DefaultValueRecordLayout_AUTOSAR_Platform_BaseTypes_uint16 60.0 RB_PT_PCT_SWC_GAC_CompuMethods_ratio_0p001 0.0 60. FORMAT "%10.5"
 /begin ANNOTATION ANNOTATION_LABEL "Description (coming from AUTOSAR DESC field)" /begin ANNOTATION_TEXT "Time above which null adaption shall be aborted.\r\n" /end ANNOTATION_TEXT /end ANNOTATION
/end CHARACTERISTIC
/begin CHARACTERISTIC GAC_CALIB.GAC_EOLNullLearnPrk.GAC_NULLPOSITIONOFFSETTGT "" VALUE 0x80610E04 DefaultValueRecordLayout_AUTOSAR_Platform_BaseTypes_uint16 32.0 RB_PT_PCT_SWC_GAC_CompuMethods_ratio_0p001 0.0 32. FORMAT "%10.5"
 /begin ANNOTATION ANNOTATION_LABEL "Description (coming from AUTOSAR DESC field)"
  /begin ANNOTATION_TEXT "Actuator position beyond which finding lower/upper null point is considered achieved.\r\n" /end ANNOTATION_TEXT
 /end ANNOTATION
/end CHARACTERISTIC
/begin CHARACTERISTIC GAC_CALIB.GAC_EOLNullLearnPrk.GAC_NULLTGTACHIEVEDTHRES "" VALUE 0x80610E06 DefaultValueRecordLayout_AUTOSAR_Platform_BaseTypes_uint16 32.0 RB_PT_PCT_SWC_GAC_CompuMethods_ratio_0p001 0.0 32. FORMAT "%10.5"
 /begin ANNOTATION ANNOTATION_LABEL "Description (coming from AUTOSAR DESC field)"
  /begin ANNOTATION_TEXT "Actuator position tolerance for considering Neutral Stabilisation assessment.\r\n" /end ANNOTATION_TEXT
 /end ANNOTATION
/end CHARACTERISTIC
/begin CHARACTERISTIC GAC_CALIB.GAC_EOLNullLearnPrk.GAC_RAMPRATECURRENT "" VALUE 0x80610E0C DefaultValueRecordLayout_AUTOSAR_Platform_BaseTypes_uint8 250.0 RB_PT_PCT_SWC_GAC_CompuMethods_ident 0.0 250. FORMAT "%10.5"
 /begin ANNOTATION ANNOTATION_LABEL "Description (coming from AUTOSAR DESC field)"
  /begin ANNOTATION_TEXT "Current increment during finding of the upper/lower null points.\r\n" /end ANNOTATION_TEXT
 /end ANNOTATION
/end CHARACTERISTIC
/begin CHARACTERISTIC GAC_CALIB.GAC_EOLNullLearnPrk.GAC_TGTNULLADAPTIGAIN "" VALUE 0x80610E08 DefaultValueRecordLayout_AUTOSAR_Platform_BaseTypes_sint16 10.0 RB_PT_PCT_SWC_GAC_CompuMethods_Ratio_0p001__3 -5. 5. FORMAT "%10.5"
 /begin ANNOTATION ANNOTATION_LABEL "Description (coming from AUTOSAR DESC field)" /begin ANNOTATION_TEXT "Null adapt neutral stabilisation control I gain.\r\n" /end ANNOTATION_TEXT /end ANNOTATION
/end CHARACTERISTIC
/begin CHARACTERISTIC GAC_CALIB.GAC_EOLNullLearnPrk.GAC_TGTNULLADAPTPGAIN "" VALUE 0x80610E0A DefaultValueRecordLayout_AUTOSAR_Platform_BaseTypes_sint16 10000.0 RB_PT_PCT_SWC_GAC_CompuMethods_ident -5000. 5000. FORMAT "%10.5"
 /begin ANNOTATION ANNOTATION_LABEL "Description (coming from AUTOSAR DESC field)" /begin ANNOTATION_TEXT "Null adapt neutral stabilisation control P gain.\r\n" /end ANNOTATION_TEXT /end ANNOTATION
/end CHARACTERISTIC
/begin CHARACTERISTIC GAC_CALIB.GAC_EOLPosnLearn.GAC_EOLActuationA1.GAC_CMDSTAYINGR "" VALUE 0x80610E34 DefaultValueRecordLayout_AUTOSAR_Platform_BaseTypes_uint8 5.0 RB_PT_PCT_SWC_GAC_CompuMethods_Enumerations_GAC_EnumActuatorCmd 0.0 5. FORMAT "%10.5"
 /begin ANNOTATION ANNOTATION_LABEL "Description (coming from AUTOSAR DESC field)" /begin ANNOTATION_TEXT "Command to stay in the current gear\r\n" /end ANNOTATION_TEXT /end ANNOTATION
/end CHARACTERISTIC
/begin CHARACTERISTIC GAC_CALIB.GAC_EOLPosnLearn.GAC_EOLActuationA2.GAC_CMDSTAYINGR "" VALUE 0x80610E35 DefaultValueRecordLayout_AUTOSAR_Platform_BaseTypes_uint8 5.0 RB_PT_PCT_SWC_GAC_CompuMethods_Enumerations_GAC_EnumActuatorCmd 0.0 5. FORMAT "%10.5"
 /begin ANNOTATION ANNOTATION_LABEL "Description (coming from AUTOSAR DESC field)" /begin ANNOTATION_TEXT "Command to stay in the current gear\r\n" /end ANNOTATION_TEXT /end ANNOTATION
/end CHARACTERISTIC
/begin CHARACTERISTIC GAC_CALIB.GAC_EOLPosnLearn.GAC_EOLActuationB1.GAC_CMDSTAYINGR "" VALUE 0x80610E36 DefaultValueRecordLayout_AUTOSAR_Platform_BaseTypes_uint8 5.0 RB_PT_PCT_SWC_GAC_CompuMethods_Enumerations_GAC_EnumActuatorCmd 0.0 5. FORMAT "%10.5"
 /begin ANNOTATION ANNOTATION_LABEL "Description (coming from AUTOSAR DESC field)" /begin ANNOTATION_TEXT "Command to stay in the current gear\r\n" /end ANNOTATION_TEXT /end ANNOTATION
/end CHARACTERISTIC
/begin CHARACTERISTIC GAC_CALIB.GAC_EOLPosnLearn.GAC_EOLActuationB2.GAC_CMDSTAYINGR "" VALUE 0x80610E37 DefaultValueRecordLayout_AUTOSAR_Platform_BaseTypes_uint8 5.0 RB_PT_PCT_SWC_GAC_CompuMethods_Enumerations_GAC_EnumActuatorCmd 0.0 5. FORMAT "%10.5"
 /begin ANNOTATION ANNOTATION_LABEL "Description (coming from AUTOSAR DESC field)" /begin ANNOTATION_TEXT "Command to stay in the current gear\r\n" /end ANNOTATION_TEXT /end ANNOTATION
/end CHARACTERISTIC
/begin CHARACTERISTIC GAC_CALIB.GAC_EOLPosnLearn.GAC_EOLActuationC1.GAC_CMDSTAYINGR "" VALUE 0x80610E38 DefaultValueRecordLayout_AUTOSAR_Platform_BaseTypes_uint8 5.0 RB_PT_PCT_SWC_GAC_CompuMethods_Enumerations_GAC_EnumActuatorCmd 0.0 5. FORMAT "%10.5"
 /begin ANNOTATION ANNOTATION_LABEL "Description (coming from AUTOSAR DESC field)" /begin ANNOTATION_TEXT "Command to stay in the current gear\r\n" /end ANNOTATION_TEXT /end ANNOTATION
/end CHARACTERISTIC
/begin CHARACTERISTIC GAC_CALIB.GAC_EOLPosnLearn.GAC_EOLActuationC2.GAC_CMDSTAYINGR "" VALUE 0x80610E39 DefaultValueRecordLayout_AUTOSAR_Platform_BaseTypes_uint8 5.0 RB_PT_PCT_SWC_GAC_CompuMethods_Enumerations_GAC_EnumActuatorCmd 0.0 5. FORMAT "%10.5"
 /begin ANNOTATION ANNOTATION_LABEL "Description (coming from AUTOSAR DESC field)" /begin ANNOTATION_TEXT "Command to stay in the current gear\r\n" /end ANNOTATION_TEXT /end ANNOTATION
/end CHARACTERISTIC
/begin CHARACTERISTIC GAC_CALIB.GAC_EOLPosnLearn.GAC_EOLActuationD1.GAC_CMDSTAYINGR "" VALUE 0x80610E3A DefaultValueRecordLayout_AUTOSAR_Platform_BaseTypes_uint8 5.0 RB_PT_PCT_SWC_GAC_CompuMethods_Enumerations_GAC_EnumActuatorCmd 0.0 5. FORMAT "%10.5"
 /begin ANNOTATION ANNOTATION_LABEL "Description (coming from AUTOSAR DESC field)" /begin ANNOTATION_TEXT "Command to stay in the current gear\r\n" /end ANNOTATION_TEXT /end ANNOTATION
/end CHARACTERISTIC
/begin CHARACTERISTIC GAC_CALIB.GAC_EOLPosnLearn.GAC_EOLActuationF1.GAC_CMDSTAYINGR "" VALUE 0x80610E3B DefaultValueRecordLayout_AUTOSAR_Platform_BaseTypes_uint8 5.0 RB_PT_PCT_SWC_GAC_CompuMethods_Enumerations_GAC_EnumActuatorCmd 0.0 5. FORMAT "%10.5"
 /begin ANNOTATION ANNOTATION_LABEL "Description (coming from AUTOSAR DESC field)" /begin ANNOTATION_TEXT "Command to stay in the current gear\r\n" /end ANNOTATION_TEXT /end ANNOTATION
/end CHARACTERISTIC
/begin CHARACTERISTIC GAC_CALIB.GAC_EOLPosnLearn.GAC_EOLActuationF2.GAC_CMDSTAYINGR "" VALUE 0x80610E3C DefaultValueRecordLayout_AUTOSAR_Platform_BaseTypes_uint8 5.0 RB_PT_PCT_SWC_GAC_CompuMethods_Enumerations_GAC_EnumActuatorCmd 0.0 5. FORMAT "%10.5"
 /begin ANNOTATION ANNOTATION_LABEL "Description (coming from AUTOSAR DESC field)" /begin ANNOTATION_TEXT "Command to stay in the current gear\r\n" /end ANNOTATION_TEXT /end ANNOTATION
/end CHARACTERISTIC
/begin CHARACTERISTIC GAC_CALIB.GAC_EOLPosnLearn.GAC_EOLPosnLrnResultA.GAC_POSNINGRLWRLIM "" VALUE 0x80610E3E DefaultValueRecordLayout_AUTOSAR_Platform_BaseTypes_sint16 40.0 RB_PT_PCT_SWC_GAC_CompuMethods_ratio_0p001 -20. 20. FORMAT "%10.5"
 /begin ANNOTATION ANNOTATION_LABEL "Description (coming from AUTOSAR DESC field)" /begin ANNOTATION_TEXT "Lower pass limit on the in gear position\r\n" /end ANNOTATION_TEXT /end ANNOTATION
/end CHARACTERISTIC
/begin CHARACTERISTIC GAC_CALIB.GAC_EOLPosnLearn.GAC_EOLPosnLrnResultA.GAC_POSNINGRUPRLIM "" VALUE 0x80610E40 DefaultValueRecordLayout_AUTOSAR_Platform_BaseTypes_sint16 40.0 RB_PT_PCT_SWC_GAC_CompuMethods_ratio_0p001 -20. 20. FORMAT "%10.5"
 /begin ANNOTATION ANNOTATION_LABEL "Description (coming from AUTOSAR DESC field)" /begin ANNOTATION_TEXT "Upper pass limit on the in gear position\r\n" /end ANNOTATION_TEXT /end ANNOTATION
/end CHARACTERISTIC
/begin CHARACTERISTIC GAC_CALIB.GAC_EOLPosnLearn.GAC_EOLPosnLrnResultA.GAC_POSNNOFSTLWRLIM "" VALUE 0x80610E42 DefaultValueRecordLayout_AUTOSAR_Platform_BaseTypes_sint16 40.0 RB_PT_PCT_SWC_GAC_CompuMethods_ratio_0p001 -20. 20. FORMAT "%10.5"
 /begin ANNOTATION ANNOTATION_LABEL "Description (coming from AUTOSAR DESC field)" /begin ANNOTATION_TEXT "Lower pass limit on the Neutral position offset.\r\n" /end ANNOTATION_TEXT /end ANNOTATION
/end CHARACTERISTIC
/begin CHARACTERISTIC GAC_CALIB.GAC_EOLPosnLearn.GAC_EOLPosnLrnResultA.GAC_POSNNOFSTUPRLIM "" VALUE 0x80610E44 DefaultValueRecordLayout_AUTOSAR_Platform_BaseTypes_sint16 40.0 RB_PT_PCT_SWC_GAC_CompuMethods_ratio_0p001 -20. 20. FORMAT "%10.5"
 /begin ANNOTATION ANNOTATION_LABEL "Description (coming from AUTOSAR DESC field)" /begin ANNOTATION_TEXT "Upper pass limit on the Neutral position offset.\r\n" /end ANNOTATION_TEXT /end ANNOTATION
/end CHARACTERISTIC
/begin CHARACTERISTIC GAC_CALIB.GAC_EOLPosnLearn.GAC_EOLPosnLrnResultA.GAC_POSNVARNOFSTLIM "" VALUE 0x80610E46 DefaultValueRecordLayout_AUTOSAR_Platform_BaseTypes_sint16 40.0 RB_PT_PCT_SWC_GAC_CompuMethods_ratio_0p001 -20. 20. FORMAT "%10.5"
 /begin ANNOTATION ANNOTATION_LABEL "Description (coming from AUTOSAR DESC field)"
  /begin ANNOTATION_TEXT "Variation limit on the Neutral position offsets, for this actuator.\r\n" /end ANNOTATION_TEXT
 /end ANNOTATION
/end CHARACTERISTIC
/begin CHARACTERISTIC GAC_CALIB.GAC_EOLPosnLearn.GAC_EOLPosnLrnResultB.GAC_POSNINGRLWRLIM "" VALUE 0x80610E48 DefaultValueRecordLayout_AUTOSAR_Platform_BaseTypes_sint16 40.0 RB_PT_PCT_SWC_GAC_CompuMethods_ratio_0p001 -20. 20. FORMAT "%10.5"
 /begin ANNOTATION ANNOTATION_LABEL "Description (coming from AUTOSAR DESC field)" /begin ANNOTATION_TEXT "Lower pass limit on the in gear position\r\n" /end ANNOTATION_TEXT /end ANNOTATION
/end CHARACTERISTIC
/begin CHARACTERISTIC GAC_CALIB.GAC_EOLPosnLearn.GAC_EOLPosnLrnResultB.GAC_POSNINGRUPRLIM "" VALUE 0x80610E4A DefaultValueRecordLayout_AUTOSAR_Platform_BaseTypes_sint16 40.0 RB_PT_PCT_SWC_GAC_CompuMethods_ratio_0p001 -20. 20. FORMAT "%10.5"
 /begin ANNOTATION ANNOTATION_LABEL "Description (coming from AUTOSAR DESC field)" /begin ANNOTATION_TEXT "Upper pass limit on the in gear position\r\n" /end ANNOTATION_TEXT /end ANNOTATION
/end CHARACTERISTIC
/begin CHARACTERISTIC GAC_CALIB.GAC_EOLPosnLearn.GAC_EOLPosnLrnResultB.GAC_POSNNOFSTLWRLIM "" VALUE 0x80610E4C DefaultValueRecordLayout_AUTOSAR_Platform_BaseTypes_sint16 40.0 RB_PT_PCT_SWC_GAC_CompuMethods_ratio_0p001 -20. 20. FORMAT "%10.5"
 /begin ANNOTATION ANNOTATION_LABEL "Description (coming from AUTOSAR DESC field)" /begin ANNOTATION_TEXT "Lower pass limit on the Neutral position offset.\r\n" /end ANNOTATION_TEXT /end ANNOTATION
/end CHARACTERISTIC
/begin CHARACTERISTIC GAC_CALIB.GAC_EOLPosnLearn.GAC_EOLPosnLrnResultB.GAC_POSNNOFSTUPRLIM "" VALUE 0x80610E4E DefaultValueRecordLayout_AUTOSAR_Platform_BaseTypes_sint16 40.0 RB_PT_PCT_SWC_GAC_CompuMethods_ratio_0p001 -20. 20. FORMAT "%10.5"
 /begin ANNOTATION ANNOTATION_LABEL "Description (coming from AUTOSAR DESC field)" /begin ANNOTATION_TEXT "Upper pass limit on the Neutral position offset.\r\n" /end ANNOTATION_TEXT /end ANNOTATION
/end CHARACTERISTIC
/begin CHARACTERISTIC GAC_CALIB.GAC_EOLPosnLearn.GAC_EOLPosnLrnResultB.GAC_POSNVARNOFSTLIM "" VALUE 0x80610E50 DefaultValueRecordLayout_AUTOSAR_Platform_BaseTypes_sint16 40.0 RB_PT_PCT_SWC_GAC_CompuMethods_ratio_0p001 -20. 20. FORMAT "%10.5"
 /begin ANNOTATION ANNOTATION_LABEL "Description (coming from AUTOSAR DESC field)"
  /begin ANNOTATION_TEXT "Variation limit on the Neutral position offsets, for this actuator.\r\n" /end ANNOTATION_TEXT
 /end ANNOTATION
/end CHARACTERISTIC
/begin CHARACTERISTIC GAC_CALIB.GAC_EOLPosnLearn.GAC_EOLPosnLrnResultC.GAC_POSNINGRLWRLIM "" VALUE 0x80610E52 DefaultValueRecordLayout_AUTOSAR_Platform_BaseTypes_sint16 40.0 RB_PT_PCT_SWC_GAC_CompuMethods_ratio_0p001 -20. 20. FORMAT "%10.5"
 /begin ANNOTATION ANNOTATION_LABEL "Description (coming from AUTOSAR DESC field)" /begin ANNOTATION_TEXT "Lower pass limit on the in gear position\r\n" /end ANNOTATION_TEXT /end ANNOTATION
/end CHARACTERISTIC
/begin CHARACTERISTIC GAC_CALIB.GAC_EOLPosnLearn.GAC_EOLPosnLrnResultC.GAC_POSNINGRUPRLIM "" VALUE 0x80610E54 DefaultValueRecordLayout_AUTOSAR_Platform_BaseTypes_sint16 40.0 RB_PT_PCT_SWC_GAC_CompuMethods_ratio_0p001 -20. 20. FORMAT "%10.5"
 /begin ANNOTATION ANNOTATION_LABEL "Description (coming from AUTOSAR DESC field)" /begin ANNOTATION_TEXT "Upper pass limit on the in gear position\r\n" /end ANNOTATION_TEXT /end ANNOTATION
/end CHARACTERISTIC
/begin CHARACTERISTIC GAC_CALIB.GAC_EOLPosnLearn.GAC_EOLPosnLrnResultC.GAC_POSNNOFSTLWRLIM "" VALUE 0x80610E56 DefaultValueRecordLayout_AUTOSAR_Platform_BaseTypes_sint16 40.0 RB_PT_PCT_SWC_GAC_CompuMethods_ratio_0p001 -20. 20. FORMAT "%10.5"
 /begin ANNOTATION ANNOTATION_LABEL "Description (coming from AUTOSAR DESC field)" /begin ANNOTATION_TEXT "Lower pass limit on the Neutral position offset.\r\n" /end ANNOTATION_TEXT /end ANNOTATION
/end CHARACTERISTIC
/begin CHARACTERISTIC GAC_CALIB.GAC_EOLPosnLearn.GAC_EOLPosnLrnResultC.GAC_POSNNOFSTUPRLIM "" VALUE 0x80610E58 DefaultValueRecordLayout_AUTOSAR_Platform_BaseTypes_sint16 40.0 RB_PT_PCT_SWC_GAC_CompuMethods_ratio_0p001 -20. 20. FORMAT "%10.5"
 /begin ANNOTATION ANNOTATION_LABEL "Description (coming from AUTOSAR DESC field)" /begin ANNOTATION_TEXT "Upper pass limit on the Neutral position offset.\r\n" /end ANNOTATION_TEXT /end ANNOTATION
/end CHARACTERISTIC
/begin CHARACTERISTIC GAC_CALIB.GAC_EOLPosnLearn.GAC_EOLPosnLrnResultC.GAC_POSNVARNOFSTLIM "" VALUE 0x80610E5A DefaultValueRecordLayout_AUTOSAR_Platform_BaseTypes_sint16 40.0 RB_PT_PCT_SWC_GAC_CompuMethods_ratio_0p001 -20. 20. FORMAT "%10.5"
 /begin ANNOTATION ANNOTATION_LABEL "Description (coming from AUTOSAR DESC field)"
  /begin ANNOTATION_TEXT "Variation limit on the Neutral position offsets, for this actuator.\r\n" /end ANNOTATION_TEXT
 /end ANNOTATION
/end CHARACTERISTIC
/begin CHARACTERISTIC GAC_CALIB.GAC_EOLPosnLearn.GAC_EOLPosnLrnResultD.GAC_POSNINGRLWRLIM "" VALUE 0x80610E5C DefaultValueRecordLayout_AUTOSAR_Platform_BaseTypes_sint16 40.0 RB_PT_PCT_SWC_GAC_CompuMethods_ratio_0p001 -20. 20. FORMAT "%10.5"
 /begin ANNOTATION ANNOTATION_LABEL "Description (coming from AUTOSAR DESC field)" /begin ANNOTATION_TEXT "Lower pass limit on the in gear position\r\n" /end ANNOTATION_TEXT /end ANNOTATION
/end CHARACTERISTIC
/begin CHARACTERISTIC GAC_CALIB.GAC_EOLPosnLearn.GAC_EOLPosnLrnResultD.GAC_POSNINGRUPRLIM "" VALUE 0x80610E5E DefaultValueRecordLayout_AUTOSAR_Platform_BaseTypes_sint16 40.0 RB_PT_PCT_SWC_GAC_CompuMethods_ratio_0p001 -20. 20. FORMAT "%10.5"
 /begin ANNOTATION ANNOTATION_LABEL "Description (coming from AUTOSAR DESC field)" /begin ANNOTATION_TEXT "Upper pass limit on the in gear position\r\n" /end ANNOTATION_TEXT /end ANNOTATION
/end CHARACTERISTIC
/begin CHARACTERISTIC GAC_CALIB.GAC_EOLPosnLearn.GAC_EOLPosnLrnResultD.GAC_POSNNOFSTLWRLIM "" VALUE 0x80610E60 DefaultValueRecordLayout_AUTOSAR_Platform_BaseTypes_sint16 40.0 RB_PT_PCT_SWC_GAC_CompuMethods_ratio_0p001 -20. 20. FORMAT "%10.5"
 /begin ANNOTATION ANNOTATION_LABEL "Description (coming from AUTOSAR DESC field)" /begin ANNOTATION_TEXT "Lower pass limit on the Neutral position offset.\r\n" /end ANNOTATION_TEXT /end ANNOTATION
/end CHARACTERISTIC
/begin CHARACTERISTIC GAC_CALIB.GAC_EOLPosnLearn.GAC_EOLPosnLrnResultD.GAC_POSNNOFSTUPRLIM "" VALUE 0x80610E62 DefaultValueRecordLayout_AUTOSAR_Platform_BaseTypes_sint16 40.0 RB_PT_PCT_SWC_GAC_CompuMethods_ratio_0p001 -20. 20. FORMAT "%10.5"
 /begin ANNOTATION ANNOTATION_LABEL "Description (coming from AUTOSAR DESC field)" /begin ANNOTATION_TEXT "Upper pass limit on the Neutral position offset.\r\n" /end ANNOTATION_TEXT /end ANNOTATION
/end CHARACTERISTIC
/begin CHARACTERISTIC GAC_CALIB.GAC_EOLPosnLearn.GAC_EOLPosnLrnResultD.GAC_POSNVARNOFSTLIM "" VALUE 0x80610E64 DefaultValueRecordLayout_AUTOSAR_Platform_BaseTypes_sint16 40.0 RB_PT_PCT_SWC_GAC_CompuMethods_ratio_0p001 -20. 20. FORMAT "%10.5"
 /begin ANNOTATION ANNOTATION_LABEL "Description (coming from AUTOSAR DESC field)"
  /begin ANNOTATION_TEXT "Variation limit on the Neutral position offsets, for this actuator.\r\n" /end ANNOTATION_TEXT
 /end ANNOTATION
/end CHARACTERISTIC
/begin CHARACTERISTIC GAC_CALIB.GAC_EOLPosnLearn.GAC_EOLPosnLrnResultF.GAC_POSNINGRLWRLIM "" VALUE 0x80610E66 DefaultValueRecordLayout_AUTOSAR_Platform_BaseTypes_sint16 40.0 RB_PT_PCT_SWC_GAC_CompuMethods_ratio_0p001 -20. 20. FORMAT "%10.5"
 /begin ANNOTATION ANNOTATION_LABEL "Description (coming from AUTOSAR DESC field)" /begin ANNOTATION_TEXT "Lower pass limit on the in gear position\r\n" /end ANNOTATION_TEXT /end ANNOTATION
/end CHARACTERISTIC
/begin CHARACTERISTIC GAC_CALIB.GAC_EOLPosnLearn.GAC_EOLPosnLrnResultF.GAC_POSNINGRUPRLIM "" VALUE 0x80610E68 DefaultValueRecordLayout_AUTOSAR_Platform_BaseTypes_sint16 40.0 RB_PT_PCT_SWC_GAC_CompuMethods_ratio_0p001 -20. 20. FORMAT "%10.5"
 /begin ANNOTATION ANNOTATION_LABEL "Description (coming from AUTOSAR DESC field)" /begin ANNOTATION_TEXT "Upper pass limit on the in gear position\r\n" /end ANNOTATION_TEXT /end ANNOTATION
/end CHARACTERISTIC
/begin CHARACTERISTIC GAC_CALIB.GAC_EOLPosnLearn.GAC_EOLPosnLrnResultF.GAC_POSNNOFSTLWRLIM "" VALUE 0x80610E6A DefaultValueRecordLayout_AUTOSAR_Platform_BaseTypes_sint16 40.0 RB_PT_PCT_SWC_GAC_CompuMethods_ratio_0p001 -20. 20. FORMAT "%10.5"
 /begin ANNOTATION ANNOTATION_LABEL "Description (coming from AUTOSAR DESC field)" /begin ANNOTATION_TEXT "Lower pass limit on the Neutral position offset.\r\n" /end ANNOTATION_TEXT /end ANNOTATION
/end CHARACTERISTIC
/begin CHARACTERISTIC GAC_CALIB.GAC_EOLPosnLearn.GAC_EOLPosnLrnResultF.GAC_POSNNOFSTUPRLIM "" VALUE 0x80610E6C DefaultValueRecordLayout_AUTOSAR_Platform_BaseTypes_sint16 40.0 RB_PT_PCT_SWC_GAC_CompuMethods_ratio_0p001 -20. 20. FORMAT "%10.5"
 /begin ANNOTATION ANNOTATION_LABEL "Description (coming from AUTOSAR DESC field)" /begin ANNOTATION_TEXT "Upper pass limit on the Neutral position offset.\r\n" /end ANNOTATION_TEXT /end ANNOTATION
/end CHARACTERISTIC
/begin CHARACTERISTIC GAC_CALIB.GAC_EOLPosnLearn.GAC_EOLPosnLrnResultF.GAC_POSNVARNOFSTLIM "" VALUE 0x80610E6E DefaultValueRecordLayout_AUTOSAR_Platform_BaseTypes_sint16 40.0 RB_PT_PCT_SWC_GAC_CompuMethods_ratio_0p001 -20. 20. FORMAT "%10.5"
 /begin ANNOTATION ANNOTATION_LABEL "Description (coming from AUTOSAR DESC field)"
  /begin ANNOTATION_TEXT "Variation limit on the Neutral position offsets, for this actuator.\r\n" /end ANNOTATION_TEXT
 /end ANNOTATION
/end CHARACTERISTIC
/begin CHARACTERISTIC GAC_CALIB.GAC_EOLPosnLearn.GAC_FLGGRACF2EOLENBL "" VALUE 0x80610E32 DefaultValueRecordLayout_AUTOSAR_Platform_BaseTypes_boolean 255.0 AUTOSAR_Platform_CompuMethods_boolean 0.0 255. FORMAT "%10.5"
 /begin ANNOTATION ANNOTATION_LABEL "Description (coming from AUTOSAR DESC field)"
  /begin ANNOTATION_TEXT "Flag enabling gear actuator F2 coupling state for EOL.\r\n" /end ANNOTATION_TEXT
 /end ANNOTATION
/end CHARACTERISTIC
/begin CHARACTERISTIC GAC_CALIB.GAC_EOLPosnLearn.GAC_IDSHYBBANKSEQPOSNLRN "" VAL_BLK 0x80610E0E DefaultValueRecordLayout_AUTOSAR_Platform_BaseTypes_uint8 255.0 RB_PT_PCT_SWC_GAC_CompuMethods_ident 0.0 255. FORMAT "%10.5"
 /begin ANNOTATION ANNOTATION_LABEL "Description (coming from AUTOSAR DESC field)"
  /begin ANNOTATION_TEXT "Matrix of target gears and hybrid modes for set points of EOL learm\r\n" /end ANNOTATION_TEXT
 /end ANNOTATION
 MATRIX_DIM 10 3 1 /end CHARACTERISTIC
/begin CHARACTERISTIC GAC_CALIB.GAC_EOLPosnLearn.GAC_NUMMAXSEQSETPT "" VALUE 0x80610E33 DefaultValueRecordLayout_AUTOSAR_Platform_BaseTypes_uint8 255.0 RB_PT_PCT_SWC_GAC_CompuMethods_ident 0.0 255. FORMAT "%10.5"
 /begin ANNOTATION ANNOTATION_LABEL "Description (coming from AUTOSAR DESC field)"
  /begin ANNOTATION_TEXT "Number of repetitions of each sequence setpoint, during EOL position learn.\r\n" /end ANNOTATION_TEXT
 /end ANNOTATION
/end CHARACTERISTIC
/begin CHARACTERISTIC GAC_CALIB.GAC_EOLPosnLearn.GAC_TMMAXINGREOLPOSNLRN "" VALUE 0x80610E2C DefaultValueRecordLayout_AUTOSAR_Platform_BaseTypes_uint16 65.535 RB_PT_PCT_SWC_GAC_CompuMethods_ratio_0p001 0.0 65.535 FORMAT "%10.5"
 /begin ANNOTATION ANNOTATION_LABEL "Description (coming from AUTOSAR DESC field)" /begin ANNOTATION_TEXT "Time to wait in the achieved hyb/bank requests.\r\n" /end ANNOTATION_TEXT /end ANNOTATION
/end CHARACTERISTIC
/begin CHARACTERISTIC GAC_CALIB.GAC_EOLPosnLearn.GAC_TMMAXINNEOLPOSNLRN "" VALUE 0x80610E2E DefaultValueRecordLayout_AUTOSAR_Platform_BaseTypes_uint16 65.535 RB_PT_PCT_SWC_GAC_CompuMethods_ratio_0p001 0.0 65.535 FORMAT "%10.5"
 /begin ANNOTATION ANNOTATION_LABEL "Description (coming from AUTOSAR DESC field)"
  /begin ANNOTATION_TEXT "Time to wait in the achieved hybrid coupling and bank Neutral requests.\r\n" /end ANNOTATION_TEXT
 /end ANNOTATION
/end CHARACTERISTIC
/begin CHARACTERISTIC GAC_CALIB.GAC_EOLPosnLearn.GAC_TMMININGREOLPOSNLRN "" VALUE 0x80610E30 DefaultValueRecordLayout_AUTOSAR_Platform_BaseTypes_uint16 65.535 RB_PT_PCT_SWC_GAC_CompuMethods_ratio_0p001 0.0 65.535 FORMAT "%10.5"
 /begin ANNOTATION ANNOTATION_LABEL "Description (coming from AUTOSAR DESC field)" /begin ANNOTATION_TEXT "Time to wait in the achieved hyb/bank requests.\r\n" /end ANNOTATION_TEXT /end ANNOTATION
/end CHARACTERISTIC
/begin CHARACTERISTIC GAC_CALIB.GAC_EolRqTmoutTmr.LIB_DT "" VALUE 0x80610E70 DefaultValueRecordLayout_AUTOSAR_Platform_BaseTypes_uint16 65.535 RB_PT_PCT_SWC_GAC_CompuMethods_ratio_0p001 0.0 65.535 FORMAT "%10.5"
 /begin ANNOTATION ANNOTATION_LABEL "Description (coming from AUTOSAR DESC field)" /begin ANNOTATION_TEXT "Timer decrement value.\r\n" /end ANNOTATION_TEXT /end ANNOTATION
/end CHARACTERISTIC
/begin CHARACTERISTIC GAC_CALIB.GAC_FailedGearHandling.GAC_GEARFAILEDBITMASKIMMEDIATE "" VALUE 0x80610E72 DefaultValueRecordLayout_AUTOSAR_Platform_BaseTypes_uint16 65535.0 RB_PT_PCT_SWC_GAC_CompuMethods_ident 0.0 65535. FORMAT "%10.5"
 /begin ANNOTATION ANNOTATION_LABEL "Description (coming from AUTOSAR DESC field)" /begin ANNOTATION_TEXT "Bit mask for the gear failed check\r\n" /end ANNOTATION_TEXT /end ANNOTATION
/end CHARACTERISTIC
/begin CHARACTERISTIC GAC_CALIB.GAC_FailedGearHandling.GAC_GEARFAILEDBITMASKNOTIMMEDIATE "" VALUE 0x80610E74 DefaultValueRecordLayout_AUTOSAR_Platform_BaseTypes_uint16 65535.0 RB_PT_PCT_SWC_GAC_CompuMethods_ident 0.0 65535. FORMAT "%10.5"
 /begin ANNOTATION ANNOTATION_LABEL "Description (coming from AUTOSAR DESC field)" /begin ANNOTATION_TEXT "Bit mask for the gear failed check\r\n" /end ANNOTATION_TEXT /end ANNOTATION
/end CHARACTERISTIC
/begin CHARACTERISTIC GAC_CALIB.GAC_FCTGRACVELTOFLWNEG "" VALUE 0x80610C9A DefaultValueRecordLayout_AUTOSAR_Platform_BaseTypes_uint16 50.0 RB_PT_PCT_SWC_GAC_CompuMethods_ratio_0p01 0.0 50. FORMAT "%10.5"
 /begin ANNOTATION ANNOTATION_LABEL "Description (coming from AUTOSAR DESC field)"
  /begin ANNOTATION_TEXT "Conversion factor from actuator velocity to flow rate in negative direction.\r\n" /end ANNOTATION_TEXT
 /end ANNOTATION
/end CHARACTERISTIC
/begin CHARACTERISTIC GAC_CALIB.GAC_FCTGRACVELTOFLWPOS "" VALUE 0x80610C9C DefaultValueRecordLayout_AUTOSAR_Platform_BaseTypes_uint16 50.0 RB_PT_PCT_SWC_GAC_CompuMethods_ratio_0p01 0.0 50. FORMAT "%10.5"
 /begin ANNOTATION ANNOTATION_LABEL "Description (coming from AUTOSAR DESC field)"
  /begin ANNOTATION_TEXT "Conversion factor from actuator velocity to flow rate in positive direction.\r\n" /end ANNOTATION_TEXT
 /end ANNOTATION
/end CHARACTERISTIC
/begin CHARACTERISTIC GAC_CALIB.GAC_FCTPLACFLOWTGTTOLIVE "" VALUE 0x80610D3F DefaultValueRecordLayout_AUTOSAR_Platform_BaseTypes_uint8 2.55 RB_PT_PCT_SWC_GAC_CompuMethods_ratio_0p01 0.0 2.55 FORMAT "%10.5"
 /begin ANNOTATION ANNOTATION_LABEL "Description (coming from AUTOSAR DESC field)"
  /begin ANNOTATION_TEXT "factor to modify the target flow to the live flow for PCL\r\n" /end ANNOTATION_TEXT
 /end ANNOTATION
/end CHARACTERISTIC
/begin CHARACTERISTIC GAC_CALIB.GAC_FLGAGGSTATICENGINEOFF "" VALUE 0x80610D40 DefaultValueRecordLayout_AUTOSAR_Platform_BaseTypes_uint8 255.0 DefaultIdenticalCompu 0.0 255. FORMAT "%10.5"
 /begin ANNOTATION ANNOTATION_LABEL "Description (coming from AUTOSAR DESC field)"
  /begin ANNOTATION_TEXT "Flag to enable the static aggression when the engine is off\r\n" /end ANNOTATION_TEXT
 /end ANNOTATION
/end CHARACTERISTIC
/begin CHARACTERISTIC GAC_CALIB.GAC_FLGBOBAGGRQ "" VALUE 0x80610D41 DefaultValueRecordLayout_AUTOSAR_Platform_BaseTypes_uint8 255.0 DefaultIdenticalCompu 0.0 255. FORMAT "%10.5"
 /begin ANNOTATION ANNOTATION_LABEL "Description (coming from AUTOSAR DESC field)"
  /begin ANNOTATION_TEXT "Flag to enable bob request for the aggression command\r\n" /end ANNOTATION_TEXT
 /end ANNOTATION
/end CHARACTERISTIC
/begin CHARACTERISTIC GAC_CALIB.GAC_FLGBOBENBLDRSHUTTLEASEV "" VALUE 0x80610D42 DefaultValueRecordLayout_AUTOSAR_Platform_BaseTypes_uint8 255.0 DefaultIdenticalCompu 0.0 255. FORMAT "%10.5"
 /begin ANNOTATION ANNOTATION_LABEL "Description (coming from AUTOSAR DESC field)" /begin ANNOTATION_TEXT "Flag to enable d-r shuttling as EV aggression\r\n" /end ANNOTATION_TEXT /end ANNOTATION
/end CHARACTERISTIC
/begin CHARACTERISTIC GAC_CALIB.GAC_FLGBOBEOLDONE "" VALUE 0x80610D43 DefaultValueRecordLayout_AUTOSAR_Platform_BaseTypes_boolean 255.0 AUTOSAR_Platform_CompuMethods_boolean 0.0 255. FORMAT "%10.5"
 /begin ANNOTATION ANNOTATION_LABEL "Description (coming from AUTOSAR DESC field)"
  /begin ANNOTATION_TEXT "Flag manually setting EOL learning done with preset values.\r\n" /end ANNOTATION_TEXT
 /end ANNOTATION
/end CHARACTERISTIC
/begin CHARACTERISTIC GAC_CALIB.GAC_FLGBOBIDFAILEDVALVE "" VALUE 0x80610D44 DefaultValueRecordLayout_AUTOSAR_Platform_BaseTypes_uint8 255.0 DefaultIdenticalCompu 0.0 255. FORMAT "%10.5"
 /begin ANNOTATION ANNOTATION_LABEL "Description (coming from AUTOSAR DESC field)" /begin ANNOTATION_TEXT "BOB override for the failed valve ID\r\n" /end ANNOTATION_TEXT /end ANNOTATION
/end CHARACTERISTIC
/begin CHARACTERISTIC GAC_CALIB.GAC_FLGBOBLIMITVEHSPEED "" VALUE 0x80610D45 DefaultValueRecordLayout_AUTOSAR_Platform_BaseTypes_uint8 255.0 DefaultIdenticalCompu 0.0 255. FORMAT "%10.5"
 /begin ANNOTATION ANNOTATION_LABEL "Description (coming from AUTOSAR DESC field)" /begin ANNOTATION_TEXT "Flag to trigger the vehicle speed limitation logic\r\n" /end ANNOTATION_TEXT /end ANNOTATION
/end CHARACTERISTIC
/begin CHARACTERISTIC GAC_CALIB.GAC_FLGBOBRESETFAILURES "" VALUE 0x80610D46 DefaultValueRecordLayout_AUTOSAR_Platform_BaseTypes_uint8 255.0 DefaultIdenticalCompu 0.0 255. FORMAT "%10.5"
 /begin ANNOTATION ANNOTATION_LABEL "Description (coming from AUTOSAR DESC field)" /begin ANNOTATION_TEXT "bob flag to reset GAC failures\r\n" /end ANNOTATION_TEXT /end ANNOTATION
/end CHARACTERISTIC
/begin CHARACTERISTIC GAC_CALIB.GAC_FLGBOBSETUPVALVESRQ "" VALUE 0x80610D47 DefaultValueRecordLayout_AUTOSAR_Platform_BaseTypes_uint8 255.0 DefaultIdenticalCompu 0.0 255. FORMAT "%10.5"
 /begin ANNOTATION ANNOTATION_LABEL "Description (coming from AUTOSAR DESC field)" /begin ANNOTATION_TEXT "BOB for the setup valves request from SEQ\r\n" /end ANNOTATION_TEXT /end ANNOTATION
/end CHARACTERISTIC
/begin CHARACTERISTIC GAC_CALIB.GAC_FLGBYPASSEOLCOND "" VALUE 0x80610D48 DefaultValueRecordLayout_AUTOSAR_Platform_BaseTypes_boolean 255.0 AUTOSAR_Platform_CompuMethods_boolean 0.0 255. FORMAT "%10.5"
 /begin ANNOTATION ANNOTATION_LABEL "Description (coming from AUTOSAR DESC field)"
  /begin ANNOTATION_TEXT "Flag bypassing preconditions that allow the EOL learn.\r\n" /end ANNOTATION_TEXT
 /end ANNOTATION
/end CHARACTERISTIC
/begin CHARACTERISTIC GAC_CALIB.GAC_FLGBYPASSEOLRESETLATCH "" VALUE 0x80610D49 DefaultValueRecordLayout_AUTOSAR_Platform_BaseTypes_uint8 255.0 DefaultIdenticalCompu 0.0 255. FORMAT "%10.5"
 /begin ANNOTATION ANNOTATION_LABEL "Description (coming from AUTOSAR DESC field)" /begin ANNOTATION_TEXT "Flag to bypass the EOL latch - for testing purposes\r\n" /end ANNOTATION_TEXT /end ANNOTATION
/end CHARACTERISTIC
/begin CHARACTERISTIC GAC_CALIB.GAC_FLGBYPASSWAITFASTDFALLS "" VALUE 0x80610D4A DefaultValueRecordLayout_AUTOSAR_Platform_BaseTypes_uint8 255.0 DefaultIdenticalCompu 0.0 255. FORMAT "%10.5"
 /begin ANNOTATION ANNOTATION_LABEL "Description (coming from AUTOSAR DESC field)"
  /begin ANNOTATION_TEXT "Flag to bypass the gear wait command from SEQ before performing the fast D falling actions\r\n" /end ANNOTATION_TEXT
 /end ANNOTATION
/end CHARACTERISTIC
/begin CHARACTERISTIC GAC_CALIB.GAC_FLGCOASTINGNASDRSHUTTLEENBL "" VALUE 0x80610D4B DefaultValueRecordLayout_AUTOSAR_Platform_BaseTypes_uint8 255.0 DefaultIdenticalCompu 0.0 255. FORMAT "%10.5"
 /begin ANNOTATION ANNOTATION_LABEL "Description (coming from AUTOSAR DESC field)"
  /begin ANNOTATION_TEXT "Flag to enable a coasting neutral situation as a DR shuttle\r\n" /end ANNOTATION_TEXT
 /end ANNOTATION
/end CHARACTERISTIC
/begin CHARACTERISTIC GAC_CALIB.GAC_FLGENBLAUTOEOL "" VALUE 0x80610D4C DefaultValueRecordLayout_AUTOSAR_Platform_BaseTypes_uint8 255.0 DefaultIdenticalCompu 0.0 255. FORMAT "%10.5"
 /begin ANNOTATION ANNOTATION_LABEL "Description (coming from AUTOSAR DESC field)" /begin ANNOTATION_TEXT "flag to enable the auto EOL on power up\r\n" /end ANNOTATION_TEXT /end ANNOTATION
/end CHARACTERISTIC
/begin CHARACTERISTIC GAC_CALIB.GAC_FLGENBLCSHIFTFORDENGA "" VALUE 0x80610D4D DefaultValueRecordLayout_AUTOSAR_Platform_BaseTypes_uint8 255.0 DefaultIdenticalCompu 0.0 255. FORMAT "%10.5"
 /begin ANNOTATION ANNOTATION_LABEL "Description (coming from AUTOSAR DESC field)"
  /begin ANNOTATION_TEXT "Flag to enable a shift in the synchro C position to assist cold engagements of synchro A - DO NOT SWITCH ON\r\n" /end ANNOTATION_TEXT
 /end ANNOTATION
/end CHARACTERISTIC
/begin CHARACTERISTIC GAC_CALIB.GAC_FLGENBLDRSHUTTLEASEV "" VALUE 0x80610D4E DefaultValueRecordLayout_AUTOSAR_Platform_BaseTypes_uint8 255.0 DefaultIdenticalCompu 0.0 255. FORMAT "%10.5"
 /begin ANNOTATION ANNOTATION_LABEL "Description (coming from AUTOSAR DESC field)" /begin ANNOTATION_TEXT "Flag to enable d-r shuttling as EV aggression\r\n" /end ANNOTATION_TEXT /end ANNOTATION
/end CHARACTERISTIC
/begin CHARACTERISTIC GAC_CALIB.GAC_FLGENBLFASTD "" VALUE 0x80610D4F DefaultValueRecordLayout_AUTOSAR_Platform_BaseTypes_uint8 255.0 DefaultIdenticalCompu 0.0 255. FORMAT "%10.5"
 /begin ANNOTATION ANNOTATION_LABEL "Description (coming from AUTOSAR DESC field)" /begin ANNOTATION_TEXT "flag to enable the fast n to drive logic\r\n" /end ANNOTATION_TEXT /end ANNOTATION
/end CHARACTERISTIC
/begin CHARACTERISTIC GAC_CALIB.GAC_FLGENBLNULLLEARNNOFFSET "" VALUE 0x80610D50 DefaultValueRecordLayout_AUTOSAR_Platform_BaseTypes_uint8 255.0 DefaultIdenticalCompu 0.0 255. FORMAT "%10.5"
 /begin ANNOTATION ANNOTATION_LABEL "Description (coming from AUTOSAR DESC field)"
  /begin ANNOTATION_TEXT "Flag to enable the EOL null learn neutral offset function\r\n" /end ANNOTATION_TEXT
 /end ANNOTATION
/end CHARACTERISTIC
/begin CHARACTERISTIC GAC_CALIB.GAC_FLGENBLNULLLRNENDNCMD "" VALUE 0x80610D51 DefaultValueRecordLayout_AUTOSAR_Platform_BaseTypes_uint8 255.0 DefaultIdenticalCompu 0.0 255. FORMAT "%10.5"
 /begin ANNOTATION ANNOTATION_LABEL "Description (coming from AUTOSAR DESC field)"
  /begin ANNOTATION_TEXT "flag to enable the return to neutral command when the null learn ends\r\n" /end ANNOTATION_TEXT
 /end ANNOTATION
/end CHARACTERISTIC
/begin CHARACTERISTIC GAC_CALIB.GAC_FLGENBLTMPGRACOFFSET "" VALUE 0x80610D52 DefaultValueRecordLayout_AUTOSAR_Platform_BaseTypes_uint8 255.0 DefaultIdenticalCompu 0.0 255. FORMAT "%10.5"
 /begin ANNOTATION ANNOTATION_LABEL "Description (coming from AUTOSAR DESC field)" /begin ANNOTATION_TEXT "Flag to enable the grac temperature offset\r\n" /end ANNOTATION_TEXT /end ANNOTATION
/end CHARACTERISTIC
/begin CHARACTERISTIC GAC_CALIB.GAC_FLGEVMODEAGGOVERRIDE "" VALUE 0x80610D53 DefaultValueRecordLayout_AUTOSAR_Platform_BaseTypes_uint8 255.0 DefaultIdenticalCompu 0.0 255. FORMAT "%10.5" /end CHARACTERISTIC
/begin CHARACTERISTIC GAC_CALIB.GAC_FLGFAILEDTABINTONLY "" VALUE 0x80610D54 DefaultValueRecordLayout_AUTOSAR_Platform_BaseTypes_boolean 255.0 AUTOSAR_Platform_CompuMethods_boolean 0.0 255. FORMAT "%10.5"
 /begin ANNOTATION ANNOTATION_LABEL "Description (coming from AUTOSAR DESC field)"
  /begin ANNOTATION_TEXT "Flag blocking external contribution to failed gear tables, thus only updated internally in GAC.\r\n" /end ANNOTATION_TEXT
 /end ANNOTATION
/end CHARACTERISTIC
/begin CHARACTERISTIC GAC_CALIB.GAC_FLGINTBOBNOSYNC "" VALUE 0x80610D55 DefaultValueRecordLayout_AUTOSAR_Platform_BaseTypes_boolean 255.0 AUTOSAR_Platform_CompuMethods_boolean 0.0 255. FORMAT "%10.5"
 /begin ANNOTATION ANNOTATION_LABEL "Description (coming from AUTOSAR DESC field)"
  /begin ANNOTATION_TEXT "Flag to override the rising edge command on the gear command BOBs\r\n" /end ANNOTATION_TEXT
 /end ANNOTATION
/end CHARACTERISTIC
/begin CHARACTERISTIC GAC_CALIB.GAC_FLGINTBOBTRIG "" VALUE 0x80610D56 DefaultValueRecordLayout_AUTOSAR_Platform_BaseTypes_boolean 255.0 AUTOSAR_Platform_CompuMethods_boolean 0.0 255. FORMAT "%10.5"
 /begin ANNOTATION ANNOTATION_LABEL "Description (coming from AUTOSAR DESC field)"
  /begin ANNOTATION_TEXT "Flag triggering synchronised passthrough of internal manual intervention values.\r\n" /end ANNOTATION_TEXT
 /end ANNOTATION
/end CHARACTERISTIC
/begin CHARACTERISTIC GAC_CALIB.GAC_FLGOKADPNDRIFT "" VALUE 0x80610D57 DefaultValueRecordLayout_AUTOSAR_Platform_BaseTypes_boolean 255.0 AUTOSAR_Platform_CompuMethods_boolean 0.0 255. FORMAT "%10.5"
 /begin ANNOTATION ANNOTATION_LABEL "Description (coming from AUTOSAR DESC field)" /begin ANNOTATION_TEXT "Flag enabling Neutral drift adaption.\r\n" /end ANNOTATION_TEXT /end ANNOTATION
/end CHARACTERISTIC
/begin CHARACTERISTIC GAC_CALIB.GAC_FLGOKINTBOB "" VALUE 0x80610C9E DefaultValueRecordLayout_AUTOSAR_Platform_BaseTypes_uint16 65535.0 RB_PT_PCT_SWC_GAC_CompuMethods_ident 0.0 65535. FORMAT "%10.5"
 /begin ANNOTATION ANNOTATION_LABEL "Description (coming from AUTOSAR DESC field)" /begin ANNOTATION_TEXT "Flag enabling internal GAC manual intervention mode.\r\n" /end ANNOTATION_TEXT /end ANNOTATION
/end CHARACTERISTIC
/begin CHARACTERISTIC GAC_CALIB.GAC_FLGR26FEEDBACKMONITOR "" VALUE 0x80610D58 DefaultValueRecordLayout_AUTOSAR_Platform_BaseTypes_uint8 255.0 DefaultIdenticalCompu 0.0 255. FORMAT "%10.5" /end CHARACTERISTIC
/begin CHARACTERISTIC GAC_CALIB.GAC_FLGR26ONN2DENBL "" VALUE 0x80610D59 DefaultValueRecordLayout_AUTOSAR_Platform_BaseTypes_uint8 255.0 DefaultIdenticalCompu 0.0 255. FORMAT "%10.5"
 /begin ANNOTATION ANNOTATION_LABEL "Description (coming from AUTOSAR DESC field)" /begin ANNOTATION_TEXT "enable an r26 push on a neutral to drive transition\r\n" /end ANNOTATION_TEXT /end ANNOTATION
/end CHARACTERISTIC
/begin CHARACTERISTIC GAC_CALIB.GAC_FLGR26ONN2DPUSHNOTSEENONLY "" VALUE 0x80610D5A DefaultValueRecordLayout_AUTOSAR_Platform_BaseTypes_uint8 255.0 DefaultIdenticalCompu 0.0 255. FORMAT "%10.5"
 /begin ANNOTATION ANNOTATION_LABEL "Description (coming from AUTOSAR DESC field)"
  /begin ANNOTATION_TEXT "enable an r26 push on a neutral to drive transition only when the r26 push is not seen\r\n" /end ANNOTATION_TEXT
 /end ANNOTATION
/end CHARACTERISTIC
/begin CHARACTERISTIC GAC_CALIB.GAC_FLGREINITNVRQ "" VALUE 0x80610D5B DefaultValueRecordLayout_AUTOSAR_Platform_BaseTypes_boolean 255.0 AUTOSAR_Platform_CompuMethods_boolean 0.0 255. FORMAT "%10.5"
 /begin ANNOTATION ANNOTATION_LABEL "Description (coming from AUTOSAR DESC field)" /begin ANNOTATION_TEXT "Flag requesting re-initialisation of NV variables.\r\n" /end ANNOTATION_TEXT /end ANNOTATION
/end CHARACTERISTIC
/begin CHARACTERISTIC GAC_CALIB.GAC_FLGRESETADPINGRPOSNRQ "" VALUE 0x80610D5C DefaultValueRecordLayout_AUTOSAR_Platform_BaseTypes_boolean 255.0 AUTOSAR_Platform_CompuMethods_boolean 0.0 255. FORMAT "%10.5"
 /begin ANNOTATION ANNOTATION_LABEL "Description (coming from AUTOSAR DESC field)"
  /begin ANNOTATION_TEXT "Flag requesting reset of in gear position adaptation.\r\n" /end ANNOTATION_TEXT
 /end ANNOTATION
/end CHARACTERISTIC
/begin CHARACTERISTIC GAC_CALIB.GAC_FLGRESETENGAGEDETAILS "" VALUE 0x80610D5D DefaultValueRecordLayout_AUTOSAR_Platform_BaseTypes_uint8 255.0 DefaultIdenticalCompu 0.0 255. FORMAT "%10.5"
 /begin ANNOTATION ANNOTATION_LABEL "Description (coming from AUTOSAR DESC field)" /begin ANNOTATION_TEXT "flag to manually reset the engagement details table\r\n" /end ANNOTATION_TEXT /end ANNOTATION
/end CHARACTERISTIC
/begin CHARACTERISTIC GAC_CALIB.GAC_FLGSCMDDONEHBCINIT "" VAL_BLK 0x80610C50 DefaultValueRecordLayout_AUTOSAR_Platform_BaseTypes_boolean 255.0 AUTOSAR_Platform_CompuMethods_boolean 0.0 255. FORMAT "%10.5"
 /begin ANNOTATION ANNOTATION_LABEL "Description (coming from AUTOSAR DESC field)"
  /begin ANNOTATION_TEXT "Array of initialisation flags indicating corresponding (IdsCmdRespHBC) command completed by the Hybrid and Bank controller (HBC).\r\n" /end ANNOTATION_TEXT
 /end ANNOTATION
 MATRIX_DIM 5 1 1 /end CHARACTERISTIC
/begin CHARACTERISTIC GAC_CALIB.GAC_FLGSCOMPATGRSPAR "" VAL_BLK 0x80610B8B DefaultValueRecordLayout_AUTOSAR_Platform_BaseTypes_boolean 255.0 AUTOSAR_Platform_CompuMethods_boolean 0.0 255. FORMAT "%10.5"
 /begin ANNOTATION ANNOTATION_LABEL "Description (coming from AUTOSAR DESC field)"
  /begin ANNOTATION_TEXT "Array indicating compatible combinations of odd and even gear requests.\r\n" /end ANNOTATION_TEXT
 /end ANNOTATION
 MATRIX_DIM 12 12 1 /end CHARACTERISTIC
/begin CHARACTERISTIC GAC_CALIB.GAC_FLGSELECTNEUTRALFASTDFALLS "" VALUE 0x80610D5E DefaultValueRecordLayout_AUTOSAR_Platform_BaseTypes_uint8 255.0 DefaultIdenticalCompu 0.0 255. FORMAT "%10.5"
 /begin ANNOTATION ANNOTATION_LABEL "Description (coming from AUTOSAR DESC field)"
  /begin ANNOTATION_TEXT "Flag to enable the strategy to select neutral when the fast D conditions are no longer true\r\n" /end ANNOTATION_TEXT
 /end ANNOTATION
/end CHARACTERISTIC
/begin CHARACTERISTIC GAC_CALIB.GAC_FLGSEVENGRPAR "" VAL_BLK 0x80610C1B DefaultValueRecordLayout_AUTOSAR_Platform_BaseTypes_boolean 255.0 AUTOSAR_Platform_CompuMethods_boolean 0.0 255. FORMAT "%10.5"
 /begin ANNOTATION ANNOTATION_LABEL "Description (coming from AUTOSAR DESC field)"
  /begin ANNOTATION_TEXT "Array of flags indicating the gear is on the even bank.\r\n" /end ANNOTATION_TEXT
 /end ANNOTATION
 MATRIX_DIM 12 1 1 /end CHARACTERISTIC
/begin CHARACTERISTIC GAC_CALIB.GAC_FLGSODDGRPAR "" VAL_BLK 0x80610C27 DefaultValueRecordLayout_AUTOSAR_Platform_BaseTypes_boolean 255.0 AUTOSAR_Platform_CompuMethods_boolean 0.0 255. FORMAT "%10.5"
 /begin ANNOTATION ANNOTATION_LABEL "Description (coming from AUTOSAR DESC field)"
  /begin ANNOTATION_TEXT "Array of flags indicating the gear is on the odd bank.\r\n" /end ANNOTATION_TEXT
 /end ANNOTATION
 MATRIX_DIM 12 1 1 /end CHARACTERISTIC
/begin CHARACTERISTIC GAC_CALIB.GAC_FLGUSEOLDTIMEEST "" VALUE 0x80610D5F DefaultValueRecordLayout_AUTOSAR_Platform_BaseTypes_uint8 255.0 DefaultIdenticalCompu 0.0 255. FORMAT "%10.5"
 /begin ANNOTATION ANNOTATION_LABEL "Description (coming from AUTOSAR DESC field)"
  /begin ANNOTATION_TEXT "Flag to switch back to the old time estimation method\r\n" /end ANNOTATION_TEXT
 /end ANNOTATION
/end CHARACTERISTIC
/begin CHARACTERISTIC GAC_CALIB.GAC_FLWCOOLTHRESHFASTD "" VALUE 0x80610CA0 DefaultValueRecordLayout_AUTOSAR_Platform_BaseTypes_uint16 127.5 RB_PT_PCT_SWC_GAC_CompuMethods_flow_0p01 0.0 127.5 FORMAT "%10.5"
 /begin ANNOTATION ANNOTATION_LABEL "Description (coming from AUTOSAR DESC field)"
  /begin ANNOTATION_TEXT "Clutch cooling flow threshold to enable the fast neutral to drive strategy\r\n" /end ANNOTATION_TEXT
 /end ANNOTATION
/end CHARACTERISTIC
/begin CHARACTERISTIC GAC_CALIB.GAC_FLWRSRV "" VALUE 0x80610CA2 DefaultValueRecordLayout_AUTOSAR_Platform_BaseTypes_uint16 127.5 RB_PT_PCT_SWC_GAC_CompuMethods_flow_0p01 0.0 127.5 FORMAT "%10.5"
 /begin ANNOTATION ANNOTATION_LABEL "Description (coming from AUTOSAR DESC field)" /begin ANNOTATION_TEXT "Forecasted flow demand.\r\n" /end ANNOTATION_TEXT /end ANNOTATION
/end CHARACTERISTIC
/begin CHARACTERISTIC GAC_CALIB.GAC_GracA.GAC_AREAPISTDEFAULT "" VALUE 0x80610EAC DefaultValueRecordLayout_AUTOSAR_Platform_BaseTypes_uint16 0.01 RB_PT_PCT_SWC_GAC_CompuMethods_ratio_0p000001 0.0 0.01 FORMAT "%10.5"
 /begin ANNOTATION ANNOTATION_LABEL "Description (coming from AUTOSAR DESC field)" /begin ANNOTATION_TEXT "Default area of piston in calculations\r\n" /end ANNOTATION_TEXT /end ANNOTATION
/end CHARACTERISTIC
/begin CHARACTERISTIC GAC_CALIB.GAC_GracA.GAC_BlkrRlsCtrl.GAC_POSNGRACBLKRRLSEND "" VALUE 0x80610F6C DefaultValueRecordLayout_AUTOSAR_Platform_BaseTypes_uint16 20.0 RB_PT_PCT_SWC_GAC_CompuMethods_ratio_0p001 0.0 20. FORMAT "%10.5"
 /begin ANNOTATION ANNOTATION_LABEL "Description (coming from AUTOSAR DESC field)"
  /begin ANNOTATION_TEXT "Gear actuator position used for detecting blocker release end.\r\n" /end ANNOTATION_TEXT
 /end ANNOTATION
/end CHARACTERISTIC
/begin CHARACTERISTIC GAC_CALIB.GAC_GracA.GAC_BlkrRlsCtrl.GAC_PRESSBLKRRLSGRNEG "" VAL_BLK 0x80610F58 DefaultValueRecordLayout_AUTOSAR_Platform_BaseTypes_uint16 32.0 RB_PT_PCT_SWC_GAC_CompuMethods_ratio_0p001 0.0 32. FORMAT "%10.5"
 /begin ANNOTATION ANNOTATION_LABEL "Description (coming from AUTOSAR DESC field)"
  /begin ANNOTATION_TEXT "Pressures for blocker release for engaging negative gear.\r\n" /end ANNOTATION_TEXT
 /end ANNOTATION
 MATRIX_DIM 4 1 1 /end CHARACTERISTIC
/begin CHARACTERISTIC GAC_CALIB.GAC_GracA.GAC_BlkrRlsCtrl.GAC_PRESSBLKRRLSGRPOS "" VAL_BLK 0x80610F60 DefaultValueRecordLayout_AUTOSAR_Platform_BaseTypes_uint16 32.0 RB_PT_PCT_SWC_GAC_CompuMethods_ratio_0p001 0.0 32. FORMAT "%10.5"
 /begin ANNOTATION ANNOTATION_LABEL "Description (coming from AUTOSAR DESC field)"
  /begin ANNOTATION_TEXT "Pressures for blocker release for engaging positive gear.\r\n" /end ANNOTATION_TEXT
 /end ANNOTATION
 MATRIX_DIM 4 1 1 /end CHARACTERISTIC
/begin CHARACTERISTIC GAC_CALIB.GAC_GracA.GAC_BlkrRlsCtrl.GAC_PRESSMINBLKRRLS "" VAL_BLK 0x80610F68 DefaultValueRecordLayout_AUTOSAR_Platform_BaseTypes_uint16 32.0 RB_PT_PCT_SWC_GAC_CompuMethods_ratio_0p001 0.0 32. FORMAT "%10.5"
 /begin ANNOTATION ANNOTATION_LABEL "Description (coming from AUTOSAR DESC field)"
  /begin ANNOTATION_TEXT "Minimum pressure steps for blocker release engaging negative/positive gears.\r\n" /end ANNOTATION_TEXT
 /end ANNOTATION
 MATRIX_DIM 2 1 1 /end CHARACTERISTIC
/begin CHARACTERISTIC GAC_CALIB.GAC_GracA.GAC_BlkrRlsCtrl.GAC_PRESSSTEPBLKRLSSTATIC "" VALUE 0x80610F6E DefaultValueRecordLayout_AUTOSAR_Platform_BaseTypes_uint16 32.0 RB_PT_PCT_SWC_GAC_CompuMethods_ratio_0p001 0.0 32. FORMAT "%10.5"
 /begin ANNOTATION ANNOTATION_LABEL "Description (coming from AUTOSAR DESC field)"
  /begin ANNOTATION_TEXT "Minimum pressure step for blocker release for static shift.\r\n" /end ANNOTATION_TEXT
 /end ANNOTATION
/end CHARACTERISTIC
/begin CHARACTERISTIC GAC_CALIB.GAC_GracA.GAC_BOBFLGBYPASSSYNCVALID "" VALUE 0x80610F3A DefaultValueRecordLayout_AUTOSAR_Platform_BaseTypes_uint8 255.0 DefaultIdenticalCompu 0.0 255. FORMAT "%10.5"
 /begin ANNOTATION ANNOTATION_LABEL "Description (coming from AUTOSAR DESC field)" /begin ANNOTATION_TEXT "Bob flag to bypass valid sync check\r\n" /end ANNOTATION_TEXT /end ANNOTATION
/end CHARACTERISTIC
/begin CHARACTERISTIC GAC_CALIB.GAC_GracA.GAC_BRAKEPRESSVLOWAGGLIM "" VALUE 0x80610EAE DefaultValueRecordLayout_AUTOSAR_Platform_BaseTypes_uint16 409.5 RB_PT_PCT_SWC_GAC_CompuMethods_ratio_0p1 0.0 409.5 FORMAT "%10.5"
 /begin ANNOTATION ANNOTATION_LABEL "Description (coming from AUTOSAR DESC field)"
  /begin ANNOTATION_TEXT "The brake pressure limit for the very low aggression to be commanded\r\n" /end ANNOTATION_TEXT
 /end ANNOTATION
/end CHARACTERISTIC
/begin CHARACTERISTIC GAC_CALIB.GAC_GracA.GAC_DIAPISTACTUATORLEFT "" VALUE 0x80610EB0 DefaultValueRecordLayout_AUTOSAR_Platform_BaseTypes_uint16 65.535 RB_PT_PCT_SWC_GAC_CompuMethods_ratio_0p001 0.0 65.535 FORMAT "%10.5"
 /begin ANNOTATION ANNOTATION_LABEL "Description (coming from AUTOSAR DESC field)" /begin ANNOTATION_TEXT "Diameter of the actuator piston - left\r\n" /end ANNOTATION_TEXT /end ANNOTATION
/end CHARACTERISTIC
/begin CHARACTERISTIC GAC_CALIB.GAC_GracA.GAC_DIAPISTACTUATORRIGHT "" VALUE 0x80610EB2 DefaultValueRecordLayout_AUTOSAR_Platform_BaseTypes_uint16 65.535 RB_PT_PCT_SWC_GAC_CompuMethods_ratio_0p001 0.0 65.535 FORMAT "%10.5"
 /begin ANNOTATION ANNOTATION_LABEL "Description (coming from AUTOSAR DESC field)" /begin ANNOTATION_TEXT "Diameter of the actuator piston - right\r\n" /end ANNOTATION_TEXT /end ANNOTATION
/end CHARACTERISTIC
/begin CHARACTERISTIC GAC_CALIB.GAC_GracA.GAC_DtntCtrl.GAC_FLGSAGGDTNTCTRLOK "" VAL_BLK 0x80610F78 DefaultValueRecordLayout_AUTOSAR_Platform_BaseTypes_boolean 255.0 AUTOSAR_Platform_CompuMethods_boolean 0.0 255. FORMAT "%10.5"
 /begin ANNOTATION ANNOTATION_LABEL "Description (coming from AUTOSAR DESC field)"
  /begin ANNOTATION_TEXT "Array of flags enabling detent control for each actuation aggression.\r\n" /end ANNOTATION_TEXT
 /end ANNOTATION
 MATRIX_DIM 4 1 1 /end CHARACTERISTIC
/begin CHARACTERISTIC GAC_CALIB.GAC_GracA.GAC_DtntCtrl.GAC_PRESSDTNTCTRLEOLGRNEG "" VALUE 0x80610F7C DefaultValueRecordLayout_AUTOSAR_Platform_BaseTypes_sint16 64.0 RB_PT_PCT_SWC_GAC_CompuMethods_ratio_0p001 -32. 32. FORMAT "%10.5"
 /begin ANNOTATION ANNOTATION_LABEL "Description (coming from AUTOSAR DESC field)"
  /begin ANNOTATION_TEXT "Pressure for detent control engaging negative gear, during EOL Neutral learn.\r\n" /end ANNOTATION_TEXT
 /end ANNOTATION
/end CHARACTERISTIC
/begin CHARACTERISTIC GAC_CALIB.GAC_GracA.GAC_DtntCtrl.GAC_PRESSDTNTCTRLEOLGRPOS "" VALUE 0x80610F7E DefaultValueRecordLayout_AUTOSAR_Platform_BaseTypes_sint16 64.0 RB_PT_PCT_SWC_GAC_CompuMethods_ratio_0p001 -32. 32. FORMAT "%10.5"
 /begin ANNOTATION ANNOTATION_LABEL "Description (coming from AUTOSAR DESC field)"
  /begin ANNOTATION_TEXT "Pressure for detent control engaging positive gear, during EOL Neutral learn.\r\n" /end ANNOTATION_TEXT
 /end ANNOTATION
/end CHARACTERISTIC
/begin CHARACTERISTIC GAC_CALIB.GAC_GracA.GAC_DtntCtrl.GAC_PRESSDTNTCTRLEVGRNEG "" MAP 0x80610F80 RB_PT_PCT_SWC_GAC_RecordLayouts_RL_Map_sint16_12_uint16_3_sint16_4 64.0 RB_PT_PCT_SWC_GAC_CompuMethods_ratio_0p001 -32. 32. FORMAT "%10.5"
 /begin ANNOTATION ANNOTATION_LABEL "Description (coming from AUTOSAR DESC field)"
  /begin ANNOTATION_TEXT "Detent pressure offset for negative gear engagements - static aggression\r\n" /end ANNOTATION_TEXT
 /end ANNOTATION
 /begin AXIS_DESCR STD_AXIS NO_INPUT_QUANTITY RB_PT_PCT_SWC_GAC_CompuMethods_ratio_0p001 3 0.0 40. FORMAT "%10.5" DEPOSIT ABSOLUTE /end AXIS_DESCR
 /begin AXIS_DESCR STD_AXIS NO_INPUT_QUANTITY RB_PT_PCT_SWC_GAC_CompuMethods_ident 4 -50. 200. FORMAT "%10.5" DEPOSIT ABSOLUTE /end AXIS_DESCR
/end CHARACTERISTIC
/begin CHARACTERISTIC GAC_CALIB.GAC_GracA.GAC_DtntCtrl.GAC_PRESSDTNTCTRLEVGRPOS "" MAP 0x80610FAA RB_PT_PCT_SWC_GAC_RecordLayouts_RL_Map_sint16_12_uint16_3_sint16_4 64.0 RB_PT_PCT_SWC_GAC_CompuMethods_ratio_0p001 -32. 32. FORMAT "%10.5"
 /begin ANNOTATION ANNOTATION_LABEL "Description (coming from AUTOSAR DESC field)"
  /begin ANNOTATION_TEXT "Detent pressure offset for positive gear engagements - static aggression\r\n" /end ANNOTATION_TEXT
 /end ANNOTATION
 /begin AXIS_DESCR STD_AXIS NO_INPUT_QUANTITY RB_PT_PCT_SWC_GAC_CompuMethods_ratio_0p001 3 0.0 40. FORMAT "%10.5" DEPOSIT ABSOLUTE /end AXIS_DESCR
 /begin AXIS_DESCR STD_AXIS NO_INPUT_QUANTITY RB_PT_PCT_SWC_GAC_CompuMethods_ident 4 -50. 200. FORMAT "%10.5" DEPOSIT ABSOLUTE /end AXIS_DESCR
/end CHARACTERISTIC
/begin CHARACTERISTIC GAC_CALIB.GAC_GracA.GAC_DtntCtrl.GAC_PRESSDTNTCTRLHIGRNEG "" MAP 0x80610FD4 RB_PT_PCT_SWC_GAC_RecordLayouts_RL_Map_sint16_12_uint16_3_sint16_4 64.0 RB_PT_PCT_SWC_GAC_CompuMethods_ratio_0p001 -32. 32. FORMAT "%10.5"
 /begin ANNOTATION ANNOTATION_LABEL "Description (coming from AUTOSAR DESC field)"
  /begin ANNOTATION_TEXT "Detent pressure offset for negative gear engagements - high aggression\r\n" /end ANNOTATION_TEXT
 /end ANNOTATION
 /begin AXIS_DESCR STD_AXIS NO_INPUT_QUANTITY RB_PT_PCT_SWC_GAC_CompuMethods_ratio_0p001 3 0.0 40. FORMAT "%10.5" DEPOSIT ABSOLUTE /end AXIS_DESCR
 /begin AXIS_DESCR STD_AXIS NO_INPUT_QUANTITY RB_PT_PCT_SWC_GAC_CompuMethods_ident 4 -50. 200. FORMAT "%10.5" DEPOSIT ABSOLUTE /end AXIS_DESCR
/end CHARACTERISTIC
/begin CHARACTERISTIC GAC_CALIB.GAC_GracA.GAC_DtntCtrl.GAC_PRESSDTNTCTRLHIGRPOS "" MAP 0x80610FFE RB_PT_PCT_SWC_GAC_RecordLayouts_RL_Map_sint16_12_uint16_3_sint16_4 64.0 RB_PT_PCT_SWC_GAC_CompuMethods_ratio_0p001 -32. 32. FORMAT "%10.5"
 /begin ANNOTATION ANNOTATION_LABEL "Description (coming from AUTOSAR DESC field)"
  /begin ANNOTATION_TEXT "Detent pressure offset for positive gear engagements - high aggression\r\n" /end ANNOTATION_TEXT
 /end ANNOTATION
 /begin AXIS_DESCR STD_AXIS NO_INPUT_QUANTITY RB_PT_PCT_SWC_GAC_CompuMethods_ratio_0p001 3 0.0 40. FORMAT "%10.5" DEPOSIT ABSOLUTE /end AXIS_DESCR
 /begin AXIS_DESCR STD_AXIS NO_INPUT_QUANTITY RB_PT_PCT_SWC_GAC_CompuMethods_ident 4 -50. 200. FORMAT "%10.5" DEPOSIT ABSOLUTE /end AXIS_DESCR
/end CHARACTERISTIC
/begin CHARACTERISTIC GAC_CALIB.GAC_GracA.GAC_DtntCtrl.GAC_PRESSDTNTCTRLLOWGRNEG "" MAP 0x80611028 RB_PT_PCT_SWC_GAC_RecordLayouts_RL_Map_sint16_12_uint16_3_sint16_4 64.0 RB_PT_PCT_SWC_GAC_CompuMethods_ratio_0p001 -32. 32. FORMAT "%10.5"
 /begin ANNOTATION ANNOTATION_LABEL "Description (coming from AUTOSAR DESC field)"
  /begin ANNOTATION_TEXT "Detent pressure offset for negative gear engagements - low aggression\r\n" /end ANNOTATION_TEXT
 /end ANNOTATION
 /begin AXIS_DESCR STD_AXIS NO_INPUT_QUANTITY RB_PT_PCT_SWC_GAC_CompuMethods_ratio_0p001 3 0.0 40. FORMAT "%10.5" DEPOSIT ABSOLUTE /end AXIS_DESCR
 /begin AXIS_DESCR STD_AXIS NO_INPUT_QUANTITY RB_PT_PCT_SWC_GAC_CompuMethods_ident 4 -50. 200. FORMAT "%10.5" DEPOSIT ABSOLUTE /end AXIS_DESCR
/end CHARACTERISTIC
/begin CHARACTERISTIC GAC_CALIB.GAC_GracA.GAC_DtntCtrl.GAC_PRESSDTNTCTRLLOWGRPOS "" MAP 0x80611052 RB_PT_PCT_SWC_GAC_RecordLayouts_RL_Map_sint16_12_uint16_3_sint16_4 64.0 RB_PT_PCT_SWC_GAC_CompuMethods_ratio_0p001 -32. 32. FORMAT "%10.5"
 /begin ANNOTATION ANNOTATION_LABEL "Description (coming from AUTOSAR DESC field)"
  /begin ANNOTATION_TEXT "Detent pressure offset for positive gear engagements - low aggression\r\n" /end ANNOTATION_TEXT
 /end ANNOTATION
 /begin AXIS_DESCR STD_AXIS NO_INPUT_QUANTITY RB_PT_PCT_SWC_GAC_CompuMethods_ratio_0p001 3 0.0 40. FORMAT "%10.5" DEPOSIT ABSOLUTE /end AXIS_DESCR
 /begin AXIS_DESCR STD_AXIS NO_INPUT_QUANTITY RB_PT_PCT_SWC_GAC_CompuMethods_ident 4 -50. 200. FORMAT "%10.5" DEPOSIT ABSOLUTE /end AXIS_DESCR
/end CHARACTERISTIC
/begin CHARACTERISTIC GAC_CALIB.GAC_GracA.GAC_DtntCtrl.GAC_PRESSDTNTCTRLMEDGRNEG "" MAP 0x8061107C RB_PT_PCT_SWC_GAC_RecordLayouts_RL_Map_sint16_12_uint16_3_sint16_4 64.0 RB_PT_PCT_SWC_GAC_CompuMethods_ratio_0p001 -32. 32. FORMAT "%10.5"
 /begin ANNOTATION ANNOTATION_LABEL "Description (coming from AUTOSAR DESC field)"
  /begin ANNOTATION_TEXT "Detent pressure offset for negative gear engagements - medium aggression\r\n" /end ANNOTATION_TEXT
 /end ANNOTATION
 /begin AXIS_DESCR STD_AXIS NO_INPUT_QUANTITY RB_PT_PCT_SWC_GAC_CompuMethods_ratio_0p001 3 0.0 40. FORMAT "%10.5" DEPOSIT ABSOLUTE /end AXIS_DESCR
 /begin AXIS_DESCR STD_AXIS NO_INPUT_QUANTITY RB_PT_PCT_SWC_GAC_CompuMethods_ident 4 -50. 200. FORMAT "%10.5" DEPOSIT ABSOLUTE /end AXIS_DESCR
/end CHARACTERISTIC
/begin CHARACTERISTIC GAC_CALIB.GAC_GracA.GAC_DtntCtrl.GAC_PRESSDTNTCTRLMEDGRPOS "" MAP 0x806110A6 RB_PT_PCT_SWC_GAC_RecordLayouts_RL_Map_sint16_12_uint16_3_sint16_4 64.0 RB_PT_PCT_SWC_GAC_CompuMethods_ratio_0p001 -32. 32. FORMAT "%10.5"
 /begin ANNOTATION ANNOTATION_LABEL "Description (coming from AUTOSAR DESC field)"
  /begin ANNOTATION_TEXT "Detent pressure offset for positive gear engagements - medium aggression\r\n" /end ANNOTATION_TEXT
 /end ANNOTATION
 /begin AXIS_DESCR STD_AXIS NO_INPUT_QUANTITY RB_PT_PCT_SWC_GAC_CompuMethods_ratio_0p001 3 0.0 40. FORMAT "%10.5" DEPOSIT ABSOLUTE /end AXIS_DESCR
 /begin AXIS_DESCR STD_AXIS NO_INPUT_QUANTITY RB_PT_PCT_SWC_GAC_CompuMethods_ident 4 -50. 200. FORMAT "%10.5" DEPOSIT ABSOLUTE /end AXIS_DESCR
/end CHARACTERISTIC
/begin CHARACTERISTIC GAC_CALIB.GAC_GracA.GAC_DtntCtrl.GAC_PRESSDTNTCTRLSTATICGRNEG "" MAP 0x806110D0 RB_PT_PCT_SWC_GAC_RecordLayouts_RL_Map_sint16_12_uint16_3_sint16_4 64.0 RB_PT_PCT_SWC_GAC_CompuMethods_ratio_0p001 -32. 32. FORMAT "%10.5"
 /begin ANNOTATION ANNOTATION_LABEL "Description (coming from AUTOSAR DESC field)"
  /begin ANNOTATION_TEXT "Detent pressure offset for negative gear engagements - static aggression\r\n" /end ANNOTATION_TEXT
 /end ANNOTATION
 /begin AXIS_DESCR STD_AXIS NO_INPUT_QUANTITY RB_PT_PCT_SWC_GAC_CompuMethods_ratio_0p001 3 0.0 40. FORMAT "%10.5" DEPOSIT ABSOLUTE /end AXIS_DESCR
 /begin AXIS_DESCR STD_AXIS NO_INPUT_QUANTITY RB_PT_PCT_SWC_GAC_CompuMethods_ident 4 -50. 200. FORMAT "%10.5" DEPOSIT ABSOLUTE /end AXIS_DESCR
/end CHARACTERISTIC
/begin CHARACTERISTIC GAC_CALIB.GAC_GracA.GAC_DtntCtrl.GAC_PRESSDTNTCTRLSTATICGRPOS "" MAP 0x806110FA RB_PT_PCT_SWC_GAC_RecordLayouts_RL_Map_sint16_12_uint16_3_sint16_4 64.0 RB_PT_PCT_SWC_GAC_CompuMethods_ratio_0p001 -32. 32. FORMAT "%10.5"
 /begin ANNOTATION ANNOTATION_LABEL "Description (coming from AUTOSAR DESC field)"
  /begin ANNOTATION_TEXT "Detent pressure offset for positive gear engagements - static aggression\r\n" /end ANNOTATION_TEXT
 /end ANNOTATION
 /begin AXIS_DESCR STD_AXIS NO_INPUT_QUANTITY RB_PT_PCT_SWC_GAC_CompuMethods_ratio_0p001 3 0.0 40. FORMAT "%10.5" DEPOSIT ABSOLUTE /end AXIS_DESCR
 /begin AXIS_DESCR STD_AXIS NO_INPUT_QUANTITY RB_PT_PCT_SWC_GAC_CompuMethods_ident 4 -50. 200. FORMAT "%10.5" DEPOSIT ABSOLUTE /end AXIS_DESCR
/end CHARACTERISTIC
/begin CHARACTERISTIC GAC_CALIB.GAC_GracA.GAC_DtntCtrl.GAC_PRESSDTNTCTRLVLOWGRNEG "" MAP 0x80611124 RB_PT_PCT_SWC_GAC_RecordLayouts_RL_Map_sint16_12_uint16_3_sint16_4 64.0 RB_PT_PCT_SWC_GAC_CompuMethods_ratio_0p001 -32. 32. FORMAT "%10.5"
 /begin ANNOTATION ANNOTATION_LABEL "Description (coming from AUTOSAR DESC field)"
  /begin ANNOTATION_TEXT "Detent pressure offset for negative gear engagements - very low aggression\r\n" /end ANNOTATION_TEXT
 /end ANNOTATION
 /begin AXIS_DESCR STD_AXIS NO_INPUT_QUANTITY RB_PT_PCT_SWC_GAC_CompuMethods_ratio_0p001 3 0.0 40. FORMAT "%10.5" DEPOSIT ABSOLUTE /end AXIS_DESCR
 /begin AXIS_DESCR STD_AXIS NO_INPUT_QUANTITY RB_PT_PCT_SWC_GAC_CompuMethods_ident 4 -50. 200. FORMAT "%10.5" DEPOSIT ABSOLUTE /end AXIS_DESCR
/end CHARACTERISTIC
/begin CHARACTERISTIC GAC_CALIB.GAC_GracA.GAC_DtntCtrl.GAC_PRESSDTNTCTRLVLOWGRPOS "" MAP 0x8061114E RB_PT_PCT_SWC_GAC_RecordLayouts_RL_Map_sint16_12_uint16_3_sint16_4 64.0 RB_PT_PCT_SWC_GAC_CompuMethods_ratio_0p001 -32. 32. FORMAT "%10.5"
 /begin ANNOTATION ANNOTATION_LABEL "Description (coming from AUTOSAR DESC field)"
  /begin ANNOTATION_TEXT "Detent pressure offset for positive gear engagements - very low aggression\r\n" /end ANNOTATION_TEXT
 /end ANNOTATION
 /begin AXIS_DESCR STD_AXIS NO_INPUT_QUANTITY RB_PT_PCT_SWC_GAC_CompuMethods_ratio_0p001 3 0.0 40. FORMAT "%10.5" DEPOSIT ABSOLUTE /end AXIS_DESCR
 /begin AXIS_DESCR STD_AXIS NO_INPUT_QUANTITY RB_PT_PCT_SWC_GAC_CompuMethods_ident 4 -50. 200. FORMAT "%10.5" DEPOSIT ABSOLUTE /end AXIS_DESCR
/end CHARACTERISTIC
/begin CHARACTERISTIC GAC_CALIB.GAC_GracA.GAC_DtntCtrl.GAC_VELSGRACDTNTCTRLLIM "" VAL_BLK 0x80610F70 DefaultValueRecordLayout_AUTOSAR_Platform_BaseTypes_uint16 1.2 RB_PT_PCT_SWC_GAC_CompuMethods_ratio_0p001 0.0 1.2 FORMAT "%10.5"
 /begin ANNOTATION ANNOTATION_LABEL "Description (coming from AUTOSAR DESC field)"
  /begin ANNOTATION_TEXT "Array of gear actuator velocities for each actuation aggression, used for limiting of detent control.\r\n" /end ANNOTATION_TEXT
 /end ANNOTATION
 MATRIX_DIM 4 1 1 /end CHARACTERISTIC
/begin CHARACTERISTIC GAC_CALIB.GAC_GracA.GAC_FCTFLWRIGHT "" VALUE 0x80610EB4 DefaultValueRecordLayout_AUTOSAR_Platform_BaseTypes_uint16 1.5 RB_PT_PCT_SWC_GAC_CompuMethods_ratio_0p001 0.0 1.5 FORMAT "%10.5"
 /begin ANNOTATION ANNOTATION_LABEL "Description (coming from AUTOSAR DESC field)"
  /begin ANNOTATION_TEXT "Factor for upscaling the flow demand due to piston area difference.\r\n" /end ANNOTATION_TEXT
 /end ANNOTATION
/end CHARACTERISTIC
/begin CHARACTERISTIC GAC_CALIB.GAC_GracA.GAC_FCTPRESSRIGHT "" VALUE 0x80610EB6 DefaultValueRecordLayout_AUTOSAR_Platform_BaseTypes_uint16 1.5 RB_PT_PCT_SWC_GAC_CompuMethods_ratio_0p001 0.0 1.5 FORMAT "%10.5"
 /begin ANNOTATION ANNOTATION_LABEL "Description (coming from AUTOSAR DESC field)"
  /begin ANNOTATION_TEXT "Factor for upscaling the flow demand due to piston area difference.\r\n" /end ANNOTATION_TEXT
 /end ANNOTATION
/end CHARACTERISTIC
/begin CHARACTERISTIC GAC_CALIB.GAC_GracA.GAC_FCTRONSYNCLRNDELTAADPT "" VALUE 0x80610F3B DefaultValueRecordLayout_AUTOSAR_Platform_BaseTypes_uint8 1.0 RB_PT_PCT_SWC_GAC_CompuMethods_ratio_0p01 0.0 1. FORMAT "%10.5"
 /begin ANNOTATION ANNOTATION_LABEL "Description (coming from AUTOSAR DESC field)" /begin ANNOTATION_TEXT "Factor to adapt the in gear position by\r\n" /end ANNOTATION_TEXT /end ANNOTATION
/end CHARACTERISTIC
/begin CHARACTERISTIC GAC_CALIB.GAC_GracA.GAC_FCTRRETRYINGRPOSMOD "" VALUE 0x80610EB8 DefaultValueRecordLayout_AUTOSAR_Platform_BaseTypes_sint16 40.0 RB_PT_PCT_SWC_GAC_CompuMethods_ratio_0p001 -20. 20. FORMAT "%10.5"
 /begin ANNOTATION ANNOTATION_LABEL "Description (coming from AUTOSAR DESC field)"
  /begin ANNOTATION_TEXT "The modification factor to the in gear position on retries\r\n" /end ANNOTATION_TEXT
 /end ANNOTATION
/end CHARACTERISTIC
/begin CHARACTERISTIC GAC_CALIB.GAC_GracA.GAC_FLGAGGEVENBL "" VALUE 0x80610F3C DefaultValueRecordLayout_AUTOSAR_Platform_BaseTypes_uint8 255.0 DefaultIdenticalCompu 0.0 255. FORMAT "%10.5"
 /begin ANNOTATION ANNOTATION_LABEL "Description (coming from AUTOSAR DESC field)"
  /begin ANNOTATION_TEXT "Flag to indicate if the EV mode aggression can be used\r\n" /end ANNOTATION_TEXT
 /end ANNOTATION
/end CHARACTERISTIC
/begin CHARACTERISTIC GAC_CALIB.GAC_GracA.GAC_FLGBOBADAPTPONEVERYSHIFT "" VALUE 0x80610F3D DefaultValueRecordLayout_AUTOSAR_Platform_BaseTypes_uint8 255.0 DefaultIdenticalCompu 0.0 255. FORMAT "%10.5"
 /begin ANNOTATION ANNOTATION_LABEL "Description (coming from AUTOSAR DESC field)"
  /begin ANNOTATION_TEXT "Trigger the logic to clear the adaptions and relearn them on every shift\r\n" /end ANNOTATION_TEXT
 /end ANNOTATION
/end CHARACTERISTIC
/begin CHARACTERISTIC GAC_CALIB.GAC_GracA.GAC_FLGDISABLEGBLK2ITERM "" VALUE 0x80610F3E DefaultValueRecordLayout_AUTOSAR_Platform_BaseTypes_uint8 255.0 DefaultIdenticalCompu 0.0 255. FORMAT "%10.5"
 /begin ANNOTATION ANNOTATION_LABEL "Description (coming from AUTOSAR DESC field)" /begin ANNOTATION_TEXT "Flag to disable the i term during gear blocking 2\r\n" /end ANNOTATION_TEXT /end ANNOTATION
/end CHARACTERISTIC
/begin CHARACTERISTIC GAC_CALIB.GAC_GracA.GAC_FLGDISABLENEGDETECTION "" VALUE 0x80610F3F DefaultValueRecordLayout_AUTOSAR_Platform_BaseTypes_uint8 255.0 DefaultIdenticalCompu 0.0 255. FORMAT "%10.5"
 /begin ANNOTATION ANNOTATION_LABEL "Description (coming from AUTOSAR DESC field)" /begin ANNOTATION_TEXT "Flag to disable negative gear detection\r\n" /end ANNOTATION_TEXT /end ANNOTATION
/end CHARACTERISTIC
/begin CHARACTERISTIC GAC_CALIB.GAC_GracA.GAC_FLGDISABLEPOSDETECTION "" VALUE 0x80610F40 DefaultValueRecordLayout_AUTOSAR_Platform_BaseTypes_uint8 255.0 DefaultIdenticalCompu 0.0 255. FORMAT "%10.5"
 /begin ANNOTATION ANNOTATION_LABEL "Description (coming from AUTOSAR DESC field)" /begin ANNOTATION_TEXT "Flag to disable positive gear detection\r\n" /end ANNOTATION_TEXT /end ANNOTATION
/end CHARACTERISTIC
/begin CHARACTERISTIC GAC_CALIB.GAC_GracA.GAC_FLGDISABLESLIPCHECK "" VALUE 0x80610F41 DefaultValueRecordLayout_AUTOSAR_Platform_BaseTypes_uint8 255.0 DefaultIdenticalCompu 0.0 255. FORMAT "%10.5"
 /begin ANNOTATION ANNOTATION_LABEL "Description (coming from AUTOSAR DESC field)"
  /begin ANNOTATION_TEXT "Flag to disable slip checking for the end of synchronisation\r\n" /end ANNOTATION_TEXT
 /end ANNOTATION
/end CHARACTERISTIC
/begin CHARACTERISTIC GAC_CALIB.GAC_GracA.GAC_FLGENBLBENDCOMPSYNCPOS "" VALUE 0x80610F42 DefaultValueRecordLayout_AUTOSAR_Platform_BaseTypes_uint8 255.0 DefaultIdenticalCompu 0.0 255. FORMAT "%10.5"
 /begin ANNOTATION ANNOTATION_LABEL "Description (coming from AUTOSAR DESC field)" /begin ANNOTATION_TEXT "flag to enable synchroniser bending compensation\r\n" /end ANNOTATION_TEXT /end ANNOTATION
/end CHARACTERISTIC
/begin CHARACTERISTIC GAC_CALIB.GAC_GracA.GAC_FLGENBLCALCFLWTGT "" VALUE 0x80610F43 DefaultValueRecordLayout_AUTOSAR_Platform_BaseTypes_uint8 255.0 DefaultIdenticalCompu 0.0 255. FORMAT "%10.5"
 /begin ANNOTATION ANNOTATION_LABEL "Description (coming from AUTOSAR DESC field)" /begin ANNOTATION_TEXT "Flag to activate calculated flow target\r\n" /end ANNOTATION_TEXT /end ANNOTATION
/end CHARACTERISTIC
/begin CHARACTERISTIC GAC_CALIB.GAC_GracA.GAC_FLGENBLNBANDMODIFY "" VALUE 0x80610F44 DefaultValueRecordLayout_AUTOSAR_Platform_BaseTypes_uint8 255.0 DefaultIdenticalCompu 0.0 255. FORMAT "%10.5"
 /begin ANNOTATION ANNOTATION_LABEL "Description (coming from AUTOSAR DESC field)"
  /begin ANNOTATION_TEXT "Flag to allow the neutral window to be modified for gear floating cases\r\n" /end ANNOTATION_TEXT
 /end ANNOTATION
/end CHARACTERISTIC
/begin CHARACTERISTIC GAC_CALIB.GAC_GracA.GAC_FLGENBLNEUTRALCLOSEOUT "" VALUE 0x80610F45 DefaultValueRecordLayout_AUTOSAR_Platform_BaseTypes_uint8 255.0 DefaultIdenticalCompu 0.0 255. FORMAT "%10.5"
 /begin ANNOTATION ANNOTATION_LABEL "Description (coming from AUTOSAR DESC field)"
  /begin ANNOTATION_TEXT "Flag to enable I term to close out small errors in neutral\r\n" /end ANNOTATION_TEXT
 /end ANNOTATION
/end CHARACTERISTIC
/begin CHARACTERISTIC GAC_CALIB.GAC_GracA.GAC_FLGENBLPRESSANDHOLD "" VALUE 0x80610F46 DefaultValueRecordLayout_AUTOSAR_Platform_BaseTypes_uint8 255.0 DefaultIdenticalCompu 0.0 255. FORMAT "%10.5"
 /begin ANNOTATION ANNOTATION_LABEL "Description (coming from AUTOSAR DESC field)" /begin ANNOTATION_TEXT "Flag to enable press and hold functionality\r\n" /end ANNOTATION_TEXT /end ANNOTATION
/end CHARACTERISTIC
/begin CHARACTERISTIC GAC_CALIB.GAC_GracA.GAC_FLGENBLPRESSCONTROLDISABLE "" VALUE 0x80610F47 DefaultValueRecordLayout_AUTOSAR_Platform_BaseTypes_uint8 255.0 DefaultIdenticalCompu 0.0 255. FORMAT "%10.5"
 /begin ANNOTATION ANNOTATION_LABEL "Description (coming from AUTOSAR DESC field)"
  /begin ANNOTATION_TEXT "Flag to disable the pressure control terms (pressure i, p, and velocity i) terms from impacting the EOL position learn\r\n" /end ANNOTATION_TEXT
 /end ANNOTATION
/end CHARACTERISTIC
/begin CHARACTERISTIC GAC_CALIB.GAC_GracA.GAC_FLGENBLPRESSINTONEUTRAL "" VALUE 0x80610F48 DefaultValueRecordLayout_AUTOSAR_Platform_BaseTypes_uint8 255.0 DefaultIdenticalCompu 0.0 255. FORMAT "%10.5"
 /begin ANNOTATION ANNOTATION_LABEL "Description (coming from AUTOSAR DESC field)" /begin ANNOTATION_TEXT "Flag to enable press and hold functionality\r\n" /end ANNOTATION_TEXT /end ANNOTATION
/end CHARACTERISTIC
/begin CHARACTERISTIC GAC_CALIB.GAC_GracA.GAC_FLGENBLVLOWAGG "" VALUE 0x80610F49 DefaultValueRecordLayout_AUTOSAR_Platform_BaseTypes_uint8 255.0 DefaultIdenticalCompu 0.0 255. FORMAT "%10.5"
 /begin ANNOTATION ANNOTATION_LABEL "Description (coming from AUTOSAR DESC field)" /begin ANNOTATION_TEXT "Flag to enable very low aggression\r\n" /end ANNOTATION_TEXT /end ANNOTATION
/end CHARACTERISTIC
/begin CHARACTERISTIC GAC_CALIB.GAC_GracA.GAC_FLGEVMODEAGGVERYLOW "" VALUE 0x80610F4A DefaultValueRecordLayout_AUTOSAR_Platform_BaseTypes_uint8 255.0 DefaultIdenticalCompu 0.0 255. FORMAT "%10.5"
 /begin ANNOTATION ANNOTATION_LABEL "Description (coming from AUTOSAR DESC field)" /begin ANNOTATION_TEXT "flag to allow the very low aggression for EV mode\r\n" /end ANNOTATION_TEXT /end ANNOTATION
/end CHARACTERISTIC
/begin CHARACTERISTIC GAC_CALIB.GAC_GracA.GAC_FLGEVSYNCAGAINSTDRAGENBL "" VALUE 0x80610F4B DefaultValueRecordLayout_AUTOSAR_Platform_BaseTypes_uint8 255.0 DefaultIdenticalCompu 0.0 255. FORMAT "%10.5"
 /begin ANNOTATION ANNOTATION_LABEL "Description (coming from AUTOSAR DESC field)"
  /begin ANNOTATION_TEXT "Flag to enable the strategy to only synchronise against the drag\r\n" /end ANNOTATION_TEXT
 /end ANNOTATION
/end CHARACTERISTIC
/begin CHARACTERISTIC GAC_CALIB.GAC_GracA.GAC_FLGGBLK0MINTGTSYNC "" VALUE 0x80610F4C DefaultValueRecordLayout_AUTOSAR_Platform_BaseTypes_uint8 255.0 DefaultIdenticalCompu 0.0 255. FORMAT "%10.5"
 /begin ANNOTATION ANNOTATION_LABEL "Description (coming from AUTOSAR DESC field)"
  /begin ANNOTATION_TEXT "flag to enable the strategy to have the gblk 0 time at least as large as the target time to synchronise the shaft\r\n" /end ANNOTATION_TEXT
 /end ANNOTATION
/end CHARACTERISTIC
/begin CHARACTERISTIC GAC_CALIB.GAC_GracA.GAC_FLGLIMITENDPRESSTOSYNCPRESS "" VALUE 0x80610F4D DefaultValueRecordLayout_AUTOSAR_Platform_BaseTypes_uint8 255.0 DefaultIdenticalCompu 0.0 255. FORMAT "%10.5"
 /begin ANNOTATION ANNOTATION_LABEL "Description (coming from AUTOSAR DESC field)"
  /begin ANNOTATION_TEXT "limit the minimum pressure in the free flight phase to the max pressure during the synchronisation phase\r\n" /end ANNOTATION_TEXT
 /end ANNOTATION
/end CHARACTERISTIC
/begin CHARACTERISTIC GAC_CALIB.GAC_GracA.GAC_FLGMOVINGMUSTBEINRANGE "" VALUE 0x80610F4E DefaultValueRecordLayout_AUTOSAR_Platform_BaseTypes_uint8 255.0 DefaultIdenticalCompu 0.0 255. FORMAT "%10.5"
 /begin ANNOTATION ANNOTATION_LABEL "Description (coming from AUTOSAR DESC field)" /begin ANNOTATION_TEXT "Moving detected must be in position range\r\n" /end ANNOTATION_TEXT /end ANNOTATION
/end CHARACTERISTIC
/begin CHARACTERISTIC GAC_CALIB.GAC_GracA.GAC_FLGNOPOSPOSNFROMN "" VALUE 0x80610F4F DefaultValueRecordLayout_AUTOSAR_Platform_BaseTypes_boolean 255.0 AUTOSAR_Platform_CompuMethods_boolean 0.0 255. FORMAT "%10.5"
 /begin ANNOTATION ANNOTATION_LABEL "Description (coming from AUTOSAR DESC field)"
  /begin ANNOTATION_TEXT "Flag inhibiting entry to positive position states, once in Neutral.\r\n" /end ANNOTATION_TEXT
 /end ANNOTATION
/end CHARACTERISTIC
/begin CHARACTERISTIC GAC_CALIB.GAC_GracA.GAC_FLGNOTMPCONDUPDATE "" VALUE 0x80610F50 DefaultValueRecordLayout_AUTOSAR_Platform_BaseTypes_boolean 255.0 AUTOSAR_Platform_CompuMethods_boolean 0.0 255. FORMAT "%10.5"
 /begin ANNOTATION ANNOTATION_LABEL "Description (coming from AUTOSAR DESC field)"
  /begin ANNOTATION_TEXT "Flag enabling continuous update of slow tasks without depending on temperature change condition.\r\n" /end ANNOTATION_TEXT
 /end ANNOTATION
/end CHARACTERISTIC
/begin CHARACTERISTIC GAC_CALIB.GAC_GracA.GAC_FLGNSTOPITERMRESETMAXTMR "" VALUE 0x80610F51 DefaultValueRecordLayout_AUTOSAR_Platform_BaseTypes_uint8 255.0 DefaultIdenticalCompu 0.0 255. FORMAT "%10.5"
 /begin ANNOTATION ANNOTATION_LABEL "Description (coming from AUTOSAR DESC field)"
  /begin ANNOTATION_TEXT "Flag to activate a maximum timer for the N stop I term reset\r\n" /end ANNOTATION_TEXT
 /end ANNOTATION
/end CHARACTERISTIC
/begin CHARACTERISTIC GAC_CALIB.GAC_GracA.GAC_FLGPVSCONFIG "" VALUE 0x80610F52 DefaultValueRecordLayout_AUTOSAR_Platform_BaseTypes_uint8 255.0 DefaultIdenticalCompu 0.0 255. FORMAT "%10.5"
 /begin ANNOTATION ANNOTATION_LABEL "Description (coming from AUTOSAR DESC field)"
  /begin ANNOTATION_TEXT "Flag to indicate whether or not the transmission is a PVS transmission\r\n" /end ANNOTATION_TEXT
 /end ANNOTATION
/end CHARACTERISTIC
/begin CHARACTERISTIC GAC_CALIB.GAC_GracA.GAC_FLGRESETGBLCKPRESSWHENMOVING "" VALUE 0x80610F53 DefaultValueRecordLayout_AUTOSAR_Platform_BaseTypes_uint8 255.0 DefaultIdenticalCompu 0.0 255. FORMAT "%10.5"
 /begin ANNOTATION ANNOTATION_LABEL "Description (coming from AUTOSAR DESC field)"
  /begin ANNOTATION_TEXT "Flag to reset the additional pressure from the gear block 3 pressure ramp once the synchro is moving\r\n" /end ANNOTATION_TEXT
 /end ANNOTATION
/end CHARACTERISTIC
/begin CHARACTERISTIC GAC_CALIB.GAC_GracA.GAC_FLGRESETITERMONSYNC "" VALUE 0x80610F54 DefaultValueRecordLayout_AUTOSAR_Platform_BaseTypes_uint8 255.0 DefaultIdenticalCompu 0.0 255. FORMAT "%10.5"
 /begin ANNOTATION ANNOTATION_LABEL "Description (coming from AUTOSAR DESC field)" /begin ANNOTATION_TEXT "Flag to reset the I term when on the synchro cone\r\n" /end ANNOTATION_TEXT /end ANNOTATION
/end CHARACTERISTIC
/begin CHARACTERISTIC GAC_CALIB.GAC_GracA.GAC_FLGSTATICADAPTENBL "" VALUE 0x80610F55 DefaultValueRecordLayout_AUTOSAR_Platform_BaseTypes_uint8 255.0 DefaultIdenticalCompu 0.0 255. FORMAT "%10.5"
 /begin ANNOTATION ANNOTATION_LABEL "Description (coming from AUTOSAR DESC field)" /begin ANNOTATION_TEXT "Allow static adaptions\r\n" /end ANNOTATION_TEXT /end ANNOTATION
/end CHARACTERISTIC
/begin CHARACTERISTIC GAC_CALIB.GAC_GracA.GAC_FLGUSELEARNEDSYNCPOS "" VALUE 0x80610F56 DefaultValueRecordLayout_AUTOSAR_Platform_BaseTypes_uint8 255.0 DefaultIdenticalCompu 0.0 255. FORMAT "%10.5"
 /begin ANNOTATION ANNOTATION_LABEL "Description (coming from AUTOSAR DESC field)"
  /begin ANNOTATION_TEXT "Flag to indicate the use of the learned on synchro position when determining synchronisation end\r\n" /end ANNOTATION_TEXT
 /end ANNOTATION
/end CHARACTERISTIC
/begin CHARACTERISTIC GAC_CALIB.GAC_GracA.GAC_FLGUSENSTOPERROR "" VALUE 0x80610F57 DefaultValueRecordLayout_AUTOSAR_Platform_BaseTypes_uint8 255.0 DefaultIdenticalCompu 0.0 255. FORMAT "%10.5"
 /begin ANNOTATION ANNOTATION_LABEL "Description (coming from AUTOSAR DESC field)" /begin ANNOTATION_TEXT "Flag to use N stop error instead of main error term\r\n" /end ANNOTATION_TEXT /end ANNOTATION
/end CHARACTERISTIC
/begin CHARACTERISTIC GAC_CALIB.GAC_GracA.GAC_FLOWMINITERMCLOSEOUT "" VALUE 0x80610EBA DefaultValueRecordLayout_AUTOSAR_Platform_BaseTypes_sint16 64.0 RB_PT_PCT_SWC_GAC_CompuMethods_ratio_0p001 -32. 32. FORMAT "%10.5"
 /begin ANNOTATION ANNOTATION_LABEL "Description (coming from AUTOSAR DESC field)" /begin ANNOTATION_TEXT "minimum synchro flow to enable neutral close out\r\n" /end ANNOTATION_TEXT /end ANNOTATION
/end CHARACTERISTIC
/begin CHARACTERISTIC GAC_CALIB.GAC_GracA.GAC_FLWGHOLDBCKLIM "" VALUE 0x80610EBC DefaultValueRecordLayout_AUTOSAR_Platform_BaseTypes_sint16 64.0 RB_PT_PCT_SWC_GAC_CompuMethods_ratio_0p001 -32. 32. FORMAT "%10.5"
 /begin ANNOTATION ANNOTATION_LABEL "Description (coming from AUTOSAR DESC field)" /begin ANNOTATION_TEXT "Flow limit used for GHold active.\r\n" /end ANNOTATION_TEXT /end ANNOTATION
/end CHARACTERISTIC
/begin CHARACTERISTIC GAC_CALIB.GAC_GracA.GAC_FLWMINGBLCK3 "" VALUE 0x80610EBE DefaultValueRecordLayout_AUTOSAR_Platform_BaseTypes_sint16 64.0 RB_PT_PCT_SWC_GAC_CompuMethods_ratio_0p001 -32. 32. FORMAT "%10.5"
 /begin ANNOTATION ANNOTATION_LABEL "Description (coming from AUTOSAR DESC field)" /begin ANNOTATION_TEXT "minimum flow to allow gear block 3 strategy\r\n" /end ANNOTATION_TEXT /end ANNOTATION
/end CHARACTERISTIC
/begin CHARACTERISTIC GAC_CALIB.GAC_GracA.GAC_FLWSFFVELCTRLNOSYNCABS "" CURVE 0x80611302 RB_PT_PCT_SWC_GAC_RecordLayouts_RL_Curve_uint16_4_uint16_4 32.0 RB_PT_PCT_SWC_GAC_CompuMethods_ratio_0p001 0.0 32. FORMAT "%10.5"
 /begin ANNOTATION ANNOTATION_LABEL "Description (coming from AUTOSAR DESC field)"
  /begin ANNOTATION_TEXT "Unsigned feedforward flow gains for velocity control before the synchro phase or Neutral actuation.\r\n" /end ANNOTATION_TEXT
 /end ANNOTATION
 /begin AXIS_DESCR STD_AXIS NO_INPUT_QUANTITY RB_PT_PCT_SWC_GAC_CompuMethods_ratio_0p001 4 0.0 1.2 FORMAT "%10.5" DEPOSIT ABSOLUTE /end AXIS_DESCR
/end CHARACTERISTIC
/begin CHARACTERISTIC GAC_CALIB.GAC_GracA.GAC_FLWSFFVELCTRLSYNCABS "" CURVE 0x80611314 RB_PT_PCT_SWC_GAC_RecordLayouts_RL_Curve_uint16_4_uint16_4 32.0 RB_PT_PCT_SWC_GAC_CompuMethods_ratio_0p001 0.0 32. FORMAT "%10.5"
 /begin ANNOTATION ANNOTATION_LABEL "Description (coming from AUTOSAR DESC field)"
  /begin ANNOTATION_TEXT "Unsigned feedforward flow gains for velocity control after the synchro phase.\r\n" /end ANNOTATION_TEXT
 /end ANNOTATION
 /begin AXIS_DESCR STD_AXIS NO_INPUT_QUANTITY RB_PT_PCT_SWC_GAC_CompuMethods_ratio_0p001 4 0.0 1.2 FORMAT "%10.5" DEPOSIT ABSOLUTE /end AXIS_DESCR
/end CHARACTERISTIC
/begin CHARACTERISTIC GAC_CALIB.GAC_GracA.GAC_FLWSIVELCTRLNOSYNC "" CURVE 0x80611326 RB_PT_PCT_SWC_GAC_RecordLayouts_RL_Curve_sint16_7_sint16_7 64.0 RB_PT_PCT_SWC_GAC_CompuMethods_ratio_0p001 -32. 32. FORMAT "%10.5"
 /begin ANNOTATION ANNOTATION_LABEL "Description (coming from AUTOSAR DESC field)"
  /begin ANNOTATION_TEXT "Integral flow gains for velocity control before the synchro phase.\r\n" /end ANNOTATION_TEXT
 /end ANNOTATION
 /begin AXIS_DESCR STD_AXIS NO_INPUT_QUANTITY RB_PT_PCT_SWC_GAC_CompuMethods_ratio_0p001 7 -1.2 1.2 FORMAT "%10.5" DEPOSIT ABSOLUTE /end AXIS_DESCR
/end CHARACTERISTIC
/begin CHARACTERISTIC GAC_CALIB.GAC_GracA.GAC_FLWSIVELCTRLSYNC "" CURVE 0x80611344 RB_PT_PCT_SWC_GAC_RecordLayouts_RL_Curve_sint16_7_sint16_7 64.0 RB_PT_PCT_SWC_GAC_CompuMethods_ratio_0p001 -32. 32. FORMAT "%10.5"
 /begin ANNOTATION ANNOTATION_LABEL "Description (coming from AUTOSAR DESC field)"
  /begin ANNOTATION_TEXT "Integral flow gains for velocity control after the synchro phase.\r\n" /end ANNOTATION_TEXT
 /end ANNOTATION
 /begin AXIS_DESCR STD_AXIS NO_INPUT_QUANTITY RB_PT_PCT_SWC_GAC_CompuMethods_ratio_0p001 7 -1.2 1.2 FORMAT "%10.5" DEPOSIT ABSOLUTE /end AXIS_DESCR
/end CHARACTERISTIC
/begin CHARACTERISTIC GAC_CALIB.GAC_GracA.GAC_FLWSNHOLD "" CURVE 0x80611362 RB_PT_PCT_SWC_GAC_RecordLayouts_RL_Curve_sint16_4_uint16_4 64.0 RB_PT_PCT_SWC_GAC_CompuMethods_ratio_0p001 -32. 32. FORMAT "%10.5"
 /begin ANNOTATION ANNOTATION_LABEL "Description (coming from AUTOSAR DESC field)"
  /begin ANNOTATION_TEXT "Proportional flow gains for velocity (position) control in NHold or drain phase after actuation to Neutral.\r\n" /end ANNOTATION_TEXT
 /end ANNOTATION
 /begin AXIS_DESCR STD_AXIS NO_INPUT_QUANTITY RB_PT_PCT_SWC_GAC_CompuMethods_ratio_0p001 4 0.0 20. FORMAT "%10.5" DEPOSIT ABSOLUTE /end AXIS_DESCR
/end CHARACTERISTIC
/begin CHARACTERISTIC GAC_CALIB.GAC_GracA.GAC_FLWSPVELCTRLGHOLD "" CURVE 0x80611374 RB_PT_PCT_SWC_GAC_RecordLayouts_RL_Curve_sint16_7_sint16_7 64.0 RB_PT_PCT_SWC_GAC_CompuMethods_ratio_0p001 -32. 32. FORMAT "%10.5"
 /begin ANNOTATION ANNOTATION_LABEL "Description (coming from AUTOSAR DESC field)"
  /begin ANNOTATION_TEXT "Proportional flow gains for velocity (position) control in the GHold phase.\r\n" /end ANNOTATION_TEXT
 /end ANNOTATION
 /begin AXIS_DESCR STD_AXIS NO_INPUT_QUANTITY RB_PT_PCT_SWC_GAC_CompuMethods_ratio_0p001 7 -2. 2. FORMAT "%10.5" DEPOSIT ABSOLUTE /end AXIS_DESCR
/end CHARACTERISTIC
/begin CHARACTERISTIC GAC_CALIB.GAC_GracA.GAC_FLWSPVELCTRLGHOLDRULE26 "" CURVE 0x80611392 RB_PT_PCT_SWC_GAC_RecordLayouts_RL_Curve_sint16_7_sint16_7 64.0 RB_PT_PCT_SWC_GAC_CompuMethods_ratio_0p001 -32. 32. FORMAT "%10.5"
 /begin ANNOTATION ANNOTATION_LABEL "Description (coming from AUTOSAR DESC field)"
  /begin ANNOTATION_TEXT "Proportional flow gains for velocity (position) control in the GHold phase.\r\n" /end ANNOTATION_TEXT
 /end ANNOTATION
 /begin AXIS_DESCR STD_AXIS NO_INPUT_QUANTITY RB_PT_PCT_SWC_GAC_CompuMethods_ratio_0p001 7 -2. 2. FORMAT "%10.5" DEPOSIT ABSOLUTE /end AXIS_DESCR
/end CHARACTERISTIC
/begin CHARACTERISTIC GAC_CALIB.GAC_GracA.GAC_FLWSPVELCTRLNSTOP "" MAP 0x806113B0 RB_PT_PCT_SWC_GAC_RecordLayouts_RL_Map_sint16_27_sint16_9_sint16_3 64.0 RB_PT_PCT_SWC_GAC_CompuMethods_ratio_0p001 -32. 32. FORMAT "%10.5"
 /begin ANNOTATION ANNOTATION_LABEL "Description (coming from AUTOSAR DESC field)"
  /begin ANNOTATION_TEXT "Proportional flow gains for velocity control in the NStop phase.\r\n" /end ANNOTATION_TEXT
 /end ANNOTATION
 /begin AXIS_DESCR STD_AXIS NO_INPUT_QUANTITY RB_PT_PCT_SWC_GAC_CompuMethods_ratio_0p001 9 -1.2 1.2 FORMAT "%10.5" DEPOSIT ABSOLUTE /end AXIS_DESCR
 /begin AXIS_DESCR STD_AXIS NO_INPUT_QUANTITY RB_PT_PCT_SWC_GAC_CompuMethods_ident 3 -50. 200. FORMAT "%10.5" DEPOSIT ABSOLUTE /end AXIS_DESCR
/end CHARACTERISTIC
/begin CHARACTERISTIC GAC_CALIB.GAC_GracA.GAC_FLWSVLVSTUCKDEM "" VAL_BLK 0x80610E98 DefaultValueRecordLayout_AUTOSAR_Platform_BaseTypes_sint16 64.0 RB_PT_PCT_SWC_GAC_CompuMethods_ratio_0p001 -32. 32. FORMAT "%10.5"
 /begin ANNOTATION ANNOTATION_LABEL "Description (coming from AUTOSAR DESC field)"
  /begin ANNOTATION_TEXT "Flow demands requested by the valve stuck diagnostic and failure handling..\r\n" /end ANNOTATION_TEXT
 /end ANNOTATION
 MATRIX_DIM 3 1 1 /end CHARACTERISTIC
/begin CHARACTERISTIC GAC_CALIB.GAC_GracA.GAC_GracPosnInitTmr.LIB_DT "" VALUE 0x80611178 DefaultValueRecordLayout_AUTOSAR_Platform_BaseTypes_uint16 65.535 RB_PT_PCT_SWC_GAC_CompuMethods_ratio_0p001 0.0 65.535 FORMAT "%10.5"
 /begin ANNOTATION ANNOTATION_LABEL "Description (coming from AUTOSAR DESC field)" /begin ANNOTATION_TEXT "Timer decrement value.\r\n" /end ANNOTATION_TEXT /end ANNOTATION
/end CHARACTERISTIC
/begin CHARACTERISTIC GAC_CALIB.GAC_GracA.GAC_IDDIAGENBLSHIFT "" VALUE 0x80610EA0 DefaultValueRecordLayout_AUTOSAR_Platform_BaseTypes_uint32 4194304.0 RB_PT_PCT_SWC_GAC_CompuMethods_ident 0.0 4194304. FORMAT "%10.5"
 /begin ANNOTATION ANNOTATION_LABEL "Description (coming from AUTOSAR DESC field)"
  /begin ANNOTATION_TEXT "multiplication factor to shift the bits for each actuator\r\n" /end ANNOTATION_TEXT
 /end ANNOTATION
/end CHARACTERISTIC
/begin CHARACTERISTIC GAC_CALIB.GAC_GracA.GAC_InGearLearn.GAC_FCTRINGEARLRNDELTAADPT "" VALUE 0x80611182 DefaultValueRecordLayout_AUTOSAR_Platform_BaseTypes_uint8 1.0 RB_PT_PCT_SWC_GAC_CompuMethods_ratio_0p01 0.0 1. FORMAT "%10.5"
 /begin ANNOTATION ANNOTATION_LABEL "Description (coming from AUTOSAR DESC field)"
  /begin ANNOTATION_TEXT "percentage factor of the delta that is added to the learned in gear position\r\n" /end ANNOTATION_TEXT
 /end ANNOTATION
/end CHARACTERISTIC
/begin CHARACTERISTIC GAC_CALIB.GAC_GracA.GAC_InGearLearn.GAC_FCTRINGEARLRNDELTAADPTNOSTORE "" VALUE 0x80611183 DefaultValueRecordLayout_AUTOSAR_Platform_BaseTypes_uint8 1.0 RB_PT_PCT_SWC_GAC_CompuMethods_ratio_0p01 0.0 1. FORMAT "%10.5"
 /begin ANNOTATION ANNOTATION_LABEL "Description (coming from AUTOSAR DESC field)"
  /begin ANNOTATION_TEXT "percentage factor of the delta that is added to the learned in gear position\r\n" /end ANNOTATION_TEXT
 /end ANNOTATION
/end CHARACTERISTIC
/begin CHARACTERISTIC GAC_CALIB.GAC_GracA.GAC_InGearLearn.GAC_FLGCHECKNOFSTDURINGINGRLEARN "" VALUE 0x80611184 DefaultValueRecordLayout_AUTOSAR_Platform_BaseTypes_uint8 255.0 DefaultIdenticalCompu 0.0 255. FORMAT "%10.5"
 /begin ANNOTATION ANNOTATION_LABEL "Description (coming from AUTOSAR DESC field)"
  /begin ANNOTATION_TEXT "Flag to enable/disable checking neutral offset during in gear learn\r\n" /end ANNOTATION_TEXT
 /end ANNOTATION
/end CHARACTERISTIC
/begin CHARACTERISTIC GAC_CALIB.GAC_GracA.GAC_InGearLearn.GAC_FLGCHECKNOFSTDURINGUDSEXPORT "" VALUE 0x80611185 DefaultValueRecordLayout_AUTOSAR_Platform_BaseTypes_uint8 255.0 DefaultIdenticalCompu 0.0 255. FORMAT "%10.5"
 /begin ANNOTATION ANNOTATION_LABEL "Description (coming from AUTOSAR DESC field)"
  /begin ANNOTATION_TEXT "Flag to enable/disable checking neutral offset during in gear learn - UDS version\r\n" /end ANNOTATION_TEXT
 /end ANNOTATION
/end CHARACTERISTIC
/begin CHARACTERISTIC GAC_CALIB.GAC_GracA.GAC_InGearLearn.GAC_FLGFORCEINGRLEARNCHECK "" VALUE 0x80611186 DefaultValueRecordLayout_AUTOSAR_Platform_BaseTypes_uint8 255.0 DefaultIdenticalCompu 0.0 255. FORMAT "%10.5"
 /begin ANNOTATION ANNOTATION_LABEL "Description (coming from AUTOSAR DESC field)"
  /begin ANNOTATION_TEXT "Flag to force the in gear position learn check and write to NV\r\n" /end ANNOTATION_TEXT
 /end ANNOTATION
/end CHARACTERISTIC
/begin CHARACTERISTIC GAC_CALIB.GAC_GracA.GAC_InGearLearn.GAC_FLGRESETINGEARPOSIFADAPTBAD "" VALUE 0x80611187 DefaultValueRecordLayout_AUTOSAR_Platform_BaseTypes_uint8 255.0 DefaultIdenticalCompu 0.0 255. FORMAT "%10.5"
 /begin ANNOTATION ANNOTATION_LABEL "Description (coming from AUTOSAR DESC field)"
  /begin ANNOTATION_TEXT "Flag to enable value reset if the adaption if the in gear learned position is bad\r\n" /end ANNOTATION_TEXT
 /end ANNOTATION
/end CHARACTERISTIC
/begin CHARACTERISTIC GAC_CALIB.GAC_GracA.GAC_InGearLearn.GAC_FLGRESETINVALIDLEARN "" VALUE 0x80611188 DefaultValueRecordLayout_AUTOSAR_Platform_BaseTypes_uint8 255.0 DefaultIdenticalCompu 0.0 255. FORMAT "%10.5"
 /begin ANNOTATION ANNOTATION_LABEL "Description (coming from AUTOSAR DESC field)"
  /begin ANNOTATION_TEXT "Flag to enable value reset if any learn if the in gear learned position is bad\r\n" /end ANNOTATION_TEXT
 /end ANNOTATION
/end CHARACTERISTIC
/begin CHARACTERISTIC GAC_CALIB.GAC_GracA.GAC_InGearLearn.GAC_FLGUSEORIGINGRLEARN "" VALUE 0x80611189 DefaultValueRecordLayout_AUTOSAR_Platform_BaseTypes_uint8 255.0 DefaultIdenticalCompu 0.0 255. FORMAT "%10.5"
 /begin ANNOTATION ANNOTATION_LABEL "Description (coming from AUTOSAR DESC field)" /begin ANNOTATION_TEXT "Flag to enable/ disable old in gear learn method\r\n" /end ANNOTATION_TEXT /end ANNOTATION
/end CHARACTERISTIC
/begin CHARACTERISTIC GAC_CALIB.GAC_GracA.GAC_InGearLearn.GAC_IDINGEARLEARNUDSVALUE "" VALUE 0x8061118A DefaultValueRecordLayout_AUTOSAR_Platform_BaseTypes_uint8 255.0 RB_PT_PCT_SWC_GAC_CompuMethods_ident 0.0 255. FORMAT "%10.5"
 /begin ANNOTATION ANNOTATION_LABEL "Description (coming from AUTOSAR DESC field)"
  /begin ANNOTATION_TEXT "Switch case input to switch learned value sent out over UDS\r\n" /end ANNOTATION_TEXT
 /end ANNOTATION
/end CHARACTERISTIC
/begin CHARACTERISTIC GAC_CALIB.GAC_GracA.GAC_InGearLearn.GAC_IDSYNCHRODIRNOTPOSSIBLE "" VALUE 0x8061118B DefaultValueRecordLayout_AUTOSAR_Platform_BaseTypes_uint8 255.0 RB_PT_PCT_SWC_GAC_CompuMethods_ident 0.0 255. FORMAT "%10.5"
 /begin ANNOTATION ANNOTATION_LABEL "Description (coming from AUTOSAR DESC field)"
  /begin ANNOTATION_TEXT "ID to indicate that the synchroniser position direction is not possible (1=left not possible, 2=right not possible)\r\n" /end ANNOTATION_TEXT
 /end ANNOTATION
/end CHARACTERISTIC
/begin CHARACTERISTIC GAC_CALIB.GAC_GracA.GAC_InGearLearn.GAC_POSNLESSINGRLRNNEG "" VALUE 0x8061117A DefaultValueRecordLayout_AUTOSAR_Platform_BaseTypes_uint16 2.0 RB_PT_PCT_SWC_GAC_CompuMethods_ratio_0p001 0.0 2. FORMAT "%10.5"
 /begin ANNOTATION ANNOTATION_LABEL "Description (coming from AUTOSAR DESC field)"
  /begin ANNOTATION_TEXT "Position margin removed for calculation of the learnt in negative gear position.\r\n" /end ANNOTATION_TEXT
 /end ANNOTATION
/end CHARACTERISTIC
/begin CHARACTERISTIC GAC_CALIB.GAC_GracA.GAC_InGearLearn.GAC_POSNLESSINGRLRNPOS "" VALUE 0x8061117C DefaultValueRecordLayout_AUTOSAR_Platform_BaseTypes_uint16 2.0 RB_PT_PCT_SWC_GAC_CompuMethods_ratio_0p001 0.0 2. FORMAT "%10.5"
 /begin ANNOTATION ANNOTATION_LABEL "Description (coming from AUTOSAR DESC field)"
  /begin ANNOTATION_TEXT "Position margin removed for calculation of the learnt in positive gear position.\r\n" /end ANNOTATION_TEXT
 /end ANNOTATION
/end CHARACTERISTIC
/begin CHARACTERISTIC GAC_CALIB.GAC_GracA.GAC_InGearLearn.GAC_POSNMAXINGRLRN "" VALUE 0x8061117E DefaultValueRecordLayout_AUTOSAR_Platform_BaseTypes_sint16 40.0 RB_PT_PCT_SWC_GAC_CompuMethods_ratio_0p001 -20. 20. FORMAT "%10.5"
 /begin ANNOTATION ANNOTATION_LABEL "Description (coming from AUTOSAR DESC field)" /begin ANNOTATION_TEXT "Maximum allowed position for in gear learn.\r\n" /end ANNOTATION_TEXT /end ANNOTATION
/end CHARACTERISTIC
/begin CHARACTERISTIC GAC_CALIB.GAC_GracA.GAC_InGearLearn.GAC_POSNMININGRLRN "" VALUE 0x80611180 DefaultValueRecordLayout_AUTOSAR_Platform_BaseTypes_sint16 40.0 RB_PT_PCT_SWC_GAC_CompuMethods_ratio_0p001 -20. 20. FORMAT "%10.5"
 /begin ANNOTATION ANNOTATION_LABEL "Description (coming from AUTOSAR DESC field)" /begin ANNOTATION_TEXT "Minimum allowed position for in gear learn.\r\n" /end ANNOTATION_TEXT /end ANNOTATION
/end CHARACTERISTIC
/begin CHARACTERISTIC GAC_CALIB.GAC_GracA.GAC_InGearLearnTrig.GAC_BOBFLGFORCEINGEARLEARN "" VALUE 0x80611194 DefaultValueRecordLayout_AUTOSAR_Platform_BaseTypes_uint8 255.0 DefaultIdenticalCompu 0.0 255. FORMAT "%10.5"
 /begin ANNOTATION ANNOTATION_LABEL "Description (coming from AUTOSAR DESC field)" /begin ANNOTATION_TEXT "Flag to force in gear position learn\r\n" /end ANNOTATION_TEXT /end ANNOTATION
/end CHARACTERISTIC
/begin CHARACTERISTIC GAC_CALIB.GAC_GracA.GAC_InGearLearnTrig.GAC_CNTTRIGADPINGRPOS "" VALUE 0x80611195 DefaultValueRecordLayout_AUTOSAR_Platform_BaseTypes_uint8 10.0 RB_PT_PCT_SWC_GAC_CompuMethods_ident 0.0 10. FORMAT "%10.5"
 /begin ANNOTATION ANNOTATION_LABEL "Description (coming from AUTOSAR DESC field)"
  /begin ANNOTATION_TEXT "Counter value used to trigger the request for in positive gear learn.\r\n" /end ANNOTATION_TEXT
 /end ANNOTATION
/end CHARACTERISTIC
/begin CHARACTERISTIC GAC_CALIB.GAC_GracA.GAC_InGearLearnTrig.GAC_CNTTRIGAPPINGRNEG "" VALUE 0x80611196 DefaultValueRecordLayout_AUTOSAR_Platform_BaseTypes_uint8 10.0 RB_PT_PCT_SWC_GAC_CompuMethods_ident 0.0 10. FORMAT "%10.5"
 /begin ANNOTATION ANNOTATION_LABEL "Description (coming from AUTOSAR DESC field)"
  /begin ANNOTATION_TEXT "Counter value used to trigger the request for in negative gear learn.\r\n" /end ANNOTATION_TEXT
 /end ANNOTATION
/end CHARACTERISTIC
/begin CHARACTERISTIC GAC_CALIB.GAC_GracA.GAC_InGearLearnTrig.GAC_FLGSADPINGRNEGAGGOK "" VAL_BLK 0x8061118C DefaultValueRecordLayout_AUTOSAR_Platform_BaseTypes_boolean 255.0 AUTOSAR_Platform_CompuMethods_boolean 0.0 255. FORMAT "%10.5"
 /begin ANNOTATION ANNOTATION_LABEL "Description (coming from AUTOSAR DESC field)"
  /begin ANNOTATION_TEXT "Array of flags indicating in negative gear learn allowed, for each actuation aggression.\r\n" /end ANNOTATION_TEXT
 /end ANNOTATION
 MATRIX_DIM 4 1 1 /end CHARACTERISTIC
/begin CHARACTERISTIC GAC_CALIB.GAC_GracA.GAC_InGearLearnTrig.GAC_FLGSADPINGRPOSAGGOK "" VAL_BLK 0x80611190 DefaultValueRecordLayout_AUTOSAR_Platform_BaseTypes_boolean 255.0 AUTOSAR_Platform_CompuMethods_boolean 0.0 255. FORMAT "%10.5"
 /begin ANNOTATION ANNOTATION_LABEL "Description (coming from AUTOSAR DESC field)"
  /begin ANNOTATION_TEXT "Array of flags indicating in positive gear learn allowed, for each actuation aggression.\r\n" /end ANNOTATION_TEXT
 /end ANNOTATION
 MATRIX_DIM 4 1 1 /end CHARACTERISTIC
/begin CHARACTERISTIC GAC_CALIB.GAC_GracA.GAC_InGrDebTmr.LIB_DT "" VALUE 0x80611198 DefaultValueRecordLayout_AUTOSAR_Platform_BaseTypes_uint16 65.535 RB_PT_PCT_SWC_GAC_CompuMethods_ratio_0p001 0.0 65.535 FORMAT "%10.5"
 /begin ANNOTATION ANNOTATION_LABEL "Description (coming from AUTOSAR DESC field)" /begin ANNOTATION_TEXT "Timer decrement value.\r\n" /end ANNOTATION_TEXT /end ANNOTATION
/end CHARACTERISTIC
/begin CHARACTERISTIC GAC_CALIB.GAC_GracA.GAC_InGrPressToEndStopTmr.LIB_DT "" VALUE 0x8061119A DefaultValueRecordLayout_AUTOSAR_Platform_BaseTypes_uint16 65.535 RB_PT_PCT_SWC_GAC_CompuMethods_ratio_0p001 0.0 65.535 FORMAT "%10.5"
 /begin ANNOTATION ANNOTATION_LABEL "Description (coming from AUTOSAR DESC field)" /begin ANNOTATION_TEXT "Timer decrement value.\r\n" /end ANNOTATION_TEXT /end ANNOTATION
/end CHARACTERISTIC
/begin CHARACTERISTIC GAC_CALIB.GAC_GracA.GAC_InNDebTmr.LIB_DT "" VALUE 0x8061119C DefaultValueRecordLayout_AUTOSAR_Platform_BaseTypes_uint16 65.535 RB_PT_PCT_SWC_GAC_CompuMethods_ratio_0p001 0.0 65.535 FORMAT "%10.5"
 /begin ANNOTATION ANNOTATION_LABEL "Description (coming from AUTOSAR DESC field)" /begin ANNOTATION_TEXT "Timer decrement value.\r\n" /end ANNOTATION_TEXT /end ANNOTATION
/end CHARACTERISTIC
/begin CHARACTERISTIC GAC_CALIB.GAC_GracA.GAC_POSNADPPUSHINGR "" VALUE 0x80610EC0 DefaultValueRecordLayout_AUTOSAR_Platform_BaseTypes_uint16 100.0 RB_PT_PCT_SWC_GAC_CompuMethods_ident 0.0 100. FORMAT "%10.5"
 /begin ANNOTATION ANNOTATION_LABEL "Description (coming from AUTOSAR DESC field)"
  /begin ANNOTATION_TEXT "Gear actuator position used for adaptation 'push in gear'.\r\n" /end ANNOTATION_TEXT
 /end ANNOTATION
/end CHARACTERISTIC
/begin CHARACTERISTIC GAC_CALIB.GAC_GracA.GAC_POSNGRACCLOSEOUTTHRESH "" VALUE 0x80610EC2 DefaultValueRecordLayout_AUTOSAR_Platform_BaseTypes_uint16 20.0 RB_PT_PCT_SWC_GAC_CompuMethods_ratio_0p001 0.0 20. FORMAT "%10.5"
 /begin ANNOTATION ANNOTATION_LABEL "Description (coming from AUTOSAR DESC field)"
  /begin ANNOTATION_TEXT "Maximum absolute synchroniser position for the neutral close out to activate\r\n" /end ANNOTATION_TEXT
 /end ANNOTATION
/end CHARACTERISTIC
/begin CHARACTERISTIC GAC_CALIB.GAC_GracA.GAC_POSNGRACFAILPUSHINGR "" VALUE 0x80610EC4 DefaultValueRecordLayout_AUTOSAR_Platform_BaseTypes_uint16 100.0 RB_PT_PCT_SWC_GAC_CompuMethods_ident 0.0 100. FORMAT "%10.5"
 /begin ANNOTATION ANNOTATION_LABEL "Description (coming from AUTOSAR DESC field)"
  /begin ANNOTATION_TEXT "Gear actuator position used for 'fail push in gear' active.\r\n" /end ANNOTATION_TEXT
 /end ANNOTATION
/end CHARACTERISTIC
/begin CHARACTERISTIC GAC_CALIB.GAC_GracA.GAC_POSNGRACNSTOPRESETI "" VALUE 0x80610EC6 DefaultValueRecordLayout_AUTOSAR_Platform_BaseTypes_uint16 20.0 RB_PT_PCT_SWC_GAC_CompuMethods_ratio_0p001 0.0 20. FORMAT "%10.5"
 /begin ANNOTATION ANNOTATION_LABEL "Description (coming from AUTOSAR DESC field)"
  /begin ANNOTATION_TEXT "Gear actuator position used for resetting the I term during NStop phase.\r\n" /end ANNOTATION_TEXT
 /end ANNOTATION
/end CHARACTERISTIC
/begin CHARACTERISTIC GAC_CALIB.GAC_GracA.GAC_POSNGRACSYNCDEFAULT "" VALUE 0x80610EC8 DefaultValueRecordLayout_AUTOSAR_Platform_BaseTypes_sint16 40.0 RB_PT_PCT_SWC_GAC_CompuMethods_ratio_0p001 -20. 20. FORMAT "%10.5"
 /begin ANNOTATION ANNOTATION_LABEL "Description (coming from AUTOSAR DESC field)"
  /begin ANNOTATION_TEXT "Gear actuator limit position used for synchronisation end detection.\r\n" /end ANNOTATION_TEXT
 /end ANNOTATION
/end CHARACTERISTIC
/begin CHARACTERISTIC GAC_CALIB.GAC_GracA.GAC_POSNGRACSYNCEXITMIN "" VALUE 0x80610ECA DefaultValueRecordLayout_AUTOSAR_Platform_BaseTypes_sint16 40.0 RB_PT_PCT_SWC_GAC_CompuMethods_ratio_0p001 -20. 20. FORMAT "%10.5"
 /begin ANNOTATION ANNOTATION_LABEL "Description (coming from AUTOSAR DESC field)"
  /begin ANNOTATION_TEXT "Gear actuator low position used for synchronisation start detection on the positive gear.\r\n" /end ANNOTATION_TEXT
 /end ANNOTATION
/end CHARACTERISTIC
/begin CHARACTERISTIC GAC_CALIB.GAC_GracA.GAC_POSNGRACSYNCHIGR "" VALUE 0x80610ECC DefaultValueRecordLayout_AUTOSAR_Platform_BaseTypes_sint16 40.0 RB_PT_PCT_SWC_GAC_CompuMethods_ratio_0p001 -20. 20. FORMAT "%10.5"
 /begin ANNOTATION ANNOTATION_LABEL "Description (coming from AUTOSAR DESC field)"
  /begin ANNOTATION_TEXT "Gear actuator high position used for synchronisation start detection on the positive gear.\r\n" /end ANNOTATION_TEXT
 /end ANNOTATION
/end CHARACTERISTIC
/begin CHARACTERISTIC GAC_CALIB.GAC_GracA.GAC_POSNGRACSYNCLOWGR "" VALUE 0x80610ECE DefaultValueRecordLayout_AUTOSAR_Platform_BaseTypes_sint16 40.0 RB_PT_PCT_SWC_GAC_CompuMethods_ratio_0p001 -20. 20. FORMAT "%10.5"
 /begin ANNOTATION ANNOTATION_LABEL "Description (coming from AUTOSAR DESC field)"
  /begin ANNOTATION_TEXT "Gear actuator low position used for synchronisation start detection on the positive gear.\r\n" /end ANNOTATION_TEXT
 /end ANNOTATION
/end CHARACTERISTIC
/begin CHARACTERISTIC GAC_CALIB.GAC_GracA.GAC_POSNMAXINGRLRN "" VALUE 0x80610ED0 DefaultValueRecordLayout_AUTOSAR_Platform_BaseTypes_sint16 40.0 RB_PT_PCT_SWC_GAC_CompuMethods_ratio_0p001 -20. 20. FORMAT "%10.5"
 /begin ANNOTATION ANNOTATION_LABEL "Description (coming from AUTOSAR DESC field)" /begin ANNOTATION_TEXT "Maximum allowed position for in negative gear learn.\r\n" /end ANNOTATION_TEXT /end ANNOTATION
/end CHARACTERISTIC
/begin CHARACTERISTIC GAC_CALIB.GAC_GracA.GAC_POSNMAXMODNBAND "" VALUE 0x80610ED2 DefaultValueRecordLayout_AUTOSAR_Platform_BaseTypes_sint16 40.0 RB_PT_PCT_SWC_GAC_CompuMethods_ratio_0p001 -20. 20. FORMAT "%10.5"
 /begin ANNOTATION ANNOTATION_LABEL "Description (coming from AUTOSAR DESC field)"
  /begin ANNOTATION_TEXT "Maximum allowed position that GAC can modify the neutral offset band for drifting actuators\r\n" /end ANNOTATION_TEXT
 /end ANNOTATION
/end CHARACTERISTIC
/begin CHARACTERISTIC GAC_CALIB.GAC_GracA.GAC_POSNNMODIFY "" VALUE 0x80610ED4 DefaultValueRecordLayout_AUTOSAR_Platform_BaseTypes_sint16 40.0 RB_PT_PCT_SWC_GAC_CompuMethods_ratio_0p001 -20. 20. FORMAT "%10.5"
 /begin ANNOTATION ANNOTATION_LABEL "Description (coming from AUTOSAR DESC field)" /begin ANNOTATION_TEXT "Position offset for the neutral window detection\r\n" /end ANNOTATION_TEXT /end ANNOTATION
/end CHARACTERISTIC
/begin CHARACTERISTIC GAC_CALIB.GAC_GracA.GAC_POSNOFFSETGHOLD "" VALUE 0x80610ED6 DefaultValueRecordLayout_AUTOSAR_Platform_BaseTypes_sint16 40.0 RB_PT_PCT_SWC_GAC_CompuMethods_ratio_0p001 -20. 20. FORMAT "%10.5"
 /begin ANNOTATION ANNOTATION_LABEL "Description (coming from AUTOSAR DESC field)"
  /begin ANNOTATION_TEXT "Position tolerance used for gear hold phase target position.\r\n" /end ANNOTATION_TEXT
 /end ANNOTATION
/end CHARACTERISTIC
/begin CHARACTERISTIC GAC_CALIB.GAC_GracA.GAC_POSNSFRKBENDGRNEG "" CURVE 0x80611402 RB_PT_PCT_SWC_GAC_RecordLayouts_RL_Curve_sint16_6_uint16_6 4.0 RB_PT_PCT_SWC_GAC_CompuMethods_ratio_0p001 -2. 2. FORMAT "%10.5"
 /begin ANNOTATION ANNOTATION_LABEL "Description (coming from AUTOSAR DESC field)"
  /begin ANNOTATION_TEXT "map for pressure to fork bend in the negative direction\r\n" /end ANNOTATION_TEXT
 /end ANNOTATION
 /begin AXIS_DESCR STD_AXIS NO_INPUT_QUANTITY RB_PT_PCT_SWC_GAC_CompuMethods_ratio_0p001 6 0.0 32. FORMAT "%10.5" DEPOSIT ABSOLUTE /end AXIS_DESCR
/end CHARACTERISTIC
/begin CHARACTERISTIC GAC_CALIB.GAC_GracA.GAC_POSNSFRKBENDGRPOS "" CURVE 0x8061141C RB_PT_PCT_SWC_GAC_RecordLayouts_RL_Curve_sint16_6_uint16_6 4.0 RB_PT_PCT_SWC_GAC_CompuMethods_ratio_0p001 -2. 2. FORMAT "%10.5"
 /begin ANNOTATION ANNOTATION_LABEL "Description (coming from AUTOSAR DESC field)"
  /begin ANNOTATION_TEXT "map for pressure to fork bend in the positive direction\r\n" /end ANNOTATION_TEXT
 /end ANNOTATION
 /begin AXIS_DESCR STD_AXIS NO_INPUT_QUANTITY RB_PT_PCT_SWC_GAC_CompuMethods_ratio_0p001 6 0.0 32. FORMAT "%10.5" DEPOSIT ABSOLUTE /end AXIS_DESCR
/end CHARACTERISTIC
/begin CHARACTERISTIC GAC_CALIB.GAC_GracA.GAC_POSNSTRIGNSTOPGRNEG "" CURVE 0x80611436 RB_PT_PCT_SWC_GAC_RecordLayouts_RL_Curve_sint16_4_sint16_4 40.0 RB_PT_PCT_SWC_GAC_CompuMethods_ratio_0p001 -20. 20. FORMAT "%10.5"
 /begin ANNOTATION ANNOTATION_LABEL "Description (coming from AUTOSAR DESC field)"
  /begin ANNOTATION_TEXT "Actuator position which NStop phase is activated - negative gear case.\r\n" /end ANNOTATION_TEXT
 /end ANNOTATION
 /begin AXIS_DESCR STD_AXIS NO_INPUT_QUANTITY RB_PT_PCT_SWC_GAC_CompuMethods_ident 4 -50. 200. FORMAT "%10.5" DEPOSIT ABSOLUTE /end AXIS_DESCR
/end CHARACTERISTIC
/begin CHARACTERISTIC GAC_CALIB.GAC_GracA.GAC_POSNSTRIGNSTOPGRPOS "" CURVE 0x80611448 RB_PT_PCT_SWC_GAC_RecordLayouts_RL_Curve_sint16_4_sint16_4 40.0 RB_PT_PCT_SWC_GAC_CompuMethods_ratio_0p001 -20. 20. FORMAT "%10.5"
 /begin ANNOTATION ANNOTATION_LABEL "Description (coming from AUTOSAR DESC field)"
  /begin ANNOTATION_TEXT "Actuator position which NStop phase is activated - positive gear case.\r\n" /end ANNOTATION_TEXT
 /end ANNOTATION
 /begin AXIS_DESCR STD_AXIS NO_INPUT_QUANTITY RB_PT_PCT_SWC_GAC_CompuMethods_ident 4 -50. 200. FORMAT "%10.5" DEPOSIT ABSOLUTE /end AXIS_DESCR
/end CHARACTERISTIC
/begin CHARACTERISTIC GAC_CALIB.GAC_GracA.GAC_POSNSYNCFORCEEND "" VALUE 0x80610ED8 DefaultValueRecordLayout_AUTOSAR_Platform_BaseTypes_uint16 20.0 RB_PT_PCT_SWC_GAC_CompuMethods_ratio_0p001 0.0 20. FORMAT "%10.5"
 /begin ANNOTATION ANNOTATION_LABEL "Description (coming from AUTOSAR DESC field)"
  /begin ANNOTATION_TEXT "Position that the synchronisation phase is forced to end\r\n" /end ANNOTATION_TEXT
 /end ANNOTATION
/end CHARACTERISTIC
/begin CHARACTERISTIC GAC_CALIB.GAC_GracA.GAC_POSNTOLEXITNEOLDONE "" VALUE 0x80610EDA DefaultValueRecordLayout_AUTOSAR_Platform_BaseTypes_sint16 40.0 RB_PT_PCT_SWC_GAC_CompuMethods_ratio_0p001 -20. 20. FORMAT "%10.5"
 /begin ANNOTATION ANNOTATION_LABEL "Description (coming from AUTOSAR DESC field)"
  /begin ANNOTATION_TEXT "Neutral position tolerance when EOL Neutral learn has completed.\r\n" /end ANNOTATION_TEXT
 /end ANNOTATION
/end CHARACTERISTIC
/begin CHARACTERISTIC GAC_CALIB.GAC_GracA.GAC_POSNTOLGHOLD "" VALUE 0x80610EDC DefaultValueRecordLayout_AUTOSAR_Platform_BaseTypes_uint16 5.0 RB_PT_PCT_SWC_GAC_CompuMethods_ratio_0p001 0.0 5. FORMAT "%10.5"
 /begin ANNOTATION ANNOTATION_LABEL "Description (coming from AUTOSAR DESC field)"
  /begin ANNOTATION_TEXT "Position tolerance used for gear hold phase target position.\r\n" /end ANNOTATION_TEXT
 /end ANNOTATION
/end CHARACTERISTIC
/begin CHARACTERISTIC GAC_CALIB.GAC_GracA.GAC_POSNTOLINNEOLDONE "" VALUE 0x80610EDE DefaultValueRecordLayout_AUTOSAR_Platform_BaseTypes_sint16 40.0 RB_PT_PCT_SWC_GAC_CompuMethods_ratio_0p001 -20. 20. FORMAT "%10.5"
 /begin ANNOTATION ANNOTATION_LABEL "Description (coming from AUTOSAR DESC field)"
  /begin ANNOTATION_TEXT "Neutral position tolerance when EOL Neutral learn has completed.\r\n" /end ANNOTATION_TEXT
 /end ANNOTATION
/end CHARACTERISTIC
/begin CHARACTERISTIC GAC_CALIB.GAC_GracA.GAC_POSNTRIGNSTOPDFLT "" VALUE 0x80610EE0 DefaultValueRecordLayout_AUTOSAR_Platform_BaseTypes_sint16 40.0 RB_PT_PCT_SWC_GAC_CompuMethods_ratio_0p001 -20. 20. FORMAT "%10.5"
 /begin ANNOTATION ANNOTATION_LABEL "Description (coming from AUTOSAR DESC field)"
  /begin ANNOTATION_TEXT "Actuator position which NStop phase is activated - default value.\r\n" /end ANNOTATION_TEXT
 /end ANNOTATION
/end CHARACTERISTIC
/begin CHARACTERISTIC GAC_CALIB.GAC_GracA.GAC_PPPULSETMC "" VALUE 0x80610EE2 DefaultValueRecordLayout_AUTOSAR_Platform_BaseTypes_sint16 200.0 RB_PT_PCT_SWC_GAC_CompuMethods_ident -100. 100. FORMAT "%10.5"
 /begin ANNOTATION ANNOTATION_LABEL "Description (coming from AUTOSAR DESC field)"
  /begin ANNOTATION_TEXT "pP valve pressure pulse time linear function - intercept value.\r\n" /end ANNOTATION_TEXT
 /end ANNOTATION
/end CHARACTERISTIC
/begin CHARACTERISTIC GAC_CALIB.GAC_GracA.GAC_PPPULSETMM "" VALUE 0x80610EE4 DefaultValueRecordLayout_AUTOSAR_Platform_BaseTypes_sint16 2.0 RB_PT_PCT_SWC_GAC_CompuMethods_ratio_0p01 -1. 1. FORMAT "%10.5"
 /begin ANNOTATION ANNOTATION_LABEL "Description (coming from AUTOSAR DESC field)"
  /begin ANNOTATION_TEXT "pP valve pressure pulse time linear function - gradient value.\r\n" /end ANNOTATION_TEXT
 /end ANNOTATION
/end CHARACTERISTIC
/begin CHARACTERISTIC GAC_CALIB.GAC_GracA.GAC_PRESSADDGBLKTMOUT "" VALUE 0x80610EE6 DefaultValueRecordLayout_AUTOSAR_Platform_BaseTypes_uint16 32.0 RB_PT_PCT_SWC_GAC_CompuMethods_ratio_0p001 0.0 32. FORMAT "%10.5"
 /begin ANNOTATION ANNOTATION_LABEL "Description (coming from AUTOSAR DESC field)" /begin ANNOTATION_TEXT "Pressure step added for gear block timeout.\r\n" /end ANNOTATION_TEXT /end ANNOTATION
/end CHARACTERISTIC
/begin CHARACTERISTIC GAC_CALIB.GAC_GracA.GAC_PRESSFFVELCTRLNOSYNC "" MAP 0x8061145A RB_PT_PCT_SWC_GAC_RecordLayouts_RL_Map_uint16_12_uint16_6_sint16_2 32.0 RB_PT_PCT_SWC_GAC_CompuMethods_ratio_0p001 0.0 32. FORMAT "%10.5"
 /begin ANNOTATION ANNOTATION_LABEL "Description (coming from AUTOSAR DESC field)"
  /begin ANNOTATION_TEXT "Feedforward pressure gains for velocity control before the synchro phase or Neutral actuation.\r\n" /end ANNOTATION_TEXT
 /end ANNOTATION
 /begin AXIS_DESCR STD_AXIS NO_INPUT_QUANTITY RB_PT_PCT_SWC_GAC_CompuMethods_ratio_0p001 6 0.0 1.2 FORMAT "%10.5" DEPOSIT ABSOLUTE /end AXIS_DESCR
 /begin AXIS_DESCR STD_AXIS NO_INPUT_QUANTITY RB_PT_PCT_SWC_GAC_CompuMethods_ident 2 -50. 200. FORMAT "%10.5" DEPOSIT ABSOLUTE /end AXIS_DESCR
/end CHARACTERISTIC
/begin CHARACTERISTIC GAC_CALIB.GAC_GracA.GAC_PRESSFFVELCTRLNOSYNC2 "" CURVE 0x80611486 RB_PT_PCT_SWC_GAC_RecordLayouts_RL_Curve_uint16_5_uint16_5 32.0 RB_PT_PCT_SWC_GAC_CompuMethods_ratio_0p001 0.0 32. FORMAT "%10.5"
 /begin ANNOTATION ANNOTATION_LABEL "Description (coming from AUTOSAR DESC field)"
  /begin ANNOTATION_TEXT "Feedforward pressure gains for velocity control before the synchro phase or Neutral actuation.\r\n" /end ANNOTATION_TEXT
 /end ANNOTATION
 /begin AXIS_DESCR STD_AXIS NO_INPUT_QUANTITY RB_PT_PCT_SWC_GAC_CompuMethods_ratio_0p001 5 0.0 1.2 FORMAT "%10.5" DEPOSIT ABSOLUTE /end AXIS_DESCR
/end CHARACTERISTIC
/begin CHARACTERISTIC GAC_CALIB.GAC_GracA.GAC_PRESSFFVELCTRLSYNC "" MAP 0x8061149C RB_PT_PCT_SWC_GAC_RecordLayouts_RL_Map_uint16_10_uint16_5_sint16_2 32.0 RB_PT_PCT_SWC_GAC_CompuMethods_ratio_0p001 0.0 32. FORMAT "%10.5"
 /begin ANNOTATION ANNOTATION_LABEL "Description (coming from AUTOSAR DESC field)"
  /begin ANNOTATION_TEXT "Feedforward pressure gains for velocity control after the synchro phase.\r\n" /end ANNOTATION_TEXT
 /end ANNOTATION
 /begin AXIS_DESCR STD_AXIS NO_INPUT_QUANTITY RB_PT_PCT_SWC_GAC_CompuMethods_ratio_0p001 5 0.0 1.2 FORMAT "%10.5" DEPOSIT ABSOLUTE /end AXIS_DESCR
 /begin AXIS_DESCR STD_AXIS NO_INPUT_QUANTITY RB_PT_PCT_SWC_GAC_CompuMethods_ident 2 -50. 200. FORMAT "%10.5" DEPOSIT ABSOLUTE /end AXIS_DESCR
/end CHARACTERISTIC
/begin CHARACTERISTIC GAC_CALIB.GAC_GracA.GAC_PRESSFFVELCTRLSYNC2 "" CURVE 0x806114C2 RB_PT_PCT_SWC_GAC_RecordLayouts_RL_Curve_uint16_4_uint16_4 32.0 RB_PT_PCT_SWC_GAC_CompuMethods_ratio_0p001 0.0 32. FORMAT "%10.5"
 /begin ANNOTATION ANNOTATION_LABEL "Description (coming from AUTOSAR DESC field)"
  /begin ANNOTATION_TEXT "Feedforward pressure gains for velocity control after the synchro phase.\r\n" /end ANNOTATION_TEXT
 /end ANNOTATION
 /begin AXIS_DESCR STD_AXIS NO_INPUT_QUANTITY RB_PT_PCT_SWC_GAC_CompuMethods_ratio_0p001 4 0.0 1.2 FORMAT "%10.5" DEPOSIT ABSOLUTE /end AXIS_DESCR
/end CHARACTERISTIC
/begin CHARACTERISTIC GAC_CALIB.GAC_GracA.GAC_PRESSGHOLDACTV "" VALUE 0x80610EE8 DefaultValueRecordLayout_AUTOSAR_Platform_BaseTypes_uint16 32.0 RB_PT_PCT_SWC_GAC_CompuMethods_ratio_0p001 0.0 32. FORMAT "%10.5"
 /begin ANNOTATION ANNOTATION_LABEL "Description (coming from AUTOSAR DESC field)" /begin ANNOTATION_TEXT "Pressure request for GHold active.\r\n" /end ANNOTATION_TEXT /end ANNOTATION
/end CHARACTERISTIC
/begin CHARACTERISTIC GAC_CALIB.GAC_GracA.GAC_PRESSGHOLDACTVNOADAPTION "" VALUE 0x80610EEA DefaultValueRecordLayout_AUTOSAR_Platform_BaseTypes_uint16 32.0 RB_PT_PCT_SWC_GAC_CompuMethods_ratio_0p001 0.0 32. FORMAT "%10.5"
 /begin ANNOTATION ANNOTATION_LABEL "Description (coming from AUTOSAR DESC field)" /begin ANNOTATION_TEXT "Pressure request for GHold active.\r\n" /end ANNOTATION_TEXT /end ANNOTATION
/end CHARACTERISTIC
/begin CHARACTERISTIC GAC_CALIB.GAC_GracA.GAC_PRESSGHOLDACTVNOOTHERSHIFT "" VALUE 0x80610EEC DefaultValueRecordLayout_AUTOSAR_Platform_BaseTypes_uint16 32.0 RB_PT_PCT_SWC_GAC_CompuMethods_ratio_0p001 0.0 32. FORMAT "%10.5"
 /begin ANNOTATION ANNOTATION_LABEL "Description (coming from AUTOSAR DESC field)" /begin ANNOTATION_TEXT "Pressure request for GHold active.\r\n" /end ANNOTATION_TEXT /end ANNOTATION
/end CHARACTERISTIC
/begin CHARACTERISTIC GAC_CALIB.GAC_GracA.GAC_PRESSGHOLDACTVRULE26 "" VALUE 0x80610EEE DefaultValueRecordLayout_AUTOSAR_Platform_BaseTypes_uint16 32.0 RB_PT_PCT_SWC_GAC_CompuMethods_ratio_0p001 0.0 32. FORMAT "%10.5"
 /begin ANNOTATION ANNOTATION_LABEL "Description (coming from AUTOSAR DESC field)" /begin ANNOTATION_TEXT "Pressure request for GHold active.\r\n" /end ANNOTATION_TEXT /end ANNOTATION
/end CHARACTERISTIC
/begin CHARACTERISTIC GAC_CALIB.GAC_GracA.GAC_PRESSGHOLDACTVSTATIC "" VALUE 0x80610EF0 DefaultValueRecordLayout_AUTOSAR_Platform_BaseTypes_uint16 32.0 RB_PT_PCT_SWC_GAC_CompuMethods_ratio_0p001 0.0 32. FORMAT "%10.5"
 /begin ANNOTATION ANNOTATION_LABEL "Description (coming from AUTOSAR DESC field)" /begin ANNOTATION_TEXT "Pressure request for GHold active static cases\r\n" /end ANNOTATION_TEXT /end ANNOTATION
/end CHARACTERISTIC
/begin CHARACTERISTIC GAC_CALIB.GAC_GracA.GAC_PRESSIVELCTRL "" CURVE 0x806114D4 RB_PT_PCT_SWC_GAC_RecordLayouts_RL_Curve_sint16_7_sint16_7 64.0 RB_PT_PCT_SWC_GAC_CompuMethods_ratio_0p001 -32. 32. FORMAT "%10.5"
 /begin ANNOTATION ANNOTATION_LABEL "Description (coming from AUTOSAR DESC field)" /begin ANNOTATION_TEXT "Integral pressure gains for velocity control.\r\n" /end ANNOTATION_TEXT /end ANNOTATION
 /begin AXIS_DESCR STD_AXIS NO_INPUT_QUANTITY RB_PT_PCT_SWC_GAC_CompuMethods_ratio_0p001 7 -1.2 1.2 FORMAT "%10.5" DEPOSIT ABSOLUTE /end AXIS_DESCR
/end CHARACTERISTIC
/begin CHARACTERISTIC GAC_CALIB.GAC_GracA.GAC_PRESSIVELCTRLGBLOCK2 "" CURVE 0x806114F2 RB_PT_PCT_SWC_GAC_RecordLayouts_RL_Curve_sint16_7_sint16_7 64.0 RB_PT_PCT_SWC_GAC_CompuMethods_ratio_0p001 -32. 32. FORMAT "%10.5"
 /begin ANNOTATION ANNOTATION_LABEL "Description (coming from AUTOSAR DESC field)" /begin ANNOTATION_TEXT "Integral pressure gains for velocity control.\r\n" /end ANNOTATION_TEXT /end ANNOTATION
 /begin AXIS_DESCR STD_AXIS NO_INPUT_QUANTITY RB_PT_PCT_SWC_GAC_CompuMethods_ratio_0p001 7 -1.2 1.2 FORMAT "%10.5" DEPOSIT ABSOLUTE /end AXIS_DESCR
/end CHARACTERISTIC
/begin CHARACTERISTIC GAC_CALIB.GAC_GracA.GAC_PRESSIVELCTRLGBLOCK3 "" CURVE 0x80611510 RB_PT_PCT_SWC_GAC_RecordLayouts_RL_Curve_sint16_4_sint16_4 64.0 RB_PT_PCT_SWC_GAC_CompuMethods_ratio_0p001 -32. 32. FORMAT "%10.5"
 /begin ANNOTATION ANNOTATION_LABEL "Description (coming from AUTOSAR DESC field)" /begin ANNOTATION_TEXT "Integral pressure gains for velocity control.\r\n" /end ANNOTATION_TEXT /end ANNOTATION
 /begin AXIS_DESCR STD_AXIS NO_INPUT_QUANTITY RB_PT_PCT_SWC_GAC_CompuMethods_ratio_0p001 4 -1.2 1.2 FORMAT "%10.5" DEPOSIT ABSOLUTE /end AXIS_DESCR
/end CHARACTERISTIC
/begin CHARACTERISTIC GAC_CALIB.GAC_GracA.GAC_PRESSMINEVPOSTSYNC "" VALUE 0x80610EF2 DefaultValueRecordLayout_AUTOSAR_Platform_BaseTypes_uint16 32.0 RB_PT_PCT_SWC_GAC_CompuMethods_ratio_0p001 0.0 32. FORMAT "%10.5"
 /begin ANNOTATION ANNOTATION_LABEL "Description (coming from AUTOSAR DESC field)" /begin ANNOTATION_TEXT "Minimum pressure demand during velocity control.\r\n" /end ANNOTATION_TEXT /end ANNOTATION
/end CHARACTERISTIC
/begin CHARACTERISTIC GAC_CALIB.GAC_GracA.GAC_PRESSMINVELCTRLDEM "" VALUE 0x80610EF4 DefaultValueRecordLayout_AUTOSAR_Platform_BaseTypes_uint16 32.0 RB_PT_PCT_SWC_GAC_CompuMethods_ratio_0p001 0.0 32. FORMAT "%10.5"
 /begin ANNOTATION ANNOTATION_LABEL "Description (coming from AUTOSAR DESC field)" /begin ANNOTATION_TEXT "Minimum pressure demand during velocity control.\r\n" /end ANNOTATION_TEXT /end ANNOTATION
/end CHARACTERISTIC
/begin CHARACTERISTIC GAC_CALIB.GAC_GracA.GAC_PRESSMINVELCTRLDEMMAP "" CURVE 0x80611522 RB_PT_PCT_SWC_GAC_RecordLayouts_RL_Curve_uint16_4_sint16_4 32.0 RB_PT_PCT_SWC_GAC_CompuMethods_ratio_0p001 0.0 32. FORMAT "%10.5"
 /begin ANNOTATION ANNOTATION_LABEL "Description (coming from AUTOSAR DESC field)"
  /begin ANNOTATION_TEXT "Minimum pressure demand during velocity control based on temperature\r\n" /end ANNOTATION_TEXT
 /end ANNOTATION
 /begin AXIS_DESCR STD_AXIS NO_INPUT_QUANTITY RB_PT_PCT_SWC_GAC_CompuMethods_ident 4 -50. 200. FORMAT "%10.5" DEPOSIT ABSOLUTE /end AXIS_DESCR
/end CHARACTERISTIC
/begin CHARACTERISTIC GAC_CALIB.GAC_GracA.GAC_PRESSONFLWVELCTRLNOSYNC "" MAP 0x80611534 RB_PT_PCT_SWC_GAC_RecordLayouts_RL_Map_uint16_10_uint16_5_sint16_2 32.0 RB_PT_PCT_SWC_GAC_CompuMethods_ratio_0p001 0.0 32. FORMAT "%10.5"
 /begin ANNOTATION ANNOTATION_LABEL "Description (coming from AUTOSAR DESC field)"
  /begin ANNOTATION_TEXT "Flow based pressure gains for velocity control before the synchro phase.\r\n" /end ANNOTATION_TEXT
 /end ANNOTATION
 /begin AXIS_DESCR STD_AXIS NO_INPUT_QUANTITY RB_PT_PCT_SWC_GAC_CompuMethods_ratio_0p001 5 0.0 32. FORMAT "%10.5" DEPOSIT ABSOLUTE /end AXIS_DESCR
 /begin AXIS_DESCR STD_AXIS NO_INPUT_QUANTITY RB_PT_PCT_SWC_GAC_CompuMethods_ident 2 -50. 200. FORMAT "%10.5" DEPOSIT ABSOLUTE /end AXIS_DESCR
/end CHARACTERISTIC
/begin CHARACTERISTIC GAC_CALIB.GAC_GracA.GAC_PRESSONFLWVELCTRLNOSYNC2 "" CURVE 0x8061155A RB_PT_PCT_SWC_GAC_RecordLayouts_RL_Curve_uint16_3_uint16_3 32.0 RB_PT_PCT_SWC_GAC_CompuMethods_ratio_0p001 0.0 32. FORMAT "%10.5"
 /begin ANNOTATION ANNOTATION_LABEL "Description (coming from AUTOSAR DESC field)"
  /begin ANNOTATION_TEXT "Flow based pressure gains for velocity control before the synchro phase.\r\n" /end ANNOTATION_TEXT
 /end ANNOTATION
 /begin AXIS_DESCR STD_AXIS NO_INPUT_QUANTITY RB_PT_PCT_SWC_GAC_CompuMethods_ratio_0p001 3 0.0 32. FORMAT "%10.5" DEPOSIT ABSOLUTE /end AXIS_DESCR
/end CHARACTERISTIC
/begin CHARACTERISTIC GAC_CALIB.GAC_GracA.GAC_PRESSONFLWVELCTRLSYNC "" CURVE 0x80611568 RB_PT_PCT_SWC_GAC_RecordLayouts_RL_Curve_uint16_5_uint16_5 32.0 RB_PT_PCT_SWC_GAC_CompuMethods_ratio_0p001 0.0 32. FORMAT "%10.5"
 /begin ANNOTATION ANNOTATION_LABEL "Description (coming from AUTOSAR DESC field)"
  /begin ANNOTATION_TEXT "Flow based pressure gains for velocity control after the synchro phase.\r\n" /end ANNOTATION_TEXT
 /end ANNOTATION
 /begin AXIS_DESCR STD_AXIS NO_INPUT_QUANTITY RB_PT_PCT_SWC_GAC_CompuMethods_ratio_0p001 5 0.0 32. FORMAT "%10.5" DEPOSIT ABSOLUTE /end AXIS_DESCR
/end CHARACTERISTIC
/begin CHARACTERISTIC GAC_CALIB.GAC_GracA.GAC_PRESSPVLVPULSE "" VALUE 0x80610EF6 DefaultValueRecordLayout_AUTOSAR_Platform_BaseTypes_uint16 32.0 RB_PT_PCT_SWC_GAC_CompuMethods_ratio_0p001 0.0 32. FORMAT "%10.5"
 /begin ANNOTATION ANNOTATION_LABEL "Description (coming from AUTOSAR DESC field)" /begin ANNOTATION_TEXT "Pressure request for pressure valve pulse phase.\r\n" /end ANNOTATION_TEXT /end ANNOTATION
/end CHARACTERISTIC
/begin CHARACTERISTIC GAC_CALIB.GAC_GracA.GAC_PRESSPVLVPULSEDRAIN "" VALUE 0x80610EF8 DefaultValueRecordLayout_AUTOSAR_Platform_BaseTypes_uint16 32.0 RB_PT_PCT_SWC_GAC_CompuMethods_ratio_0p001 0.0 32. FORMAT "%10.5"
 /begin ANNOTATION ANNOTATION_LABEL "Description (coming from AUTOSAR DESC field)"
  /begin ANNOTATION_TEXT "Pressure request for pressure valve pulse if drain phase not yet completed.\r\n" /end ANNOTATION_TEXT
 /end ANNOTATION
/end CHARACTERISTIC
/begin CHARACTERISTIC GAC_CALIB.GAC_GracA.GAC_PRESSSYNCENDEVMAX "" VALUE 0x80610EFA DefaultValueRecordLayout_AUTOSAR_Platform_BaseTypes_uint16 32.0 RB_PT_PCT_SWC_GAC_CompuMethods_ratio_0p001 0.0 32. FORMAT "%10.5"
 /begin ANNOTATION ANNOTATION_LABEL "Description (coming from AUTOSAR DESC field)"
  /begin ANNOTATION_TEXT "Max pressure to hand over into the sync end phase in EV mode\r\n" /end ANNOTATION_TEXT
 /end ANNOTATION
/end CHARACTERISTIC
/begin CHARACTERISTIC GAC_CALIB.GAC_GracA.GAC_PVlvPulseTmr.LIB_DT "" VALUE 0x8061119E DefaultValueRecordLayout_AUTOSAR_Platform_BaseTypes_uint16 65.535 RB_PT_PCT_SWC_GAC_CompuMethods_ratio_0p001 0.0 65.535 FORMAT "%10.5"
 /begin ANNOTATION ANNOTATION_LABEL "Description (coming from AUTOSAR DESC field)" /begin ANNOTATION_TEXT "Timer decrement value.\r\n" /end ANNOTATION_TEXT /end ANNOTATION
/end CHARACTERISTIC
/begin CHARACTERISTIC GAC_CALIB.GAC_GracA.GAC_ROCSPDSYNCSLIPTGTMAX "" VALUE 0x80610EA4 DefaultValueRecordLayout_AUTOSAR_Platform_BaseTypes_uint32 100000.0 RB_PT_PCT_SWC_GAC_CompuMethods_ratio_10p0 0.0 100000. FORMAT "%10.5"
 /begin ANNOTATION ANNOTATION_LABEL "Description (coming from AUTOSAR DESC field)"
  /begin ANNOTATION_TEXT "Maximum limit for target rate of change of synchro slip.\r\n" /end ANNOTATION_TEXT
 /end ANNOTATION
/end CHARACTERISTIC
/begin CHARACTERISTIC GAC_CALIB.GAC_GracA.GAC_ROCSPDSYNCSLIPTGTMIN "" VALUE 0x80610EA8 DefaultValueRecordLayout_AUTOSAR_Platform_BaseTypes_uint32 100000.0 RB_PT_PCT_SWC_GAC_CompuMethods_ratio_10p0 0.0 100000. FORMAT "%10.5"
 /begin ANNOTATION ANNOTATION_LABEL "Description (coming from AUTOSAR DESC field)"
  /begin ANNOTATION_TEXT "Minimum limit for target rate of change of synchro slip.\r\n" /end ANNOTATION_TEXT
 /end ANNOTATION
/end CHARACTERISTIC
/begin CHARACTERISTIC GAC_CALIB.GAC_GracA.GAC_ROCSYNCSLIPGRPOS "" VALUE 0x80610EFC DefaultValueRecordLayout_AUTOSAR_Platform_BaseTypes_sint16 655350.0 RB_PT_PCT_SWC_GAC_CompuMethods_ratio_10p0 -327680. 327670. FORMAT "%10.5"
 /begin ANNOTATION ANNOTATION_LABEL "Description (coming from AUTOSAR DESC field)"
  /begin ANNOTATION_TEXT "Rate of change of synchro slip used for synchro start detection on the positive gear.\r\n" /end ANNOTATION_TEXT
 /end ANNOTATION
/end CHARACTERISTIC
/begin CHARACTERISTIC GAC_CALIB.GAC_GracA.GAC_SPDSLIPSYNCFORGBLK0 "" VALUE 0x80610EFE DefaultValueRecordLayout_AUTOSAR_Platform_BaseTypes_sint16 40000.0 RB_PT_PCT_SWC_GAC_CompuMethods_ident -20000. 20000. FORMAT "%10.5"
 /begin ANNOTATION ANNOTATION_LABEL "Description (coming from AUTOSAR DESC field)"
  /begin ANNOTATION_TEXT "Initial synchroniser slip used for allowing synchoniser start detection.\r\n" /end ANNOTATION_TEXT
 /end ANNOTATION
/end CHARACTERISTIC
/begin CHARACTERISTIC GAC_CALIB.GAC_GracA.GAC_SPDSLIPSYNCFORONSYNC "" VALUE 0x80610F00 DefaultValueRecordLayout_AUTOSAR_Platform_BaseTypes_sint16 40000.0 RB_PT_PCT_SWC_GAC_CompuMethods_ident -20000. 20000. FORMAT "%10.5"
 /begin ANNOTATION ANNOTATION_LABEL "Description (coming from AUTOSAR DESC field)"
  /begin ANNOTATION_TEXT "Initial synchroniser slip used for allowing synchoniser start detection.\r\n" /end ANNOTATION_TEXT
 /end ANNOTATION
/end CHARACTERISTIC
/begin CHARACTERISTIC GAC_CALIB.GAC_GracA.GAC_SPDSSLIPSYNCEND "" CURVE 0x8061157E RB_PT_PCT_SWC_GAC_RecordLayouts_RL_Curve_uint16_5_sint16_5 20000.0 RB_PT_PCT_SWC_GAC_CompuMethods_ident 0.0 20000. FORMAT "%10.5"
 /begin ANNOTATION ANNOTATION_LABEL "Description (coming from AUTOSAR DESC field)"
  /begin ANNOTATION_TEXT "Synchro slip speed thresholds for detection of synchronisation end, based on transmission output speed.\r\n" /end ANNOTATION_TEXT
 /end ANNOTATION
 /begin AXIS_DESCR STD_AXIS NO_INPUT_QUANTITY RB_PT_PCT_SWC_GAC_CompuMethods_ident 5 -20000. 20000. FORMAT "%10.5" DEPOSIT ABSOLUTE /end AXIS_DESCR
/end CHARACTERISTIC
/begin CHARACTERISTIC GAC_CALIB.GAC_GracA.GAC_SPEEDSLIPTHRESHAGAINSTDRAG "" VALUE 0x80610F02 DefaultValueRecordLayout_AUTOSAR_Platform_BaseTypes_sint16 40000.0 RB_PT_PCT_SWC_GAC_CompuMethods_ident -20000. 20000. FORMAT "%10.5"
 /begin ANNOTATION ANNOTATION_LABEL "Description (coming from AUTOSAR DESC field)"
  /begin ANNOTATION_TEXT "slip speed required to complete synchronise against drag strategy\r\n" /end ANNOTATION_TEXT
 /end ANNOTATION
/end CHARACTERISTIC
/begin CHARACTERISTIC GAC_CALIB.GAC_GracA.GAC_SyncAgainstDragTmr.LIB_DT "" VALUE 0x806111A0 DefaultValueRecordLayout_AUTOSAR_Platform_BaseTypes_uint16 65.535 RB_PT_PCT_SWC_GAC_CompuMethods_ratio_0p001 0.0 65.535 FORMAT "%10.5"
 /begin ANNOTATION ANNOTATION_LABEL "Description (coming from AUTOSAR DESC field)" /begin ANNOTATION_TEXT "Timer decrement value.\r\n" /end ANNOTATION_TEXT /end ANNOTATION
/end CHARACTERISTIC
/begin CHARACTERISTIC GAC_CALIB.GAC_GracA.GAC_SyncCtrl.GAC_FCTSYNCPRESSBLEND "" CURVE 0x80611200 RB_PT_PCT_SWC_GAC_RecordLayouts_RL_Curve_uint8_6_uint8_6 1.0 RB_PT_PCT_SWC_GAC_CompuMethods_ratio_0p01 0.0 1. FORMAT "%10.5"
 /begin ANNOTATION ANNOTATION_LABEL "Description (coming from AUTOSAR DESC field)"
  /begin ANNOTATION_TEXT "Pressure blending multiplication factor as a function of synchronisation progression\r\n" /end ANNOTATION_TEXT
 /end ANNOTATION
 /begin AXIS_DESCR STD_AXIS NO_INPUT_QUANTITY RB_PT_PCT_SWC_GAC_CompuMethods_ratio_0p01 6 0.0 1. FORMAT "%10.5" DEPOSIT ABSOLUTE /end AXIS_DESCR
/end CHARACTERISTIC
/begin CHARACTERISTIC GAC_CALIB.GAC_GracA.GAC_SyncCtrl.GAC_FLGENBLBLK0HIRAMP "" VALUE 0x806111F6 DefaultValueRecordLayout_AUTOSAR_Platform_BaseTypes_uint8 255.0 DefaultIdenticalCompu 0.0 255. FORMAT "%10.5"
 /begin ANNOTATION ANNOTATION_LABEL "Description (coming from AUTOSAR DESC field)"
  /begin ANNOTATION_TEXT "enable/disable flag for ramping the pressure aggressively when gear blocking type 0 occurs\r\n" /end ANNOTATION_TEXT
 /end ANNOTATION
/end CHARACTERISTIC
/begin CHARACTERISTIC GAC_CALIB.GAC_GracA.GAC_SyncCtrl.GAC_FLGENBLCALCSYNCPRESSTGT "" VALUE 0x806111F7 DefaultValueRecordLayout_AUTOSAR_Platform_BaseTypes_uint8 255.0 DefaultIdenticalCompu 0.0 255. FORMAT "%10.5"
 /begin ANNOTATION ANNOTATION_LABEL "Description (coming from AUTOSAR DESC field)" /begin ANNOTATION_TEXT "flag to enable calculated pressure target\r\n" /end ANNOTATION_TEXT /end ANNOTATION
/end CHARACTERISTIC
/begin CHARACTERISTIC GAC_CALIB.GAC_GracA.GAC_SyncCtrl.GAC_FLGENBLPRESSURESHUNT "" VALUE 0x806111F8 DefaultValueRecordLayout_AUTOSAR_Platform_BaseTypes_uint8 255.0 DefaultIdenticalCompu 0.0 255. FORMAT "%10.5"
 /begin ANNOTATION ANNOTATION_LABEL "Description (coming from AUTOSAR DESC field)" /begin ANNOTATION_TEXT "flag to enable pressure shunt feature\r\n" /end ANNOTATION_TEXT /end ANNOTATION
/end CHARACTERISTIC
/begin CHARACTERISTIC GAC_CALIB.GAC_GracA.GAC_SyncCtrl.GAC_FLGENBLPRESSURESHUNT1STATTEMPT "" VALUE 0x806111F9 DefaultValueRecordLayout_AUTOSAR_Platform_BaseTypes_uint8 255.0 DefaultIdenticalCompu 0.0 255. FORMAT "%10.5"
 /begin ANNOTATION ANNOTATION_LABEL "Description (coming from AUTOSAR DESC field)"
  /begin ANNOTATION_TEXT "flag to enable pressure shunt feature at the first engagement attempt\r\n" /end ANNOTATION_TEXT
 /end ANNOTATION
/end CHARACTERISTIC
/begin CHARACTERISTIC GAC_CALIB.GAC_GracA.GAC_SyncCtrl.GAC_FLGEVMODEGBLK0ENBL "" VALUE 0x806111FA DefaultValueRecordLayout_AUTOSAR_Platform_BaseTypes_uint8 255.0 DefaultIdenticalCompu 0.0 255. FORMAT "%10.5"
 /begin ANNOTATION ANNOTATION_LABEL "Description (coming from AUTOSAR DESC field)" /begin ANNOTATION_TEXT "Flag to enable EV mode gblock 0 pressure spike\r\n" /end ANNOTATION_TEXT /end ANNOTATION
/end CHARACTERISTIC
/begin CHARACTERISTIC GAC_CALIB.GAC_GracA.GAC_SyncCtrl.GAC_FLGLATCHSYNCBLENDUNTILEND "" VALUE 0x806111FB DefaultValueRecordLayout_AUTOSAR_Platform_BaseTypes_uint8 255.0 DefaultIdenticalCompu 0.0 255. FORMAT "%10.5"
 /begin ANNOTATION ANNOTATION_LABEL "Description (coming from AUTOSAR DESC field)" /begin ANNOTATION_TEXT "latch the synchronisation blend until end\r\n" /end ANNOTATION_TEXT /end ANNOTATION
/end CHARACTERISTIC
/begin CHARACTERISTIC GAC_CALIB.GAC_GracA.GAC_SyncCtrl.GAC_FLGSSTEPTOMAXFRKPEAK1STATTEMPT "" VAL_BLK 0x806111D2 DefaultValueRecordLayout_AUTOSAR_Platform_BaseTypes_uint8 255.0 DefaultIdenticalCompu 0.0 255. FORMAT "%10.5"
 /begin ANNOTATION ANNOTATION_LABEL "Description (coming from AUTOSAR DESC field)"
  /begin ANNOTATION_TEXT "allow the pressure command to go from the lower to the higher pressure limit based on aggression command\r\n" /end ANNOTATION_TEXT
 /end ANNOTATION
 MATRIX_DIM 5 1 1 /end CHARACTERISTIC
/begin CHARACTERISTIC GAC_CALIB.GAC_GracA.GAC_SyncCtrl.GAC_FLWSSYNCCTRLTGT "" VAL_BLK 0x806111A2 DefaultValueRecordLayout_AUTOSAR_Platform_BaseTypes_sint16 64.0 RB_PT_PCT_SWC_GAC_CompuMethods_ratio_0p001 -32. 32. FORMAT "%10.5"
 /begin ANNOTATION ANNOTATION_LABEL "Description (coming from AUTOSAR DESC field)"
  /begin ANNOTATION_TEXT "Flow targets for synchro control for each actuation aggression.\r\n" /end ANNOTATION_TEXT
 /end ANNOTATION
 MATRIX_DIM 4 1 1 /end CHARACTERISTIC
/begin CHARACTERISTIC GAC_CALIB.GAC_GracA.GAC_SyncCtrl.GAC_FLWSYNCCTRLVLOWTGT "" VALUE 0x806111D8 DefaultValueRecordLayout_AUTOSAR_Platform_BaseTypes_sint16 64.0 RB_PT_PCT_SWC_GAC_CompuMethods_ratio_0p001 -32. 32. FORMAT "%10.5"
 /begin ANNOTATION ANNOTATION_LABEL "Description (coming from AUTOSAR DESC field)"
  /begin ANNOTATION_TEXT "Flow target for synchro control for very low aggression actuation.\r\n" /end ANNOTATION_TEXT
 /end ANNOTATION
/end CHARACTERISTIC
/begin CHARACTERISTIC GAC_CALIB.GAC_GracA.GAC_SyncCtrl.GAC_PRESSIADDGBLOCK "" VALUE 0x806111DA DefaultValueRecordLayout_AUTOSAR_Platform_BaseTypes_sint16 64.0 RB_PT_PCT_SWC_GAC_CompuMethods_ratio_0p001 -32. 32. FORMAT "%10.5"
 /begin ANNOTATION ANNOTATION_LABEL "Description (coming from AUTOSAR DESC field)"
  /begin ANNOTATION_TEXT "Additive integral pressure term for synchro control when gear blocking type 0 occurs\r\n" /end ANNOTATION_TEXT
 /end ANNOTATION
/end CHARACTERISTIC
/begin CHARACTERISTIC GAC_CALIB.GAC_GracA.GAC_SyncCtrl.GAC_PRESSIADDNOSLIP "" VALUE 0x806111DC DefaultValueRecordLayout_AUTOSAR_Platform_BaseTypes_sint16 64.0 RB_PT_PCT_SWC_GAC_CompuMethods_ratio_0p001 -32. 32. FORMAT "%10.5"
 /begin ANNOTATION ANNOTATION_LABEL "Description (coming from AUTOSAR DESC field)"
  /begin ANNOTATION_TEXT "Additive integral pressure term for synchro control when syncrhro slip is negligible\r\n" /end ANNOTATION_TEXT
 /end ANNOTATION
/end CHARACTERISTIC
/begin CHARACTERISTIC GAC_CALIB.GAC_GracA.GAC_SyncCtrl.GAC_PRESSIADDSYNCHIGRNEG "" CURVE 0x8061120E RB_PT_PCT_SWC_GAC_RecordLayouts_RL_Curve_sint16_5_uint16_5 64.0 RB_PT_PCT_SWC_GAC_CompuMethods_ratio_0p001 -32. 32. FORMAT "%10.5"
 /begin ANNOTATION ANNOTATION_LABEL "Description (coming from AUTOSAR DESC field)"
  /begin ANNOTATION_TEXT "Additive integral pressure term for synchro control engaging to negative gear with high aggression actuation.\r\n" /end ANNOTATION_TEXT
 /end ANNOTATION
 /begin AXIS_DESCR STD_AXIS NO_INPUT_QUANTITY RB_PT_PCT_SWC_GAC_CompuMethods_ratio_10p0 5 0.0 100000. FORMAT "%10.5" DEPOSIT ABSOLUTE /end AXIS_DESCR
/end CHARACTERISTIC
/begin CHARACTERISTIC GAC_CALIB.GAC_GracA.GAC_SyncCtrl.GAC_PRESSIADDSYNCHIGRPOS "" CURVE 0x80611224 RB_PT_PCT_SWC_GAC_RecordLayouts_RL_Curve_sint16_5_uint16_5 64.0 RB_PT_PCT_SWC_GAC_CompuMethods_ratio_0p001 -32. 32. FORMAT "%10.5"
 /begin ANNOTATION ANNOTATION_LABEL "Description (coming from AUTOSAR DESC field)"
  /begin ANNOTATION_TEXT "Additive integral pressure term for synchro control engaging to positive gear with high aggression actuation.\r\n" /end ANNOTATION_TEXT
 /end ANNOTATION
 /begin AXIS_DESCR STD_AXIS NO_INPUT_QUANTITY RB_PT_PCT_SWC_GAC_CompuMethods_ratio_10p0 5 0.0 100000. FORMAT "%10.5" DEPOSIT ABSOLUTE /end AXIS_DESCR
/end CHARACTERISTIC
/begin CHARACTERISTIC GAC_CALIB.GAC_GracA.GAC_SyncCtrl.GAC_PRESSIADDSYNCLIM "" VALUE 0x806111DE DefaultValueRecordLayout_AUTOSAR_Platform_BaseTypes_sint16 64.0 RB_PT_PCT_SWC_GAC_CompuMethods_ratio_0p001 -32. 32. FORMAT "%10.5"
 /begin ANNOTATION ANNOTATION_LABEL "Description (coming from AUTOSAR DESC field)"
  /begin ANNOTATION_TEXT "Limited additive integral pressure term when rate of change of sync slip not ok for sync control.\r\n" /end ANNOTATION_TEXT
 /end ANNOTATION
/end CHARACTERISTIC
/begin CHARACTERISTIC GAC_CALIB.GAC_GracA.GAC_SyncCtrl.GAC_PRESSIADDSYNCLOWGRNEG "" CURVE 0x8061123A RB_PT_PCT_SWC_GAC_RecordLayouts_RL_Curve_sint16_5_uint16_5 64.0 RB_PT_PCT_SWC_GAC_CompuMethods_ratio_0p001 -32. 32. FORMAT "%10.5"
 /begin ANNOTATION ANNOTATION_LABEL "Description (coming from AUTOSAR DESC field)"
  /begin ANNOTATION_TEXT "Additive integral pressure term for synchro control engaging to negative gear with low aggression actuation.\r\n" /end ANNOTATION_TEXT
 /end ANNOTATION
 /begin AXIS_DESCR STD_AXIS NO_INPUT_QUANTITY RB_PT_PCT_SWC_GAC_CompuMethods_ratio_10p0 5 0.0 100000. FORMAT "%10.5" DEPOSIT ABSOLUTE /end AXIS_DESCR
/end CHARACTERISTIC
/begin CHARACTERISTIC GAC_CALIB.GAC_GracA.GAC_SyncCtrl.GAC_PRESSIADDSYNCLOWGRPOS "" CURVE 0x80611250 RB_PT_PCT_SWC_GAC_RecordLayouts_RL_Curve_sint16_5_uint16_5 64.0 RB_PT_PCT_SWC_GAC_CompuMethods_ratio_0p001 -32. 32. FORMAT "%10.5"
 /begin ANNOTATION ANNOTATION_LABEL "Description (coming from AUTOSAR DESC field)"
  /begin ANNOTATION_TEXT "Additive integral pressure term for synchro control engaging to positive gear with low aggression actuation.\r\n" /end ANNOTATION_TEXT
 /end ANNOTATION
 /begin AXIS_DESCR STD_AXIS NO_INPUT_QUANTITY RB_PT_PCT_SWC_GAC_CompuMethods_ratio_10p0 5 0.0 100000. FORMAT "%10.5" DEPOSIT ABSOLUTE /end AXIS_DESCR
/end CHARACTERISTIC
/begin CHARACTERISTIC GAC_CALIB.GAC_GracA.GAC_SyncCtrl.GAC_PRESSIADDSYNCMEDGRNEG "" CURVE 0x80611266 RB_PT_PCT_SWC_GAC_RecordLayouts_RL_Curve_sint16_5_uint16_5 64.0 RB_PT_PCT_SWC_GAC_CompuMethods_ratio_0p001 -32. 32. FORMAT "%10.5"
 /begin ANNOTATION ANNOTATION_LABEL "Description (coming from AUTOSAR DESC field)"
  /begin ANNOTATION_TEXT "Additive integral pressure term for synchro control engaging to negative gear with medium aggression actuation.\r\n" /end ANNOTATION_TEXT
 /end ANNOTATION
 /begin AXIS_DESCR STD_AXIS NO_INPUT_QUANTITY RB_PT_PCT_SWC_GAC_CompuMethods_ratio_10p0 5 0.0 100000. FORMAT "%10.5" DEPOSIT ABSOLUTE /end AXIS_DESCR
/end CHARACTERISTIC
/begin CHARACTERISTIC GAC_CALIB.GAC_GracA.GAC_SyncCtrl.GAC_PRESSIADDSYNCMEDGRPOS "" CURVE 0x8061127C RB_PT_PCT_SWC_GAC_RecordLayouts_RL_Curve_sint16_5_uint16_5 64.0 RB_PT_PCT_SWC_GAC_CompuMethods_ratio_0p001 -32. 32. FORMAT "%10.5"
 /begin ANNOTATION ANNOTATION_LABEL "Description (coming from AUTOSAR DESC field)"
  /begin ANNOTATION_TEXT "Additive integral pressure term for synchro control engaging to positive gear with mediium aggression actuation.\r\n" /end ANNOTATION_TEXT
 /end ANNOTATION
 /begin AXIS_DESCR STD_AXIS NO_INPUT_QUANTITY RB_PT_PCT_SWC_GAC_CompuMethods_ratio_10p0 5 0.0 100000. FORMAT "%10.5" DEPOSIT ABSOLUTE /end AXIS_DESCR
/end CHARACTERISTIC
/begin CHARACTERISTIC GAC_CALIB.GAC_GracA.GAC_SyncCtrl.GAC_PRESSIADDSYNCSLIPUDEF "" VALUE 0x806111E0 DefaultValueRecordLayout_AUTOSAR_Platform_BaseTypes_sint16 64.0 RB_PT_PCT_SWC_GAC_CompuMethods_ratio_0p001 -32. 32. FORMAT "%10.5"
 /begin ANNOTATION ANNOTATION_LABEL "Description (coming from AUTOSAR DESC field)"
  /begin ANNOTATION_TEXT "Additive integral pressure term for synchro control when syncrhro slip is unknown.\r\n" /end ANNOTATION_TEXT
 /end ANNOTATION
/end CHARACTERISTIC
/begin CHARACTERISTIC GAC_CALIB.GAC_GracA.GAC_SyncCtrl.GAC_PRESSLIMSSYNCIGRNEG "" VAL_BLK 0x806111AA DefaultValueRecordLayout_AUTOSAR_Platform_BaseTypes_sint16 64.0 RB_PT_PCT_SWC_GAC_CompuMethods_ratio_0p001 -32. 32. FORMAT "%10.5"
 /begin ANNOTATION ANNOTATION_LABEL "Description (coming from AUTOSAR DESC field)"
  /begin ANNOTATION_TEXT "Integral pressure addition limit for synchro control engaging negative gear, for each actuation aggression.\r\n" /end ANNOTATION_TEXT
 /end ANNOTATION
 MATRIX_DIM 4 1 1 /end CHARACTERISTIC
/begin CHARACTERISTIC GAC_CALIB.GAC_GracA.GAC_SyncCtrl.GAC_PRESSLIMSSYNCIGRPOS "" VAL_BLK 0x806111B2 DefaultValueRecordLayout_AUTOSAR_Platform_BaseTypes_sint16 64.0 RB_PT_PCT_SWC_GAC_CompuMethods_ratio_0p001 -32. 32. FORMAT "%10.5"
 /begin ANNOTATION ANNOTATION_LABEL "Description (coming from AUTOSAR DESC field)"
  /begin ANNOTATION_TEXT "Integral pressure addition limit for synchro control engaging positive gear, for each actuation aggression.\r\n" /end ANNOTATION_TEXT
 /end ANNOTATION
 MATRIX_DIM 4 1 1 /end CHARACTERISTIC
/begin CHARACTERISTIC GAC_CALIB.GAC_GracA.GAC_SyncCtrl.GAC_PRESSLIMSYNCHIMAP "" CURVE 0x80611292 RB_PT_PCT_SWC_GAC_RecordLayouts_RL_Curve_uint16_4_sint16_4 32.0 RB_PT_PCT_SWC_GAC_CompuMethods_ratio_0p001 0.0 32. FORMAT "%10.5"
 /begin ANNOTATION ANNOTATION_LABEL "Description (coming from AUTOSAR DESC field)"
  /begin ANNOTATION_TEXT "Limit for the static pressure engagements based on temperature - high aggression\r\n" /end ANNOTATION_TEXT
 /end ANNOTATION
 /begin AXIS_DESCR STD_AXIS NO_INPUT_QUANTITY RB_PT_PCT_SWC_GAC_CompuMethods_ident 4 -50. 200. FORMAT "%10.5" DEPOSIT ABSOLUTE /end AXIS_DESCR
/end CHARACTERISTIC
/begin CHARACTERISTIC GAC_CALIB.GAC_GracA.GAC_SyncCtrl.GAC_PRESSLIMSYNCLOWMAP "" CURVE 0x806112A4 RB_PT_PCT_SWC_GAC_RecordLayouts_RL_Curve_uint16_4_sint16_4 32.0 RB_PT_PCT_SWC_GAC_CompuMethods_ratio_0p001 0.0 32. FORMAT "%10.5"
 /begin ANNOTATION ANNOTATION_LABEL "Description (coming from AUTOSAR DESC field)"
  /begin ANNOTATION_TEXT "Limit for the static pressure engagements based on temperature- low aggression\r\n" /end ANNOTATION_TEXT
 /end ANNOTATION
 /begin AXIS_DESCR STD_AXIS NO_INPUT_QUANTITY RB_PT_PCT_SWC_GAC_CompuMethods_ident 4 -50. 200. FORMAT "%10.5" DEPOSIT ABSOLUTE /end AXIS_DESCR
/end CHARACTERISTIC
/begin CHARACTERISTIC GAC_CALIB.GAC_GracA.GAC_SyncCtrl.GAC_PRESSLIMSYNCMEDMAP "" CURVE 0x806112B6 RB_PT_PCT_SWC_GAC_RecordLayouts_RL_Curve_uint16_4_sint16_4 32.0 RB_PT_PCT_SWC_GAC_CompuMethods_ratio_0p001 0.0 32. FORMAT "%10.5"
 /begin ANNOTATION ANNOTATION_LABEL "Description (coming from AUTOSAR DESC field)"
  /begin ANNOTATION_TEXT "Limit for the static pressure engagements based on temperature - medium aggression\r\n" /end ANNOTATION_TEXT
 /end ANNOTATION
 /begin AXIS_DESCR STD_AXIS NO_INPUT_QUANTITY RB_PT_PCT_SWC_GAC_CompuMethods_ident 4 -50. 200. FORMAT "%10.5" DEPOSIT ABSOLUTE /end AXIS_DESCR
/end CHARACTERISTIC
/begin CHARACTERISTIC GAC_CALIB.GAC_GracA.GAC_SyncCtrl.GAC_PRESSLIMSYNCSTATICMAP "" CURVE 0x806112C8 RB_PT_PCT_SWC_GAC_RecordLayouts_RL_Curve_uint16_4_sint16_4 32.0 RB_PT_PCT_SWC_GAC_CompuMethods_ratio_0p001 0.0 32. FORMAT "%10.5"
 /begin ANNOTATION ANNOTATION_LABEL "Description (coming from AUTOSAR DESC field)"
  /begin ANNOTATION_TEXT "Limit for the static pressure engagements based on temperature - static aggression\r\n" /end ANNOTATION_TEXT
 /end ANNOTATION
 /begin AXIS_DESCR STD_AXIS NO_INPUT_QUANTITY RB_PT_PCT_SWC_GAC_CompuMethods_ident 4 -50. 200. FORMAT "%10.5" DEPOSIT ABSOLUTE /end AXIS_DESCR
/end CHARACTERISTIC
/begin CHARACTERISTIC GAC_CALIB.GAC_GracA.GAC_SyncCtrl.GAC_PRESSLIMSYNCVLOWMAP "" CURVE 0x806112DA RB_PT_PCT_SWC_GAC_RecordLayouts_RL_Curve_uint16_4_sint16_4 32.0 RB_PT_PCT_SWC_GAC_CompuMethods_ratio_0p001 0.0 32. FORMAT "%10.5"
 /begin ANNOTATION ANNOTATION_LABEL "Description (coming from AUTOSAR DESC field)"
  /begin ANNOTATION_TEXT "Limit for the static pressure engagements based on temperature - very low aggression\r\n" /end ANNOTATION_TEXT
 /end ANNOTATION
 /begin AXIS_DESCR STD_AXIS NO_INPUT_QUANTITY RB_PT_PCT_SWC_GAC_CompuMethods_ident 4 -50. 200. FORMAT "%10.5" DEPOSIT ABSOLUTE /end AXIS_DESCR
/end CHARACTERISTIC
/begin CHARACTERISTIC GAC_CALIB.GAC_GracA.GAC_SyncCtrl.GAC_PRESSSHUNTCUT "" VALUE 0x806111E2 DefaultValueRecordLayout_AUTOSAR_Platform_BaseTypes_sint16 64.0 RB_PT_PCT_SWC_GAC_CompuMethods_ratio_0p001 -32. 32. FORMAT "%10.5"
 /begin ANNOTATION ANNOTATION_LABEL "Description (coming from AUTOSAR DESC field)"
  /begin ANNOTATION_TEXT "Pressure demand when the shunt pressure cut is active\r\n" /end ANNOTATION_TEXT
 /end ANNOTATION
/end CHARACTERISTIC
/begin CHARACTERISTIC GAC_CALIB.GAC_GracA.GAC_SyncCtrl.GAC_PRESSSYNCBLENDMAX "" VALUE 0x806111E4 DefaultValueRecordLayout_AUTOSAR_Platform_BaseTypes_uint16 32.0 RB_PT_PCT_SWC_GAC_CompuMethods_ratio_0p001 0.0 32. FORMAT "%10.5"
 /begin ANNOTATION ANNOTATION_LABEL "Description (coming from AUTOSAR DESC field)"
  /begin ANNOTATION_TEXT "Limited additive integral pressure term when rate of change of sync slip not ok for sync control.\r\n" /end ANNOTATION_TEXT
 /end ANNOTATION
/end CHARACTERISTIC
/begin CHARACTERISTIC GAC_CALIB.GAC_GracA.GAC_SyncCtrl.GAC_ROCSPDSYNCSLIPOK "" VALUE 0x806111E6 DefaultValueRecordLayout_AUTOSAR_Platform_BaseTypes_sint16 655350.0 RB_PT_PCT_SWC_GAC_CompuMethods_ratio_10p0 -327680. 327670. FORMAT "%10.5"
 /begin ANNOTATION ANNOTATION_LABEL "Description (coming from AUTOSAR DESC field)"
  /begin ANNOTATION_TEXT "Rate of change of synchro slip for detection of sync control ok.\r\n" /end ANNOTATION_TEXT
 /end ANNOTATION
/end CHARACTERISTIC
/begin CHARACTERISTIC GAC_CALIB.GAC_GracA.GAC_SyncCtrl.GAC_SPDTHRESHHOLDITERM "" VALUE 0x806111E8 DefaultValueRecordLayout_AUTOSAR_Platform_BaseTypes_sint16 40000.0 RB_PT_PCT_SWC_GAC_CompuMethods_ident -20000. 20000. FORMAT "%10.5"
 /begin ANNOTATION ANNOTATION_LABEL "Description (coming from AUTOSAR DESC field)"
  /begin ANNOTATION_TEXT "speed threshold below which, the I term is not allowed to increase\r\n" /end ANNOTATION_TEXT
 /end ANNOTATION
/end CHARACTERISTIC
/begin CHARACTERISTIC GAC_CALIB.GAC_GracA.GAC_SyncCtrl.GAC_SPEEDSLIPMAXFORPRESSUREINC "" VALUE 0x806111EA DefaultValueRecordLayout_AUTOSAR_Platform_BaseTypes_sint16 40000.0 RB_PT_PCT_SWC_GAC_CompuMethods_ident -20000. 20000. FORMAT "%10.5"
 /begin ANNOTATION ANNOTATION_LABEL "Description (coming from AUTOSAR DESC field)"
  /begin ANNOTATION_TEXT "slip speed limit to step to the retry pressure on the first attempt\r\n" /end ANNOTATION_TEXT
 /end ANNOTATION
/end CHARACTERISTIC
/begin CHARACTERISTIC GAC_CALIB.GAC_GracA.GAC_SyncCtrl.GAC_SYNCCTRLFLOWTC "" VALUE 0x806111EC DefaultValueRecordLayout_AUTOSAR_Platform_BaseTypes_uint16 0.999 RB_PT_PCT_SWC_GAC_CompuMethods_ratio_0p001 0.001 1. FORMAT "%10.5"
 /begin ANNOTATION ANNOTATION_LABEL "Description (coming from AUTOSAR DESC field)" /begin ANNOTATION_TEXT "Synchro control flow demand time constant.\r\n" /end ANNOTATION_TEXT /end ANNOTATION
/end CHARACTERISTIC
/begin CHARACTERISTIC GAC_CALIB.GAC_GracA.GAC_SyncCtrl.GAC_SYNCCTRLPRESSMINMAP "" CURVE 0x806112EC RB_PT_PCT_SWC_GAC_RecordLayouts_RL_Curve_uint16_4_sint16_4 32.0 RB_PT_PCT_SWC_GAC_CompuMethods_ratio_0p001 0.0 32. FORMAT "%10.5"
 /begin ANNOTATION ANNOTATION_LABEL "Description (coming from AUTOSAR DESC field)"
  /begin ANNOTATION_TEXT "Synchronisation pressure minimum based on temperature\r\n" /end ANNOTATION_TEXT
 /end ANNOTATION
 /begin AXIS_DESCR STD_AXIS NO_INPUT_QUANTITY RB_PT_PCT_SWC_GAC_CompuMethods_ident 4 -50. 200. FORMAT "%10.5" DEPOSIT ABSOLUTE /end AXIS_DESCR
/end CHARACTERISTIC
/begin CHARACTERISTIC GAC_CALIB.GAC_GracA.GAC_SyncCtrl.GAC_TEMPMAXPRESSURESHUNTOKAY "" VALUE 0x806111EE DefaultValueRecordLayout_AUTOSAR_Platform_BaseTypes_sint16 250.0 RB_PT_PCT_SWC_GAC_CompuMethods_ident -50. 200. FORMAT "%10.5"
 /begin ANNOTATION ANNOTATION_LABEL "Description (coming from AUTOSAR DESC field)" /begin ANNOTATION_TEXT "Maximum temperature to enable the pressure shunt\r\n" /end ANNOTATION_TEXT /end ANNOTATION
/end CHARACTERISTIC
/begin CHARACTERISTIC GAC_CALIB.GAC_GracA.GAC_SyncCtrl.GAC_TEMPMINPRESSURESHUNTOKAY "" VALUE 0x806111F0 DefaultValueRecordLayout_AUTOSAR_Platform_BaseTypes_sint16 250.0 RB_PT_PCT_SWC_GAC_CompuMethods_ident -50. 200. FORMAT "%10.5"
 /begin ANNOTATION ANNOTATION_LABEL "Description (coming from AUTOSAR DESC field)" /begin ANNOTATION_TEXT "Minimum temperature to enable the pressure shunt\r\n" /end ANNOTATION_TEXT /end ANNOTATION
/end CHARACTERISTIC
/begin CHARACTERISTIC GAC_CALIB.GAC_GracA.GAC_SyncCtrl.GAC_TMMAXPRESSURESHUNT "" VALUE 0x806111F2 DefaultValueRecordLayout_AUTOSAR_Platform_BaseTypes_uint16 65.535 RB_PT_PCT_SWC_GAC_CompuMethods_ratio_0p001 0.0 65.535 FORMAT "%10.5"
 /begin ANNOTATION ANNOTATION_LABEL "Description (coming from AUTOSAR DESC field)" /begin ANNOTATION_TEXT "Maximum time the pressure shunt can operate for\r\n" /end ANNOTATION_TEXT /end ANNOTATION
/end CHARACTERISTIC
/begin CHARACTERISTIC GAC_CALIB.GAC_GracA.GAC_SyncCtrl.GAC_TmrPressureShunt.LIB_DT "" VALUE 0x806111FC DefaultValueRecordLayout_AUTOSAR_Platform_BaseTypes_uint16 65.535 RB_PT_PCT_SWC_GAC_CompuMethods_ratio_0p001 0.0 65.535 FORMAT "%10.5"
 /begin ANNOTATION ANNOTATION_LABEL "Description (coming from AUTOSAR DESC field)" /begin ANNOTATION_TEXT "Timer decrement value.\r\n" /end ANNOTATION_TEXT /end ANNOTATION
/end CHARACTERISTIC
/begin CHARACTERISTIC GAC_CALIB.GAC_GracA.GAC_SyncCtrl.GAC_TMSDEBGRACSLOWSYNCOK "" VAL_BLK 0x806111BA DefaultValueRecordLayout_AUTOSAR_Platform_BaseTypes_uint16 65.535 RB_PT_PCT_SWC_GAC_CompuMethods_ratio_0p001 0.0 65.535 FORMAT "%10.5"
 /begin ANNOTATION ANNOTATION_LABEL "Description (coming from AUTOSAR DESC field)"
  /begin ANNOTATION_TEXT "Debounce times for detecting slow enough for synchro control, for each actuation aggression.\r\n" /end ANNOTATION_TEXT
 /end ANNOTATION
 MATRIX_DIM 4 1 1 /end CHARACTERISTIC
/begin CHARACTERISTIC GAC_CALIB.GAC_GracA.GAC_SyncCtrl.GAC_TMSDEBROCSLIPFORSYNC "" VAL_BLK 0x806111C2 DefaultValueRecordLayout_AUTOSAR_Platform_BaseTypes_uint16 65.535 RB_PT_PCT_SWC_GAC_CompuMethods_ratio_0p001 0.0 65.535 FORMAT "%10.5"
 /begin ANNOTATION ANNOTATION_LABEL "Description (coming from AUTOSAR DESC field)"
  /begin ANNOTATION_TEXT "Debounce times for detecting rate of change of slip ok for synchro control, for each actuation aggression.\r\n" /end ANNOTATION_TEXT
 /end ANNOTATION
 MATRIX_DIM 4 1 1 /end CHARACTERISTIC
/begin CHARACTERISTIC GAC_CALIB.GAC_GracA.GAC_SyncCtrl.GAC_TMSHUNTPRESSURECUT "" VALUE 0x806111F4 DefaultValueRecordLayout_AUTOSAR_Platform_BaseTypes_uint16 65.535 RB_PT_PCT_SWC_GAC_CompuMethods_ratio_0p001 0.0 65.535 FORMAT "%10.5"
 /begin ANNOTATION ANNOTATION_LABEL "Description (coming from AUTOSAR DESC field)" /begin ANNOTATION_TEXT "Maximum time the shunt pressure cut can occur for\r\n" /end ANNOTATION_TEXT /end ANNOTATION
/end CHARACTERISTIC
/begin CHARACTERISTIC GAC_CALIB.GAC_GracA.GAC_SyncCtrl.GAC_VELSGRACSLOWABS "" VAL_BLK 0x806111CA DefaultValueRecordLayout_AUTOSAR_Platform_BaseTypes_uint16 1.2 RB_PT_PCT_SWC_GAC_CompuMethods_ratio_0p001 0.0 1.2 FORMAT "%10.5"
 /begin ANNOTATION ANNOTATION_LABEL "Description (coming from AUTOSAR DESC field)"
  /begin ANNOTATION_TEXT "Unsigned gear actuator velocities for detecting slow enough for synchro control, for each actuation aggression.\r\n" /end ANNOTATION_TEXT
 /end ANNOTATION
 MATRIX_DIM 4 1 1 /end CHARACTERISTIC
/begin CHARACTERISTIC GAC_CALIB.GAC_GracA.GAC_SyncCtrl.LIB_CountUpTimer.LIB_DT "" VALUE 0x806111FE DefaultValueRecordLayout_AUTOSAR_Platform_BaseTypes_uint16 65.535 RB_PT_PCT_SWC_GAC_CompuMethods_ratio_0p001 0.0 65.535 FORMAT "%10.5"
 /begin ANNOTATION ANNOTATION_LABEL "Description (coming from AUTOSAR DESC field)" /begin ANNOTATION_TEXT "Timer decrement value.\r\n" /end ANNOTATION_TEXT /end ANNOTATION
/end CHARACTERISTIC
/begin CHARACTERISTIC GAC_CALIB.GAC_GracA.GAC_TIMEMAXWAITUNTILAGAINSTDRAG "" VALUE 0x80610F04 DefaultValueRecordLayout_AUTOSAR_Platform_BaseTypes_uint16 65.535 RB_PT_PCT_SWC_GAC_CompuMethods_ratio_0p001 0.0 65.535 FORMAT "%10.5"
 /begin ANNOTATION ANNOTATION_LABEL "Description (coming from AUTOSAR DESC field)"
  /begin ANNOTATION_TEXT "Max time to wait for the synchronisation to be against drag before engagements commence\r\n" /end ANNOTATION_TEXT
 /end ANNOTATION
/end CHARACTERISTIC
/begin CHARACTERISTIC GAC_CALIB.GAC_GracA.GAC_TMDEBFORCEONSYNC "" VALUE 0x80610F06 DefaultValueRecordLayout_AUTOSAR_Platform_BaseTypes_uint16 65.535 RB_PT_PCT_SWC_GAC_CompuMethods_ratio_0p001 0.0 65.535 FORMAT "%10.5"
 /begin ANNOTATION ANNOTATION_LABEL "Description (coming from AUTOSAR DESC field)"
  /begin ANNOTATION_TEXT "Debounce time for detecting force sychronisation start.\r\n" /end ANNOTATION_TEXT
 /end ANNOTATION
/end CHARACTERISTIC
/begin CHARACTERISTIC GAC_CALIB.GAC_GracA.GAC_TMDEBFORCEONSYNCEV "" VALUE 0x80610F08 DefaultValueRecordLayout_AUTOSAR_Platform_BaseTypes_uint16 65.535 RB_PT_PCT_SWC_GAC_CompuMethods_ratio_0p001 0.0 65.535 FORMAT "%10.5"
 /begin ANNOTATION ANNOTATION_LABEL "Description (coming from AUTOSAR DESC field)"
  /begin ANNOTATION_TEXT "Debounce time for detecting force sychronisation start.\r\n" /end ANNOTATION_TEXT
 /end ANNOTATION
/end CHARACTERISTIC
/begin CHARACTERISTIC GAC_CALIB.GAC_GracA.GAC_TMDEBGBLK0EVMODE "" CURVE 0x80611594 RB_PT_PCT_SWC_GAC_RecordLayouts_RL_Curve_uint16_4_sint16_4 65.535 RB_PT_PCT_SWC_GAC_CompuMethods_ratio_0p001 0.0 65.535 FORMAT "%10.5"
 /begin ANNOTATION ANNOTATION_LABEL "Description (coming from AUTOSAR DESC field)"
  /begin ANNOTATION_TEXT "Debounce time to be stuck on the synchroniser - variable with temperature\r\n" /end ANNOTATION_TEXT
 /end ANNOTATION
 /begin AXIS_DESCR STD_AXIS NO_INPUT_QUANTITY RB_PT_PCT_SWC_GAC_CompuMethods_ident 4 -50. 200. FORMAT "%10.5" DEPOSIT ABSOLUTE /end AXIS_DESCR
/end CHARACTERISTIC
/begin CHARACTERISTIC GAC_CALIB.GAC_GracA.GAC_TMFAILPUSHINGR "" VALUE 0x80610F0A DefaultValueRecordLayout_AUTOSAR_Platform_BaseTypes_uint16 10.0 RB_PT_PCT_SWC_GAC_CompuMethods_ratio_0p001 0.0 10. FORMAT "%10.5"
 /begin ANNOTATION ANNOTATION_LABEL "Description (coming from AUTOSAR DESC field)" /begin ANNOTATION_TEXT "Time used for detecting 'fail push in gear'.\r\n" /end ANNOTATION_TEXT /end ANNOTATION
/end CHARACTERISTIC
/begin CHARACTERISTIC GAC_CALIB.GAC_GracA.GAC_TMHOLDFLWISYNCEND "" VALUE 0x80610F0C DefaultValueRecordLayout_AUTOSAR_Platform_BaseTypes_uint16 65.535 RB_PT_PCT_SWC_GAC_CompuMethods_ratio_0p001 0.0 65.535 FORMAT "%10.5"
 /begin ANNOTATION ANNOTATION_LABEL "Description (coming from AUTOSAR DESC field)"
  /begin ANNOTATION_TEXT "Time to hold the integral flow term for velocity control upon synchronisation end detected.\r\n" /end ANNOTATION_TEXT
 /end ANNOTATION
/end CHARACTERISTIC
/begin CHARACTERISTIC GAC_CALIB.GAC_GracA.GAC_TMHOLDFLWITOSYNC "" VALUE 0x80610F0E DefaultValueRecordLayout_AUTOSAR_Platform_BaseTypes_uint16 65.535 RB_PT_PCT_SWC_GAC_CompuMethods_ratio_0p001 0.0 65.535 FORMAT "%10.5"
 /begin ANNOTATION ANNOTATION_LABEL "Description (coming from AUTOSAR DESC field)"
  /begin ANNOTATION_TEXT "Time to hold the integral flow term for velocity control upon actuation to gear from Neutral.\r\n" /end ANNOTATION_TEXT
 /end ANNOTATION
/end CHARACTERISTIC
/begin CHARACTERISTIC GAC_CALIB.GAC_GracA.GAC_TMHOLDFLWITOSYNCHIAGG "" VALUE 0x80610F10 DefaultValueRecordLayout_AUTOSAR_Platform_BaseTypes_uint16 65.535 RB_PT_PCT_SWC_GAC_CompuMethods_ratio_0p001 0.0 65.535 FORMAT "%10.5"
 /begin ANNOTATION ANNOTATION_LABEL "Description (coming from AUTOSAR DESC field)"
  /begin ANNOTATION_TEXT "Time to hold the integral flow term for velocity control upon actuation to gear from Neutral - high aggression actuation.\r\n" /end ANNOTATION_TEXT
 /end ANNOTATION
/end CHARACTERISTIC
/begin CHARACTERISTIC GAC_CALIB.GAC_GracA.GAC_TMHOLDFLWITOSYNCLOW "" VALUE 0x80610F12 DefaultValueRecordLayout_AUTOSAR_Platform_BaseTypes_uint16 65.535 RB_PT_PCT_SWC_GAC_CompuMethods_ratio_0p001 0.0 65.535 FORMAT "%10.5"
 /begin ANNOTATION ANNOTATION_LABEL "Description (coming from AUTOSAR DESC field)"
  /begin ANNOTATION_TEXT "Time to hold the integral flow term for velocity control upon actuation to gear from Neutral - low hold time.\r\n" /end ANNOTATION_TEXT
 /end ANNOTATION
/end CHARACTERISTIC
/begin CHARACTERISTIC GAC_CALIB.GAC_GracA.GAC_TMINITINNNOFLOAT "" VALUE 0x80610F14 DefaultValueRecordLayout_AUTOSAR_Platform_BaseTypes_uint16 65.535 RB_PT_PCT_SWC_GAC_CompuMethods_ratio_0p001 0.0 65.535 FORMAT "%10.5"
 /begin ANNOTATION ANNOTATION_LABEL "Description (coming from AUTOSAR DESC field)"
  /begin ANNOTATION_TEXT "Time to determine that the gear is not floating out of neutral\r\n" /end ANNOTATION_TEXT
 /end ANNOTATION
/end CHARACTERISTIC
/begin CHARACTERISTIC GAC_CALIB.GAC_GracA.GAC_TMMAXNSTOPITERMRESET "" VALUE 0x80610F16 DefaultValueRecordLayout_AUTOSAR_Platform_BaseTypes_uint16 65.535 RB_PT_PCT_SWC_GAC_CompuMethods_ratio_0p001 0.0 65.535 FORMAT "%10.5"
 /begin ANNOTATION ANNOTATION_LABEL "Description (coming from AUTOSAR DESC field)"
  /begin ANNOTATION_TEXT "Maximum time for the I term reset to be active for when the N stop condition is active\r\n" /end ANNOTATION_TEXT
 /end ANNOTATION
/end CHARACTERISTIC
/begin CHARACTERISTIC GAC_CALIB.GAC_GracA.GAC_TMPINTRPNSTOPVELTGT "" VALUE 0x80610F18 DefaultValueRecordLayout_AUTOSAR_Platform_BaseTypes_sint16 250.0 RB_PT_PCT_SWC_GAC_CompuMethods_ident -50. 200. FORMAT "%10.5"
 /begin ANNOTATION ANNOTATION_LABEL "Description (coming from AUTOSAR DESC field)"
  /begin ANNOTATION_TEXT "Temperature used for assessing interpolation of the NStop velocity target.\r\n" /end ANNOTATION_TEXT
 /end ANNOTATION
/end CHARACTERISTIC
/begin CHARACTERISTIC GAC_CALIB.GAC_GracA.GAC_TMPINTRPVELCTRLPRESSFF "" VALUE 0x80610F1A DefaultValueRecordLayout_AUTOSAR_Platform_BaseTypes_sint16 250.0 RB_PT_PCT_SWC_GAC_CompuMethods_ident -50. 200. FORMAT "%10.5"
 /begin ANNOTATION ANNOTATION_LABEL "Description (coming from AUTOSAR DESC field)"
  /begin ANNOTATION_TEXT "Temperature used for assessing interpolation of the velocity control feedforward pressure term.\r\n" /end ANNOTATION_TEXT
 /end ANNOTATION
/end CHARACTERISTIC
/begin CHARACTERISTIC GAC_CALIB.GAC_GracA.GAC_TMPINTRPVELCTRLPRESSONFLW "" VALUE 0x80610F1C DefaultValueRecordLayout_AUTOSAR_Platform_BaseTypes_sint16 250.0 RB_PT_PCT_SWC_GAC_CompuMethods_ident -50. 200. FORMAT "%10.5"
 /begin ANNOTATION ANNOTATION_LABEL "Description (coming from AUTOSAR DESC field)"
  /begin ANNOTATION_TEXT "Temperature used for assessing interpolation of the velocity control flow based pressure term.\r\n" /end ANNOTATION_TEXT
 /end ANNOTATION
/end CHARACTERISTIC
/begin CHARACTERISTIC GAC_CALIB.GAC_GracA.GAC_TMPRESSENDSTOP "" VALUE 0x80610F1E DefaultValueRecordLayout_AUTOSAR_Platform_BaseTypes_uint16 65.535 RB_PT_PCT_SWC_GAC_CompuMethods_ratio_0p001 0.0 65.535 FORMAT "%10.5"
 /begin ANNOTATION ANNOTATION_LABEL "Description (coming from AUTOSAR DESC field)" /begin ANNOTATION_TEXT "Synchronisation time target for static shifts7\r\n" /end ANNOTATION_TEXT /end ANNOTATION
/end CHARACTERISTIC
/begin CHARACTERISTIC GAC_CALIB.GAC_GracA.GAC_TMPRESSENDSTOPSYNCF "" VALUE 0x80610F20 DefaultValueRecordLayout_AUTOSAR_Platform_BaseTypes_uint16 65.535 RB_PT_PCT_SWC_GAC_CompuMethods_ratio_0p001 0.0 65.535 FORMAT "%10.5"
 /begin ANNOTATION ANNOTATION_LABEL "Description (coming from AUTOSAR DESC field)" /begin ANNOTATION_TEXT "Synchronisation time target for static shifts7\r\n" /end ANNOTATION_TEXT /end ANNOTATION
/end CHARACTERISTIC
/begin CHARACTERISTIC GAC_CALIB.GAC_GracA.GAC_TMPVLVNOPULSE "" VALUE 0x80610F22 DefaultValueRecordLayout_AUTOSAR_Platform_BaseTypes_uint16 65.535 RB_PT_PCT_SWC_GAC_CompuMethods_ratio_0p001 0.0 65.535 FORMAT "%10.5"
 /begin ANNOTATION ANNOTATION_LABEL "Description (coming from AUTOSAR DESC field)"
  /begin ANNOTATION_TEXT "Time for which no pulse is allowed on the pressure valve.\r\n" /end ANNOTATION_TEXT
 /end ANNOTATION
/end CHARACTERISTIC
/begin CHARACTERISTIC GAC_CALIB.GAC_GracA.GAC_TmrInNState.LIB_DT "" VALUE 0x806112FE DefaultValueRecordLayout_AUTOSAR_Platform_BaseTypes_uint16 65.535 RB_PT_PCT_SWC_GAC_CompuMethods_ratio_0p001 0.0 65.535 FORMAT "%10.5"
 /begin ANNOTATION ANNOTATION_LABEL "Description (coming from AUTOSAR DESC field)" /begin ANNOTATION_TEXT "Timer decrement value.\r\n" /end ANNOTATION_TEXT /end ANNOTATION
/end CHARACTERISTIC
/begin CHARACTERISTIC GAC_CALIB.GAC_GracA.GAC_TmrNStopITermReset.LIB_DT "" VALUE 0x80611300 DefaultValueRecordLayout_AUTOSAR_Platform_BaseTypes_uint16 65.535 RB_PT_PCT_SWC_GAC_CompuMethods_ratio_0p001 0.0 65.535 FORMAT "%10.5"
 /begin ANNOTATION ANNOTATION_LABEL "Description (coming from AUTOSAR DESC field)" /begin ANNOTATION_TEXT "Timer decrement value.\r\n" /end ANNOTATION_TEXT /end ANNOTATION
/end CHARACTERISTIC
/begin CHARACTERISTIC GAC_CALIB.GAC_GracA.GAC_TMSHOLDFLWIVELCTRLN "" CURVE 0x806115A6 RB_PT_PCT_SWC_GAC_RecordLayouts_RL_Curve_uint16_2_sint16_2 65.535 RB_PT_PCT_SWC_GAC_CompuMethods_ratio_0p001 0.0 65.535 FORMAT "%10.5"
 /begin ANNOTATION ANNOTATION_LABEL "Description (coming from AUTOSAR DESC field)"
  /begin ANNOTATION_TEXT "Times used for the hold of the integral flow term for velocity control Neutral actuation.\r\n" /end ANNOTATION_TEXT
 /end ANNOTATION
 /begin AXIS_DESCR STD_AXIS NO_INPUT_QUANTITY RB_PT_PCT_SWC_GAC_CompuMethods_ident 2 -50. 200. FORMAT "%10.5" DEPOSIT ABSOLUTE /end AXIS_DESCR
/end CHARACTERISTIC
/begin CHARACTERISTIC GAC_CALIB.GAC_GracA.GAC_TMSSYNCTGT "" VAL_BLK 0x80610E78 DefaultValueRecordLayout_AUTOSAR_Platform_BaseTypes_uint16 65.535 RB_PT_PCT_SWC_GAC_CompuMethods_ratio_0p001 0.0 65.535 FORMAT "%10.5"
 /begin ANNOTATION ANNOTATION_LABEL "Description (coming from AUTOSAR DESC field)"
  /begin ANNOTATION_TEXT "Array of times indicating the target synchronisation time for positive/negative gear and actuation aggression.\r\n" /end ANNOTATION_TEXT
 /end ANNOTATION
 MATRIX_DIM 4 2 1 /end CHARACTERISTIC
/begin CHARACTERISTIC GAC_CALIB.GAC_GracA.GAC_TMSSYNCTGTCLOW "" VALUE 0x80610F24 DefaultValueRecordLayout_AUTOSAR_Platform_BaseTypes_uint16 65.535 RB_PT_PCT_SWC_GAC_CompuMethods_ratio_0p001 0.0 65.535 FORMAT "%10.5"
 /begin ANNOTATION ANNOTATION_LABEL "Description (coming from AUTOSAR DESC field)" /begin ANNOTATION_TEXT "Synchronisation time target for static shifts7\r\n" /end ANNOTATION_TEXT /end ANNOTATION
/end CHARACTERISTIC
/begin CHARACTERISTIC GAC_CALIB.GAC_GracA.GAC_TMSSYNCTGTCLOW1STGR "" VALUE 0x80610F26 DefaultValueRecordLayout_AUTOSAR_Platform_BaseTypes_uint16 65.535 RB_PT_PCT_SWC_GAC_CompuMethods_ratio_0p001 0.0 65.535 FORMAT "%10.5"
 /begin ANNOTATION ANNOTATION_LABEL "Description (coming from AUTOSAR DESC field)" /begin ANNOTATION_TEXT "Synchronisation time target for static shifts7\r\n" /end ANNOTATION_TEXT /end ANNOTATION
/end CHARACTERISTIC
/begin CHARACTERISTIC GAC_CALIB.GAC_GracA.GAC_TMSSYNCTGTDR "" VALUE 0x80610F28 DefaultValueRecordLayout_AUTOSAR_Platform_BaseTypes_uint16 65.535 RB_PT_PCT_SWC_GAC_CompuMethods_ratio_0p001 0.0 65.535 FORMAT "%10.5"
 /begin ANNOTATION ANNOTATION_LABEL "Description (coming from AUTOSAR DESC field)" /begin ANNOTATION_TEXT "Synchronisation time target for static shifts7\r\n" /end ANNOTATION_TEXT /end ANNOTATION
/end CHARACTERISTIC
/begin CHARACTERISTIC GAC_CALIB.GAC_GracA.GAC_TMSSYNCTGTSTATIC "" VALUE 0x80610F2A DefaultValueRecordLayout_AUTOSAR_Platform_BaseTypes_uint16 65.535 RB_PT_PCT_SWC_GAC_CompuMethods_ratio_0p001 0.0 65.535 FORMAT "%10.5"
 /begin ANNOTATION ANNOTATION_LABEL "Description (coming from AUTOSAR DESC field)" /begin ANNOTATION_TEXT "Synchronisation time target for static shifts7\r\n" /end ANNOTATION_TEXT /end ANNOTATION
/end CHARACTERISTIC
/begin CHARACTERISTIC GAC_CALIB.GAC_GracA.GAC_VELGRACADPPUSHINGRNEGTGT "" VALUE 0x80610F2C DefaultValueRecordLayout_AUTOSAR_Platform_BaseTypes_sint16 2.4 RB_PT_PCT_SWC_GAC_CompuMethods_ratio_0p001 -1.2 1.2 FORMAT "%10.5"
 /begin ANNOTATION ANNOTATION_LABEL "Description (coming from AUTOSAR DESC field)"
  /begin ANNOTATION_TEXT "Velocity target for the gear actuator during adaptation 'push in (negative) gear' active.\r\n" /end ANNOTATION_TEXT
 /end ANNOTATION
/end CHARACTERISTIC
/begin CHARACTERISTIC GAC_CALIB.GAC_GracA.GAC_VELGRACADPPUSHINGRPOSTGT "" VALUE 0x80610F2E DefaultValueRecordLayout_AUTOSAR_Platform_BaseTypes_sint16 2.4 RB_PT_PCT_SWC_GAC_CompuMethods_ratio_0p001 -1.2 1.2 FORMAT "%10.5"
 /begin ANNOTATION ANNOTATION_LABEL "Description (coming from AUTOSAR DESC field)"
  /begin ANNOTATION_TEXT "Velocity target for the gear actuator during adaptation 'push in (positive) gear' active.\r\n" /end ANNOTATION_TEXT
 /end ANNOTATION
/end CHARACTERISTIC
/begin CHARACTERISTIC GAC_CALIB.GAC_GracA.GAC_VELGRACFAILPUSHINGR "" VALUE 0x80610F30 DefaultValueRecordLayout_AUTOSAR_Platform_BaseTypes_sint16 2.4 RB_PT_PCT_SWC_GAC_CompuMethods_ratio_0p001 -1.2 1.2 FORMAT "%10.5"
 /begin ANNOTATION ANNOTATION_LABEL "Description (coming from AUTOSAR DESC field)"
  /begin ANNOTATION_TEXT "Velocity target for the gear actuator during 'fail push in gear' active.\r\n" /end ANNOTATION_TEXT
 /end ANNOTATION
/end CHARACTERISTIC
/begin CHARACTERISTIC GAC_CALIB.GAC_GracA.GAC_VELGRACMOVING "" VALUE 0x80610F32 DefaultValueRecordLayout_AUTOSAR_Platform_BaseTypes_sint16 0.6 RB_PT_PCT_SWC_GAC_CompuMethods_ratio_0p0001 -0.3 0.3 FORMAT "%10.5"
 /begin ANNOTATION ANNOTATION_LABEL "Description (coming from AUTOSAR DESC field)"
  /begin ANNOTATION_TEXT "Gear actuator velocity used for detecting synchronisation start on the positive gear.\r\n" /end ANNOTATION_TEXT
 /end ANNOTATION
/end CHARACTERISTIC
/begin CHARACTERISTIC GAC_CALIB.GAC_GracA.GAC_VELGRACMOVINGENDSYNC "" CURVE 0x806115B0 RB_PT_PCT_SWC_GAC_RecordLayouts_RL_Curve_sint16_4_uint16_4 0.6 RB_PT_PCT_SWC_GAC_CompuMethods_ratio_0p0001 -0.3 0.3 FORMAT "%10.5"
 /begin ANNOTATION ANNOTATION_LABEL "Description (coming from AUTOSAR DESC field)"
  /begin ANNOTATION_TEXT "velocity exit condition as a function of synchro position\r\n" /end ANNOTATION_TEXT
 /end ANNOTATION
 /begin AXIS_DESCR STD_AXIS NO_INPUT_QUANTITY RB_PT_PCT_SWC_GAC_CompuMethods_ratio_0p001 4 0.0 20. FORMAT "%10.5" DEPOSIT ABSOLUTE /end AXIS_DESCR
/end CHARACTERISTIC
/begin CHARACTERISTIC GAC_CALIB.GAC_GracA.GAC_VELGRACNSTOPRESETI "" VALUE 0x80610F34 DefaultValueRecordLayout_AUTOSAR_Platform_BaseTypes_uint16 1.2 RB_PT_PCT_SWC_GAC_CompuMethods_ratio_0p001 0.0 1.2 FORMAT "%10.5"
 /begin ANNOTATION ANNOTATION_LABEL "Description (coming from AUTOSAR DESC field)"
  /begin ANNOTATION_TEXT "Gear actuator velocity used for resetting the I term during NStop phase.\r\n" /end ANNOTATION_TEXT
 /end ANNOTATION
/end CHARACTERISTIC
/begin CHARACTERISTIC GAC_CALIB.GAC_GracA.GAC_VELGRACSTOPPED "" VALUE 0x80610F36 DefaultValueRecordLayout_AUTOSAR_Platform_BaseTypes_sint16 0.6 RB_PT_PCT_SWC_GAC_CompuMethods_ratio_0p0001 -0.3 0.3 FORMAT "%10.5"
 /begin ANNOTATION ANNOTATION_LABEL "Description (coming from AUTOSAR DESC field)"
  /begin ANNOTATION_TEXT "Gear actuator velocity used for detecting if the synchro has stopped\r\n" /end ANNOTATION_TEXT
 /end ANNOTATION
/end CHARACTERISTIC
/begin CHARACTERISTIC GAC_CALIB.GAC_GracA.GAC_VELGRACTHRESHNEUTRALCLOSEOUT "" VALUE 0x80610F38 DefaultValueRecordLayout_AUTOSAR_Platform_BaseTypes_sint16 2.4 RB_PT_PCT_SWC_GAC_CompuMethods_ratio_0p001 -1.2 1.2 FORMAT "%10.5"
 /begin ANNOTATION ANNOTATION_LABEL "Description (coming from AUTOSAR DESC field)"
  /begin ANNOTATION_TEXT "Velocity target for the gear actuator during 'fail push in gear' active.\r\n" /end ANNOTATION_TEXT
 /end ANNOTATION
/end CHARACTERISTIC
/begin CHARACTERISTIC GAC_CALIB.GAC_GracA.GAC_VELSDROPGBLK2 "" VAL_BLK 0x80610E88 DefaultValueRecordLayout_AUTOSAR_Platform_BaseTypes_uint16 1.2 RB_PT_PCT_SWC_GAC_CompuMethods_ratio_0p001 0.0 1.2 FORMAT "%10.5"
 /begin ANNOTATION ANNOTATION_LABEL "Description (coming from AUTOSAR DESC field)"
  /begin ANNOTATION_TEXT "Drop velocities for gear block 2 detection, for each actuation aggression\r\n" /end ANNOTATION_TEXT
 /end ANNOTATION
 MATRIX_DIM 4 1 1 /end CHARACTERISTIC
/begin CHARACTERISTIC GAC_CALIB.GAC_GracA.GAC_VELSGRACGRNEGEVSYNCTGT "" CURVE 0x806115C2 RB_PT_PCT_SWC_GAC_RecordLayouts_RL_Curve_sint16_4_sint16_4 2.4 RB_PT_PCT_SWC_GAC_CompuMethods_ratio_0p001 -1.2 1.2 FORMAT "%10.5"
 /begin ANNOTATION ANNOTATION_LABEL "Description (coming from AUTOSAR DESC field)"
  /begin ANNOTATION_TEXT "Gear actuator velocity targets for engaging negative gear in low aggression post-synchro phase.\r\n" /end ANNOTATION_TEXT
 /end ANNOTATION
 /begin AXIS_DESCR STD_AXIS NO_INPUT_QUANTITY RB_PT_PCT_SWC_GAC_CompuMethods_ident 4 -100. 100. FORMAT "%10.5" DEPOSIT ABSOLUTE /end AXIS_DESCR
/end CHARACTERISTIC
/begin CHARACTERISTIC GAC_CALIB.GAC_GracA.GAC_VELSGRACGRNEGEVTGT "" CURVE 0x806115D4 RB_PT_PCT_SWC_GAC_RecordLayouts_RL_Curve_sint16_8_sint16_8 2.4 RB_PT_PCT_SWC_GAC_CompuMethods_ratio_0p001 -1.2 1.2 FORMAT "%10.5"
 /begin ANNOTATION ANNOTATION_LABEL "Description (coming from AUTOSAR DESC field)"
  /begin ANNOTATION_TEXT "Gear actuator velocity targets for engaging negative gear in low aggression pre-synchro phase.\r\n" /end ANNOTATION_TEXT
 /end ANNOTATION
 /begin AXIS_DESCR STD_AXIS NO_INPUT_QUANTITY RB_PT_PCT_SWC_GAC_CompuMethods_ident 8 -100. 100. FORMAT "%10.5" DEPOSIT ABSOLUTE /end AXIS_DESCR
/end CHARACTERISTIC
/begin CHARACTERISTIC GAC_CALIB.GAC_GracA.GAC_VELSGRACGRNEGHISYNCTGT "" CURVE 0x806115F6 RB_PT_PCT_SWC_GAC_RecordLayouts_RL_Curve_sint16_4_sint16_4 2.4 RB_PT_PCT_SWC_GAC_CompuMethods_ratio_0p001 -1.2 1.2 FORMAT "%10.5"
 /begin ANNOTATION ANNOTATION_LABEL "Description (coming from AUTOSAR DESC field)"
  /begin ANNOTATION_TEXT "Gear actuator velocity targets for engaging negative gear in high aggression post-synchro phase.\r\n" /end ANNOTATION_TEXT
 /end ANNOTATION
 /begin AXIS_DESCR STD_AXIS NO_INPUT_QUANTITY RB_PT_PCT_SWC_GAC_CompuMethods_ident 4 -100. 100. FORMAT "%10.5" DEPOSIT ABSOLUTE /end AXIS_DESCR
/end CHARACTERISTIC
/begin CHARACTERISTIC GAC_CALIB.GAC_GracA.GAC_VELSGRACGRNEGHITGT "" CURVE 0x80611608 RB_PT_PCT_SWC_GAC_RecordLayouts_RL_Curve_sint16_8_sint16_8 2.4 RB_PT_PCT_SWC_GAC_CompuMethods_ratio_0p001 -1.2 1.2 FORMAT "%10.5"
 /begin ANNOTATION ANNOTATION_LABEL "Description (coming from AUTOSAR DESC field)"
  /begin ANNOTATION_TEXT "Gear actuator velocity targets for engaging negative gear in high aggression pre-synchro phase.\r\n" /end ANNOTATION_TEXT
 /end ANNOTATION
 /begin AXIS_DESCR STD_AXIS NO_INPUT_QUANTITY RB_PT_PCT_SWC_GAC_CompuMethods_ident 8 -100. 100. FORMAT "%10.5" DEPOSIT ABSOLUTE /end AXIS_DESCR
/end CHARACTERISTIC
/begin CHARACTERISTIC GAC_CALIB.GAC_GracA.GAC_VELSGRACGRNEGLOWSYNCTGT "" CURVE 0x8061162A RB_PT_PCT_SWC_GAC_RecordLayouts_RL_Curve_sint16_4_sint16_4 2.4 RB_PT_PCT_SWC_GAC_CompuMethods_ratio_0p001 -1.2 1.2 FORMAT "%10.5"
 /begin ANNOTATION ANNOTATION_LABEL "Description (coming from AUTOSAR DESC field)"
  /begin ANNOTATION_TEXT "Gear actuator velocity targets for engaging negative gear in low aggression post-synchro phase.\r\n" /end ANNOTATION_TEXT
 /end ANNOTATION
 /begin AXIS_DESCR STD_AXIS NO_INPUT_QUANTITY RB_PT_PCT_SWC_GAC_CompuMethods_ident 4 -100. 100. FORMAT "%10.5" DEPOSIT ABSOLUTE /end AXIS_DESCR
/end CHARACTERISTIC
/begin CHARACTERISTIC GAC_CALIB.GAC_GracA.GAC_VELSGRACGRNEGLOWTGT "" CURVE 0x8061163C RB_PT_PCT_SWC_GAC_RecordLayouts_RL_Curve_sint16_8_sint16_8 2.4 RB_PT_PCT_SWC_GAC_CompuMethods_ratio_0p001 -1.2 1.2 FORMAT "%10.5"
 /begin ANNOTATION ANNOTATION_LABEL "Description (coming from AUTOSAR DESC field)"
  /begin ANNOTATION_TEXT "Gear actuator velocity targets for engaging negative gear in low aggression pre-synchro phase.\r\n" /end ANNOTATION_TEXT
 /end ANNOTATION
 /begin AXIS_DESCR STD_AXIS NO_INPUT_QUANTITY RB_PT_PCT_SWC_GAC_CompuMethods_ident 8 -100. 100. FORMAT "%10.5" DEPOSIT ABSOLUTE /end AXIS_DESCR
/end CHARACTERISTIC
/begin CHARACTERISTIC GAC_CALIB.GAC_GracA.GAC_VELSGRACGRNEGMEDSYNCTGT "" CURVE 0x8061165E RB_PT_PCT_SWC_GAC_RecordLayouts_RL_Curve_sint16_4_sint16_4 2.4 RB_PT_PCT_SWC_GAC_CompuMethods_ratio_0p001 -1.2 1.2 FORMAT "%10.5"
 /begin ANNOTATION ANNOTATION_LABEL "Description (coming from AUTOSAR DESC field)"
  /begin ANNOTATION_TEXT "Gear actuator velocity targets for engaging negative gear in medium aggression post-synchro phase.\r\n" /end ANNOTATION_TEXT
 /end ANNOTATION
 /begin AXIS_DESCR STD_AXIS NO_INPUT_QUANTITY RB_PT_PCT_SWC_GAC_CompuMethods_ident 4 -100. 100. FORMAT "%10.5" DEPOSIT ABSOLUTE /end AXIS_DESCR
/end CHARACTERISTIC
/begin CHARACTERISTIC GAC_CALIB.GAC_GracA.GAC_VELSGRACGRNEGMEDTGT "" CURVE 0x80611670 RB_PT_PCT_SWC_GAC_RecordLayouts_RL_Curve_sint16_8_sint16_8 2.4 RB_PT_PCT_SWC_GAC_CompuMethods_ratio_0p001 -1.2 1.2 FORMAT "%10.5"
 /begin ANNOTATION ANNOTATION_LABEL "Description (coming from AUTOSAR DESC field)"
  /begin ANNOTATION_TEXT "Gear actuator velocity targets for engaging negative gear in medium aggression pre-synchro phase.\r\n" /end ANNOTATION_TEXT
 /end ANNOTATION
 /begin AXIS_DESCR STD_AXIS NO_INPUT_QUANTITY RB_PT_PCT_SWC_GAC_CompuMethods_ident 8 -100. 100. FORMAT "%10.5" DEPOSIT ABSOLUTE /end AXIS_DESCR
/end CHARACTERISTIC
/begin CHARACTERISTIC GAC_CALIB.GAC_GracA.GAC_VELSGRACGRNEGSTATICSYNCTGT "" CURVE 0x80611692 RB_PT_PCT_SWC_GAC_RecordLayouts_RL_Curve_sint16_4_sint16_4 2.4 RB_PT_PCT_SWC_GAC_CompuMethods_ratio_0p001 -1.2 1.2 FORMAT "%10.5"
 /begin ANNOTATION ANNOTATION_LABEL "Description (coming from AUTOSAR DESC field)"
  /begin ANNOTATION_TEXT "Gear actuator velocity targets for engaging negative gear in low aggression post-synchro phase.\r\n" /end ANNOTATION_TEXT
 /end ANNOTATION
 /begin AXIS_DESCR STD_AXIS NO_INPUT_QUANTITY RB_PT_PCT_SWC_GAC_CompuMethods_ident 4 -100. 100. FORMAT "%10.5" DEPOSIT ABSOLUTE /end AXIS_DESCR
/end CHARACTERISTIC
/begin CHARACTERISTIC GAC_CALIB.GAC_GracA.GAC_VELSGRACGRNEGSTATICTGT "" CURVE 0x806116A4 RB_PT_PCT_SWC_GAC_RecordLayouts_RL_Curve_sint16_8_sint16_8 2.4 RB_PT_PCT_SWC_GAC_CompuMethods_ratio_0p001 -1.2 1.2 FORMAT "%10.5"
 /begin ANNOTATION ANNOTATION_LABEL "Description (coming from AUTOSAR DESC field)"
  /begin ANNOTATION_TEXT "Gear actuator velocity targets for engaging negative gear in low aggression pre-synchro phase.\r\n" /end ANNOTATION_TEXT
 /end ANNOTATION
 /begin AXIS_DESCR STD_AXIS NO_INPUT_QUANTITY RB_PT_PCT_SWC_GAC_CompuMethods_ident 8 -100. 100. FORMAT "%10.5" DEPOSIT ABSOLUTE /end AXIS_DESCR
/end CHARACTERISTIC
/end MODULE
/end PROJECT
