ASAP2_VERSION 1 60
/begin PROJECT LB74x_TCU "5201C621"
/begin HEADER "" VERSION "5201C621" PROJECT_NO LB74x_TCU /end HEADER
/begin MODULE DIM ""
/begin MOD_COMMON "" BYTE_ORDER MSB_LAST ALIGNMENT_BYTE 1 ALIGNMENT_WORD 2 ALIGNMENT_LONG 4 ALIGNMENT_INT64 4 ALIGNMENT_FLOAT32_IEEE 4 ALIGNMENT_FLOAT64_IEEE 4 DATA_SIZE 32 /end MOD_COMMON
/begin CHARACTERISTIC DWC_EFLASHB.DWC_TorqueControl.DWC_TPOVERLAPSLIPTHRESHOLDOVER "" VALUE 0x8060B4E2 DefaultValueRecordLayout_AUTOSAR_Platform_BaseTypes_uint16 20000.0 RB_PT_PCT_SWC_DWC_CompuMethods_ident 0.0 20000. FORMAT "%10.5"
 /begin ANNOTATION ANNOTATION_LABEL "Description (coming from AUTOSAR DESC field)"
  /begin ANNOTATION_TEXT "Passive clutch slip threshold below which an overlap torque phase is allowed\r\n" /end ANNOTATION_TEXT
 /end ANNOTATION
/end CHARACTERISTIC
/begin CHARACTERISTIC DWC_EFLASHB.DWC_TorqueControl.DWC_TPOVERLAPSLIPTHRESHOLDUNDER "" VALUE 0x8060B4E4 DefaultValueRecordLayout_AUTOSAR_Platform_BaseTypes_uint16 20000.0 RB_PT_PCT_SWC_DWC_CompuMethods_ident 0.0 20000. FORMAT "%10.5"
 /begin ANNOTATION ANNOTATION_LABEL "Description (coming from AUTOSAR DESC field)"
  /begin ANNOTATION_TEXT "Passive clutch slip threshold below which an overlap torque phase is allowed\r\n" /end ANNOTATION_TEXT
 /end ANNOTATION
/end CHARACTERISTIC
/begin CHARACTERISTIC DWC_EFLASHB.DWC_TorqueControl.DWC_TPPOWEROFFDOWNFASTFILLVSMODE "" VAL_BLK 0x8060B3C0 DefaultValueRecordLayout_AUTOSAR_Platform_BaseTypes_boolean 255.0 AUTOSAR_Platform_CompuMethods_boolean 0.0 255. FORMAT "%10.5"
 /begin ANNOTATION ANNOTATION_LABEL "Description (coming from AUTOSAR DESC field)"
  /begin ANNOTATION_TEXT "Power off down fast fill enable vs mode (0 = auto normal, 1 = auto sport, 2 = auto track, 3 = manual normal, 4 = manual sport, 5 = manual track, 6 = electric mode, 7 = eco mode)\r\n" /end ANNOTATION_TEXT
 /end ANNOTATION
 MATRIX_DIM 8 1 1 /end CHARACTERISTIC
/begin CHARACTERISTIC DWC_EFLASHB.DWC_TorqueControl.DWC_TPPOWEROFFUPFASTFILLVSMODE "" VAL_BLK 0x8060B3C8 DefaultValueRecordLayout_AUTOSAR_Platform_BaseTypes_boolean 255.0 AUTOSAR_Platform_CompuMethods_boolean 0.0 255. FORMAT "%10.5"
 /begin ANNOTATION ANNOTATION_LABEL "Description (coming from AUTOSAR DESC field)"
  /begin ANNOTATION_TEXT "Power off up fast fill enable vs mode (0 = auto normal, 1 = auto sport, 2 = auto track, 3 = manual normal, 4 = manual sport, 5 = manual track, 6 = electric mode, 7 = eco mode)\r\n" /end ANNOTATION_TEXT
 /end ANNOTATION
 MATRIX_DIM 8 1 1 /end CHARACTERISTIC
/begin CHARACTERISTIC DWC_EFLASHB.DWC_TorqueControl.DWC_TPPOWERONUPFASTFILLVSMODE "" VAL_BLK 0x8060B3D0 DefaultValueRecordLayout_AUTOSAR_Platform_BaseTypes_boolean 255.0 AUTOSAR_Platform_CompuMethods_boolean 0.0 255. FORMAT "%10.5"
 /begin ANNOTATION ANNOTATION_LABEL "Description (coming from AUTOSAR DESC field)"
  /begin ANNOTATION_TEXT "Power on up fast fill enable vs mode (0 = auto normal, 1 = auto sport, 2 = auto track, 3 = manual normal, 4 = manual sport, 5 = manual track, 6 = electric mode, 7 = eco mode)\r\n" /end ANNOTATION_TEXT
 /end ANNOTATION
 MATRIX_DIM 8 1 1 /end CHARACTERISTIC
/begin CHARACTERISTIC DWC_EFLASHB.DWC_TorqueControl.DWC_TPTIMEMINGEAR "" MAP 0x8060DAF8 RB_PT_PCT_SWC_DWC_RecordLayouts_RL_Map_uint16_40_sint8_5_sint8_8 10.0 RB_PT_PCT_SWC_DWC_CompuMethods_ratio_0p001__2 0.0 10. FORMAT "%10.5"
 /begin ANNOTATION ANNOTATION_LABEL "Description (coming from AUTOSAR DESC field)"
  /begin ANNOTATION_TEXT "Minimum torque phase time for the GT shift as a function of the shift type index and target gear\r\n" /end ANNOTATION_TEXT
 /end ANNOTATION
 /begin AXIS_DESCR STD_AXIS NO_INPUT_QUANTITY RB_PT_PCT_SWC_DWC_CompuMethods_ratio_0p01 5 -1. 1. FORMAT "%10.5" DEPOSIT ABSOLUTE /end AXIS_DESCR
 /begin AXIS_DESCR STD_AXIS NO_INPUT_QUANTITY RB_PT_PCT_SWC_DWC_CompuMethods_ident 8 0.0 11. FORMAT "%10.5" DEPOSIT ABSOLUTE /end AXIS_DESCR
/end CHARACTERISTIC
/begin CHARACTERISTIC DWC_EFLASHB.DWC_TorqueControl.DWC_TPTIMEMINGTTEMPRPM "" MAP 0x8060DB5A RB_PT_PCT_SWC_DWC_RecordLayouts_RL_Map_uint16_36_sint16_6_sint16_6 10.0 RB_PT_PCT_SWC_DWC_CompuMethods_ratio_0p001__2 0.0 10. FORMAT "%10.5"
 /begin ANNOTATION ANNOTATION_LABEL "Description (coming from AUTOSAR DESC field)"
  /begin ANNOTATION_TEXT "Minimum torque phase time for GT style shifts as function of temperature and engine speed\r\n" /end ANNOTATION_TEXT
 /end ANNOTATION
 /begin AXIS_DESCR STD_AXIS NO_INPUT_QUANTITY RB_PT_PCT_SWC_DWC_CompuMethods_ident 6 -50. 200. FORMAT "%10.5" DEPOSIT ABSOLUTE /end AXIS_DESCR
 /begin AXIS_DESCR STD_AXIS NO_INPUT_QUANTITY RB_PT_PCT_SWC_DWC_CompuMethods_ident 6 0.0 20000. FORMAT "%10.5" DEPOSIT ABSOLUTE /end AXIS_DESCR
/end CHARACTERISTIC
/begin CHARACTERISTIC DWC_EFLASHB.DWC_TorqueControl.DWC_TPTIMEPOWERONUPSHIFTS "" MAP 0x8060DBBE RB_PT_PCT_SWC_DWC_RecordLayouts_RL_Map_uint16_88_sint8_11_sint8_8 10.0 RB_PT_PCT_SWC_DWC_CompuMethods_ratio_0p001__2 0.0 10. FORMAT "%10.5"
 /begin ANNOTATION ANNOTATION_LABEL "Description (coming from AUTOSAR DESC field)"
  /begin ANNOTATION_TEXT "Torque phase time for the GT shift as a function of the shift type index and aggression at the start of the shift\r\n" /end ANNOTATION_TEXT
 /end ANNOTATION
 /begin AXIS_DESCR STD_AXIS NO_INPUT_QUANTITY RB_PT_PCT_SWC_DWC_CompuMethods_ratio_0p01 11 -1. 1. FORMAT "%10.5" DEPOSIT ABSOLUTE /end AXIS_DESCR
 /begin AXIS_DESCR STD_AXIS NO_INPUT_QUANTITY RB_PT_PCT_SWC_DWC_CompuMethods_ident 8 -100. 100. FORMAT "%10.5" DEPOSIT ABSOLUTE /end AXIS_DESCR
/end CHARACTERISTIC
/begin CHARACTERISTIC DWC_EFLASHB.DWC_TorqueControl.DWC_TPTORQUEESTIMATEPREFILL "" VALUE 0x8060B4E6 DefaultValueRecordLayout_AUTOSAR_Platform_BaseTypes_sint16 4000.0 RB_PT_PCT_SWC_DWC_CompuMethods_ratio_0p1 -2000. 2000. FORMAT "%10.5"
 /begin ANNOTATION ANNOTATION_LABEL "Description (coming from AUTOSAR DESC field)"
  /begin ANNOTATION_TEXT "Torque estimate for pre-prefill requests (-2000.0 = do not use)\r\n" /end ANNOTATION_TEXT
 /end ANNOTATION
/end CHARACTERISTIC
/begin CHARACTERISTIC DWC_EFLASHB.DWC_TorqueControl.DWC_TPTORQUEPHASETIME "" MAP 0x8060DC86 RB_PT_PCT_SWC_DWC_RecordLayouts_RL_Map_uint16_99_sint8_9_sint8_11 10.0 RB_PT_PCT_SWC_DWC_CompuMethods_ratio_0p001__2 0.0 10. FORMAT "%10.5"
 /begin ANNOTATION ANNOTATION_LABEL "Description (coming from AUTOSAR DESC field)"
  /begin ANNOTATION_TEXT "Target torque phase time table - 0 = Pullaway, 1 = Supported, 2=Normal Auto, 3 = Sport auto, 4 = Track auto, 5 = Normal manual, 6 = Sport manual, 7 = Track manual, 8 = Power On Down End, 9 = electric mode, 10 = eco mode)\r\n" /end ANNOTATION_TEXT
 /end ANNOTATION
 /begin AXIS_DESCR STD_AXIS NO_INPUT_QUANTITY RB_PT_PCT_SWC_DWC_CompuMethods_ident 9 -100. 100. FORMAT "%10.5" DEPOSIT ABSOLUTE /end AXIS_DESCR
 /begin AXIS_DESCR STD_AXIS NO_INPUT_QUANTITY RB_PT_PCT_SWC_DWC_CompuMethods_ident 11 0.0 10. FORMAT "%10.5" DEPOSIT ABSOLUTE /end AXIS_DESCR
/end CHARACTERISTIC
/begin CHARACTERISTIC DWC_EFLASHB.DWC_TorqueControl.DWC_USEFILTEREDSPEEDARB "" VALUE 0x8060B55B DefaultValueRecordLayout_AUTOSAR_Platform_BaseTypes_boolean 255.0 AUTOSAR_Platform_CompuMethods_boolean 0.0 255. FORMAT "%10.5"
 /begin ANNOTATION ANNOTATION_LABEL "Description (coming from AUTOSAR DESC field)" /begin ANNOTATION_TEXT "Flag to use filtered input speeds for the arbitrator\r\n" /end ANNOTATION_TEXT /end ANNOTATION
/end CHARACTERISTIC
/begin CHARACTERISTIC DWC_EFLASHB.DWC_TorqueControl.DWC_USENEWPOWERONUPCODE "" VALUE 0x8060B55C DefaultValueRecordLayout_AUTOSAR_Platform_BaseTypes_boolean 255.0 AUTOSAR_Platform_CompuMethods_boolean 0.0 255. FORMAT "%10.5"
 /begin ANNOTATION ANNOTATION_LABEL "Description (coming from AUTOSAR DESC field)" /begin ANNOTATION_TEXT "Flag to activate the new code for power on upshifts\r\n" /end ANNOTATION_TEXT /end ANNOTATION
/end CHARACTERISTIC
/begin CHARACTERISTIC DWC_EFLASHB.DWC_TorqueControl.DWC_USEPULLAWAYDATAFORTIMETOSHIFT "" VALUE 0x8060B55D DefaultValueRecordLayout_AUTOSAR_Platform_BaseTypes_boolean 255.0 AUTOSAR_Platform_CompuMethods_boolean 0.0 255. FORMAT "%10.5"
 /begin ANNOTATION ANNOTATION_LABEL "Description (coming from AUTOSAR DESC field)"
  /begin ANNOTATION_TEXT "Flag to allow the calculation of time to shift to include pullaway\r\n" /end ANNOTATION_TEXT
 /end ANNOTATION
/end CHARACTERISTIC
/begin CHARACTERISTIC DWC_EFLASHB.DWC_TorqueControl.DWC_USERAWDSPEEDGRAD "" VALUE 0x8060B55E DefaultValueRecordLayout_AUTOSAR_Platform_BaseTypes_boolean 255.0 AUTOSAR_Platform_CompuMethods_boolean 0.0 255. FORMAT "%10.5"
 /begin ANNOTATION ANNOTATION_LABEL "Description (coming from AUTOSAR DESC field)"
  /begin ANNOTATION_TEXT "Flag to request the use of raw error on the slip control I term\r\n" /end ANNOTATION_TEXT
 /end ANNOTATION
/end CHARACTERISTIC
/begin CHARACTERISTIC DWC_EFLASHB.DWC_TorqueControl.DWC_USERAWERRORITERM "" VALUE 0x8060B55F DefaultValueRecordLayout_AUTOSAR_Platform_BaseTypes_boolean 255.0 AUTOSAR_Platform_CompuMethods_boolean 0.0 255. FORMAT "%10.5"
 /begin ANNOTATION ANNOTATION_LABEL "Description (coming from AUTOSAR DESC field)"
  /begin ANNOTATION_TEXT "Flag to request the use of raw error on the slip control I term\r\n" /end ANNOTATION_TEXT
 /end ANNOTATION
/end CHARACTERISTIC
/begin CHARACTERISTIC DWC_EFLASHB.DWC_TorqueControl.DWC_WSCDelayTrigger.DWC_DELAYTIME "" VALUE 0x8060C87C DefaultValueRecordLayout_AUTOSAR_Platform_BaseTypes_uint16 10.0 RB_PT_PCT_SWC_DWC_CompuMethods_ratio_0p001__2 0.0 10. FORMAT "%10.5"
 /begin ANNOTATION ANNOTATION_LABEL "Description (coming from AUTOSAR DESC field)" /begin ANNOTATION_TEXT "Event delay time\r\n" /end ANNOTATION_TEXT /end ANNOTATION
/end CHARACTERISTIC
/begin CHARACTERISTIC DWC_EFLASHB.DWC_TorqueControl.DWC_WSCENABLEIMMEDIATECONTROL "" VALUE 0x8060B560 DefaultValueRecordLayout_AUTOSAR_Platform_BaseTypes_boolean 255.0 AUTOSAR_Platform_CompuMethods_boolean 0.0 255. FORMAT "%10.5"
 /begin ANNOTATION ANNOTATION_LABEL "Description (coming from AUTOSAR DESC field)" /begin ANNOTATION_TEXT "Flag to enable immediate P and I term calculation\r\n" /end ANNOTATION_TEXT /end ANNOTATION
/end CHARACTERISTIC
/begin CHARACTERISTIC DWC_EFLASHB.DWC_TorqueControl.DWC_WSCIGAIN "" CURVE 0x8060DD64 RB_PT_PCT_SWC_DWC_RecordLayouts_RL_Curve_sint16_7_sint16_7 0.2 RB_PT_PCT_SWC_DWC_CompuMethods_ratio_0p00001 -0.1 0.1 FORMAT "%10.5"
 /begin ANNOTATION ANNOTATION_LABEL "Description (coming from AUTOSAR DESC field)" /begin ANNOTATION_TEXT "Integral gain of wheel slip controller\r\n" /end ANNOTATION_TEXT /end ANNOTATION
 /begin AXIS_DESCR STD_AXIS NO_INPUT_QUANTITY RB_PT_PCT_SWC_DWC_CompuMethods_ident 7 -20000. 20000. FORMAT "%10.5" DEPOSIT ABSOLUTE /end AXIS_DESCR
/end CHARACTERISTIC
/begin CHARACTERISTIC DWC_EFLASHB.DWC_TorqueControl.DWC_WSCITERMOFFSETSPEEDDELTA "" CURVE 0x8060DD82 RB_PT_PCT_SWC_DWC_RecordLayouts_RL_Curve_sint16_5_sint16_5 4000.0 RB_PT_PCT_SWC_DWC_CompuMethods_ratio_0p1 -2000. 2000. FORMAT "%10.5"
 /begin ANNOTATION ANNOTATION_LABEL "Description (coming from AUTOSAR DESC field)"
  /begin ANNOTATION_TEXT "WSC I term offset to load based on delta driven axle speed\r\n" /end ANNOTATION_TEXT
 /end ANNOTATION
 /begin AXIS_DESCR STD_AXIS NO_INPUT_QUANTITY RB_PT_PCT_SWC_DWC_CompuMethods_ident 5 -20000. 20000. FORMAT "%10.5" DEPOSIT ABSOLUTE /end AXIS_DESCR
/end CHARACTERISTIC
/begin CHARACTERISTIC DWC_EFLASHB.DWC_TorqueControl.DWC_WSCMAXUNDRIVENFORWSC "" VALUE 0x8060B4E8 DefaultValueRecordLayout_AUTOSAR_Platform_BaseTypes_sint16 40000.0 RB_PT_PCT_SWC_DWC_CompuMethods_ident -20000. 20000. FORMAT "%10.5"
 /begin ANNOTATION ANNOTATION_LABEL "Description (coming from AUTOSAR DESC field)"
  /begin ANNOTATION_TEXT "Maximum undriven axle speed for wheel slip control to be enabled\r\n" /end ANNOTATION_TEXT
 /end ANNOTATION
/end CHARACTERISTIC
/begin CHARACTERISTIC DWC_EFLASHB.DWC_TorqueControl.DWC_WSCMAXUNDRIVENFORWSCHYST "" VALUE 0x8060B4EA DefaultValueRecordLayout_AUTOSAR_Platform_BaseTypes_uint16 20000.0 RB_PT_PCT_SWC_DWC_CompuMethods_ident 0.0 20000. FORMAT "%10.5"
 /begin ANNOTATION ANNOTATION_LABEL "Description (coming from AUTOSAR DESC field)"
  /begin ANNOTATION_TEXT "Maximum undriven axle speed for wheel slip control to be enabled\r\n" /end ANNOTATION_TEXT
 /end ANNOTATION
/end CHARACTERISTIC
/begin CHARACTERISTIC DWC_EFLASHB.DWC_TorqueControl.DWC_WSCMUTESTINTERPOINTTIME "" VALUE 0x8060B4EC DefaultValueRecordLayout_AUTOSAR_Platform_BaseTypes_uint16 10.0 RB_PT_PCT_SWC_DWC_CompuMethods_ratio_0p001__2 0.0 10. FORMAT "%10.5"
 /begin ANNOTATION ANNOTATION_LABEL "Description (coming from AUTOSAR DESC field)" /begin ANNOTATION_TEXT "Maximum time between wheel speed sample points\r\n" /end ANNOTATION_TEXT /end ANNOTATION
/end CHARACTERISTIC
/begin CHARACTERISTIC DWC_EFLASHB.DWC_TorqueControl.DWC_WSCMUTESTTIMEOUT "" VALUE 0x8060B4EE DefaultValueRecordLayout_AUTOSAR_Platform_BaseTypes_uint16 10.0 RB_PT_PCT_SWC_DWC_CompuMethods_ratio_0p001__2 0.0 10. FORMAT "%10.5"
 /begin ANNOTATION ANNOTATION_LABEL "Description (coming from AUTOSAR DESC field)" /begin ANNOTATION_TEXT "Maximum time for mu test before abort occurs\r\n" /end ANNOTATION_TEXT /end ANNOTATION
/end CHARACTERISTIC
/begin CHARACTERISTIC DWC_EFLASHB.DWC_TorqueControl.DWC_WSCPTERMPOSIIR "" VALUE 0x8060B561 DefaultValueRecordLayout_AUTOSAR_Platform_BaseTypes_uint8 1.0 RB_PT_PCT_SWC_DWC_CompuMethods_ratio_0p01 0.0 1. FORMAT "%10.5"
 /begin ANNOTATION ANNOTATION_LABEL "Description (coming from AUTOSAR DESC field)" /begin ANNOTATION_TEXT "IIR filter coeff on positive going P terms\r\n" /end ANNOTATION_TEXT /end ANNOTATION
/end CHARACTERISTIC
/begin CHARACTERISTIC DWC_EFLASHB.DWC_TorqueControl.DWC_WSCPTERMWINDOWMAX "" CURVE 0x8060DD98 RB_PT_PCT_SWC_DWC_RecordLayouts_RL_Curve_sint16_7_sint16_7 4000.0 RB_PT_PCT_SWC_DWC_CompuMethods_ratio_0p1 -2000. 2000. FORMAT "%10.5"
 /begin ANNOTATION ANNOTATION_LABEL "Description (coming from AUTOSAR DESC field)" /begin ANNOTATION_TEXT "max p term in ration to max torque based around\r\n" /end ANNOTATION_TEXT /end ANNOTATION
 /begin AXIS_DESCR STD_AXIS NO_INPUT_QUANTITY RB_PT_PCT_SWC_DWC_CompuMethods_ident 7 -20000. 20000. FORMAT "%10.5" DEPOSIT ABSOLUTE /end AXIS_DESCR
/end CHARACTERISTIC
/begin CHARACTERISTIC DWC_EFLASHB.DWC_TorqueControl.DWC_WSCPTQ "" CURVE 0x8060DDB6 RB_PT_PCT_SWC_DWC_RecordLayouts_RL_Curve_sint16_7_sint16_7 4000.0 RB_PT_PCT_SWC_DWC_CompuMethods_ratio_0p1 -2000. 2000. FORMAT "%10.5"
 /begin ANNOTATION ANNOTATION_LABEL "Description (coming from AUTOSAR DESC field)" /begin ANNOTATION_TEXT "Proportional term of wheel slip controller\r\n" /end ANNOTATION_TEXT /end ANNOTATION
 /begin AXIS_DESCR STD_AXIS NO_INPUT_QUANTITY RB_PT_PCT_SWC_DWC_CompuMethods_ident 7 -20000. 20000. FORMAT "%10.5" DEPOSIT ABSOLUTE /end AXIS_DESCR
/end CHARACTERISTIC
/begin CHARACTERISTIC DWC_EFLASHB.DWC_TorqueControl.DWC_WSCTARGETDRIVENVSUNDRIVENSPEED "" CURVE 0x8060DDD4 RB_PT_PCT_SWC_DWC_RecordLayouts_RL_Curve_sint16_11_sint16_11 40000.0 RB_PT_PCT_SWC_DWC_CompuMethods_ident -20000. 20000. FORMAT "%10.5"
 /begin ANNOTATION ANNOTATION_LABEL "Description (coming from AUTOSAR DESC field)" /begin ANNOTATION_TEXT "Target driven axle speed vs. undriven axle speed\r\n" /end ANNOTATION_TEXT /end ANNOTATION
 /begin AXIS_DESCR STD_AXIS NO_INPUT_QUANTITY RB_PT_PCT_SWC_DWC_CompuMethods_ident 11 -20000. 20000. FORMAT "%10.5" DEPOSIT ABSOLUTE /end AXIS_DESCR
/end CHARACTERISTIC
/begin CHARACTERISTIC DWC_EFLASHB.DWC_TransmissionLosses.DWC_HIGHTEMPTHRES "" VALUE 0x8060DE20 DefaultValueRecordLayout_AUTOSAR_Platform_BaseTypes_sint16 250.0 RB_PT_PCT_SWC_DWC_CompuMethods_ident -50. 200. FORMAT "%10.5"
 /begin ANNOTATION ANNOTATION_LABEL "Description (coming from AUTOSAR DESC field)" /begin ANNOTATION_TEXT "Temperature of low temp map data\r\n" /end ANNOTATION_TEXT /end ANNOTATION
/end CHARACTERISTIC
/begin CHARACTERISTIC DWC_EFLASHB.DWC_TransmissionLosses.DWC_LOWTEMPTHRES "" VALUE 0x8060DE22 DefaultValueRecordLayout_AUTOSAR_Platform_BaseTypes_sint16 250.0 RB_PT_PCT_SWC_DWC_CompuMethods_ident -50. 200. FORMAT "%10.5"
 /begin ANNOTATION ANNOTATION_LABEL "Description (coming from AUTOSAR DESC field)" /begin ANNOTATION_TEXT "Temperature of low temp map data\r\n" /end ANNOTATION_TEXT /end ANNOTATION
/end CHARACTERISTIC
/begin CHARACTERISTIC DWC_EFLASHB.DWC_TransmissionLosses.DWC_MAXCCVALVECURRENT "" VALUE 0x8060DE24 DefaultValueRecordLayout_AUTOSAR_Platform_BaseTypes_uint16 4999.0 RB_PT_PCT_SWC_DWC_CompuMethods_ident 1. 5000. FORMAT "%10.5"
 /begin ANNOTATION ANNOTATION_LABEL "Description (coming from AUTOSAR DESC field)" /begin ANNOTATION_TEXT "Maximum sum of the two cooling valave currents\r\n" /end ANNOTATION_TEXT /end ANNOTATION
/end CHARACTERISTIC
/begin CHARACTERISTIC DWC_EFLASHB.DWC_TransmissionLosses.DWC_MAXSUMOFVALVECURRENTS "" VALUE 0x8060DE26 DefaultValueRecordLayout_AUTOSAR_Platform_BaseTypes_uint16 4999.0 RB_PT_PCT_SWC_DWC_CompuMethods_ident 1. 5000. FORMAT "%10.5"
 /begin ANNOTATION ANNOTATION_LABEL "Description (coming from AUTOSAR DESC field)" /begin ANNOTATION_TEXT "Maximum sum of the two cooling valave currents\r\n" /end ANNOTATION_TEXT /end ANNOTATION
/end CHARACTERISTIC
/begin CHARACTERISTIC DWC_EFLASHB.DWC_TransmissionLosses.DWC_MEDTEMPTHRES "" VALUE 0x8060DE28 DefaultValueRecordLayout_AUTOSAR_Platform_BaseTypes_sint16 250.0 RB_PT_PCT_SWC_DWC_CompuMethods_ident -50. 200. FORMAT "%10.5"
 /begin ANNOTATION ANNOTATION_LABEL "Description (coming from AUTOSAR DESC field)" /begin ANNOTATION_TEXT "Temperature of low temp map data\r\n" /end ANNOTATION_TEXT /end ANNOTATION
/end CHARACTERISTIC
/begin CHARACTERISTIC DWC_EFLASHB.DWC_TransmissionLosses.DWC_TRANSMISSIONLOSS "" VALUE 0x8060DE2A DefaultValueRecordLayout_AUTOSAR_Platform_BaseTypes_uint16 2000.0 RB_PT_PCT_SWC_DWC_CompuMethods_ratio_0p1 0.0 2000. FORMAT "%10.5"
 /begin ANNOTATION ANNOTATION_LABEL "Description (coming from AUTOSAR DESC field)" /begin ANNOTATION_TEXT "Transmission drag torque on engine\r\n" /end ANNOTATION_TEXT /end ANNOTATION
/end CHARACTERISTIC
/begin CHARACTERISTIC DWC_EFLASHB.DWC_TransmissionLosses.DWC_USEFIXEDLOSS "" VALUE 0x8060DE2C DefaultValueRecordLayout_AUTOSAR_Platform_BaseTypes_boolean 255.0 AUTOSAR_Platform_CompuMethods_boolean 0.0 255. FORMAT "%10.5"
 /begin ANNOTATION ANNOTATION_LABEL "Description (coming from AUTOSAR DESC field)"
  /begin ANNOTATION_TEXT "Parameter to enable the transmission losses to be set to a fixed value\r\n" /end ANNOTATION_TEXT
 /end ANNOTATION
/end CHARACTERISTIC
/begin CHARACTERISTIC DWC_EFLASHB.DWC_TransmissionLosses.DWC_VISCOUSDRAGMAXK1 "" MAP 0x8060DE2E RB_PT_PCT_SWC_DWC_RecordLayouts_RL_Map_sint16_156_sint16_6_sint16_26 4000.0 RB_PT_PCT_SWC_DWC_CompuMethods_ratio_0p1 -2000. 2000. FORMAT "%10.5"
 /begin ANNOTATION ANNOTATION_LABEL "Description (coming from AUTOSAR DESC field)"
  /begin ANNOTATION_TEXT "Temperature related viscous drag related to demand torque\r\n" /end ANNOTATION_TEXT
 /end ANNOTATION
 /begin AXIS_DESCR STD_AXIS NO_INPUT_QUANTITY RB_PT_PCT_SWC_DWC_CompuMethods_ident 6 -50. 200. FORMAT "%10.5" DEPOSIT ABSOLUTE /end AXIS_DESCR
 /begin AXIS_DESCR STD_AXIS NO_INPUT_QUANTITY RB_PT_PCT_SWC_DWC_CompuMethods_ident 26 -20000. 20000. FORMAT "%10.5" DEPOSIT ABSOLUTE /end AXIS_DESCR
/end CHARACTERISTIC
/begin CHARACTERISTIC DWC_EFLASHB.DWC_TransmissionLosses.DWC_VISCOUSDRAGMAXK2 "" MAP 0x8060DFAA RB_PT_PCT_SWC_DWC_RecordLayouts_RL_Map_sint16_156_sint16_6_sint16_26 4000.0 RB_PT_PCT_SWC_DWC_CompuMethods_ratio_0p1 -2000. 2000. FORMAT "%10.5"
 /begin ANNOTATION ANNOTATION_LABEL "Description (coming from AUTOSAR DESC field)"
  /begin ANNOTATION_TEXT "Temperature related viscous drag related to demand torque\r\n" /end ANNOTATION_TEXT
 /end ANNOTATION
 /begin AXIS_DESCR STD_AXIS NO_INPUT_QUANTITY RB_PT_PCT_SWC_DWC_CompuMethods_ident 6 -50. 200. FORMAT "%10.5" DEPOSIT ABSOLUTE /end AXIS_DESCR
 /begin AXIS_DESCR STD_AXIS NO_INPUT_QUANTITY RB_PT_PCT_SWC_DWC_CompuMethods_ident 26 -20000. 20000. FORMAT "%10.5" DEPOSIT ABSOLUTE /end AXIS_DESCR
/end CHARACTERISTIC
/begin CHARACTERISTIC DWC_EFLASHB.DWC_TransmissionLosses.DWC_VISCOUSDRAGMINK1 "" MAP 0x8060E126 RB_PT_PCT_SWC_DWC_RecordLayouts_RL_Map_sint16_156_sint16_6_sint16_26 4000.0 RB_PT_PCT_SWC_DWC_CompuMethods_ratio_0p1 -2000. 2000. FORMAT "%10.5"
 /begin ANNOTATION ANNOTATION_LABEL "Description (coming from AUTOSAR DESC field)"
  /begin ANNOTATION_TEXT "Temperature related viscous drag related to demand torque\r\n" /end ANNOTATION_TEXT
 /end ANNOTATION
 /begin AXIS_DESCR STD_AXIS NO_INPUT_QUANTITY RB_PT_PCT_SWC_DWC_CompuMethods_ident 6 -50. 200. FORMAT "%10.5" DEPOSIT ABSOLUTE /end AXIS_DESCR
 /begin AXIS_DESCR STD_AXIS NO_INPUT_QUANTITY RB_PT_PCT_SWC_DWC_CompuMethods_ident 26 -20000. 20000. FORMAT "%10.5" DEPOSIT ABSOLUTE /end AXIS_DESCR
/end CHARACTERISTIC
/begin CHARACTERISTIC DWC_EFLASHB.DWC_TransmissionLosses.DWC_VISCOUSDRAGMINK2 "" MAP 0x8060E2A2 RB_PT_PCT_SWC_DWC_RecordLayouts_RL_Map_sint16_156_sint16_6_sint16_26 4000.0 RB_PT_PCT_SWC_DWC_CompuMethods_ratio_0p1 -2000. 2000. FORMAT "%10.5"
 /begin ANNOTATION ANNOTATION_LABEL "Description (coming from AUTOSAR DESC field)"
  /begin ANNOTATION_TEXT "Temperature related viscous drag related to demand torque\r\n" /end ANNOTATION_TEXT
 /end ANNOTATION
 /begin AXIS_DESCR STD_AXIS NO_INPUT_QUANTITY RB_PT_PCT_SWC_DWC_CompuMethods_ident 6 -50. 200. FORMAT "%10.5" DEPOSIT ABSOLUTE /end AXIS_DESCR
 /begin AXIS_DESCR STD_AXIS NO_INPUT_QUANTITY RB_PT_PCT_SWC_DWC_CompuMethods_ident 26 -20000. 20000. FORMAT "%10.5" DEPOSIT ABSOLUTE /end AXIS_DESCR
/end CHARACTERISTIC
/begin CHARACTERISTIC DWC_EFLASHB.DWC_USERAWSLIPSPEEDPHASECTRL "" VALUE 0x806098CC DefaultValueRecordLayout_AUTOSAR_Platform_BaseTypes_boolean 255.0 AUTOSAR_Platform_CompuMethods_boolean 0.0 255. FORMAT "%10.5"
 /begin ANNOTATION ANNOTATION_LABEL "Description (coming from AUTOSAR DESC field)" /begin ANNOTATION_TEXT "Flag to use raw slip for speed phase control module\r\n" /end ANNOTATION_TEXT /end ANNOTATION
/end CHARACTERISTIC
/begin CHARACTERISTIC DWC_EFLASHROMB.DWC_HIGHESTTORQUEGEARHYST "" VALUE 0x806076FC DefaultValueRecordLayout_AUTOSAR_Platform_BaseTypes_uint16 2000.0 RB_PT_PCT_SWC_DWC_CompuMethods_ratio_0p1 0.0 2000. FORMAT "%10.5"
 /begin ANNOTATION ANNOTATION_LABEL "Description (coming from AUTOSAR DESC field)" /begin ANNOTATION_TEXT "Hysteresis on decision for highest torque gear\r\n" /end ANNOTATION_TEXT /end ANNOTATION
/end CHARACTERISTIC
/begin CHARACTERISTIC DWC_EFLASHROMB.DWC_InputProcessing.DWC_AGGRESSIVEMANUAL "" VALUE 0x80607704 DefaultValueRecordLayout_AUTOSAR_Platform_BaseTypes_boolean 255.0 AUTOSAR_Platform_CompuMethods_boolean 0.0 255. FORMAT "%10.5"
 /begin ANNOTATION ANNOTATION_LABEL "Description (coming from AUTOSAR DESC field)" /begin ANNOTATION_TEXT "Aggressive manual mode shifts enable\r\n" /end ANNOTATION_TEXT /end ANNOTATION
/end CHARACTERISTIC
/begin CHARACTERISTIC DWC_EFLASHROMB.DWC_InputProcessing.DWC_BRAKEPRESSURENOTBACKEDUP "" VALUE 0x80607705 DefaultValueRecordLayout_AUTOSAR_Platform_BaseTypes_boolean 255.0 AUTOSAR_Platform_CompuMethods_boolean 0.0 255. FORMAT "%10.5"
 /begin ANNOTATION ANNOTATION_LABEL "Description (coming from AUTOSAR DESC field)"
  /begin ANNOTATION_TEXT "Flag to indicate that brake pressure signal is not substituted, therefore requiring DWC to do it\r\n" /end ANNOTATION_TEXT
 /end ANNOTATION
/end CHARACTERISTIC
/begin CHARACTERISTIC DWC_EFLASHROMB.DWC_InputProcessing.DWC_DEFAULTTEMPERATURE "" VALUE 0x80607700 DefaultValueRecordLayout_AUTOSAR_Platform_BaseTypes_sint16 250.0 RB_PT_PCT_SWC_DWC_CompuMethods_ident -50. 200. FORMAT "%10.5"
 /begin ANNOTATION ANNOTATION_LABEL "Description (coming from AUTOSAR DESC field)"
  /begin ANNOTATION_TEXT "Calibrated default temperature in the case of all sensors failed\r\n" /end ANNOTATION_TEXT
 /end ANNOTATION
/end CHARACTERISTIC
/begin CHARACTERISTIC DWC_EFLASHROMB.DWC_InputProcessing.DWC_DRIVERTORQUEMAXIMUM "" VALUE 0x80607702 DefaultValueRecordLayout_AUTOSAR_Platform_BaseTypes_uint16 1900.0 RB_PT_PCT_SWC_DWC_CompuMethods_ratio_0p1 100. 2000. FORMAT "%10.5"
 /begin ANNOTATION ANNOTATION_LABEL "Description (coming from AUTOSAR DESC field)"
  /begin ANNOTATION_TEXT "Maximum driver demand torque (for calculation of percentage aggression - optionally)\r\n" /end ANNOTATION_TEXT
 /end ANNOTATION
/end CHARACTERISTIC
/begin CHARACTERISTIC DWC_EFLASHROMB.DWC_InputProcessing.DWC_INPUT1SIGNED "" VALUE 0x80607706 DefaultValueRecordLayout_AUTOSAR_Platform_BaseTypes_boolean 255.0 AUTOSAR_Platform_CompuMethods_boolean 0.0 255. FORMAT "%10.5"
 /begin ANNOTATION ANNOTATION_LABEL "Description (coming from AUTOSAR DESC field)"
  /begin ANNOTATION_TEXT "Flag indicating that input shaft 1 speed is signed on input to DWC\r\n" /end ANNOTATION_TEXT
 /end ANNOTATION
/end CHARACTERISTIC
/begin CHARACTERISTIC DWC_EFLASHROMB.DWC_InputProcessing.DWC_INPUT2SIGNED "" VALUE 0x80607707 DefaultValueRecordLayout_AUTOSAR_Platform_BaseTypes_boolean 255.0 AUTOSAR_Platform_CompuMethods_boolean 0.0 255. FORMAT "%10.5"
 /begin ANNOTATION ANNOTATION_LABEL "Description (coming from AUTOSAR DESC field)"
  /begin ANNOTATION_TEXT "Flag indicating that input shaft 1 speed is signed on input to DWC\r\n" /end ANNOTATION_TEXT
 /end ANNOTATION
/end CHARACTERISTIC
/begin CHARACTERISTIC DWC_EFLASHROMB.DWC_InputProcessing.DWC_K1PressureCorrect.DWC_ADAPTDELTATEMP "" VAL_BLK 0x8060770C DefaultValueRecordLayout_AUTOSAR_Platform_BaseTypes_sint16 64.0 RB_PT_PCT_SWC_DWC_CompuMethods_ratio_0p001__2 -32. 32. FORMAT "%10.5"
 /begin ANNOTATION ANNOTATION_LABEL "Description (coming from AUTOSAR DESC field)" /begin ANNOTATION_TEXT "Working points of temperature adaptation\r\n" /end ANNOTATION_TEXT /end ANNOTATION
 MATRIX_DIM 7 1 1 /end CHARACTERISTIC
/begin CHARACTERISTIC DWC_EFLASHROMB.DWC_InputProcessing.DWC_K1PressureCorrect.DWC_MAXOFFSETTEMP "" VAL_BLK 0x8060771A DefaultValueRecordLayout_AUTOSAR_Platform_BaseTypes_sint16 64.0 RB_PT_PCT_SWC_DWC_CompuMethods_ratio_0p001__2 -32. 32. FORMAT "%10.5"
 /begin ANNOTATION ANNOTATION_LABEL "Description (coming from AUTOSAR DESC field)" /begin ANNOTATION_TEXT "Working points of temperature adaptation\r\n" /end ANNOTATION_TEXT /end ANNOTATION
 MATRIX_DIM 7 1 1 /end CHARACTERISTIC
/begin CHARACTERISTIC DWC_EFLASHROMB.DWC_InputProcessing.DWC_K1PressureCorrect.DWC_MINOFFSETTEMP "" VAL_BLK 0x80607728 DefaultValueRecordLayout_AUTOSAR_Platform_BaseTypes_sint16 64.0 RB_PT_PCT_SWC_DWC_CompuMethods_ratio_0p001__2 -32. 32. FORMAT "%10.5"
 /begin ANNOTATION ANNOTATION_LABEL "Description (coming from AUTOSAR DESC field)" /begin ANNOTATION_TEXT "Working points of temperature adaptation\r\n" /end ANNOTATION_TEXT /end ANNOTATION
 MATRIX_DIM 7 1 1 /end CHARACTERISTIC
/begin CHARACTERISTIC DWC_EFLASHROMB.DWC_InputProcessing.DWC_K1PressureCorrect.DWC_TEMPPOINTS "" VAL_BLK 0x80607736 DefaultValueRecordLayout_AUTOSAR_Platform_BaseTypes_sint16 250.0 RB_PT_PCT_SWC_DWC_CompuMethods_ident -50. 200. FORMAT "%10.5"
 /begin ANNOTATION ANNOTATION_LABEL "Description (coming from AUTOSAR DESC field)" /begin ANNOTATION_TEXT "Working points of temperature adaptation\r\n" /end ANNOTATION_TEXT /end ANNOTATION
 MATRIX_DIM 7 1 1 /end CHARACTERISTIC
/begin CHARACTERISTIC DWC_EFLASHROMB.DWC_InputProcessing.DWC_K1PressureCorrect.DWC_TIMEUNTILADAPTTEMP "" VAL_BLK 0x80607744 DefaultValueRecordLayout_AUTOSAR_Platform_BaseTypes_uint16 10.0 RB_PT_PCT_SWC_DWC_CompuMethods_ratio_0p001__2 0.0 10. FORMAT "%10.5"
 /begin ANNOTATION ANNOTATION_LABEL "Description (coming from AUTOSAR DESC field)" /begin ANNOTATION_TEXT "Time until adaptation against temperature point\r\n" /end ANNOTATION_TEXT /end ANNOTATION
 MATRIX_DIM 7 1 1 /end CHARACTERISTIC
/begin CHARACTERISTIC DWC_EFLASHROMB.DWC_InputProcessing.DWC_K2PressureCorrect.DWC_ADAPTDELTATEMP "" VAL_BLK 0x80607752 DefaultValueRecordLayout_AUTOSAR_Platform_BaseTypes_sint16 64.0 RB_PT_PCT_SWC_DWC_CompuMethods_ratio_0p001__2 -32. 32. FORMAT "%10.5"
 /begin ANNOTATION ANNOTATION_LABEL "Description (coming from AUTOSAR DESC field)" /begin ANNOTATION_TEXT "Working points of temperature adaptation\r\n" /end ANNOTATION_TEXT /end ANNOTATION
 MATRIX_DIM 7 1 1 /end CHARACTERISTIC
/begin CHARACTERISTIC DWC_EFLASHROMB.DWC_InputProcessing.DWC_K2PressureCorrect.DWC_MAXOFFSETTEMP "" VAL_BLK 0x80607760 DefaultValueRecordLayout_AUTOSAR_Platform_BaseTypes_sint16 64.0 RB_PT_PCT_SWC_DWC_CompuMethods_ratio_0p001__2 -32. 32. FORMAT "%10.5"
 /begin ANNOTATION ANNOTATION_LABEL "Description (coming from AUTOSAR DESC field)" /begin ANNOTATION_TEXT "Working points of temperature adaptation\r\n" /end ANNOTATION_TEXT /end ANNOTATION
 MATRIX_DIM 7 1 1 /end CHARACTERISTIC
/begin CHARACTERISTIC DWC_EFLASHROMB.DWC_InputProcessing.DWC_K2PressureCorrect.DWC_MINOFFSETTEMP "" VAL_BLK 0x8060776E DefaultValueRecordLayout_AUTOSAR_Platform_BaseTypes_sint16 64.0 RB_PT_PCT_SWC_DWC_CompuMethods_ratio_0p001__2 -32. 32. FORMAT "%10.5"
 /begin ANNOTATION ANNOTATION_LABEL "Description (coming from AUTOSAR DESC field)" /begin ANNOTATION_TEXT "Working points of temperature adaptation\r\n" /end ANNOTATION_TEXT /end ANNOTATION
 MATRIX_DIM 7 1 1 /end CHARACTERISTIC
/begin CHARACTERISTIC DWC_EFLASHROMB.DWC_InputProcessing.DWC_K2PressureCorrect.DWC_TEMPPOINTS "" VAL_BLK 0x8060777C DefaultValueRecordLayout_AUTOSAR_Platform_BaseTypes_sint16 250.0 RB_PT_PCT_SWC_DWC_CompuMethods_ident -50. 200. FORMAT "%10.5"
 /begin ANNOTATION ANNOTATION_LABEL "Description (coming from AUTOSAR DESC field)" /begin ANNOTATION_TEXT "Working points of temperature adaptation\r\n" /end ANNOTATION_TEXT /end ANNOTATION
 MATRIX_DIM 7 1 1 /end CHARACTERISTIC
/begin CHARACTERISTIC DWC_EFLASHROMB.DWC_InputProcessing.DWC_K2PressureCorrect.DWC_TIMEUNTILADAPTTEMP "" VAL_BLK 0x8060778A DefaultValueRecordLayout_AUTOSAR_Platform_BaseTypes_uint16 10.0 RB_PT_PCT_SWC_DWC_CompuMethods_ratio_0p001__2 0.0 10. FORMAT "%10.5"
 /begin ANNOTATION ANNOTATION_LABEL "Description (coming from AUTOSAR DESC field)" /begin ANNOTATION_TEXT "Time until adaptation against temperature point\r\n" /end ANNOTATION_TEXT /end ANNOTATION
 MATRIX_DIM 7 1 1 /end CHARACTERISTIC
/begin CHARACTERISTIC DWC_EFLASHROMB.DWC_InputProcessing.DWC_OUTPUTSPEEDNOTBACKEDUP "" VALUE 0x80607708 DefaultValueRecordLayout_AUTOSAR_Platform_BaseTypes_boolean 255.0 AUTOSAR_Platform_CompuMethods_boolean 0.0 255. FORMAT "%10.5"
 /begin ANNOTATION ANNOTATION_LABEL "Description (coming from AUTOSAR DESC field)"
  /begin ANNOTATION_TEXT "Flag to indicate that output speed signal is not substituted, therefore requiring DWC to do it\r\n" /end ANNOTATION_TEXT
 /end ANNOTATION
/end CHARACTERISTIC
/begin CHARACTERISTIC DWC_EFLASHROMB.DWC_InputProcessing.DWC_PEDALPOSITIVEAGGRESSION "" VALUE 0x80607709 DefaultValueRecordLayout_AUTOSAR_Platform_BaseTypes_uint8 102.0 RB_PT_PCT_SWC_DWC_CompuMethods_ratio_0p4 0.0 102. FORMAT "%10.5"
 /begin ANNOTATION ANNOTATION_LABEL "Description (coming from AUTOSAR DESC field)"
  /begin ANNOTATION_TEXT "Percentage throttle for positive only shift aggression\r\n" /end ANNOTATION_TEXT
 /end ANNOTATION
/end CHARACTERISTIC
/begin CHARACTERISTIC DWC_EFLASHROMB.DWC_InputProcessing.DWC_USEPTMODEFORSHIFTMODE "" VALUE 0x8060770A DefaultValueRecordLayout_AUTOSAR_Platform_BaseTypes_boolean 255.0 AUTOSAR_Platform_CompuMethods_boolean 0.0 255. FORMAT "%10.5"
 /begin ANNOTATION ANNOTATION_LABEL "Description (coming from AUTOSAR DESC field)"
  /begin ANNOTATION_TEXT "Flag to force the use of powertrain mode for shifting mode, rather than gear lever state\r\n" /end ANNOTATION_TEXT
 /end ANNOTATION
/end CHARACTERISTIC
/begin CHARACTERISTIC DWC_EFLASHROMB.DWC_K1DeviceControl.DWC_ASGSlipConditions.DWC_TIMERDT "" VALUE 0x80607850 DefaultValueRecordLayout_AUTOSAR_Platform_BaseTypes_uint16 10.0 RB_PT_PCT_SWC_DWC_CompuMethods_ratio_0p001__2 0.0 10. FORMAT "%10.5"
 /begin ANNOTATION ANNOTATION_LABEL "Description (coming from AUTOSAR DESC field)"
  /begin ANNOTATION_TEXT "Count down rate of timer (call rate of timed out task)\r\n" /end ANNOTATION_TEXT
 /end ANNOTATION
/end CHARACTERISTIC
/begin CHARACTERISTIC DWC_EFLASHROMB.DWC_K1DeviceControl.DWC_FAILUREBANKID "" VALUE 0x8060784C DefaultValueRecordLayout_AUTOSAR_Platform_BaseTypes_uint8 2.0 RB_PT_PCT_SWC_DWC_CompuMethods_ident 0.0 2. FORMAT "%10.5"
 /begin ANNOTATION ANNOTATION_LABEL "Description (coming from AUTOSAR DESC field)" /begin ANNOTATION_TEXT "Data to be loaded into failed gear table on failure\r\n" /end ANNOTATION_TEXT /end ANNOTATION
/end CHARACTERISTIC
/begin CHARACTERISTIC DWC_EFLASHROMB.DWC_K1DeviceControl.DWC_FAILUREGEARID "" VALUE 0x8060784D DefaultValueRecordLayout_AUTOSAR_Platform_BaseTypes_uint8 11.0 RB_PT_PCT_SWC_DWC_CompuMethods_ident 0.0 11. FORMAT "%10.5"
 /begin ANNOTATION ANNOTATION_LABEL "Description (coming from AUTOSAR DESC field)" /begin ANNOTATION_TEXT "Data to be loaded into failed gear table on failure\r\n" /end ANNOTATION_TEXT /end ANNOTATION
/end CHARACTERISTIC
/begin CHARACTERISTIC DWC_EFLASHROMB.DWC_K1DeviceControl.DWC_FAILUREHYBID "" VALUE 0x8060784E DefaultValueRecordLayout_AUTOSAR_Platform_BaseTypes_uint8 6.0 RB_PT_PCT_SWC_DWC_CompuMethods_ident 0.0 6. FORMAT "%10.5"
 /begin ANNOTATION ANNOTATION_LABEL "Description (coming from AUTOSAR DESC field)" /begin ANNOTATION_TEXT "Index of failed hybrid mode table to be written to.\r\n" /end ANNOTATION_TEXT /end ANNOTATION
/end CHARACTERISTIC
/begin CHARACTERISTIC DWC_EFLASHROMB.DWC_K1DeviceControl.DWC_FillController.DWC_FILLPULSETIMEFACTORSOFT "" VALUE 0x80607852 DefaultValueRecordLayout_AUTOSAR_Platform_BaseTypes_uint16 1.0 RB_PT_PCT_SWC_DWC_CompuMethods_ratio_0p001__2 0.0 1. FORMAT "%10.5"
 /begin ANNOTATION ANNOTATION_LABEL "Description (coming from AUTOSAR DESC field)"
  /begin ANNOTATION_TEXT "Factor applied to start time that the pulse will run for (all of it = 1.0)\r\n" /end ANNOTATION_TEXT
 /end ANNOTATION
/end CHARACTERISTIC
/begin CHARACTERISTIC DWC_EFLASHROMB.DWC_K1DeviceControl.DWC_OBDKPLEARNMAXLIMIT "" VALUE 0x80607844 DefaultValueRecordLayout_AUTOSAR_Platform_BaseTypes_sint16 34.0 RB_PT_PCT_SWC_DWC_CompuMethods_ratio_0p001__2 -2. 32. FORMAT "%10.5"
 /begin ANNOTATION ANNOTATION_LABEL "Description (coming from AUTOSAR DESC field)"
  /begin ANNOTATION_TEXT "Maximum allowable kisspoint learnt by EOL kisspoint test\r\n" /end ANNOTATION_TEXT
 /end ANNOTATION
/end CHARACTERISTIC
/begin CHARACTERISTIC DWC_EFLASHROMB.DWC_K1DeviceControl.DWC_OBDKPLEARNMINLIMIT "" VALUE 0x80607846 DefaultValueRecordLayout_AUTOSAR_Platform_BaseTypes_sint16 34.0 RB_PT_PCT_SWC_DWC_CompuMethods_ratio_0p001__2 -2. 32. FORMAT "%10.5"
 /begin ANNOTATION ANNOTATION_LABEL "Description (coming from AUTOSAR DESC field)"
  /begin ANNOTATION_TEXT "Minimum allowable kisspoint learnt by EOL kisspoint test\r\n" /end ANNOTATION_TEXT
 /end ANNOTATION
/end CHARACTERISTIC
/begin CHARACTERISTIC DWC_EFLASHROMB.DWC_K1DeviceControl.DWC_OBDPCLEARNMAXLIMIT "" VALUE 0x80607848 DefaultValueRecordLayout_AUTOSAR_Platform_BaseTypes_sint16 2000.0 RB_PT_PCT_SWC_DWC_CompuMethods_ratio_0p1 -1000. 1000. FORMAT "%10.5"
 /begin ANNOTATION ANNOTATION_LABEL "Description (coming from AUTOSAR DESC field)" /begin ANNOTATION_TEXT "Maximum PC offset current for EOL adaption\r\n" /end ANNOTATION_TEXT /end ANNOTATION
/end CHARACTERISTIC
/begin CHARACTERISTIC DWC_EFLASHROMB.DWC_K1DeviceControl.DWC_OBDPCLEARNMINLIMIT "" VALUE 0x8060784A DefaultValueRecordLayout_AUTOSAR_Platform_BaseTypes_sint16 2000.0 RB_PT_PCT_SWC_DWC_CompuMethods_ratio_0p1 -1000. 1000. FORMAT "%10.5"
 /begin ANNOTATION ANNOTATION_LABEL "Description (coming from AUTOSAR DESC field)" /begin ANNOTATION_TEXT "Minimum PC offset current for EOL adaption\r\n" /end ANNOTATION_TEXT /end ANNOTATION
/end CHARACTERISTIC
/begin CHARACTERISTIC DWC_EFLASHROMB.DWC_K1DeviceControl.DWC_OBDTESTDECODE "" VAL_BLK 0x80607798 DefaultValueRecordLayout_AUTOSAR_Platform_BaseTypes_uint8 6.0 RB_PT_PCT_SWC_DWC_CompuMethods_ident 0.0 6. FORMAT "%10.5"
 /begin ANNOTATION ANNOTATION_LABEL "Description (coming from AUTOSAR DESC field)" /begin ANNOTATION_TEXT "Decoder for OBD tests and state/status'\r\n" /end ANNOTATION_TEXT /end ANNOTATION
 MATRIX_DIM 55 3 1 /end CHARACTERISTIC
/begin CHARACTERISTIC DWC_EFLASHROMB.DWC_K1DeviceControl.DWC_OPTIONSMASK "" VALUE 0x80607840 DefaultValueRecordLayout_AUTOSAR_Platform_BaseTypes_uint32 4.294967295E9 RB_PT_PCT_SWC_DWC_CompuMethods_ident 0.0 4.294967295E9 FORMAT "%10.5"
 /begin ANNOTATION ANNOTATION_LABEL "Description (coming from AUTOSAR DESC field)" /begin ANNOTATION_TEXT "Mask to enable device controller options\r\n" /end ANNOTATION_TEXT /end ANNOTATION
/end CHARACTERISTIC
/begin CHARACTERISTIC DWC_EFLASHROMB.DWC_K1DeviceControl.DWC_PressCurrent.DWC_MAXPRESSVSENGSPD "" CURVE 0x80607854 RB_PT_PCT_SWC_DWC_RecordLayouts_RL_Curve_sint16_5_uint16_5 34.0 RB_PT_PCT_SWC_DWC_CompuMethods_ratio_0p001__2 -2. 32. FORMAT "%10.5"
 /begin ANNOTATION ANNOTATION_LABEL "Description (coming from AUTOSAR DESC field)"
  /begin ANNOTATION_TEXT "Maximum pressure demand vs. engine speed (clutch seal PV rating limited)\r\n" /end ANNOTATION_TEXT
 /end ANNOTATION
 /begin AXIS_DESCR STD_AXIS NO_INPUT_QUANTITY RB_PT_PCT_SWC_DWC_CompuMethods_ident 5 0.0 20000. FORMAT "%10.5" DEPOSIT ABSOLUTE /end AXIS_DESCR
/end CHARACTERISTIC
/begin CHARACTERISTIC DWC_EFLASHROMB.DWC_K1DeviceControl.DWC_PressCurrent.DWC_VALVEFFCORRECTION "" MAP 0x8060786A RB_PT_PCT_SWC_DWC_RecordLayouts_RL_Map_uint16_35_sint16_7_sint16_5 1.0 RB_PT_PCT_SWC_DWC_CompuMethods_ratio_0p001__2 0.0 1. FORMAT "%10.5"
 /begin ANNOTATION ANNOTATION_LABEL "Description (coming from AUTOSAR DESC field)"
  /begin ANNOTATION_TEXT "Proportional current offset vs error and target pressure\r\n" /end ANNOTATION_TEXT
 /end ANNOTATION
 /begin AXIS_DESCR STD_AXIS NO_INPUT_QUANTITY RB_PT_PCT_SWC_DWC_CompuMethods_ratio_0p001__2 7 -32. 32. FORMAT "%10.5" DEPOSIT ABSOLUTE /end AXIS_DESCR
 /begin AXIS_DESCR STD_AXIS NO_INPUT_QUANTITY RB_PT_PCT_SWC_DWC_CompuMethods_ratio_0p001__2 5 -32. 32. FORMAT "%10.5" DEPOSIT ABSOLUTE /end AXIS_DESCR
/end CHARACTERISTIC
/begin CHARACTERISTIC DWC_EFLASHROMB.DWC_K1DeviceControl.DWC_PressCurrent.DWC_VALVENORMALDERIVGAINTEMP "" MAP 0x806078CC RB_PT_PCT_SWC_DWC_RecordLayouts_RL_Map_sint16_9_sint16_3_sint16_3 20.0 RB_PT_PCT_SWC_DWC_CompuMethods_ratio_0p001__2 -10. 10. FORMAT "%10.5"
 /begin ANNOTATION ANNOTATION_LABEL "Description (coming from AUTOSAR DESC field)" /begin ANNOTATION_TEXT "Derivative gain against temperature\r\n" /end ANNOTATION_TEXT /end ANNOTATION
 /begin AXIS_DESCR STD_AXIS NO_INPUT_QUANTITY RB_PT_PCT_SWC_DWC_CompuMethods_ratio_0p001__2 3 -32. 32. FORMAT "%10.5" DEPOSIT ABSOLUTE /end AXIS_DESCR
 /begin AXIS_DESCR STD_AXIS NO_INPUT_QUANTITY RB_PT_PCT_SWC_DWC_CompuMethods_ident 3 -50. 200. FORMAT "%10.5" DEPOSIT ABSOLUTE /end AXIS_DESCR
/end CHARACTERISTIC
/begin CHARACTERISTIC DWC_EFLASHROMB.DWC_K1DeviceControl.DWC_PressCurrent.DWC_VALVEPRESSCURRENTVSTEMP "" MAP 0x806078EE RB_PT_PCT_SWC_DWC_RecordLayouts_RL_Map_uint16_55_sint16_11_sint16_5 5000.0 RB_PT_PCT_SWC_DWC_CompuMethods_ident 0.0 5000. FORMAT "%10.5"
 /begin ANNOTATION ANNOTATION_LABEL "Description (coming from AUTOSAR DESC field)"
  /begin ANNOTATION_TEXT "Pressure to current characteristic of valve, compensated for temperature\r\n" /end ANNOTATION_TEXT
 /end ANNOTATION
 /begin AXIS_DESCR STD_AXIS NO_INPUT_QUANTITY RB_PT_PCT_SWC_DWC_CompuMethods_ratio_0p001__2 11 -2. 32. FORMAT "%10.5" DEPOSIT ABSOLUTE /end AXIS_DESCR
 /begin AXIS_DESCR STD_AXIS NO_INPUT_QUANTITY RB_PT_PCT_SWC_DWC_CompuMethods_ident 5 -50. 200. FORMAT "%10.5" DEPOSIT ABSOLUTE /end AXIS_DESCR
/end CHARACTERISTIC
/begin CHARACTERISTIC DWC_EFLASHROMB.DWC_K1DeviceControl.DWC_PressCurrent.DWC_VALVEPROPCORRPOSTFILL "" MAP 0x80607980 RB_PT_PCT_SWC_DWC_RecordLayouts_RL_Map_sint16_35_sint16_7_sint16_5 2000.0 RB_PT_PCT_SWC_DWC_CompuMethods_ident -1000. 1000. FORMAT "%10.5"
 /begin ANNOTATION ANNOTATION_LABEL "Description (coming from AUTOSAR DESC field)"
  /begin ANNOTATION_TEXT "Proportional current offset vs error and target pressure\r\n" /end ANNOTATION_TEXT
 /end ANNOTATION
 /begin AXIS_DESCR STD_AXIS NO_INPUT_QUANTITY RB_PT_PCT_SWC_DWC_CompuMethods_ratio_0p001__2 7 -32. 32. FORMAT "%10.5" DEPOSIT ABSOLUTE /end AXIS_DESCR
 /begin AXIS_DESCR STD_AXIS NO_INPUT_QUANTITY RB_PT_PCT_SWC_DWC_CompuMethods_ratio_0p001__2 5 -32. 32. FORMAT "%10.5" DEPOSIT ABSOLUTE /end AXIS_DESCR
/end CHARACTERISTIC
/begin CHARACTERISTIC DWC_EFLASHROMB.DWC_K1DeviceControl.DWC_PressCurrent.DWC_VALVEPROPORTIONALCORRECTION "" MAP 0x806079E2 RB_PT_PCT_SWC_DWC_RecordLayouts_RL_Map_sint16_35_sint16_7_sint16_5 2000.0 RB_PT_PCT_SWC_DWC_CompuMethods_ident -1000. 1000. FORMAT "%10.5"
 /begin ANNOTATION ANNOTATION_LABEL "Description (coming from AUTOSAR DESC field)"
  /begin ANNOTATION_TEXT "Proportional current offset vs error and target pressure\r\n" /end ANNOTATION_TEXT
 /end ANNOTATION
 /begin AXIS_DESCR STD_AXIS NO_INPUT_QUANTITY RB_PT_PCT_SWC_DWC_CompuMethods_ratio_0p001__2 7 -32. 32. FORMAT "%10.5" DEPOSIT ABSOLUTE /end AXIS_DESCR
 /begin AXIS_DESCR STD_AXIS NO_INPUT_QUANTITY RB_PT_PCT_SWC_DWC_CompuMethods_ratio_0p001__2 5 -32. 32. FORMAT "%10.5" DEPOSIT ABSOLUTE /end AXIS_DESCR
/end CHARACTERISTIC
/begin CHARACTERISTIC DWC_EFLASHROMB.DWC_K1DeviceControl.DWC_PressCurrent.DWC_VALVESTATICLINEPRESSUREDEPENDENCY "" MAP 0x80607A44 RB_PT_PCT_SWC_DWC_RecordLayouts_RL_Map_sint16_15_sint16_5_sint16_3 64.0 RB_PT_PCT_SWC_DWC_CompuMethods_ratio_0p001__2 -32. 32. FORMAT "%10.5"
 /begin ANNOTATION ANNOTATION_LABEL "Description (coming from AUTOSAR DESC field)"
  /begin ANNOTATION_TEXT "Offset for static line pressure dependency, based on line pressure and demand\r\n" /end ANNOTATION_TEXT
 /end ANNOTATION
 /begin AXIS_DESCR STD_AXIS NO_INPUT_QUANTITY RB_PT_PCT_SWC_DWC_CompuMethods_ratio_0p001__2 5 -2. 32. FORMAT "%10.5" DEPOSIT ABSOLUTE /end AXIS_DESCR
 /begin AXIS_DESCR STD_AXIS NO_INPUT_QUANTITY RB_PT_PCT_SWC_DWC_CompuMethods_ratio_0p005 3 -5. 100. FORMAT "%10.5" DEPOSIT ABSOLUTE /end AXIS_DESCR
/end CHARACTERISTIC
/begin CHARACTERISTIC DWC_EFLASHROMB.DWC_K1DeviceControl.DWC_PtoCSequence.DWC_PCMAXROW "" VALUE 0x80607AAE DefaultValueRecordLayout_AUTOSAR_Platform_BaseTypes_uint8 1.0 RB_PT_PCT_SWC_DWC_CompuMethods_ident 0.0 1. FORMAT "%10.5"
 /begin ANNOTATION ANNOTATION_LABEL "Description (coming from AUTOSAR DESC field)" /begin ANNOTATION_TEXT "Row associated with minimum speeds\r\n" /end ANNOTATION_TEXT /end ANNOTATION
/end CHARACTERISTIC
/begin CHARACTERISTIC DWC_EFLASHROMB.DWC_K1DeviceControl.DWC_PtoCSequence.DWC_PCMINROW "" VALUE 0x80607AAF DefaultValueRecordLayout_AUTOSAR_Platform_BaseTypes_uint8 1.0 RB_PT_PCT_SWC_DWC_CompuMethods_ident 0.0 1. FORMAT "%10.5"
 /begin ANNOTATION ANNOTATION_LABEL "Description (coming from AUTOSAR DESC field)" /begin ANNOTATION_TEXT "Row associated with minimum speeds\r\n" /end ANNOTATION_TEXT /end ANNOTATION
/end CHARACTERISTIC
/begin CHARACTERISTIC DWC_EFLASHROMB.DWC_K1DeviceControl.DWC_PtoCSequence.DWC_PCSPEEDGEAR "" VAL_BLK 0x80607A76 DefaultValueRecordLayout_AUTOSAR_Platform_BaseTypes_uint16 20000.0 RB_PT_PCT_SWC_DWC_CompuMethods_ident 0.0 20000. FORMAT "%10.5"
 /begin ANNOTATION ANNOTATION_LABEL "Description (coming from AUTOSAR DESC field)" /begin ANNOTATION_TEXT "Min max engine speeds for valve adaption\r\n" /end ANNOTATION_TEXT /end ANNOTATION
 MATRIX_DIM 14 2 1 /end CHARACTERISTIC
/begin CHARACTERISTIC DWC_EFLASHROMB.DWC_K1DeviceControl.DWC_TrqPress.DWC_ENABLEFILLKISSPOINTADAPT "" VALUE 0x80607AB2 DefaultValueRecordLayout_AUTOSAR_Platform_BaseTypes_boolean 255.0 AUTOSAR_Platform_CompuMethods_boolean 0.0 255. FORMAT "%10.5"
 /begin ANNOTATION ANNOTATION_LABEL "Description (coming from AUTOSAR DESC field)"
  /begin ANNOTATION_TEXT "Flag to enable kisspoint adaption during fill (separately from other methods)\r\n" /end ANNOTATION_TEXT
 /end ANNOTATION
/end CHARACTERISTIC
/begin CHARACTERISTIC DWC_EFLASHROMB.DWC_K1DeviceControl.DWC_TrqPress.DWC_FLGPRESSPOSNARRAYFIX "" VALUE 0x80607AB3 DefaultValueRecordLayout_AUTOSAR_Platform_BaseTypes_boolean 255.0 AUTOSAR_Platform_CompuMethods_boolean 0.0 255. FORMAT "%10.5"
 /begin ANNOTATION ANNOTATION_LABEL "Description (coming from AUTOSAR DESC field)"
  /begin ANNOTATION_TEXT "Flag to enable kisspoint adaption DXC_PressPosnPoints update fix\r\n" /end ANNOTATION_TEXT
 /end ANNOTATION
/end CHARACTERISTIC
/begin CHARACTERISTIC DWC_EFLASHROMB.DWC_K1DeviceControl.DWC_TrqPress.DWC_FrictionCompensator.DXC_FRCFRICTIONTEMP "" VAL_BLK 0x80607AB4 DefaultValueRecordLayout_AUTOSAR_Platform_BaseTypes_sint16 550.0 RB_PT_PCT_SWC_DWC_CompuMethods_ident -50. 500. FORMAT "%10.5"
 /begin ANNOTATION ANNOTATION_LABEL "Description (coming from AUTOSAR DESC field)"
  /begin ANNOTATION_TEXT "Temperature break points for use of different friction data\r\n" /end ANNOTATION_TEXT
 /end ANNOTATION
 MATRIX_DIM 4 1 1 /end CHARACTERISTIC
/begin CHARACTERISTIC DWC_EFLASHROMB.DWC_K1DeviceControl.DWC_TrqPress.DWC_FrictionCompensator.DXC_FRCFRICTIONTEMP1 "" MAP 0x80607ABC RB_PT_PCT_SWC_DWC_RecordLayouts_RL_MapGrouped_sint16_256_uint16_16_sint16_16 1.5 RB_PT_PCT_SWC_DWC_CompuMethods_ratio_0p0001 0.5 2. FORMAT "%10.5"
 /begin ANNOTATION ANNOTATION_LABEL "Description (coming from AUTOSAR DESC field)"
  /begin ANNOTATION_TEXT "Relative coefficient of friction - temperature point 1\r\n" /end ANNOTATION_TEXT
 /end ANNOTATION
 /begin AXIS_DESCR COM_AXIS NO_INPUT_QUANTITY RB_PT_PCT_SWC_DWC_CompuMethods_ident 16 0.0 20000. FORMAT "%10.5" AXIS_PTS_REF DWC_EFLASHROMB.DWC_K1DeviceControl.DWC_TrqPress.DWC_FrictionCompensator.DXC_FRCFRICTIONRPM DEPOSIT ABSOLUTE /end AXIS_DESCR
 /begin AXIS_DESCR COM_AXIS NO_INPUT_QUANTITY RB_PT_PCT_SWC_DWC_CompuMethods_ratio_0p1 16 -2000. 2000. FORMAT "%10.5" AXIS_PTS_REF DWC_EFLASHROMB.DWC_K1DeviceControl.DWC_TrqPress.DWC_FrictionCompensator.DXC_FRCFRICTIONTORQUE DEPOSIT ABSOLUTE /end AXIS_DESCR
/end CHARACTERISTIC
/begin CHARACTERISTIC DWC_EFLASHROMB.DWC_K1DeviceControl.DWC_TrqPress.DWC_FrictionCompensator.DXC_FRCFRICTIONTEMP2 "" MAP 0x80607CBC RB_PT_PCT_SWC_DWC_RecordLayouts_RL_MapGrouped_sint16_256_uint16_16_sint16_16 1.5 RB_PT_PCT_SWC_DWC_CompuMethods_ratio_0p0001 0.5 2. FORMAT "%10.5"
 /begin ANNOTATION ANNOTATION_LABEL "Description (coming from AUTOSAR DESC field)"
  /begin ANNOTATION_TEXT "Relative coefficient of friction - temperature point 2\r\n" /end ANNOTATION_TEXT
 /end ANNOTATION
 /begin AXIS_DESCR COM_AXIS NO_INPUT_QUANTITY RB_PT_PCT_SWC_DWC_CompuMethods_ident 16 0.0 20000. FORMAT "%10.5" AXIS_PTS_REF DWC_EFLASHROMB.DWC_K1DeviceControl.DWC_TrqPress.DWC_FrictionCompensator.DXC_FRCFRICTIONRPM DEPOSIT ABSOLUTE /end AXIS_DESCR
 /begin AXIS_DESCR COM_AXIS NO_INPUT_QUANTITY RB_PT_PCT_SWC_DWC_CompuMethods_ratio_0p1 16 -2000. 2000. FORMAT "%10.5" AXIS_PTS_REF DWC_EFLASHROMB.DWC_K1DeviceControl.DWC_TrqPress.DWC_FrictionCompensator.DXC_FRCFRICTIONTORQUE DEPOSIT ABSOLUTE /end AXIS_DESCR
/end CHARACTERISTIC
/begin CHARACTERISTIC DWC_EFLASHROMB.DWC_K1DeviceControl.DWC_TrqPress.DWC_FrictionCompensator.DXC_FRCFRICTIONTEMP3 "" MAP 0x80607EBC RB_PT_PCT_SWC_DWC_RecordLayouts_RL_MapGrouped_sint16_256_uint16_16_sint16_16 1.5 RB_PT_PCT_SWC_DWC_CompuMethods_ratio_0p0001 0.5 2. FORMAT "%10.5"
 /begin ANNOTATION ANNOTATION_LABEL "Description (coming from AUTOSAR DESC field)"
  /begin ANNOTATION_TEXT "Relative coefficient of friction - temperature point 3\r\n" /end ANNOTATION_TEXT
 /end ANNOTATION
 /begin AXIS_DESCR COM_AXIS NO_INPUT_QUANTITY RB_PT_PCT_SWC_DWC_CompuMethods_ident 16 0.0 20000. FORMAT "%10.5" AXIS_PTS_REF DWC_EFLASHROMB.DWC_K1DeviceControl.DWC_TrqPress.DWC_FrictionCompensator.DXC_FRCFRICTIONRPM DEPOSIT ABSOLUTE /end AXIS_DESCR
 /begin AXIS_DESCR COM_AXIS NO_INPUT_QUANTITY RB_PT_PCT_SWC_DWC_CompuMethods_ratio_0p1 16 -2000. 2000. FORMAT "%10.5" AXIS_PTS_REF DWC_EFLASHROMB.DWC_K1DeviceControl.DWC_TrqPress.DWC_FrictionCompensator.DXC_FRCFRICTIONTORQUE DEPOSIT ABSOLUTE /end AXIS_DESCR
/end CHARACTERISTIC
/begin CHARACTERISTIC DWC_EFLASHROMB.DWC_K1DeviceControl.DWC_TrqPress.DWC_FrictionCompensator.DXC_FRCFRICTIONTEMP4 "" MAP 0x806080BC RB_PT_PCT_SWC_DWC_RecordLayouts_RL_MapGrouped_sint16_256_uint16_16_sint16_16 1.5 RB_PT_PCT_SWC_DWC_CompuMethods_ratio_0p0001 0.5 2. FORMAT "%10.5"
 /begin ANNOTATION ANNOTATION_LABEL "Description (coming from AUTOSAR DESC field)"
  /begin ANNOTATION_TEXT "Relative coefficient of friction - temperature point 4\r\n" /end ANNOTATION_TEXT
 /end ANNOTATION
 /begin AXIS_DESCR COM_AXIS NO_INPUT_QUANTITY RB_PT_PCT_SWC_DWC_CompuMethods_ident 16 0.0 20000. FORMAT "%10.5" AXIS_PTS_REF DWC_EFLASHROMB.DWC_K1DeviceControl.DWC_TrqPress.DWC_FrictionCompensator.DXC_FRCFRICTIONRPM DEPOSIT ABSOLUTE /end AXIS_DESCR
 /begin AXIS_DESCR COM_AXIS NO_INPUT_QUANTITY RB_PT_PCT_SWC_DWC_CompuMethods_ratio_0p1 16 -2000. 2000. FORMAT "%10.5" AXIS_PTS_REF DWC_EFLASHROMB.DWC_K1DeviceControl.DWC_TrqPress.DWC_FrictionCompensator.DXC_FRCFRICTIONTORQUE DEPOSIT ABSOLUTE /end AXIS_DESCR
/end CHARACTERISTIC
/begin CHARACTERISTIC DWC_EFLASHROMB.DWC_K1DeviceControl.DWC_TrqPress.DWC_KISSPOINTADAPTTF "" CURVE 0x8060835C RB_PT_PCT_SWC_DWC_RecordLayouts_RL_Curve_sint16_5_sint16_5 64.0 RB_PT_PCT_SWC_DWC_CompuMethods_ratio_0p001__2 -32. 32. FORMAT "%10.5"
 /begin ANNOTATION ANNOTATION_LABEL "Description (coming from AUTOSAR DESC field)"
  /begin ANNOTATION_TEXT "Adaption transfer function from kisspoint error to correction\r\n" /end ANNOTATION_TEXT
 /end ANNOTATION
 /begin AXIS_DESCR STD_AXIS NO_INPUT_QUANTITY RB_PT_PCT_SWC_DWC_CompuMethods_ratio_0p1 5 -2000. 2000. FORMAT "%10.5" DEPOSIT ABSOLUTE /end AXIS_DESCR
/end CHARACTERISTIC
/begin CHARACTERISTIC DWC_EFLASHROMB.DWC_K1DeviceControl.DWC_TrqPress.DWC_KisspointSequencer.DWC_ENABLEKPCONDSWHYST "" VALUE 0x80608344 DefaultValueRecordLayout_AUTOSAR_Platform_BaseTypes_boolean 255.0 AUTOSAR_Platform_CompuMethods_boolean 0.0 255. FORMAT "%10.5"
 /begin ANNOTATION ANNOTATION_LABEL "Description (coming from AUTOSAR DESC field)" /begin ANNOTATION_TEXT "Flag to enable dynamic kisspoint learn sequence\r\n" /end ANNOTATION_TEXT /end ANNOTATION
/end CHARACTERISTIC
/begin CHARACTERISTIC DWC_EFLASHROMB.DWC_K1DeviceControl.DWC_TrqPress.DWC_KisspointSequencer.DWC_KPCOOLINGCUTREQUEST "" VALUE 0x80608345 DefaultValueRecordLayout_AUTOSAR_Platform_BaseTypes_boolean 255.0 AUTOSAR_Platform_CompuMethods_boolean 0.0 255. FORMAT "%10.5"
 /begin ANNOTATION ANNOTATION_LABEL "Description (coming from AUTOSAR DESC field)"
  /begin ANNOTATION_TEXT "Flag to enable cooling cut request during kisspoint learn\r\n" /end ANNOTATION_TEXT
 /end ANNOTATION
/end CHARACTERISTIC
/begin CHARACTERISTIC DWC_EFLASHROMB.DWC_K1DeviceControl.DWC_TrqPress.DWC_KisspointSequencer.DWC_KPDYNENABLEDYNAMIC "" VALUE 0x80608346 DefaultValueRecordLayout_AUTOSAR_Platform_BaseTypes_boolean 255.0 AUTOSAR_Platform_CompuMethods_boolean 0.0 255. FORMAT "%10.5"
 /begin ANNOTATION ANNOTATION_LABEL "Description (coming from AUTOSAR DESC field)" /begin ANNOTATION_TEXT "Flag to enable dynamic kisspoint learn sequence\r\n" /end ANNOTATION_TEXT /end ANNOTATION
/end CHARACTERISTIC
/begin CHARACTERISTIC DWC_EFLASHROMB.DWC_K1DeviceControl.DWC_TrqPress.DWC_KisspointSequencer.DWC_KPDYNENDSLIP "" VALUE 0x80608330 DefaultValueRecordLayout_AUTOSAR_Platform_BaseTypes_uint16 20000.0 RB_PT_PCT_SWC_DWC_CompuMethods_ident 0.0 20000. FORMAT "%10.5"
 /begin ANNOTATION ANNOTATION_LABEL "Description (coming from AUTOSAR DESC field)" /begin ANNOTATION_TEXT "Slip for point of sampling gradient\r\n" /end ANNOTATION_TEXT /end ANNOTATION
/end CHARACTERISTIC
/begin CHARACTERISTIC DWC_EFLASHROMB.DWC_K1DeviceControl.DWC_TrqPress.DWC_KisspointSequencer.DWC_KPDYNGRADENDFACTOR "" VALUE 0x80608347 DefaultValueRecordLayout_AUTOSAR_Platform_BaseTypes_uint8 1.0 RB_PT_PCT_SWC_DWC_CompuMethods_ratio_0p1 0.0 1. FORMAT "%10.5"
 /begin ANNOTATION ANNOTATION_LABEL "Description (coming from AUTOSAR DESC field)"
  /begin ANNOTATION_TEXT "Factor of initial snapshot slip, considered as the end of the measurement period\r\n" /end ANNOTATION_TEXT
 /end ANNOTATION
/end CHARACTERISTIC
/begin CHARACTERISTIC DWC_EFLASHROMB.DWC_K1DeviceControl.DWC_TrqPress.DWC_KisspointSequencer.DWC_KPDYNGRADSTARTFACTOR "" VALUE 0x80608348 DefaultValueRecordLayout_AUTOSAR_Platform_BaseTypes_uint8 1.0 RB_PT_PCT_SWC_DWC_CompuMethods_ratio_0p1 0.0 1. FORMAT "%10.5"
 /begin ANNOTATION ANNOTATION_LABEL "Description (coming from AUTOSAR DESC field)"
  /begin ANNOTATION_TEXT "Factor of initial snapshot slip, considered as the start of the measurement period\r\n" /end ANNOTATION_TEXT
 /end ANNOTATION
/end CHARACTERISTIC
/begin CHARACTERISTIC DWC_EFLASHROMB.DWC_K1DeviceControl.DWC_TrqPress.DWC_KisspointSequencer.DWC_KPDYNINTERLEARNTIMEMIN "" CURVE 0x8060834C RB_PT_PCT_SWC_DWC_RecordLayouts_RL_Curve_uint16_3_sint16_3 131.07 RB_PT_PCT_SWC_DWC_CompuMethods_ratio_0p002 0.0 131.07 FORMAT "%10.5"
 /begin ANNOTATION ANNOTATION_LABEL "Description (coming from AUTOSAR DESC field)"
  /begin ANNOTATION_TEXT "Minimum time between learns vs number of completed learns over life\r\n" /end ANNOTATION_TEXT
 /end ANNOTATION
 /begin AXIS_DESCR STD_AXIS NO_INPUT_QUANTITY RB_PT_PCT_SWC_DWC_CompuMethods_ident 3 0.0 32760. FORMAT "%10.5" DEPOSIT ABSOLUTE /end AXIS_DESCR
/end CHARACTERISTIC
/begin CHARACTERISTIC DWC_EFLASHROMB.DWC_K1DeviceControl.DWC_TrqPress.DWC_KisspointSequencer.DWC_KPDYNMAXTEMPERATURE "" VALUE 0x80608332 DefaultValueRecordLayout_AUTOSAR_Platform_BaseTypes_sint16 250.0 RB_PT_PCT_SWC_DWC_CompuMethods_ident -50. 200. FORMAT "%10.5"
 /begin ANNOTATION ANNOTATION_LABEL "Description (coming from AUTOSAR DESC field)" /begin ANNOTATION_TEXT "Minimum temperature for kisspoint learn\r\n" /end ANNOTATION_TEXT /end ANNOTATION
/end CHARACTERISTIC
/begin CHARACTERISTIC DWC_EFLASHROMB.DWC_K1DeviceControl.DWC_TrqPress.DWC_KisspointSequencer.DWC_KPDYNMAXTIME "" VALUE 0x80608334 DefaultValueRecordLayout_AUTOSAR_Platform_BaseTypes_uint16 10.0 RB_PT_PCT_SWC_DWC_CompuMethods_ratio_0p001__2 0.0 10. FORMAT "%10.5"
 /begin ANNOTATION ANNOTATION_LABEL "Description (coming from AUTOSAR DESC field)"
  /begin ANNOTATION_TEXT "Time considered too long for input speed to fall to engine speed\r\n" /end ANNOTATION_TEXT
 /end ANNOTATION
/end CHARACTERISTIC
/begin CHARACTERISTIC DWC_EFLASHROMB.DWC_K1DeviceControl.DWC_TrqPress.DWC_KisspointSequencer.DWC_KPDYNMININITIALSLIP "" VALUE 0x80608336 DefaultValueRecordLayout_AUTOSAR_Platform_BaseTypes_uint16 20000.0 RB_PT_PCT_SWC_DWC_CompuMethods_ident 0.0 20000. FORMAT "%10.5"
 /begin ANNOTATION ANNOTATION_LABEL "Description (coming from AUTOSAR DESC field)"
  /begin ANNOTATION_TEXT "Maximum output shaft speed change during dynamic kisspoint sequence\r\n" /end ANNOTATION_TEXT
 /end ANNOTATION
/end CHARACTERISTIC
/begin CHARACTERISTIC DWC_EFLASHROMB.DWC_K1DeviceControl.DWC_TrqPress.DWC_KisspointSequencer.DWC_KPDYNMINTEMPERATURE "" VALUE 0x80608338 DefaultValueRecordLayout_AUTOSAR_Platform_BaseTypes_sint16 250.0 RB_PT_PCT_SWC_DWC_CompuMethods_ident -50. 200. FORMAT "%10.5"
 /begin ANNOTATION ANNOTATION_LABEL "Description (coming from AUTOSAR DESC field)" /begin ANNOTATION_TEXT "Minimum temperature for kisspoint learn\r\n" /end ANNOTATION_TEXT /end ANNOTATION
/end CHARACTERISTIC
/begin CHARACTERISTIC DWC_EFLASHROMB.DWC_K1DeviceControl.DWC_TrqPress.DWC_KisspointSequencer.DWC_KPDYNOVERDUETIMEBEFOREDSTREQUEST "" VALUE 0x8060832C DefaultValueRecordLayout_AUTOSAR_Platform_BaseTypes_uint32 1000.0 RB_PT_PCT_SWC_DWC_CompuMethods_ratio_0p001__2 0.0 1000. FORMAT "%10.5"
 /begin ANNOTATION ANNOTATION_LABEL "Description (coming from AUTOSAR DESC field)"
  /begin ANNOTATION_TEXT "Maximum time that a kisspoint learn is overdue for before a kisspoint learn is requested\r\n" /end ANNOTATION_TEXT
 /end ANNOTATION
/end CHARACTERISTIC
/begin CHARACTERISTIC DWC_EFLASHROMB.DWC_K1DeviceControl.DWC_TrqPress.DWC_KisspointSequencer.DWC_KPENGINESPEEDCONDHYST "" VALUE 0x8060833A DefaultValueRecordLayout_AUTOSAR_Platform_BaseTypes_uint16 20000.0 RB_PT_PCT_SWC_DWC_CompuMethods_ident 0.0 20000. FORMAT "%10.5"
 /begin ANNOTATION ANNOTATION_LABEL "Description (coming from AUTOSAR DESC field)" /begin ANNOTATION_TEXT "Minimum engine speed for kisspoint learn\r\n" /end ANNOTATION_TEXT /end ANNOTATION
/end CHARACTERISTIC
/begin CHARACTERISTIC DWC_EFLASHROMB.DWC_K1DeviceControl.DWC_TrqPress.DWC_KisspointSequencer.DWC_KPLOADINGGEAR "" VAL_BLK 0x8060831C DefaultValueRecordLayout_AUTOSAR_Platform_BaseTypes_uint8 254.0 RB_PT_PCT_SWC_DWC_CompuMethods_ident 0.0 254. FORMAT "%10.5"
 /begin ANNOTATION ANNOTATION_LABEL "Description (coming from AUTOSAR DESC field)"
  /begin ANNOTATION_TEXT "Loading gear array against current torque gear (254 = do not run)\r\n" /end ANNOTATION_TEXT
 /end ANNOTATION
 MATRIX_DIM 14 1 1 /end CHARACTERISTIC
/begin CHARACTERISTIC DWC_EFLASHROMB.DWC_K1DeviceControl.DWC_TrqPress.DWC_KisspointSequencer.DWC_KPMAXENGINESPEED "" VAL_BLK 0x80608300 DefaultValueRecordLayout_AUTOSAR_Platform_BaseTypes_uint16 20000.0 RB_PT_PCT_SWC_DWC_CompuMethods_ident 0.0 20000. FORMAT "%10.5"
 /begin ANNOTATION ANNOTATION_LABEL "Description (coming from AUTOSAR DESC field)" /begin ANNOTATION_TEXT "Maximum engine speed for kisspoint learn per gear\r\n" /end ANNOTATION_TEXT /end ANNOTATION
 MATRIX_DIM 14 1 1 /end CHARACTERISTIC
/begin CHARACTERISTIC DWC_EFLASHROMB.DWC_K1DeviceControl.DWC_TrqPress.DWC_KisspointSequencer.DWC_KPMINENGINESPEED "" VALUE 0x8060833C DefaultValueRecordLayout_AUTOSAR_Platform_BaseTypes_uint16 20000.0 RB_PT_PCT_SWC_DWC_CompuMethods_ident 0.0 20000. FORMAT "%10.5"
 /begin ANNOTATION ANNOTATION_LABEL "Description (coming from AUTOSAR DESC field)" /begin ANNOTATION_TEXT "Minimum engine speed for kisspoint learn\r\n" /end ANNOTATION_TEXT /end ANNOTATION
/end CHARACTERISTIC
/begin CHARACTERISTIC DWC_EFLASHROMB.DWC_K1DeviceControl.DWC_TrqPress.DWC_KisspointSequencer.DWC_KPSTATLOCKTIMEOUT "" VALUE 0x8060833E DefaultValueRecordLayout_AUTOSAR_Platform_BaseTypes_uint16 10.0 RB_PT_PCT_SWC_DWC_CompuMethods_ratio_0p001__2 0.0 10. FORMAT "%10.5"
 /begin ANNOTATION ANNOTATION_LABEL "Description (coming from AUTOSAR DESC field)" /begin ANNOTATION_TEXT "Time considered too long to expect a lock\r\n" /end ANNOTATION_TEXT /end ANNOTATION
/end CHARACTERISTIC
/begin CHARACTERISTIC DWC_EFLASHROMB.DWC_K1DeviceControl.DWC_TrqPress.DWC_KisspointSequencer.DWC_KPSTATOUTPUTMAX "" VALUE 0x80608340 DefaultValueRecordLayout_AUTOSAR_Platform_BaseTypes_sint16 40000.0 RB_PT_PCT_SWC_DWC_CompuMethods_ident -20000. 20000. FORMAT "%10.5"
 /begin ANNOTATION ANNOTATION_LABEL "Description (coming from AUTOSAR DESC field)" /begin ANNOTATION_TEXT "Maximum output speed for static kisspoint learn\r\n" /end ANNOTATION_TEXT /end ANNOTATION
/end CHARACTERISTIC
/begin CHARACTERISTIC DWC_EFLASHROMB.DWC_K1DeviceControl.DWC_TrqPress.DWC_KisspointSequencer.DWC_KPSTATOUTPUTMIN "" VALUE 0x80608342 DefaultValueRecordLayout_AUTOSAR_Platform_BaseTypes_sint16 40000.0 RB_PT_PCT_SWC_DWC_CompuMethods_ident -20000. 20000. FORMAT "%10.5"
 /begin ANNOTATION ANNOTATION_LABEL "Description (coming from AUTOSAR DESC field)" /begin ANNOTATION_TEXT "Minimum output speed for static kisspoint learn\r\n" /end ANNOTATION_TEXT /end ANNOTATION
/end CHARACTERISTIC
/begin CHARACTERISTIC DWC_EFLASHROMB.DWC_K1DeviceControl.DWC_TrqPress.DWC_KisspointSequencer.DWC_KPSTATSLIPSTARTFACTOR "" VALUE 0x80608349 DefaultValueRecordLayout_AUTOSAR_Platform_BaseTypes_uint8 1.0 RB_PT_PCT_SWC_DWC_CompuMethods_ratio_0p1 0.0 1. FORMAT "%10.5"
 /begin ANNOTATION ANNOTATION_LABEL "Description (coming from AUTOSAR DESC field)"
  /begin ANNOTATION_TEXT "Factor of initial snapshot slip, after which engagement is closely monitored\r\n" /end ANNOTATION_TEXT
 /end ANNOTATION
/end CHARACTERISTIC
/begin CHARACTERISTIC DWC_EFLASHROMB.DWC_K1DeviceControl.DWC_TrqPress.DWC_KisspointSequencer.DWC_KPWETCLUTCH "" VALUE 0x8060834A DefaultValueRecordLayout_AUTOSAR_Platform_BaseTypes_boolean 255.0 AUTOSAR_Platform_CompuMethods_boolean 0.0 255. FORMAT "%10.5"
 /begin ANNOTATION ANNOTATION_LABEL "Description (coming from AUTOSAR DESC field)" /begin ANNOTATION_TEXT "Flag indicating that the clutch is wet\r\n" /end ANNOTATION_TEXT /end ANNOTATION
/end CHARACTERISTIC
/begin CHARACTERISTIC DWC_EFLASHROMB.DWC_K1DeviceControl.DWC_TrqPress.DWC_KPADAPTSTEPS "" CURVE 0x80608372 RB_PT_PCT_SWC_DWC_RecordLayouts_RL_Curve_sint16_7_sint8_7 64.0 RB_PT_PCT_SWC_DWC_CompuMethods_ratio_0p001__2 -32. 32. FORMAT "%10.5"
 /begin ANNOTATION ANNOTATION_LABEL "Description (coming from AUTOSAR DESC field)"
  /begin ANNOTATION_TEXT "Adaption step based on request from kisspoint learn state machine\r\n" /end ANNOTATION_TEXT
 /end ANNOTATION
 /begin AXIS_DESCR STD_AXIS NO_INPUT_QUANTITY RB_PT_PCT_SWC_DWC_CompuMethods_ident 7 -3. 3. FORMAT "%10.5" DEPOSIT ABSOLUTE /end AXIS_DESCR
/end CHARACTERISTIC
/begin CHARACTERISTIC DWC_EFLASHROMB.DWC_K1DeviceControl.DWC_TrqPress.DWC_MINTORQUEOFFSETTEMP "" CURVE 0x8060838A RB_PT_PCT_SWC_DWC_RecordLayouts_RL_Curve_sint16_5_sint16_5 64.0 RB_PT_PCT_SWC_DWC_CompuMethods_ratio_0p001__2 -32. 32. FORMAT "%10.5"
 /begin ANNOTATION ANNOTATION_LABEL "Description (coming from AUTOSAR DESC field)" /begin ANNOTATION_TEXT "Offset applied to kisspoint for temperature\r\n" /end ANNOTATION_TEXT /end ANNOTATION
 /begin AXIS_DESCR STD_AXIS NO_INPUT_QUANTITY RB_PT_PCT_SWC_DWC_CompuMethods_ident 5 -50. 200. FORMAT "%10.5" DEPOSIT ABSOLUTE /end AXIS_DESCR
/end CHARACTERISTIC
/begin CHARACTERISTIC DWC_EFLASHROMB.DWC_K1DeviceControl.DWC_TrqPress.DXC_MINPRESSPOSDEMAND "" VALUE 0x80607AB0 DefaultValueRecordLayout_AUTOSAR_Platform_BaseTypes_sint16 64.0 RB_PT_PCT_SWC_DWC_CompuMethods_ratio_0p001__2 -32. 32. FORMAT "%10.5"
 /begin ANNOTATION ANNOTATION_LABEL "Description (coming from AUTOSAR DESC field)" /begin ANNOTATION_TEXT "Minimum demand for pressure/position out of class\r\n" /end ANNOTATION_TEXT /end ANNOTATION
/end CHARACTERISTIC
/begin CHARACTERISTIC DWC_EFLASHROMB.DWC_K1DeviceControl.DWC_TrqPress.DXC_RPMTEMPOFFSETPOINT1 "" MAP 0x806083A0 RB_PT_PCT_SWC_DWC_RecordLayouts_RL_MapGrouped_sint16_48_uint16_8_sint16_6 64.0 RB_PT_PCT_SWC_DWC_CompuMethods_ratio_0p001__2 -32. 32. FORMAT "%10.5"
 /begin ANNOTATION ANNOTATION_LABEL "Description (coming from AUTOSAR DESC field)"
  /begin ANNOTATION_TEXT "Offset data at torque point based on engine speed and temperature\r\n" /end ANNOTATION_TEXT
 /end ANNOTATION
 /begin AXIS_DESCR COM_AXIS NO_INPUT_QUANTITY RB_PT_PCT_SWC_DWC_CompuMethods_ident 8 0.0 20000. FORMAT "%10.5" AXIS_PTS_REF DWC_EFLASHROMB.DWC_K1DeviceControl.DWC_TrqPress.DXC_RPMAXISOFFSETTABLES DEPOSIT ABSOLUTE /end AXIS_DESCR
 /begin AXIS_DESCR COM_AXIS NO_INPUT_QUANTITY RB_PT_PCT_SWC_DWC_CompuMethods_ident 6 -50. 500. FORMAT "%10.5" AXIS_PTS_REF DWC_EFLASHROMB.DWC_K1DeviceControl.DWC_TrqPress.DXC_TEMPAXISOFFSETTABLES DEPOSIT ABSOLUTE /end AXIS_DESCR
/end CHARACTERISTIC
/begin CHARACTERISTIC DWC_EFLASHROMB.DWC_K1DeviceControl.DWC_TrqPress.DXC_RPMTEMPOFFSETPOINT2 "" MAP 0x80608400 RB_PT_PCT_SWC_DWC_RecordLayouts_RL_MapGrouped_sint16_48_uint16_8_sint16_6 64.0 RB_PT_PCT_SWC_DWC_CompuMethods_ratio_0p001__2 -32. 32. FORMAT "%10.5"
 /begin ANNOTATION ANNOTATION_LABEL "Description (coming from AUTOSAR DESC field)"
  /begin ANNOTATION_TEXT "Offset data at torque point based on engine speed and temperature\r\n" /end ANNOTATION_TEXT
 /end ANNOTATION
 /begin AXIS_DESCR COM_AXIS NO_INPUT_QUANTITY RB_PT_PCT_SWC_DWC_CompuMethods_ident 8 0.0 20000. FORMAT "%10.5" AXIS_PTS_REF DWC_EFLASHROMB.DWC_K1DeviceControl.DWC_TrqPress.DXC_RPMAXISOFFSETTABLES DEPOSIT ABSOLUTE /end AXIS_DESCR
 /begin AXIS_DESCR COM_AXIS NO_INPUT_QUANTITY RB_PT_PCT_SWC_DWC_CompuMethods_ident 6 -50. 500. FORMAT "%10.5" AXIS_PTS_REF DWC_EFLASHROMB.DWC_K1DeviceControl.DWC_TrqPress.DXC_TEMPAXISOFFSETTABLES DEPOSIT ABSOLUTE /end AXIS_DESCR
/end CHARACTERISTIC
/begin CHARACTERISTIC DWC_EFLASHROMB.DWC_K1DeviceControl.DWC_TrqPress.DXC_RPMTEMPOFFSETPOINT3 "" MAP 0x80608460 RB_PT_PCT_SWC_DWC_RecordLayouts_RL_MapGrouped_sint16_48_uint16_8_sint16_6 64.0 RB_PT_PCT_SWC_DWC_CompuMethods_ratio_0p001__2 -32. 32. FORMAT "%10.5"
 /begin ANNOTATION ANNOTATION_LABEL "Description (coming from AUTOSAR DESC field)"
  /begin ANNOTATION_TEXT "Offset data at torque point based on engine speed and temperature\r\n" /end ANNOTATION_TEXT
 /end ANNOTATION
 /begin AXIS_DESCR COM_AXIS NO_INPUT_QUANTITY RB_PT_PCT_SWC_DWC_CompuMethods_ident 8 0.0 20000. FORMAT "%10.5" AXIS_PTS_REF DWC_EFLASHROMB.DWC_K1DeviceControl.DWC_TrqPress.DXC_RPMAXISOFFSETTABLES DEPOSIT ABSOLUTE /end AXIS_DESCR
 /begin AXIS_DESCR COM_AXIS NO_INPUT_QUANTITY RB_PT_PCT_SWC_DWC_CompuMethods_ident 6 -50. 500. FORMAT "%10.5" AXIS_PTS_REF DWC_EFLASHROMB.DWC_K1DeviceControl.DWC_TrqPress.DXC_TEMPAXISOFFSETTABLES DEPOSIT ABSOLUTE /end AXIS_DESCR
/end CHARACTERISTIC
/begin CHARACTERISTIC DWC_EFLASHROMB.DWC_K1DeviceControl.DWC_TrqPress.DXC_RPMTEMPOFFSETPOINT4 "" MAP 0x806084C0 RB_PT_PCT_SWC_DWC_RecordLayouts_RL_MapGrouped_sint16_48_uint16_8_sint16_6 64.0 RB_PT_PCT_SWC_DWC_CompuMethods_ratio_0p001__2 -32. 32. FORMAT "%10.5"
 /begin ANNOTATION ANNOTATION_LABEL "Description (coming from AUTOSAR DESC field)"
  /begin ANNOTATION_TEXT "Offset data at torque point based on engine speed and temperature\r\n" /end ANNOTATION_TEXT
 /end ANNOTATION
 /begin AXIS_DESCR COM_AXIS NO_INPUT_QUANTITY RB_PT_PCT_SWC_DWC_CompuMethods_ident 8 0.0 20000. FORMAT "%10.5" AXIS_PTS_REF DWC_EFLASHROMB.DWC_K1DeviceControl.DWC_TrqPress.DXC_RPMAXISOFFSETTABLES DEPOSIT ABSOLUTE /end AXIS_DESCR
 /begin AXIS_DESCR COM_AXIS NO_INPUT_QUANTITY RB_PT_PCT_SWC_DWC_CompuMethods_ident 6 -50. 500. FORMAT "%10.5" AXIS_PTS_REF DWC_EFLASHROMB.DWC_K1DeviceControl.DWC_TrqPress.DXC_TEMPAXISOFFSETTABLES DEPOSIT ABSOLUTE /end AXIS_DESCR
/end CHARACTERISTIC
/begin CHARACTERISTIC DWC_EFLASHROMB.DWC_K1DeviceControl.DWC_TrqPress.DXC_RPMTEMPOFFSETPOINT5 "" MAP 0x80608520 RB_PT_PCT_SWC_DWC_RecordLayouts_RL_MapGrouped_sint16_48_uint16_8_sint16_6 64.0 RB_PT_PCT_SWC_DWC_CompuMethods_ratio_0p001__2 -32. 32. FORMAT "%10.5"
 /begin ANNOTATION ANNOTATION_LABEL "Description (coming from AUTOSAR DESC field)"
  /begin ANNOTATION_TEXT "Offset data at torque point based on engine speed and temperature\r\n" /end ANNOTATION_TEXT
 /end ANNOTATION
 /begin AXIS_DESCR COM_AXIS NO_INPUT_QUANTITY RB_PT_PCT_SWC_DWC_CompuMethods_ident 8 0.0 20000. FORMAT "%10.5" AXIS_PTS_REF DWC_EFLASHROMB.DWC_K1DeviceControl.DWC_TrqPress.DXC_RPMAXISOFFSETTABLES DEPOSIT ABSOLUTE /end AXIS_DESCR
 /begin AXIS_DESCR COM_AXIS NO_INPUT_QUANTITY RB_PT_PCT_SWC_DWC_CompuMethods_ident 6 -50. 500. FORMAT "%10.5" AXIS_PTS_REF DWC_EFLASHROMB.DWC_K1DeviceControl.DWC_TrqPress.DXC_TEMPAXISOFFSETTABLES DEPOSIT ABSOLUTE /end AXIS_DESCR
/end CHARACTERISTIC
/begin CHARACTERISTIC DWC_EFLASHROMB.DWC_K1DeviceControl.DWC_TrqPress.DXC_RPMTEMPOFFSETPOINT6 "" MAP 0x80608580 RB_PT_PCT_SWC_DWC_RecordLayouts_RL_MapGrouped_sint16_48_uint16_8_sint16_6 64.0 RB_PT_PCT_SWC_DWC_CompuMethods_ratio_0p001__2 -32. 32. FORMAT "%10.5"
 /begin ANNOTATION ANNOTATION_LABEL "Description (coming from AUTOSAR DESC field)"
  /begin ANNOTATION_TEXT "Offset data at torque point based on engine speed and temperature\r\n" /end ANNOTATION_TEXT
 /end ANNOTATION
 /begin AXIS_DESCR COM_AXIS NO_INPUT_QUANTITY RB_PT_PCT_SWC_DWC_CompuMethods_ident 8 0.0 20000. FORMAT "%10.5" AXIS_PTS_REF DWC_EFLASHROMB.DWC_K1DeviceControl.DWC_TrqPress.DXC_RPMAXISOFFSETTABLES DEPOSIT ABSOLUTE /end AXIS_DESCR
 /begin AXIS_DESCR COM_AXIS NO_INPUT_QUANTITY RB_PT_PCT_SWC_DWC_CompuMethods_ident 6 -50. 500. FORMAT "%10.5" AXIS_PTS_REF DWC_EFLASHROMB.DWC_K1DeviceControl.DWC_TrqPress.DXC_TEMPAXISOFFSETTABLES DEPOSIT ABSOLUTE /end AXIS_DESCR
/end CHARACTERISTIC
/begin CHARACTERISTIC DWC_EFLASHROMB.DWC_K1DeviceControl.DWC_TrqPress.DXC_RPMTEMPOFFSETPOINT7 "" MAP 0x806085E0 RB_PT_PCT_SWC_DWC_RecordLayouts_RL_MapGrouped_sint16_48_uint16_8_sint16_6 64.0 RB_PT_PCT_SWC_DWC_CompuMethods_ratio_0p001__2 -32. 32. FORMAT "%10.5"
 /begin ANNOTATION ANNOTATION_LABEL "Description (coming from AUTOSAR DESC field)"
  /begin ANNOTATION_TEXT "Offset data at torque point based on engine speed and temperature\r\n" /end ANNOTATION_TEXT
 /end ANNOTATION
 /begin AXIS_DESCR COM_AXIS NO_INPUT_QUANTITY RB_PT_PCT_SWC_DWC_CompuMethods_ident 8 0.0 20000. FORMAT "%10.5" AXIS_PTS_REF DWC_EFLASHROMB.DWC_K1DeviceControl.DWC_TrqPress.DXC_RPMAXISOFFSETTABLES DEPOSIT ABSOLUTE /end AXIS_DESCR
 /begin AXIS_DESCR COM_AXIS NO_INPUT_QUANTITY RB_PT_PCT_SWC_DWC_CompuMethods_ident 6 -50. 500. FORMAT "%10.5" AXIS_PTS_REF DWC_EFLASHROMB.DWC_K1DeviceControl.DWC_TrqPress.DXC_TEMPAXISOFFSETTABLES DEPOSIT ABSOLUTE /end AXIS_DESCR
/end CHARACTERISTIC
/begin CHARACTERISTIC DWC_EFLASHROMB.DWC_K2DeviceControl.DWC_ASGSlipConditions.DWC_TIMERDT "" VALUE 0x80608718 DefaultValueRecordLayout_AUTOSAR_Platform_BaseTypes_uint16 10.0 RB_PT_PCT_SWC_DWC_CompuMethods_ratio_0p001__2 0.0 10. FORMAT "%10.5"
 /begin ANNOTATION ANNOTATION_LABEL "Description (coming from AUTOSAR DESC field)"
  /begin ANNOTATION_TEXT "Count down rate of timer (call rate of timed out task)\r\n" /end ANNOTATION_TEXT
 /end ANNOTATION
/end CHARACTERISTIC
/begin CHARACTERISTIC DWC_EFLASHROMB.DWC_K2DeviceControl.DWC_FAILUREBANKID "" VALUE 0x80608714 DefaultValueRecordLayout_AUTOSAR_Platform_BaseTypes_uint8 2.0 RB_PT_PCT_SWC_DWC_CompuMethods_ident 0.0 2. FORMAT "%10.5"
 /begin ANNOTATION ANNOTATION_LABEL "Description (coming from AUTOSAR DESC field)" /begin ANNOTATION_TEXT "Data to be loaded into failed gear table on failure\r\n" /end ANNOTATION_TEXT /end ANNOTATION
/end CHARACTERISTIC
/begin CHARACTERISTIC DWC_EFLASHROMB.DWC_K2DeviceControl.DWC_FAILUREGEARID "" VALUE 0x80608715 DefaultValueRecordLayout_AUTOSAR_Platform_BaseTypes_uint8 11.0 RB_PT_PCT_SWC_DWC_CompuMethods_ident 0.0 11. FORMAT "%10.5"
 /begin ANNOTATION ANNOTATION_LABEL "Description (coming from AUTOSAR DESC field)" /begin ANNOTATION_TEXT "Data to be loaded into failed gear table on failure\r\n" /end ANNOTATION_TEXT /end ANNOTATION
/end CHARACTERISTIC
/begin CHARACTERISTIC DWC_EFLASHROMB.DWC_K2DeviceControl.DWC_FAILUREHYBID "" VALUE 0x80608716 DefaultValueRecordLayout_AUTOSAR_Platform_BaseTypes_uint8 6.0 RB_PT_PCT_SWC_DWC_CompuMethods_ident 0.0 6. FORMAT "%10.5"
 /begin ANNOTATION ANNOTATION_LABEL "Description (coming from AUTOSAR DESC field)" /begin ANNOTATION_TEXT "Index of failed hybrid mode table to be written to.\r\n" /end ANNOTATION_TEXT /end ANNOTATION
/end CHARACTERISTIC
/begin CHARACTERISTIC DWC_EFLASHROMB.DWC_K2DeviceControl.DWC_FillController.DWC_FILLPULSETIMEFACTORSOFT "" VALUE 0x8060871A DefaultValueRecordLayout_AUTOSAR_Platform_BaseTypes_uint16 1.0 RB_PT_PCT_SWC_DWC_CompuMethods_ratio_0p001__2 0.0 1. FORMAT "%10.5"
 /begin ANNOTATION ANNOTATION_LABEL "Description (coming from AUTOSAR DESC field)"
  /begin ANNOTATION_TEXT "Factor applied to start time that the pulse will run for (all of it = 1.0)\r\n" /end ANNOTATION_TEXT
 /end ANNOTATION
/end CHARACTERISTIC
/begin CHARACTERISTIC DWC_EFLASHROMB.DWC_K2DeviceControl.DWC_OBDKPLEARNMAXLIMIT "" VALUE 0x8060870C DefaultValueRecordLayout_AUTOSAR_Platform_BaseTypes_sint16 34.0 RB_PT_PCT_SWC_DWC_CompuMethods_ratio_0p001__2 -2. 32. FORMAT "%10.5"
 /begin ANNOTATION ANNOTATION_LABEL "Description (coming from AUTOSAR DESC field)"
  /begin ANNOTATION_TEXT "Maximum allowable kisspoint learnt by EOL kisspoint test\r\n" /end ANNOTATION_TEXT
 /end ANNOTATION
/end CHARACTERISTIC
/begin CHARACTERISTIC DWC_EFLASHROMB.DWC_K2DeviceControl.DWC_OBDKPLEARNMINLIMIT "" VALUE 0x8060870E DefaultValueRecordLayout_AUTOSAR_Platform_BaseTypes_sint16 34.0 RB_PT_PCT_SWC_DWC_CompuMethods_ratio_0p001__2 -2. 32. FORMAT "%10.5"
 /begin ANNOTATION ANNOTATION_LABEL "Description (coming from AUTOSAR DESC field)"
  /begin ANNOTATION_TEXT "Minimum allowable kisspoint learnt by EOL kisspoint test\r\n" /end ANNOTATION_TEXT
 /end ANNOTATION
/end CHARACTERISTIC
/begin CHARACTERISTIC DWC_EFLASHROMB.DWC_K2DeviceControl.DWC_OBDPCLEARNMAXLIMIT "" VALUE 0x80608710 DefaultValueRecordLayout_AUTOSAR_Platform_BaseTypes_sint16 2000.0 RB_PT_PCT_SWC_DWC_CompuMethods_ratio_0p1 -1000. 1000. FORMAT "%10.5"
 /begin ANNOTATION ANNOTATION_LABEL "Description (coming from AUTOSAR DESC field)" /begin ANNOTATION_TEXT "Maximum PC offset current for EOL adaption\r\n" /end ANNOTATION_TEXT /end ANNOTATION
/end CHARACTERISTIC
/begin CHARACTERISTIC DWC_EFLASHROMB.DWC_K2DeviceControl.DWC_OBDPCLEARNMINLIMIT "" VALUE 0x80608712 DefaultValueRecordLayout_AUTOSAR_Platform_BaseTypes_sint16 2000.0 RB_PT_PCT_SWC_DWC_CompuMethods_ratio_0p1 -1000. 1000. FORMAT "%10.5"
 /begin ANNOTATION ANNOTATION_LABEL "Description (coming from AUTOSAR DESC field)" /begin ANNOTATION_TEXT "Minimum PC offset current for EOL adaption\r\n" /end ANNOTATION_TEXT /end ANNOTATION
/end CHARACTERISTIC
/begin CHARACTERISTIC DWC_EFLASHROMB.DWC_K2DeviceControl.DWC_OBDTESTDECODE "" VAL_BLK 0x80608660 DefaultValueRecordLayout_AUTOSAR_Platform_BaseTypes_uint8 6.0 RB_PT_PCT_SWC_DWC_CompuMethods_ident 0.0 6. FORMAT "%10.5"
 /begin ANNOTATION ANNOTATION_LABEL "Description (coming from AUTOSAR DESC field)" /begin ANNOTATION_TEXT "Decoder for OBD tests and state/status'\r\n" /end ANNOTATION_TEXT /end ANNOTATION
 MATRIX_DIM 55 3 1 /end CHARACTERISTIC
/begin CHARACTERISTIC DWC_EFLASHROMB.DWC_K2DeviceControl.DWC_OPTIONSMASK "" VALUE 0x80608708 DefaultValueRecordLayout_AUTOSAR_Platform_BaseTypes_uint32 4.294967295E9 RB_PT_PCT_SWC_DWC_CompuMethods_ident 0.0 4.294967295E9 FORMAT "%10.5"
 /begin ANNOTATION ANNOTATION_LABEL "Description (coming from AUTOSAR DESC field)" /begin ANNOTATION_TEXT "Mask to enable device controller options\r\n" /end ANNOTATION_TEXT /end ANNOTATION
/end CHARACTERISTIC
/begin CHARACTERISTIC DWC_EFLASHROMB.DWC_K2DeviceControl.DWC_PressCurrent.DWC_MAXPRESSVSENGSPD "" CURVE 0x8060871C RB_PT_PCT_SWC_DWC_RecordLayouts_RL_Curve_sint16_5_uint16_5 34.0 RB_PT_PCT_SWC_DWC_CompuMethods_ratio_0p001__2 -2. 32. FORMAT "%10.5"
 /begin ANNOTATION ANNOTATION_LABEL "Description (coming from AUTOSAR DESC field)"
  /begin ANNOTATION_TEXT "Maximum pressure demand vs. engine speed (clutch seal PV rating limited)\r\n" /end ANNOTATION_TEXT
 /end ANNOTATION
 /begin AXIS_DESCR STD_AXIS NO_INPUT_QUANTITY RB_PT_PCT_SWC_DWC_CompuMethods_ident 5 0.0 20000. FORMAT "%10.5" DEPOSIT ABSOLUTE /end AXIS_DESCR
/end CHARACTERISTIC
/begin CHARACTERISTIC DWC_EFLASHROMB.DWC_K2DeviceControl.DWC_PressCurrent.DWC_VALVEFFCORRECTION "" MAP 0x80608732 RB_PT_PCT_SWC_DWC_RecordLayouts_RL_Map_uint16_35_sint16_7_sint16_5 1.0 RB_PT_PCT_SWC_DWC_CompuMethods_ratio_0p001__2 0.0 1. FORMAT "%10.5"
 /begin ANNOTATION ANNOTATION_LABEL "Description (coming from AUTOSAR DESC field)"
  /begin ANNOTATION_TEXT "Proportional current offset vs error and target pressure\r\n" /end ANNOTATION_TEXT
 /end ANNOTATION
 /begin AXIS_DESCR STD_AXIS NO_INPUT_QUANTITY RB_PT_PCT_SWC_DWC_CompuMethods_ratio_0p001__2 7 -32. 32. FORMAT "%10.5" DEPOSIT ABSOLUTE /end AXIS_DESCR
 /begin AXIS_DESCR STD_AXIS NO_INPUT_QUANTITY RB_PT_PCT_SWC_DWC_CompuMethods_ratio_0p001__2 5 -32. 32. FORMAT "%10.5" DEPOSIT ABSOLUTE /end AXIS_DESCR
/end CHARACTERISTIC
/begin CHARACTERISTIC DWC_EFLASHROMB.DWC_K2DeviceControl.DWC_PressCurrent.DWC_VALVENORMALDERIVGAINTEMP "" MAP 0x80608794 RB_PT_PCT_SWC_DWC_RecordLayouts_RL_Map_sint16_9_sint16_3_sint16_3 20.0 RB_PT_PCT_SWC_DWC_CompuMethods_ratio_0p001__2 -10. 10. FORMAT "%10.5"
 /begin ANNOTATION ANNOTATION_LABEL "Description (coming from AUTOSAR DESC field)" /begin ANNOTATION_TEXT "Derivative gain against temperature\r\n" /end ANNOTATION_TEXT /end ANNOTATION
 /begin AXIS_DESCR STD_AXIS NO_INPUT_QUANTITY RB_PT_PCT_SWC_DWC_CompuMethods_ratio_0p001__2 3 -32. 32. FORMAT "%10.5" DEPOSIT ABSOLUTE /end AXIS_DESCR
 /begin AXIS_DESCR STD_AXIS NO_INPUT_QUANTITY RB_PT_PCT_SWC_DWC_CompuMethods_ident 3 -50. 200. FORMAT "%10.5" DEPOSIT ABSOLUTE /end AXIS_DESCR
/end CHARACTERISTIC
/begin CHARACTERISTIC DWC_EFLASHROMB.DWC_K2DeviceControl.DWC_PressCurrent.DWC_VALVEPRESSCURRENTVSTEMP "" MAP 0x806087B6 RB_PT_PCT_SWC_DWC_RecordLayouts_RL_Map_uint16_55_sint16_11_sint16_5 5000.0 RB_PT_PCT_SWC_DWC_CompuMethods_ident 0.0 5000. FORMAT "%10.5"
 /begin ANNOTATION ANNOTATION_LABEL "Description (coming from AUTOSAR DESC field)"
  /begin ANNOTATION_TEXT "Pressure to current characteristic of valve, compensated for temperature\r\n" /end ANNOTATION_TEXT
 /end ANNOTATION
 /begin AXIS_DESCR STD_AXIS NO_INPUT_QUANTITY RB_PT_PCT_SWC_DWC_CompuMethods_ratio_0p001__2 11 -2. 32. FORMAT "%10.5" DEPOSIT ABSOLUTE /end AXIS_DESCR
 /begin AXIS_DESCR STD_AXIS NO_INPUT_QUANTITY RB_PT_PCT_SWC_DWC_CompuMethods_ident 5 -50. 200. FORMAT "%10.5" DEPOSIT ABSOLUTE /end AXIS_DESCR
/end CHARACTERISTIC
/begin CHARACTERISTIC DWC_EFLASHROMB.DWC_K2DeviceControl.DWC_PressCurrent.DWC_VALVEPROPCORRPOSTFILL "" MAP 0x80608848 RB_PT_PCT_SWC_DWC_RecordLayouts_RL_Map_sint16_35_sint16_7_sint16_5 2000.0 RB_PT_PCT_SWC_DWC_CompuMethods_ident -1000. 1000. FORMAT "%10.5"
 /begin ANNOTATION ANNOTATION_LABEL "Description (coming from AUTOSAR DESC field)"
  /begin ANNOTATION_TEXT "Proportional current offset vs error and target pressure\r\n" /end ANNOTATION_TEXT
 /end ANNOTATION
 /begin AXIS_DESCR STD_AXIS NO_INPUT_QUANTITY RB_PT_PCT_SWC_DWC_CompuMethods_ratio_0p001__2 7 -32. 32. FORMAT "%10.5" DEPOSIT ABSOLUTE /end AXIS_DESCR
 /begin AXIS_DESCR STD_AXIS NO_INPUT_QUANTITY RB_PT_PCT_SWC_DWC_CompuMethods_ratio_0p001__2 5 -32. 32. FORMAT "%10.5" DEPOSIT ABSOLUTE /end AXIS_DESCR
/end CHARACTERISTIC
/begin CHARACTERISTIC DWC_EFLASHROMB.DWC_K2DeviceControl.DWC_PressCurrent.DWC_VALVEPROPORTIONALCORRECTION "" MAP 0x806088AA RB_PT_PCT_SWC_DWC_RecordLayouts_RL_Map_sint16_35_sint16_7_sint16_5 2000.0 RB_PT_PCT_SWC_DWC_CompuMethods_ident -1000. 1000. FORMAT "%10.5"
 /begin ANNOTATION ANNOTATION_LABEL "Description (coming from AUTOSAR DESC field)"
  /begin ANNOTATION_TEXT "Proportional current offset vs error and target pressure\r\n" /end ANNOTATION_TEXT
 /end ANNOTATION
 /begin AXIS_DESCR STD_AXIS NO_INPUT_QUANTITY RB_PT_PCT_SWC_DWC_CompuMethods_ratio_0p001__2 7 -32. 32. FORMAT "%10.5" DEPOSIT ABSOLUTE /end AXIS_DESCR
 /begin AXIS_DESCR STD_AXIS NO_INPUT_QUANTITY RB_PT_PCT_SWC_DWC_CompuMethods_ratio_0p001__2 5 -32. 32. FORMAT "%10.5" DEPOSIT ABSOLUTE /end AXIS_DESCR
/end CHARACTERISTIC
/begin CHARACTERISTIC DWC_EFLASHROMB.DWC_K2DeviceControl.DWC_PressCurrent.DWC_VALVESTATICLINEPRESSUREDEPENDENCY "" MAP 0x8060890C RB_PT_PCT_SWC_DWC_RecordLayouts_RL_Map_sint16_15_sint16_5_sint16_3 64.0 RB_PT_PCT_SWC_DWC_CompuMethods_ratio_0p001__2 -32. 32. FORMAT "%10.5"
 /begin ANNOTATION ANNOTATION_LABEL "Description (coming from AUTOSAR DESC field)"
  /begin ANNOTATION_TEXT "Offset for static line pressure dependency, based on line pressure and demand\r\n" /end ANNOTATION_TEXT
 /end ANNOTATION
 /begin AXIS_DESCR STD_AXIS NO_INPUT_QUANTITY RB_PT_PCT_SWC_DWC_CompuMethods_ratio_0p001__2 5 -2. 32. FORMAT "%10.5" DEPOSIT ABSOLUTE /end AXIS_DESCR
 /begin AXIS_DESCR STD_AXIS NO_INPUT_QUANTITY RB_PT_PCT_SWC_DWC_CompuMethods_ratio_0p005 3 -5. 100. FORMAT "%10.5" DEPOSIT ABSOLUTE /end AXIS_DESCR
/end CHARACTERISTIC
/begin CHARACTERISTIC DWC_EFLASHROMB.DWC_K2DeviceControl.DWC_PtoCSequence.DWC_PCMAXROW "" VALUE 0x80608976 DefaultValueRecordLayout_AUTOSAR_Platform_BaseTypes_uint8 1.0 RB_PT_PCT_SWC_DWC_CompuMethods_ident 0.0 1. FORMAT "%10.5"
 /begin ANNOTATION ANNOTATION_LABEL "Description (coming from AUTOSAR DESC field)" /begin ANNOTATION_TEXT "Row associated with minimum speeds\r\n" /end ANNOTATION_TEXT /end ANNOTATION
/end CHARACTERISTIC
/begin CHARACTERISTIC DWC_EFLASHROMB.DWC_K2DeviceControl.DWC_PtoCSequence.DWC_PCMINROW "" VALUE 0x80608977 DefaultValueRecordLayout_AUTOSAR_Platform_BaseTypes_uint8 1.0 RB_PT_PCT_SWC_DWC_CompuMethods_ident 0.0 1. FORMAT "%10.5"
 /begin ANNOTATION ANNOTATION_LABEL "Description (coming from AUTOSAR DESC field)" /begin ANNOTATION_TEXT "Row associated with minimum speeds\r\n" /end ANNOTATION_TEXT /end ANNOTATION
/end CHARACTERISTIC
/begin CHARACTERISTIC DWC_EFLASHROMB.DWC_K2DeviceControl.DWC_PtoCSequence.DWC_PCSPEEDGEAR "" VAL_BLK 0x8060893E DefaultValueRecordLayout_AUTOSAR_Platform_BaseTypes_uint16 20000.0 RB_PT_PCT_SWC_DWC_CompuMethods_ident 0.0 20000. FORMAT "%10.5"
 /begin ANNOTATION ANNOTATION_LABEL "Description (coming from AUTOSAR DESC field)" /begin ANNOTATION_TEXT "Min max engine speeds for valve adaption\r\n" /end ANNOTATION_TEXT /end ANNOTATION
 MATRIX_DIM 14 2 1 /end CHARACTERISTIC
/begin CHARACTERISTIC DWC_EFLASHROMB.DWC_K2DeviceControl.DWC_TrqPress.DWC_ENABLEFILLKISSPOINTADAPT "" VALUE 0x8060897A DefaultValueRecordLayout_AUTOSAR_Platform_BaseTypes_boolean 255.0 AUTOSAR_Platform_CompuMethods_boolean 0.0 255. FORMAT "%10.5"
 /begin ANNOTATION ANNOTATION_LABEL "Description (coming from AUTOSAR DESC field)"
  /begin ANNOTATION_TEXT "Flag to enable kisspoint adaption during fill (separately from other methods)\r\n" /end ANNOTATION_TEXT
 /end ANNOTATION
/end CHARACTERISTIC
/begin CHARACTERISTIC DWC_EFLASHROMB.DWC_K2DeviceControl.DWC_TrqPress.DWC_FLGPRESSPOSNARRAYFIX "" VALUE 0x8060897B DefaultValueRecordLayout_AUTOSAR_Platform_BaseTypes_boolean 255.0 AUTOSAR_Platform_CompuMethods_boolean 0.0 255. FORMAT "%10.5"
 /begin ANNOTATION ANNOTATION_LABEL "Description (coming from AUTOSAR DESC field)"
  /begin ANNOTATION_TEXT "Flag to enable kisspoint adaption DXC_PressPosnPoints update fix\r\n" /end ANNOTATION_TEXT
 /end ANNOTATION
/end CHARACTERISTIC
/begin CHARACTERISTIC DWC_EFLASHROMB.DWC_K2DeviceControl.DWC_TrqPress.DWC_FrictionCompensator.DXC_FRCFRICTIONTEMP "" VAL_BLK 0x8060897C DefaultValueRecordLayout_AUTOSAR_Platform_BaseTypes_sint16 550.0 RB_PT_PCT_SWC_DWC_CompuMethods_ident -50. 500. FORMAT "%10.5"
 /begin ANNOTATION ANNOTATION_LABEL "Description (coming from AUTOSAR DESC field)"
  /begin ANNOTATION_TEXT "Temperature break points for use of different friction data\r\n" /end ANNOTATION_TEXT
 /end ANNOTATION
 MATRIX_DIM 4 1 1 /end CHARACTERISTIC
/begin CHARACTERISTIC DWC_EFLASHROMB.DWC_K2DeviceControl.DWC_TrqPress.DWC_FrictionCompensator.DXC_FRCFRICTIONTEMP1 "" MAP 0x80608984 RB_PT_PCT_SWC_DWC_RecordLayouts_RL_MapGrouped_sint16_256_uint16_16_sint16_16 1.5 RB_PT_PCT_SWC_DWC_CompuMethods_ratio_0p0001 0.5 2. FORMAT "%10.5"
 /begin ANNOTATION ANNOTATION_LABEL "Description (coming from AUTOSAR DESC field)"
  /begin ANNOTATION_TEXT "Relative coefficient of friction - temperature point 1\r\n" /end ANNOTATION_TEXT
 /end ANNOTATION
 /begin AXIS_DESCR COM_AXIS NO_INPUT_QUANTITY RB_PT_PCT_SWC_DWC_CompuMethods_ident 16 0.0 20000. FORMAT "%10.5" AXIS_PTS_REF DWC_EFLASHROMB.DWC_K2DeviceControl.DWC_TrqPress.DWC_FrictionCompensator.DXC_FRCFRICTIONRPM DEPOSIT ABSOLUTE /end AXIS_DESCR
 /begin AXIS_DESCR COM_AXIS NO_INPUT_QUANTITY RB_PT_PCT_SWC_DWC_CompuMethods_ratio_0p1 16 -2000. 2000. FORMAT "%10.5" AXIS_PTS_REF DWC_EFLASHROMB.DWC_K2DeviceControl.DWC_TrqPress.DWC_FrictionCompensator.DXC_FRCFRICTIONTORQUE DEPOSIT ABSOLUTE /end AXIS_DESCR
/end CHARACTERISTIC
/begin CHARACTERISTIC DWC_EFLASHROMB.DWC_K2DeviceControl.DWC_TrqPress.DWC_FrictionCompensator.DXC_FRCFRICTIONTEMP2 "" MAP 0x80608B84 RB_PT_PCT_SWC_DWC_RecordLayouts_RL_MapGrouped_sint16_256_uint16_16_sint16_16 1.5 RB_PT_PCT_SWC_DWC_CompuMethods_ratio_0p0001 0.5 2. FORMAT "%10.5"
 /begin ANNOTATION ANNOTATION_LABEL "Description (coming from AUTOSAR DESC field)"
  /begin ANNOTATION_TEXT "Relative coefficient of friction - temperature point 2\r\n" /end ANNOTATION_TEXT
 /end ANNOTATION
 /begin AXIS_DESCR COM_AXIS NO_INPUT_QUANTITY RB_PT_PCT_SWC_DWC_CompuMethods_ident 16 0.0 20000. FORMAT "%10.5" AXIS_PTS_REF DWC_EFLASHROMB.DWC_K2DeviceControl.DWC_TrqPress.DWC_FrictionCompensator.DXC_FRCFRICTIONRPM DEPOSIT ABSOLUTE /end AXIS_DESCR
 /begin AXIS_DESCR COM_AXIS NO_INPUT_QUANTITY RB_PT_PCT_SWC_DWC_CompuMethods_ratio_0p1 16 -2000. 2000. FORMAT "%10.5" AXIS_PTS_REF DWC_EFLASHROMB.DWC_K2DeviceControl.DWC_TrqPress.DWC_FrictionCompensator.DXC_FRCFRICTIONTORQUE DEPOSIT ABSOLUTE /end AXIS_DESCR
/end CHARACTERISTIC
/begin CHARACTERISTIC DWC_EFLASHROMB.DWC_K2DeviceControl.DWC_TrqPress.DWC_FrictionCompensator.DXC_FRCFRICTIONTEMP3 "" MAP 0x80608D84 RB_PT_PCT_SWC_DWC_RecordLayouts_RL_MapGrouped_sint16_256_uint16_16_sint16_16 1.5 RB_PT_PCT_SWC_DWC_CompuMethods_ratio_0p0001 0.5 2. FORMAT "%10.5"
 /begin ANNOTATION ANNOTATION_LABEL "Description (coming from AUTOSAR DESC field)"
  /begin ANNOTATION_TEXT "Relative coefficient of friction - temperature point 3\r\n" /end ANNOTATION_TEXT
 /end ANNOTATION
 /begin AXIS_DESCR COM_AXIS NO_INPUT_QUANTITY RB_PT_PCT_SWC_DWC_CompuMethods_ident 16 0.0 20000. FORMAT "%10.5" AXIS_PTS_REF DWC_EFLASHROMB.DWC_K2DeviceControl.DWC_TrqPress.DWC_FrictionCompensator.DXC_FRCFRICTIONRPM DEPOSIT ABSOLUTE /end AXIS_DESCR
 /begin AXIS_DESCR COM_AXIS NO_INPUT_QUANTITY RB_PT_PCT_SWC_DWC_CompuMethods_ratio_0p1 16 -2000. 2000. FORMAT "%10.5" AXIS_PTS_REF DWC_EFLASHROMB.DWC_K2DeviceControl.DWC_TrqPress.DWC_FrictionCompensator.DXC_FRCFRICTIONTORQUE DEPOSIT ABSOLUTE /end AXIS_DESCR
/end CHARACTERISTIC
/begin CHARACTERISTIC DWC_EFLASHROMB.DWC_K2DeviceControl.DWC_TrqPress.DWC_FrictionCompensator.DXC_FRCFRICTIONTEMP4 "" MAP 0x80608F84 RB_PT_PCT_SWC_DWC_RecordLayouts_RL_MapGrouped_sint16_256_uint16_16_sint16_16 1.5 RB_PT_PCT_SWC_DWC_CompuMethods_ratio_0p0001 0.5 2. FORMAT "%10.5"
 /begin ANNOTATION ANNOTATION_LABEL "Description (coming from AUTOSAR DESC field)"
  /begin ANNOTATION_TEXT "Relative coefficient of friction - temperature point 4\r\n" /end ANNOTATION_TEXT
 /end ANNOTATION
 /begin AXIS_DESCR COM_AXIS NO_INPUT_QUANTITY RB_PT_PCT_SWC_DWC_CompuMethods_ident 16 0.0 20000. FORMAT "%10.5" AXIS_PTS_REF DWC_EFLASHROMB.DWC_K2DeviceControl.DWC_TrqPress.DWC_FrictionCompensator.DXC_FRCFRICTIONRPM DEPOSIT ABSOLUTE /end AXIS_DESCR
 /begin AXIS_DESCR COM_AXIS NO_INPUT_QUANTITY RB_PT_PCT_SWC_DWC_CompuMethods_ratio_0p1 16 -2000. 2000. FORMAT "%10.5" AXIS_PTS_REF DWC_EFLASHROMB.DWC_K2DeviceControl.DWC_TrqPress.DWC_FrictionCompensator.DXC_FRCFRICTIONTORQUE DEPOSIT ABSOLUTE /end AXIS_DESCR
/end CHARACTERISTIC
/begin CHARACTERISTIC DWC_EFLASHROMB.DWC_K2DeviceControl.DWC_TrqPress.DWC_KISSPOINTADAPTTF "" CURVE 0x80609224 RB_PT_PCT_SWC_DWC_RecordLayouts_RL_Curve_sint16_5_sint16_5 64.0 RB_PT_PCT_SWC_DWC_CompuMethods_ratio_0p001__2 -32. 32. FORMAT "%10.5"
 /begin ANNOTATION ANNOTATION_LABEL "Description (coming from AUTOSAR DESC field)"
  /begin ANNOTATION_TEXT "Adaption transfer function from kisspoint error to correction\r\n" /end ANNOTATION_TEXT
 /end ANNOTATION
 /begin AXIS_DESCR STD_AXIS NO_INPUT_QUANTITY RB_PT_PCT_SWC_DWC_CompuMethods_ratio_0p1 5 -2000. 2000. FORMAT "%10.5" DEPOSIT ABSOLUTE /end AXIS_DESCR
/end CHARACTERISTIC
/begin CHARACTERISTIC DWC_EFLASHROMB.DWC_K2DeviceControl.DWC_TrqPress.DWC_KisspointSequencer.DWC_ENABLEKPCONDSWHYST "" VALUE 0x8060920C DefaultValueRecordLayout_AUTOSAR_Platform_BaseTypes_boolean 255.0 AUTOSAR_Platform_CompuMethods_boolean 0.0 255. FORMAT "%10.5"
 /begin ANNOTATION ANNOTATION_LABEL "Description (coming from AUTOSAR DESC field)" /begin ANNOTATION_TEXT "Flag to enable dynamic kisspoint learn sequence\r\n" /end ANNOTATION_TEXT /end ANNOTATION
/end CHARACTERISTIC
/begin CHARACTERISTIC DWC_EFLASHROMB.DWC_K2DeviceControl.DWC_TrqPress.DWC_KisspointSequencer.DWC_KPCOOLINGCUTREQUEST "" VALUE 0x8060920D DefaultValueRecordLayout_AUTOSAR_Platform_BaseTypes_boolean 255.0 AUTOSAR_Platform_CompuMethods_boolean 0.0 255. FORMAT "%10.5"
 /begin ANNOTATION ANNOTATION_LABEL "Description (coming from AUTOSAR DESC field)"
  /begin ANNOTATION_TEXT "Flag to enable cooling cut request during kisspoint learn\r\n" /end ANNOTATION_TEXT
 /end ANNOTATION
/end CHARACTERISTIC
/begin CHARACTERISTIC DWC_EFLASHROMB.DWC_K2DeviceControl.DWC_TrqPress.DWC_KisspointSequencer.DWC_KPDYNENABLEDYNAMIC "" VALUE 0x8060920E DefaultValueRecordLayout_AUTOSAR_Platform_BaseTypes_boolean 255.0 AUTOSAR_Platform_CompuMethods_boolean 0.0 255. FORMAT "%10.5"
 /begin ANNOTATION ANNOTATION_LABEL "Description (coming from AUTOSAR DESC field)" /begin ANNOTATION_TEXT "Flag to enable dynamic kisspoint learn sequence\r\n" /end ANNOTATION_TEXT /end ANNOTATION
/end CHARACTERISTIC
/begin CHARACTERISTIC DWC_EFLASHROMB.DWC_K2DeviceControl.DWC_TrqPress.DWC_KisspointSequencer.DWC_KPDYNENDSLIP "" VALUE 0x806091F8 DefaultValueRecordLayout_AUTOSAR_Platform_BaseTypes_uint16 20000.0 RB_PT_PCT_SWC_DWC_CompuMethods_ident 0.0 20000. FORMAT "%10.5"
 /begin ANNOTATION ANNOTATION_LABEL "Description (coming from AUTOSAR DESC field)" /begin ANNOTATION_TEXT "Slip for point of sampling gradient\r\n" /end ANNOTATION_TEXT /end ANNOTATION
/end CHARACTERISTIC
/begin CHARACTERISTIC DWC_EFLASHROMB.DWC_K2DeviceControl.DWC_TrqPress.DWC_KisspointSequencer.DWC_KPDYNGRADENDFACTOR "" VALUE 0x8060920F DefaultValueRecordLayout_AUTOSAR_Platform_BaseTypes_uint8 1.0 RB_PT_PCT_SWC_DWC_CompuMethods_ratio_0p1 0.0 1. FORMAT "%10.5"
 /begin ANNOTATION ANNOTATION_LABEL "Description (coming from AUTOSAR DESC field)"
  /begin ANNOTATION_TEXT "Factor of initial snapshot slip, considered as the end of the measurement period\r\n" /end ANNOTATION_TEXT
 /end ANNOTATION
/end CHARACTERISTIC
/begin CHARACTERISTIC DWC_EFLASHROMB.DWC_K2DeviceControl.DWC_TrqPress.DWC_KisspointSequencer.DWC_KPDYNGRADSTARTFACTOR "" VALUE 0x80609210 DefaultValueRecordLayout_AUTOSAR_Platform_BaseTypes_uint8 1.0 RB_PT_PCT_SWC_DWC_CompuMethods_ratio_0p1 0.0 1. FORMAT "%10.5"
 /begin ANNOTATION ANNOTATION_LABEL "Description (coming from AUTOSAR DESC field)"
  /begin ANNOTATION_TEXT "Factor of initial snapshot slip, considered as the start of the measurement period\r\n" /end ANNOTATION_TEXT
 /end ANNOTATION
/end CHARACTERISTIC
/begin CHARACTERISTIC DWC_EFLASHROMB.DWC_K2DeviceControl.DWC_TrqPress.DWC_KisspointSequencer.DWC_KPDYNINTERLEARNTIMEMIN "" CURVE 0x80609214 RB_PT_PCT_SWC_DWC_RecordLayouts_RL_Curve_uint16_3_sint16_3 131.07 RB_PT_PCT_SWC_DWC_CompuMethods_ratio_0p002 0.0 131.07 FORMAT "%10.5"
 /begin ANNOTATION ANNOTATION_LABEL "Description (coming from AUTOSAR DESC field)"
  /begin ANNOTATION_TEXT "Minimum time between learns vs number of completed learns over life\r\n" /end ANNOTATION_TEXT
 /end ANNOTATION
 /begin AXIS_DESCR STD_AXIS NO_INPUT_QUANTITY RB_PT_PCT_SWC_DWC_CompuMethods_ident 3 0.0 32760. FORMAT "%10.5" DEPOSIT ABSOLUTE /end AXIS_DESCR
/end CHARACTERISTIC
/begin CHARACTERISTIC DWC_EFLASHROMB.DWC_K2DeviceControl.DWC_TrqPress.DWC_KisspointSequencer.DWC_KPDYNMAXTEMPERATURE "" VALUE 0x806091FA DefaultValueRecordLayout_AUTOSAR_Platform_BaseTypes_sint16 250.0 RB_PT_PCT_SWC_DWC_CompuMethods_ident -50. 200. FORMAT "%10.5"
 /begin ANNOTATION ANNOTATION_LABEL "Description (coming from AUTOSAR DESC field)" /begin ANNOTATION_TEXT "Minimum temperature for kisspoint learn\r\n" /end ANNOTATION_TEXT /end ANNOTATION
/end CHARACTERISTIC
/begin CHARACTERISTIC DWC_EFLASHROMB.DWC_K2DeviceControl.DWC_TrqPress.DWC_KisspointSequencer.DWC_KPDYNMAXTIME "" VALUE 0x806091FC DefaultValueRecordLayout_AUTOSAR_Platform_BaseTypes_uint16 10.0 RB_PT_PCT_SWC_DWC_CompuMethods_ratio_0p001__2 0.0 10. FORMAT "%10.5"
 /begin ANNOTATION ANNOTATION_LABEL "Description (coming from AUTOSAR DESC field)"
  /begin ANNOTATION_TEXT "Time considered too long for input speed to fall to engine speed\r\n" /end ANNOTATION_TEXT
 /end ANNOTATION
/end CHARACTERISTIC
/begin CHARACTERISTIC DWC_EFLASHROMB.DWC_K2DeviceControl.DWC_TrqPress.DWC_KisspointSequencer.DWC_KPDYNMININITIALSLIP "" VALUE 0x806091FE DefaultValueRecordLayout_AUTOSAR_Platform_BaseTypes_uint16 20000.0 RB_PT_PCT_SWC_DWC_CompuMethods_ident 0.0 20000. FORMAT "%10.5"
 /begin ANNOTATION ANNOTATION_LABEL "Description (coming from AUTOSAR DESC field)"
  /begin ANNOTATION_TEXT "Maximum output shaft speed change during dynamic kisspoint sequence\r\n" /end ANNOTATION_TEXT
 /end ANNOTATION
/end CHARACTERISTIC
/begin CHARACTERISTIC DWC_EFLASHROMB.DWC_K2DeviceControl.DWC_TrqPress.DWC_KisspointSequencer.DWC_KPDYNMINTEMPERATURE "" VALUE 0x80609200 DefaultValueRecordLayout_AUTOSAR_Platform_BaseTypes_sint16 250.0 RB_PT_PCT_SWC_DWC_CompuMethods_ident -50. 200. FORMAT "%10.5"
 /begin ANNOTATION ANNOTATION_LABEL "Description (coming from AUTOSAR DESC field)" /begin ANNOTATION_TEXT "Minimum temperature for kisspoint learn\r\n" /end ANNOTATION_TEXT /end ANNOTATION
/end CHARACTERISTIC
/begin CHARACTERISTIC DWC_EFLASHROMB.DWC_K2DeviceControl.DWC_TrqPress.DWC_KisspointSequencer.DWC_KPDYNOVERDUETIMEBEFOREDSTREQUEST "" VALUE 0x806091F4 DefaultValueRecordLayout_AUTOSAR_Platform_BaseTypes_uint32 1000.0 RB_PT_PCT_SWC_DWC_CompuMethods_ratio_0p001__2 0.0 1000. FORMAT "%10.5"
 /begin ANNOTATION ANNOTATION_LABEL "Description (coming from AUTOSAR DESC field)"
  /begin ANNOTATION_TEXT "Maximum time that a kisspoint learn is overdue for before a kisspoint learn is requested\r\n" /end ANNOTATION_TEXT
 /end ANNOTATION
/end CHARACTERISTIC
/begin CHARACTERISTIC DWC_EFLASHROMB.DWC_K2DeviceControl.DWC_TrqPress.DWC_KisspointSequencer.DWC_KPENGINESPEEDCONDHYST "" VALUE 0x80609202 DefaultValueRecordLayout_AUTOSAR_Platform_BaseTypes_uint16 20000.0 RB_PT_PCT_SWC_DWC_CompuMethods_ident 0.0 20000. FORMAT "%10.5"
 /begin ANNOTATION ANNOTATION_LABEL "Description (coming from AUTOSAR DESC field)" /begin ANNOTATION_TEXT "Minimum engine speed for kisspoint learn\r\n" /end ANNOTATION_TEXT /end ANNOTATION
/end CHARACTERISTIC
/begin CHARACTERISTIC DWC_EFLASHROMB.DWC_K2DeviceControl.DWC_TrqPress.DWC_KisspointSequencer.DWC_KPLOADINGGEAR "" VAL_BLK 0x806091E4 DefaultValueRecordLayout_AUTOSAR_Platform_BaseTypes_uint8 254.0 RB_PT_PCT_SWC_DWC_CompuMethods_ident 0.0 254. FORMAT "%10.5"
 /begin ANNOTATION ANNOTATION_LABEL "Description (coming from AUTOSAR DESC field)"
  /begin ANNOTATION_TEXT "Loading gear array against current torque gear (254 = do not run)\r\n" /end ANNOTATION_TEXT
 /end ANNOTATION
 MATRIX_DIM 14 1 1 /end CHARACTERISTIC
/begin CHARACTERISTIC DWC_EFLASHROMB.DWC_K2DeviceControl.DWC_TrqPress.DWC_KisspointSequencer.DWC_KPMAXENGINESPEED "" VAL_BLK 0x806091C8 DefaultValueRecordLayout_AUTOSAR_Platform_BaseTypes_uint16 20000.0 RB_PT_PCT_SWC_DWC_CompuMethods_ident 0.0 20000. FORMAT "%10.5"
 /begin ANNOTATION ANNOTATION_LABEL "Description (coming from AUTOSAR DESC field)" /begin ANNOTATION_TEXT "Maximum engine speed for kisspoint learn per gear\r\n" /end ANNOTATION_TEXT /end ANNOTATION
 MATRIX_DIM 14 1 1 /end CHARACTERISTIC
/begin CHARACTERISTIC DWC_EFLASHROMB.DWC_K2DeviceControl.DWC_TrqPress.DWC_KisspointSequencer.DWC_KPMINENGINESPEED "" VALUE 0x80609204 DefaultValueRecordLayout_AUTOSAR_Platform_BaseTypes_uint16 20000.0 RB_PT_PCT_SWC_DWC_CompuMethods_ident 0.0 20000. FORMAT "%10.5"
 /begin ANNOTATION ANNOTATION_LABEL "Description (coming from AUTOSAR DESC field)" /begin ANNOTATION_TEXT "Minimum engine speed for kisspoint learn\r\n" /end ANNOTATION_TEXT /end ANNOTATION
/end CHARACTERISTIC
/begin CHARACTERISTIC DWC_EFLASHROMB.DWC_K2DeviceControl.DWC_TrqPress.DWC_KisspointSequencer.DWC_KPSTATLOCKTIMEOUT "" VALUE 0x80609206 DefaultValueRecordLayout_AUTOSAR_Platform_BaseTypes_uint16 10.0 RB_PT_PCT_SWC_DWC_CompuMethods_ratio_0p001__2 0.0 10. FORMAT "%10.5"
 /begin ANNOTATION ANNOTATION_LABEL "Description (coming from AUTOSAR DESC field)" /begin ANNOTATION_TEXT "Time considered too long to expect a lock\r\n" /end ANNOTATION_TEXT /end ANNOTATION
/end CHARACTERISTIC
/begin CHARACTERISTIC DWC_EFLASHROMB.DWC_K2DeviceControl.DWC_TrqPress.DWC_KisspointSequencer.DWC_KPSTATOUTPUTMAX "" VALUE 0x80609208 DefaultValueRecordLayout_AUTOSAR_Platform_BaseTypes_sint16 40000.0 RB_PT_PCT_SWC_DWC_CompuMethods_ident -20000. 20000. FORMAT "%10.5"
 /begin ANNOTATION ANNOTATION_LABEL "Description (coming from AUTOSAR DESC field)" /begin ANNOTATION_TEXT "Maximum output speed for static kisspoint learn\r\n" /end ANNOTATION_TEXT /end ANNOTATION
/end CHARACTERISTIC
/begin CHARACTERISTIC DWC_EFLASHROMB.DWC_K2DeviceControl.DWC_TrqPress.DWC_KisspointSequencer.DWC_KPSTATOUTPUTMIN "" VALUE 0x8060920A DefaultValueRecordLayout_AUTOSAR_Platform_BaseTypes_sint16 40000.0 RB_PT_PCT_SWC_DWC_CompuMethods_ident -20000. 20000. FORMAT "%10.5"
 /begin ANNOTATION ANNOTATION_LABEL "Description (coming from AUTOSAR DESC field)" /begin ANNOTATION_TEXT "Minimum output speed for static kisspoint learn\r\n" /end ANNOTATION_TEXT /end ANNOTATION
/end CHARACTERISTIC
/begin CHARACTERISTIC DWC_EFLASHROMB.DWC_K2DeviceControl.DWC_TrqPress.DWC_KisspointSequencer.DWC_KPSTATSLIPSTARTFACTOR "" VALUE 0x80609211 DefaultValueRecordLayout_AUTOSAR_Platform_BaseTypes_uint8 1.0 RB_PT_PCT_SWC_DWC_CompuMethods_ratio_0p1 0.0 1. FORMAT "%10.5"
 /begin ANNOTATION ANNOTATION_LABEL "Description (coming from AUTOSAR DESC field)"
  /begin ANNOTATION_TEXT "Factor of initial snapshot slip, after which engagement is closely monitored\r\n" /end ANNOTATION_TEXT
 /end ANNOTATION
/end CHARACTERISTIC
/begin CHARACTERISTIC DWC_EFLASHROMB.DWC_K2DeviceControl.DWC_TrqPress.DWC_KisspointSequencer.DWC_KPWETCLUTCH "" VALUE 0x80609212 DefaultValueRecordLayout_AUTOSAR_Platform_BaseTypes_boolean 255.0 AUTOSAR_Platform_CompuMethods_boolean 0.0 255. FORMAT "%10.5"
 /begin ANNOTATION ANNOTATION_LABEL "Description (coming from AUTOSAR DESC field)" /begin ANNOTATION_TEXT "Flag indicating that the clutch is wet\r\n" /end ANNOTATION_TEXT /end ANNOTATION
/end CHARACTERISTIC
/begin CHARACTERISTIC DWC_EFLASHROMB.DWC_K2DeviceControl.DWC_TrqPress.DWC_KPADAPTSTEPS "" CURVE 0x8060923A RB_PT_PCT_SWC_DWC_RecordLayouts_RL_Curve_sint16_7_sint8_7 64.0 RB_PT_PCT_SWC_DWC_CompuMethods_ratio_0p001__2 -32. 32. FORMAT "%10.5"
 /begin ANNOTATION ANNOTATION_LABEL "Description (coming from AUTOSAR DESC field)"
  /begin ANNOTATION_TEXT "Adaption step based on request from kisspoint learn state machine\r\n" /end ANNOTATION_TEXT
 /end ANNOTATION
 /begin AXIS_DESCR STD_AXIS NO_INPUT_QUANTITY RB_PT_PCT_SWC_DWC_CompuMethods_ident 7 -3. 3. FORMAT "%10.5" DEPOSIT ABSOLUTE /end AXIS_DESCR
/end CHARACTERISTIC
/begin CHARACTERISTIC DWC_EFLASHROMB.DWC_K2DeviceControl.DWC_TrqPress.DWC_MINTORQUEOFFSETTEMP "" CURVE 0x80609252 RB_PT_PCT_SWC_DWC_RecordLayouts_RL_Curve_sint16_5_sint16_5 64.0 RB_PT_PCT_SWC_DWC_CompuMethods_ratio_0p001__2 -32. 32. FORMAT "%10.5"
 /begin ANNOTATION ANNOTATION_LABEL "Description (coming from AUTOSAR DESC field)" /begin ANNOTATION_TEXT "Offset applied to kisspoint for temperature\r\n" /end ANNOTATION_TEXT /end ANNOTATION
 /begin AXIS_DESCR STD_AXIS NO_INPUT_QUANTITY RB_PT_PCT_SWC_DWC_CompuMethods_ident 5 -50. 200. FORMAT "%10.5" DEPOSIT ABSOLUTE /end AXIS_DESCR
/end CHARACTERISTIC
/begin CHARACTERISTIC DWC_EFLASHROMB.DWC_K2DeviceControl.DWC_TrqPress.DXC_MINPRESSPOSDEMAND "" VALUE 0x80608978 DefaultValueRecordLayout_AUTOSAR_Platform_BaseTypes_sint16 64.0 RB_PT_PCT_SWC_DWC_CompuMethods_ratio_0p001__2 -32. 32. FORMAT "%10.5"
 /begin ANNOTATION ANNOTATION_LABEL "Description (coming from AUTOSAR DESC field)" /begin ANNOTATION_TEXT "Minimum demand for pressure/position out of class\r\n" /end ANNOTATION_TEXT /end ANNOTATION
/end CHARACTERISTIC
/begin CHARACTERISTIC DWC_EFLASHROMB.DWC_K2DeviceControl.DWC_TrqPress.DXC_RPMTEMPOFFSETPOINT1 "" MAP 0x80609268 RB_PT_PCT_SWC_DWC_RecordLayouts_RL_MapGrouped_sint16_48_uint16_8_sint16_6 64.0 RB_PT_PCT_SWC_DWC_CompuMethods_ratio_0p001__2 -32. 32. FORMAT "%10.5"
 /begin ANNOTATION ANNOTATION_LABEL "Description (coming from AUTOSAR DESC field)"
  /begin ANNOTATION_TEXT "Offset data at torque point based on engine speed and temperature\r\n" /end ANNOTATION_TEXT
 /end ANNOTATION
 /begin AXIS_DESCR COM_AXIS NO_INPUT_QUANTITY RB_PT_PCT_SWC_DWC_CompuMethods_ident 8 0.0 20000. FORMAT "%10.5" AXIS_PTS_REF DWC_EFLASHROMB.DWC_K2DeviceControl.DWC_TrqPress.DXC_RPMAXISOFFSETTABLES DEPOSIT ABSOLUTE /end AXIS_DESCR
 /begin AXIS_DESCR COM_AXIS NO_INPUT_QUANTITY RB_PT_PCT_SWC_DWC_CompuMethods_ident 6 -50. 500. FORMAT "%10.5" AXIS_PTS_REF DWC_EFLASHROMB.DWC_K2DeviceControl.DWC_TrqPress.DXC_TEMPAXISOFFSETTABLES DEPOSIT ABSOLUTE /end AXIS_DESCR
/end CHARACTERISTIC
/begin CHARACTERISTIC DWC_EFLASHROMB.DWC_K2DeviceControl.DWC_TrqPress.DXC_RPMTEMPOFFSETPOINT2 "" MAP 0x806092C8 RB_PT_PCT_SWC_DWC_RecordLayouts_RL_MapGrouped_sint16_48_uint16_8_sint16_6 64.0 RB_PT_PCT_SWC_DWC_CompuMethods_ratio_0p001__2 -32. 32. FORMAT "%10.5"
 /begin ANNOTATION ANNOTATION_LABEL "Description (coming from AUTOSAR DESC field)"
  /begin ANNOTATION_TEXT "Offset data at torque point based on engine speed and temperature\r\n" /end ANNOTATION_TEXT
 /end ANNOTATION
 /begin AXIS_DESCR COM_AXIS NO_INPUT_QUANTITY RB_PT_PCT_SWC_DWC_CompuMethods_ident 8 0.0 20000. FORMAT "%10.5" AXIS_PTS_REF DWC_EFLASHROMB.DWC_K2DeviceControl.DWC_TrqPress.DXC_RPMAXISOFFSETTABLES DEPOSIT ABSOLUTE /end AXIS_DESCR
 /begin AXIS_DESCR COM_AXIS NO_INPUT_QUANTITY RB_PT_PCT_SWC_DWC_CompuMethods_ident 6 -50. 500. FORMAT "%10.5" AXIS_PTS_REF DWC_EFLASHROMB.DWC_K2DeviceControl.DWC_TrqPress.DXC_TEMPAXISOFFSETTABLES DEPOSIT ABSOLUTE /end AXIS_DESCR
/end CHARACTERISTIC
/begin CHARACTERISTIC DWC_EFLASHROMB.DWC_K2DeviceControl.DWC_TrqPress.DXC_RPMTEMPOFFSETPOINT3 "" MAP 0x80609328 RB_PT_PCT_SWC_DWC_RecordLayouts_RL_MapGrouped_sint16_48_uint16_8_sint16_6 64.0 RB_PT_PCT_SWC_DWC_CompuMethods_ratio_0p001__2 -32. 32. FORMAT "%10.5"
 /begin ANNOTATION ANNOTATION_LABEL "Description (coming from AUTOSAR DESC field)"
  /begin ANNOTATION_TEXT "Offset data at torque point based on engine speed and temperature\r\n" /end ANNOTATION_TEXT
 /end ANNOTATION
 /begin AXIS_DESCR COM_AXIS NO_INPUT_QUANTITY RB_PT_PCT_SWC_DWC_CompuMethods_ident 8 0.0 20000. FORMAT "%10.5" AXIS_PTS_REF DWC_EFLASHROMB.DWC_K2DeviceControl.DWC_TrqPress.DXC_RPMAXISOFFSETTABLES DEPOSIT ABSOLUTE /end AXIS_DESCR
 /begin AXIS_DESCR COM_AXIS NO_INPUT_QUANTITY RB_PT_PCT_SWC_DWC_CompuMethods_ident 6 -50. 500. FORMAT "%10.5" AXIS_PTS_REF DWC_EFLASHROMB.DWC_K2DeviceControl.DWC_TrqPress.DXC_TEMPAXISOFFSETTABLES DEPOSIT ABSOLUTE /end AXIS_DESCR
/end CHARACTERISTIC
/begin CHARACTERISTIC DWC_EFLASHROMB.DWC_K2DeviceControl.DWC_TrqPress.DXC_RPMTEMPOFFSETPOINT4 "" MAP 0x80609388 RB_PT_PCT_SWC_DWC_RecordLayouts_RL_MapGrouped_sint16_48_uint16_8_sint16_6 64.0 RB_PT_PCT_SWC_DWC_CompuMethods_ratio_0p001__2 -32. 32. FORMAT "%10.5"
 /begin ANNOTATION ANNOTATION_LABEL "Description (coming from AUTOSAR DESC field)"
  /begin ANNOTATION_TEXT "Offset data at torque point based on engine speed and temperature\r\n" /end ANNOTATION_TEXT
 /end ANNOTATION
 /begin AXIS_DESCR COM_AXIS NO_INPUT_QUANTITY RB_PT_PCT_SWC_DWC_CompuMethods_ident 8 0.0 20000. FORMAT "%10.5" AXIS_PTS_REF DWC_EFLASHROMB.DWC_K2DeviceControl.DWC_TrqPress.DXC_RPMAXISOFFSETTABLES DEPOSIT ABSOLUTE /end AXIS_DESCR
 /begin AXIS_DESCR COM_AXIS NO_INPUT_QUANTITY RB_PT_PCT_SWC_DWC_CompuMethods_ident 6 -50. 500. FORMAT "%10.5" AXIS_PTS_REF DWC_EFLASHROMB.DWC_K2DeviceControl.DWC_TrqPress.DXC_TEMPAXISOFFSETTABLES DEPOSIT ABSOLUTE /end AXIS_DESCR
/end CHARACTERISTIC
/begin CHARACTERISTIC DWC_EFLASHROMB.DWC_K2DeviceControl.DWC_TrqPress.DXC_RPMTEMPOFFSETPOINT5 "" MAP 0x806093E8 RB_PT_PCT_SWC_DWC_RecordLayouts_RL_MapGrouped_sint16_48_uint16_8_sint16_6 64.0 RB_PT_PCT_SWC_DWC_CompuMethods_ratio_0p001__2 -32. 32. FORMAT "%10.5"
 /begin ANNOTATION ANNOTATION_LABEL "Description (coming from AUTOSAR DESC field)"
  /begin ANNOTATION_TEXT "Offset data at torque point based on engine speed and temperature\r\n" /end ANNOTATION_TEXT
 /end ANNOTATION
 /begin AXIS_DESCR COM_AXIS NO_INPUT_QUANTITY RB_PT_PCT_SWC_DWC_CompuMethods_ident 8 0.0 20000. FORMAT "%10.5" AXIS_PTS_REF DWC_EFLASHROMB.DWC_K2DeviceControl.DWC_TrqPress.DXC_RPMAXISOFFSETTABLES DEPOSIT ABSOLUTE /end AXIS_DESCR
 /begin AXIS_DESCR COM_AXIS NO_INPUT_QUANTITY RB_PT_PCT_SWC_DWC_CompuMethods_ident 6 -50. 500. FORMAT "%10.5" AXIS_PTS_REF DWC_EFLASHROMB.DWC_K2DeviceControl.DWC_TrqPress.DXC_TEMPAXISOFFSETTABLES DEPOSIT ABSOLUTE /end AXIS_DESCR
/end CHARACTERISTIC
/begin CHARACTERISTIC DWC_EFLASHROMB.DWC_K2DeviceControl.DWC_TrqPress.DXC_RPMTEMPOFFSETPOINT6 "" MAP 0x80609448 RB_PT_PCT_SWC_DWC_RecordLayouts_RL_MapGrouped_sint16_48_uint16_8_sint16_6 64.0 RB_PT_PCT_SWC_DWC_CompuMethods_ratio_0p001__2 -32. 32. FORMAT "%10.5"
 /begin ANNOTATION ANNOTATION_LABEL "Description (coming from AUTOSAR DESC field)"
  /begin ANNOTATION_TEXT "Offset data at torque point based on engine speed and temperature\r\n" /end ANNOTATION_TEXT
 /end ANNOTATION
 /begin AXIS_DESCR COM_AXIS NO_INPUT_QUANTITY RB_PT_PCT_SWC_DWC_CompuMethods_ident 8 0.0 20000. FORMAT "%10.5" AXIS_PTS_REF DWC_EFLASHROMB.DWC_K2DeviceControl.DWC_TrqPress.DXC_RPMAXISOFFSETTABLES DEPOSIT ABSOLUTE /end AXIS_DESCR
 /begin AXIS_DESCR COM_AXIS NO_INPUT_QUANTITY RB_PT_PCT_SWC_DWC_CompuMethods_ident 6 -50. 500. FORMAT "%10.5" AXIS_PTS_REF DWC_EFLASHROMB.DWC_K2DeviceControl.DWC_TrqPress.DXC_TEMPAXISOFFSETTABLES DEPOSIT ABSOLUTE /end AXIS_DESCR
/end CHARACTERISTIC
/begin CHARACTERISTIC DWC_EFLASHROMB.DWC_K2DeviceControl.DWC_TrqPress.DXC_RPMTEMPOFFSETPOINT7 "" MAP 0x806094A8 RB_PT_PCT_SWC_DWC_RecordLayouts_RL_MapGrouped_sint16_48_uint16_8_sint16_6 64.0 RB_PT_PCT_SWC_DWC_CompuMethods_ratio_0p001__2 -32. 32. FORMAT "%10.5"
 /begin ANNOTATION ANNOTATION_LABEL "Description (coming from AUTOSAR DESC field)"
  /begin ANNOTATION_TEXT "Offset data at torque point based on engine speed and temperature\r\n" /end ANNOTATION_TEXT
 /end ANNOTATION
 /begin AXIS_DESCR COM_AXIS NO_INPUT_QUANTITY RB_PT_PCT_SWC_DWC_CompuMethods_ident 8 0.0 20000. FORMAT "%10.5" AXIS_PTS_REF DWC_EFLASHROMB.DWC_K2DeviceControl.DWC_TrqPress.DXC_RPMAXISOFFSETTABLES DEPOSIT ABSOLUTE /end AXIS_DESCR
 /begin AXIS_DESCR COM_AXIS NO_INPUT_QUANTITY RB_PT_PCT_SWC_DWC_CompuMethods_ident 6 -50. 500. FORMAT "%10.5" AXIS_PTS_REF DWC_EFLASHROMB.DWC_K2DeviceControl.DWC_TrqPress.DXC_TEMPAXISOFFSETTABLES DEPOSIT ABSOLUTE /end AXIS_DESCR
/end CHARACTERISTIC
/begin CHARACTERISTIC DWC_EFLASHROMB.DWC_LOWTARGETGEARSHIFTTIMEFACT "" VALUE 0x806076FE DefaultValueRecordLayout_AUTOSAR_Platform_BaseTypes_uint8 11.0 RB_PT_PCT_SWC_DWC_CompuMethods_ident 0.0 11. FORMAT "%10.5"
 /begin ANNOTATION ANNOTATION_LABEL "Description (coming from AUTOSAR DESC field)"
  /begin ANNOTATION_TEXT "Target gear (or less) considered a low gear for shift time derivation\r\n" /end ANNOTATION_TEXT
 /end ANNOTATION
/end CHARACTERISTIC
/begin CHARACTERISTIC DWC_EFLASHROMB.DWC_MANUALTIMETOSHIFT "" CURVE 0x80609832 RB_PT_PCT_SWC_DWC_RecordLayouts_RL_Curve_uint16_2_sint16_2 10.0 RB_PT_PCT_SWC_DWC_CompuMethods_ratio_0p001__2 0.0 10. FORMAT "%10.5"
 /begin ANNOTATION ANNOTATION_LABEL "Description (coming from AUTOSAR DESC field)" /begin ANNOTATION_TEXT "Time estimate for manual mode shift\r\n" /end ANNOTATION_TEXT /end ANNOTATION
 /begin AXIS_DESCR STD_AXIS NO_INPUT_QUANTITY RB_PT_PCT_SWC_DWC_CompuMethods_ratio_0p1 2 -2000. 2000. FORMAT "%10.5" DEPOSIT ABSOLUTE /end AXIS_DESCR
/end CHARACTERISTIC
/begin CHARACTERISTIC DWC_EFLASHROMB.DWC_MAXENGINETORQUEBULKOIL "" CURVE 0x8060983C RB_PT_PCT_SWC_DWC_RecordLayouts_RL_Curve_uint16_6_sint16_6 2000.0 RB_PT_PCT_SWC_DWC_CompuMethods_ratio_0p1 0.0 2000. FORMAT "%10.5"
 /begin ANNOTATION ANNOTATION_LABEL "Description (coming from AUTOSAR DESC field)"
  /begin ANNOTATION_TEXT "Maximum engine torque vs transmission (bulk clutch) oil temperature\r\n" /end ANNOTATION_TEXT
 /end ANNOTATION
 /begin AXIS_DESCR STD_AXIS NO_INPUT_QUANTITY RB_PT_PCT_SWC_DWC_CompuMethods_ident 6 -50. 200. FORMAT "%10.5" DEPOSIT ABSOLUTE /end AXIS_DESCR
/end CHARACTERISTIC
/begin CHARACTERISTIC DWC_EFLASHROMB.DWC_MAXENGINETORQUEINLETOIL "" CURVE 0x80609856 RB_PT_PCT_SWC_DWC_RecordLayouts_RL_Curve_uint16_6_sint16_6 2000.0 RB_PT_PCT_SWC_DWC_CompuMethods_ratio_0p1 0.0 2000. FORMAT "%10.5"
 /begin ANNOTATION ANNOTATION_LABEL "Description (coming from AUTOSAR DESC field)"
  /begin ANNOTATION_TEXT "Maximum engine torque vs clutch cooling inlet oil temperature\r\n" /end ANNOTATION_TEXT
 /end ANNOTATION
 /begin AXIS_DESCR STD_AXIS NO_INPUT_QUANTITY RB_PT_PCT_SWC_DWC_CompuMethods_ident 6 -50. 200. FORMAT "%10.5" DEPOSIT ABSOLUTE /end AXIS_DESCR
/end CHARACTERISTIC
/begin CHARACTERISTIC DWC_EFLASHROMB.DWC_SpeedPhaseControl.DWC_MaxGradient.DWC_KICKDOWN5STEP "" MAP 0x8060956A RB_PT_PCT_SWC_DWC_RecordLayouts_RL_Map_sint16_15_sint8_3_sint8_5 64000.0 RB_PT_PCT_SWC_DWC_CompuMethods_ident -32000. 32000. FORMAT "%10.5"
 /begin ANNOTATION ANNOTATION_LABEL "Description (coming from AUTOSAR DESC field)"
  /begin ANNOTATION_TEXT "Gradient for power on down shifts for kickdown - 5 step\r\n" /end ANNOTATION_TEXT
 /end ANNOTATION
 /begin AXIS_DESCR STD_AXIS NO_INPUT_QUANTITY RB_PT_PCT_SWC_DWC_CompuMethods_ident 3 -100. 100. FORMAT "%10.5" DEPOSIT ABSOLUTE /end AXIS_DESCR
 /begin AXIS_DESCR STD_AXIS NO_INPUT_QUANTITY RB_PT_PCT_SWC_DWC_CompuMethods_ident 5 0.0 13. FORMAT "%10.5" DEPOSIT ABSOLUTE /end AXIS_DESCR
/end CHARACTERISTIC
/begin CHARACTERISTIC DWC_EFLASHROMB.DWC_SpeedPhaseControl.DWC_NEUTRALOFFGOINGHYST "" VALUE 0x80609568 DefaultValueRecordLayout_AUTOSAR_Platform_BaseTypes_uint16 20000.0 RB_PT_PCT_SWC_DWC_CompuMethods_ident 0.0 20000. FORMAT "%10.5"
 /begin ANNOTATION ANNOTATION_LABEL "Description (coming from AUTOSAR DESC field)" /begin ANNOTATION_TEXT "Hysteresis on neutral offgoing decision\r\n" /end ANNOTATION_TEXT /end ANNOTATION
/end CHARACTERISTIC
/begin CHARACTERISTIC DWC_EFLASHROMB.DWC_SpeedPhaseControl.DWC_NEUTRALOFFGOINGSPEED "" MAP 0x8060959E RB_PT_PCT_SWC_DWC_RecordLayouts_RL_Map_uint16_65_sint16_5_uint8_13 20000.0 RB_PT_PCT_SWC_DWC_CompuMethods_ident 0.0 20000. FORMAT "%10.5"
 /begin ANNOTATION ANNOTATION_LABEL "Description (coming from AUTOSAR DESC field)"
  /begin ANNOTATION_TEXT "Engine speed above which going shaft will be set to neutral after the torque phase\r\n" /end ANNOTATION_TEXT
 /end ANNOTATION
 /begin AXIS_DESCR STD_AXIS NO_INPUT_QUANTITY RB_PT_PCT_SWC_DWC_CompuMethods_ratio_0p1 5 -2000. 2000. FORMAT "%10.5" DEPOSIT ABSOLUTE /end AXIS_DESCR
 /begin AXIS_DESCR STD_AXIS NO_INPUT_QUANTITY RB_PT_PCT_SWC_DWC_CompuMethods_ident 13 0.0 13. FORMAT "%10.5" DEPOSIT ABSOLUTE /end AXIS_DESCR
/end CHARACTERISTIC
/begin CHARACTERISTIC DWC_EFLASHROMB.DWC_SpeedPhaseControl.DWC_SlipTargetCalc.DWC_OFFGOINGDOWNMAXSETPOINT "" VALUE 0x80609594 DefaultValueRecordLayout_AUTOSAR_Platform_BaseTypes_boolean 255.0 AUTOSAR_Platform_CompuMethods_boolean 0.0 255. FORMAT "%10.5"
 /begin ANNOTATION ANNOTATION_LABEL "Description (coming from AUTOSAR DESC field)"
  /begin ANNOTATION_TEXT "Flag to force offgoing down speed phases to max with the setpoint speed\r\n" /end ANNOTATION_TEXT
 /end ANNOTATION
/end CHARACTERISTIC
/begin CHARACTERISTIC DWC_EFLASHROMB.DWC_SpeedPhaseControl.DWC_SPEEDPHASECTRL "" VAL_BLK 0x80609528 DefaultValueRecordLayout_AUTOSAR_Platform_BaseTypes_uint8 5.0 RB_PT_PCT_SWC_DWC_CompuMethods_ident 0.0 5. FORMAT "%10.5"
 /begin ANNOTATION ANNOTATION_LABEL "Description (coming from AUTOSAR DESC field)" /begin ANNOTATION_TEXT "Type of speed phase control to perform\r\n" /end ANNOTATION_TEXT /end ANNOTATION
 MATRIX_DIM 8 8 1 /end CHARACTERISTIC
/begin CHARACTERISTIC DWC_EFLASHROMB.DWC_SpeedPhaseControl.DWC_SpeedPhaseRules.DWC_TWOCLUTCHLAUNCHVSMODE "" VAL_BLK 0x80609596 DefaultValueRecordLayout_AUTOSAR_Platform_BaseTypes_boolean 255.0 AUTOSAR_Platform_CompuMethods_boolean 0.0 255. FORMAT "%10.5"
 /begin ANNOTATION ANNOTATION_LABEL "Description (coming from AUTOSAR DESC field)"
  /begin ANNOTATION_TEXT "Power off up fast fill enable vs mode (0 = auto normal, 1 = auto sport, 2 = auto track, 3 = manual normal, 4 = manual sport, 5 = manual track)\r\n" /end ANNOTATION_TEXT
 /end ANNOTATION
 MATRIX_DIM 7 1 1 /end CHARACTERISTIC
/begin CHARACTERISTIC DWC_EFLASHROMB.DWC_TorqueControl.DWC_CONTROLLERDOMINANCE "" VAL_BLK 0x8060963C DefaultValueRecordLayout_AUTOSAR_Platform_BaseTypes_uint8 3.0 RB_PT_PCT_SWC_DWC_CompuMethods_ident 0.0 3. FORMAT "%10.5"
 /begin ANNOTATION ANNOTATION_LABEL "Description (coming from AUTOSAR DESC field)" /begin ANNOTATION_TEXT "Matrix looks up the dominant controller\r\n" /end ANNOTATION_TEXT /end ANNOTATION
 MATRIX_DIM 8 8 1 /end CHARACTERISTIC
/begin CHARACTERISTIC DWC_EFLASHROMB.DWC_TorqueControl.DWC_ENABLECLUTCHHYSTMODEL "" VALUE 0x8060968A DefaultValueRecordLayout_AUTOSAR_Platform_BaseTypes_boolean 255.0 AUTOSAR_Platform_CompuMethods_boolean 0.0 255. FORMAT "%10.5"
 /begin ANNOTATION ANNOTATION_LABEL "Description (coming from AUTOSAR DESC field)" /begin ANNOTATION_TEXT "Flag to enable clutch hysteresis model\r\n" /end ANNOTATION_TEXT /end ANNOTATION
/end CHARACTERISTIC
/begin CHARACTERISTIC DWC_EFLASHROMB.DWC_TorqueControl.DWC_ESPEEDPEDALMAXTORQUE "" MAP 0x80609738 RB_PT_PCT_SWC_DWC_RecordLayouts_RL_Map_sint16_25_uint16_5_uint8_5 4000.0 RB_PT_PCT_SWC_DWC_CompuMethods_ratio_0p1 -2000. 2000. FORMAT "%10.5"
 /begin ANNOTATION ANNOTATION_LABEL "Description (coming from AUTOSAR DESC field)"
  /begin ANNOTATION_TEXT "Maximum allowable engine torque based on engine speed and pedal\r\n" /end ANNOTATION_TEXT
 /end ANNOTATION
 /begin AXIS_DESCR STD_AXIS NO_INPUT_QUANTITY RB_PT_PCT_SWC_DWC_CompuMethods_ident 5 0.0 20000. FORMAT "%10.5" DEPOSIT ABSOLUTE /end AXIS_DESCR
 /begin AXIS_DESCR STD_AXIS NO_INPUT_QUANTITY RB_PT_PCT_SWC_DWC_CompuMethods_ratio_0p4 5 0.0 102. FORMAT "%10.5" DEPOSIT ABSOLUTE /end AXIS_DESCR
/end CHARACTERISTIC
/begin CHARACTERISTIC DWC_EFLASHROMB.DWC_TorqueControl.DWC_InertiaFeedforward.DWC_INERTIACANCELGRADIENTLIMIT "" VAL_BLK 0x8060968E DefaultValueRecordLayout_AUTOSAR_Platform_BaseTypes_sint16 64000.0 RB_PT_PCT_SWC_DWC_CompuMethods_ident -32000. 32000. FORMAT "%10.5"
 /begin ANNOTATION ANNOTATION_LABEL "Description (coming from AUTOSAR DESC field)" /begin ANNOTATION_TEXT "Gear based inertia cancel maximum authority\r\n" /end ANNOTATION_TEXT /end ANNOTATION
 MATRIX_DIM 14 1 1 /end CHARACTERISTIC
/begin CHARACTERISTIC DWC_EFLASHROMB.DWC_TorqueControl.DWC_MAXCONTROLLERJITTERIDLEADAPT "" VALUE 0x80609684 DefaultValueRecordLayout_AUTOSAR_Platform_BaseTypes_uint16 2000.0 RB_PT_PCT_SWC_DWC_CompuMethods_ratio_0p1 0.0 2000. FORMAT "%10.5"
 /begin ANNOTATION ANNOTATION_LABEL "Description (coming from AUTOSAR DESC field)"
  /begin ANNOTATION_TEXT "Maximum controller jitter to enable idle adaption (engine adaption)\r\n" /end ANNOTATION_TEXT
 /end ANNOTATION
/end CHARACTERISTIC
/begin CHARACTERISTIC DWC_EFLASHROMB.DWC_TorqueControl.DWC_MicroSlipMonitor.DWC_SLCRAMPSTEPTIME "" VALUE 0x806096AA DefaultValueRecordLayout_AUTOSAR_Platform_BaseTypes_uint16 10.0 RB_PT_PCT_SWC_DWC_CompuMethods_ratio_0p001__2 0.0 10. FORMAT "%10.5"
 /begin ANNOTATION ANNOTATION_LABEL "Description (coming from AUTOSAR DESC field)" /begin ANNOTATION_TEXT "Time for each step in the RPM target ramp\r\n" /end ANNOTATION_TEXT /end ANNOTATION
/end CHARACTERISTIC
/begin CHARACTERISTIC DWC_EFLASHROMB.DWC_TorqueControl.DWC_MicroSlipMonitor.DWC_SLCTARGETRAMPMAX "" VALUE 0x806096AC DefaultValueRecordLayout_AUTOSAR_Platform_BaseTypes_uint16 20000.0 RB_PT_PCT_SWC_DWC_CompuMethods_ident 0.0 20000. FORMAT "%10.5"
 /begin ANNOTATION ANNOTATION_LABEL "Description (coming from AUTOSAR DESC field)" /begin ANNOTATION_TEXT "Microslip target ramp maximum target\r\n" /end ANNOTATION_TEXT /end ANNOTATION
/end CHARACTERISTIC
/begin CHARACTERISTIC DWC_EFLASHROMB.DWC_TorqueControl.DWC_OPENCLUTCHTORQUEVSTEMP "" CURVE 0x8060977E RB_PT_PCT_SWC_DWC_RecordLayouts_RL_Curve_sint16_5_sint16_5 4000.0 RB_PT_PCT_SWC_DWC_CompuMethods_ratio_0p1 -2000. 2000. FORMAT "%10.5"
 /begin ANNOTATION ANNOTATION_LABEL "Description (coming from AUTOSAR DESC field)" /begin ANNOTATION_TEXT "Clutch torque considered open vs temperature\r\n" /end ANNOTATION_TEXT /end ANNOTATION
 /begin AXIS_DESCR STD_AXIS NO_INPUT_QUANTITY RB_PT_PCT_SWC_DWC_CompuMethods_ident 5 -50. 200. FORMAT "%10.5" DEPOSIT ABSOLUTE /end AXIS_DESCR
/end CHARACTERISTIC
/begin CHARACTERISTIC DWC_EFLASHROMB.DWC_TorqueControl.DWC_OVERRUNTQVSPULLAWAY "" CURVE 0x80609794 RB_PT_PCT_SWC_DWC_RecordLayouts_RL_Curve_sint16_5_uint16_5 4000.0 RB_PT_PCT_SWC_DWC_CompuMethods_ratio_0p1 -2000. 2000. FORMAT "%10.5"
 /begin ANNOTATION ANNOTATION_LABEL "Description (coming from AUTOSAR DESC field)" /begin ANNOTATION_TEXT "Minimum allowed engine torque vs time since pullaway\r\n" /end ANNOTATION_TEXT /end ANNOTATION
 /begin AXIS_DESCR STD_AXIS NO_INPUT_QUANTITY RB_PT_PCT_SWC_DWC_CompuMethods_ratio_0p001__2 5 0.0 10. FORMAT "%10.5" DEPOSIT ABSOLUTE /end AXIS_DESCR
/end CHARACTERISTIC
/begin CHARACTERISTIC DWC_EFLASHROMB.DWC_TorqueControl.DWC_SLCMinTorqueManager.DWC_SLCDYNMINTQDECRATE "" VALUE 0x80609702 DefaultValueRecordLayout_AUTOSAR_Platform_BaseTypes_uint16 2000.0 RB_PT_PCT_SWC_DWC_CompuMethods_ratio_0p1 0.0 2000. FORMAT "%10.5"
 /begin ANNOTATION ANNOTATION_LABEL "Description (coming from AUTOSAR DESC field)" /begin ANNOTATION_TEXT "Decrease rate of dynamic min controller torque\r\n" /end ANNOTATION_TEXT /end ANNOTATION
/end CHARACTERISTIC
/begin CHARACTERISTIC DWC_EFLASHROMB.DWC_TorqueControl.DWC_SLCMinTorqueManager.DWC_SLCDYNMINTQDECRATEASG "" VALUE 0x80609704 DefaultValueRecordLayout_AUTOSAR_Platform_BaseTypes_uint16 2000.0 RB_PT_PCT_SWC_DWC_CompuMethods_ratio_0p1 0.0 2000. FORMAT "%10.5"
 /begin ANNOTATION ANNOTATION_LABEL "Description (coming from AUTOSAR DESC field)"
  /begin ANNOTATION_TEXT "Decrease rate of dynamic min controller torque for ASG shift\r\n" /end ANNOTATION_TEXT
 /end ANNOTATION
/end CHARACTERISTIC
/begin CHARACTERISTIC DWC_EFLASHROMB.DWC_TorqueControl.DWC_SLCMinTorqueManager.DWC_SLCDYNMINTQPEAKTIME "" VALUE 0x80609706 DefaultValueRecordLayout_AUTOSAR_Platform_BaseTypes_uint16 10.0 RB_PT_PCT_SWC_DWC_CompuMethods_ratio_0p001__2 0.0 10. FORMAT "%10.5"
 /begin ANNOTATION ANNOTATION_LABEL "Description (coming from AUTOSAR DESC field)" /begin ANNOTATION_TEXT "Time for hold peak on dynamic minimum torque\r\n" /end ANNOTATION_TEXT /end ANNOTATION
/end CHARACTERISTIC
/begin CHARACTERISTIC DWC_EFLASHROMB.DWC_TorqueControl.DWC_SLCMinTorqueManager.DWC_SLCENGINETORQUEGEARFORCEDLOCK "" VAL_BLK 0x806096AE DefaultValueRecordLayout_AUTOSAR_Platform_BaseTypes_uint16 2000.0 RB_PT_PCT_SWC_DWC_CompuMethods_ratio_0p1 0.0 2000. FORMAT "%10.5"
 /begin ANNOTATION ANNOTATION_LABEL "Description (coming from AUTOSAR DESC field)"
  /begin ANNOTATION_TEXT "Engine torque level, above which a request to remove microslip will be made\r\n" /end ANNOTATION_TEXT
 /end ANNOTATION
 MATRIX_DIM 14 1 1 /end CHARACTERISTIC
/begin CHARACTERISTIC DWC_EFLASHROMB.DWC_TorqueControl.DWC_SLCMinTorqueManager.DWC_SLCENGINETORQUEGEARFORLOCKUP "" VAL_BLK 0x806096CA DefaultValueRecordLayout_AUTOSAR_Platform_BaseTypes_uint16 2000.0 RB_PT_PCT_SWC_DWC_CompuMethods_ratio_0p1 0.0 2000. FORMAT "%10.5"
 /begin ANNOTATION ANNOTATION_LABEL "Description (coming from AUTOSAR DESC field)"
  /begin ANNOTATION_TEXT "Engine torque level, above which a request to remove microslip will be made\r\n" /end ANNOTATION_TEXT
 /end ANNOTATION
 MATRIX_DIM 14 1 1 /end CHARACTERISTIC
/begin CHARACTERISTIC DWC_EFLASHROMB.DWC_TorqueControl.DWC_SLCMinTorqueManager.DWC_SLCENGINETORQUEGEARFORUNLOCK "" VAL_BLK 0x806096E6 DefaultValueRecordLayout_AUTOSAR_Platform_BaseTypes_uint16 2000.0 RB_PT_PCT_SWC_DWC_CompuMethods_ratio_0p1 0.0 2000. FORMAT "%10.5"
 /begin ANNOTATION ANNOTATION_LABEL "Description (coming from AUTOSAR DESC field)"
  /begin ANNOTATION_TEXT "Engine torque level, below which lockup is disallowed\r\n" /end ANNOTATION_TEXT
 /end ANNOTATION
 MATRIX_DIM 14 1 1 /end CHARACTERISTIC
/begin CHARACTERISTIC DWC_EFLASHROMB.DWC_TorqueControl.DWC_SLCPOWERONUPERRORMIN "" VALUE 0x80609686 DefaultValueRecordLayout_AUTOSAR_Platform_BaseTypes_sint16 40000.0 RB_PT_PCT_SWC_DWC_CompuMethods_ident -20000. 20000. FORMAT "%10.5"
 /begin ANNOTATION ANNOTATION_LABEL "Description (coming from AUTOSAR DESC field)"
  /begin ANNOTATION_TEXT "Minimum allowed error for slip controller in power on up shift\r\n" /end ANNOTATION_TEXT
 /end ANNOTATION
/end CHARACTERISTIC
/begin CHARACTERISTIC DWC_EFLASHROMB.DWC_TorqueControl.DWC_TorquePhaseTorque.DWC_TPTWOCLUTCHSPDFORALLTQK1 "" CURVE 0x80609708 RB_PT_PCT_SWC_DWC_RecordLayouts_RL_Curve_sint16_7_uint8_7 40000.0 RB_PT_PCT_SWC_DWC_CompuMethods_ident -20000. 20000. FORMAT "%10.5"
 /begin ANNOTATION ANNOTATION_LABEL "Description (coming from AUTOSAR DESC field)"
  /begin ANNOTATION_TEXT "Generate Input speed below which all torque will be carried on K1\r\n" /end ANNOTATION_TEXT
 /end ANNOTATION
 /begin AXIS_DESCR STD_AXIS NO_INPUT_QUANTITY RB_PT_PCT_SWC_DWC_CompuMethods_ratio_0p4 7 0.0 102. FORMAT "%10.5" DEPOSIT ABSOLUTE /end AXIS_DESCR
/end CHARACTERISTIC
/begin CHARACTERISTIC DWC_EFLASHROMB.DWC_TorqueControl.DWC_TorquePhaseTorque.DWC_TPTWOCLUTCHSPDFORALLTQK2 "" CURVE 0x80609720 RB_PT_PCT_SWC_DWC_RecordLayouts_RL_Curve_sint16_7_uint8_7 40000.0 RB_PT_PCT_SWC_DWC_CompuMethods_ident -20000. 20000. FORMAT "%10.5"
 /begin ANNOTATION ANNOTATION_LABEL "Description (coming from AUTOSAR DESC field)"
  /begin ANNOTATION_TEXT "Input speed above which all torque will be carried on K2\r\n" /end ANNOTATION_TEXT
 /end ANNOTATION
 /begin AXIS_DESCR STD_AXIS NO_INPUT_QUANTITY RB_PT_PCT_SWC_DWC_CompuMethods_ratio_0p4 7 0.0 102. FORMAT "%10.5" DEPOSIT ABSOLUTE /end AXIS_DESCR
/end CHARACTERISTIC
/begin CHARACTERISTIC DWC_EFLASHROMB.DWC_TorqueControl.DWC_TPTEMPTIMEFACTOR "" MAP 0x806097AA RB_PT_PCT_SWC_DWC_RecordLayouts_RL_Map_uint16_55_sint16_5_uint8_11 3.0 RB_PT_PCT_SWC_DWC_CompuMethods_ratio_0p001__2 0.0 3. FORMAT "%10.5"
 /begin ANNOTATION ANNOTATION_LABEL "Description (coming from AUTOSAR DESC field)" /begin ANNOTATION_TEXT "Factor applied to torque phase time for temperature\r\n" /end ANNOTATION_TEXT /end ANNOTATION
 /begin AXIS_DESCR STD_AXIS NO_INPUT_QUANTITY RB_PT_PCT_SWC_DWC_CompuMethods_ident 5 -50. 200. FORMAT "%10.5" DEPOSIT ABSOLUTE /end AXIS_DESCR
 /begin AXIS_DESCR STD_AXIS NO_INPUT_QUANTITY RB_PT_PCT_SWC_DWC_CompuMethods_ident 11 0.0 10. FORMAT "%10.5" DEPOSIT ABSOLUTE /end AXIS_DESCR
/end CHARACTERISTIC
/begin CHARACTERISTIC DWC_EFLASHROMB.DWC_TorqueControl.DWC_TPTWOCLUTCHLAUNCHVSMODE "" VAL_BLK 0x8060967C DefaultValueRecordLayout_AUTOSAR_Platform_BaseTypes_boolean 255.0 AUTOSAR_Platform_CompuMethods_boolean 0.0 255. FORMAT "%10.5"
 /begin ANNOTATION ANNOTATION_LABEL "Description (coming from AUTOSAR DESC field)"
  /begin ANNOTATION_TEXT "Power off up fast fill enable vs mode (0 = auto normal, 1 = auto sport, 2 = auto track, 3 = manual normal, 4 = manual sport, 5 = manual track, 6 = electric mode, 7 = eco mode)\r\n" /end ANNOTATION_TEXT
 /end ANNOTATION
 MATRIX_DIM 8 1 1 /end CHARACTERISTIC
/begin CHARACTERISTIC DWC_EFLASHROMB.DWC_TorqueControl.DWC_TPTWOCLUTCHTPHOLDINSPD "" VALUE 0x80609688 DefaultValueRecordLayout_AUTOSAR_Platform_BaseTypes_uint16 20000.0 RB_PT_PCT_SWC_DWC_CompuMethods_ident 0.0 20000. FORMAT "%10.5"
 /begin ANNOTATION ANNOTATION_LABEL "Description (coming from AUTOSAR DESC field)"
  /begin ANNOTATION_TEXT "Passive clutch slip threshold below which an overlap torque phase is allowed\r\n" /end ANNOTATION_TEXT
 /end ANNOTATION
/end CHARACTERISTIC
/begin CHARACTERISTIC DWC_EFLASHROMB.DWC_TorqueControl.DWC_WSCDRIVENAXLE "" VALUE 0x8060968B DefaultValueRecordLayout_AUTOSAR_Platform_BaseTypes_boolean 255.0 AUTOSAR_Platform_CompuMethods_boolean 0.0 255. FORMAT "%10.5"
 /begin ANNOTATION ANNOTATION_LABEL "Description (coming from AUTOSAR DESC field)" /begin ANNOTATION_TEXT "Switch for driven axle (0 = Rear, 1 = Front)\r\n" /end ANNOTATION_TEXT /end ANNOTATION
/end CHARACTERISTIC
/begin CHARACTERISTIC DWC_EFLASHROMB.DWC_TorqueControl.DWC_WSCUNDRIVENCORRECTIONFACTOR "" VALUE 0x8060968C DefaultValueRecordLayout_AUTOSAR_Platform_BaseTypes_uint8 2.0 RB_PT_PCT_SWC_DWC_CompuMethods_ratio_0p01 0.0 2. FORMAT "%10.5"
 /begin ANNOTATION ANNOTATION_LABEL "Description (coming from AUTOSAR DESC field)"
  /begin ANNOTATION_TEXT "Correction ratio to apply to axle speed to allow for tyre size differences\r\n" /end ANNOTATION_TEXT
 /end ANNOTATION
/end CHARACTERISTIC
/begin CHARACTERISTIC DWC_EFLASHROMB.DWC_WSCUNDRIVENCORRECTIONFACTOR "" VALUE 0x806076FF DefaultValueRecordLayout_AUTOSAR_Platform_BaseTypes_uint8 2.0 RB_PT_PCT_SWC_DWC_CompuMethods_ratio_0p01 0.0 2. FORMAT "%10.5"
 /begin ANNOTATION ANNOTATION_LABEL "Description (coming from AUTOSAR DESC field)"
  /begin ANNOTATION_TEXT "Correction ratio to apply to axle speed to allow for tyre size differences\r\n" /end ANNOTATION_TEXT
 /end ANNOTATION
/end CHARACTERISTIC
/begin CHARACTERISTIC DWC_PAACOUTPUTSPEEDENABLE "signed integer 16bit" VALUE 0x8060401E DefaultValueRecordLayout_AUTOSAR_Platform_BaseTypes_sint16 40000.0 RB_PT_PCT_SWC_DWC_CompuMethods_ident -20000. 20000. FORMAT "%10.5"
 /begin ANNOTATION ANNOTATION_LABEL "Description (coming from AUTOSAR DESC field)" /begin ANNOTATION_TEXT "Output shaft speed to enable autoclosure\r\n" /end ANNOTATION_TEXT /end ANNOTATION
/end CHARACTERISTIC
/begin CHARACTERISTIC DWC_PAACROADSLOPEENABLE "signed integer 16bit" VALUE 0x8060401C DefaultValueRecordLayout_AUTOSAR_Platform_BaseTypes_sint16 65.4 RB_PT_PCT_SWC_DWC_CompuMethods_ratio_0p001__2 -32.7 32.7 FORMAT "%10.5"
 /begin ANNOTATION ANNOTATION_LABEL "Description (coming from AUTOSAR DESC field)" /begin ANNOTATION_TEXT "Minimum gradient for auto closure\r\n" /end ANNOTATION_TEXT /end ANNOTATION
/end CHARACTERISTIC
/begin CHARACTERISTIC IOP_MINIDLEECO "unsigned integer 16bit" VALUE 0x8060401A DefaultValueRecordLayout_AUTOSAR_Platform_BaseTypes_uint16 1000.0 RB_PT_PCT_SWC_DWC_CompuMethods_Speed_50p0 500. 1500. FORMAT "%10.5"
 /begin ANNOTATION ANNOTATION_LABEL "Description (coming from AUTOSAR DESC field)" /begin ANNOTATION_TEXT "Default minimum engine idle speed when in ECO\r\n" /end ANNOTATION_TEXT /end ANNOTATION
/end CHARACTERISTIC
/begin CHARACTERISTIC IOP_MINIDLEECOCREEP "unsigned integer 16bit" VALUE 0x80604018 DefaultValueRecordLayout_AUTOSAR_Platform_BaseTypes_uint16 1000.0 RB_PT_PCT_SWC_DWC_CompuMethods_Speed_50p0 500. 1500. FORMAT "%10.5"
 /begin ANNOTATION ANNOTATION_LABEL "Description (coming from AUTOSAR DESC field)"
  /begin ANNOTATION_TEXT "Default minimum engine idle speed when in ECO but entering creep\r\n" /end ANNOTATION_TEXT
 /end ANNOTATION
/end CHARACTERISTIC
/begin CHARACTERISTIC ENG_EngineInterface_CALIB.ENG_DEFAULTTORQUE "" VALUE 0x80610A42 DefaultValueRecordLayout_AUTOSAR_Platform_BaseTypes_uint16 2047.75 RB_PT_PCT_SWC_ENG_CompuMethods_torque_0p25_m500 -500. 1547.75 FORMAT "%10.5"
 /begin ANNOTATION ANNOTATION_LABEL "Description (coming from AUTOSAR DESC field)" /begin ANNOTATION_TEXT "Value to transmit as default torque\r\n" /end ANNOTATION_TEXT /end ANNOTATION
/end CHARACTERISTIC
/begin CHARACTERISTIC ENG_EngineInterface_CALIB.ENG_EngineInterface.ENG_ENABLEFORCEDPOSGRAD "" VALUE 0x80610A52 DefaultValueRecordLayout_AUTOSAR_Platform_BaseTypes_boolean 255.0 AUTOSAR_Platform_CompuMethods_boolean 0.0 255. FORMAT "%10.5"
 /begin ANNOTATION ANNOTATION_LABEL "Description (coming from AUTOSAR DESC field)"
  /begin ANNOTATION_TEXT "Enable forced positive gradient when final speed target is greater than current speed target.\r\n" /end ANNOTATION_TEXT
 /end ANNOTATION
/end CHARACTERISTIC
/begin CHARACTERISTIC ENG_EngineInterface_CALIB.ENG_EngineInterface.ENG_ENABLESPDTRGMET "" VALUE 0x80610A53 DefaultValueRecordLayout_AUTOSAR_Platform_BaseTypes_uint8 2.0 RB_PT_PCT_SWC_ENG_CompuMethods_ident 0.0 2. FORMAT "%10.5"
 /begin ANNOTATION ANNOTATION_LABEL "Description (coming from AUTOSAR DESC field)" /begin ANNOTATION_TEXT "Enable check to be within threshold of target shaft.\r\n" /end ANNOTATION_TEXT /end ANNOTATION
/end CHARACTERISTIC
/begin CHARACTERISTIC ENG_EngineInterface_CALIB.ENG_EngineInterface.ENG_EnableSSASGGrd "" VALUE 0x80610A54 DefaultValueRecordLayout_AUTOSAR_Platform_BaseTypes_boolean 255.0 AUTOSAR_Platform_CompuMethods_boolean 0.0 255. FORMAT "%10.5"
 /begin ANNOTATION ANNOTATION_LABEL "Description (coming from AUTOSAR DESC field)" /begin ANNOTATION_TEXT "Flag to enable ASG gradient map for cranking.\r\n" /end ANNOTATION_TEXT /end ANNOTATION
/end CHARACTERISTIC
/begin CHARACTERISTIC ENG_EngineInterface_CALIB.ENG_EngineInterface.ENG_ENGINECRANKTHRESH "" VALUE 0x80610A46 DefaultValueRecordLayout_AUTOSAR_Platform_BaseTypes_uint16 20000.0 RB_PT_PCT_SWC_ENG_CompuMethods_ident 0.0 20000. FORMAT "%10.5"
 /begin ANNOTATION ANNOTATION_LABEL "Description (coming from AUTOSAR DESC field)" /begin ANNOTATION_TEXT "Engine speed threshold to check for engine crank.\r\n" /end ANNOTATION_TEXT /end ANNOTATION
/end CHARACTERISTIC
/begin CHARACTERISTIC ENG_EngineInterface_CALIB.ENG_EngineInterface.ENG_FLGALLOWNEGROLLOFFGRAD "" VALUE 0x80610A55 DefaultValueRecordLayout_AUTOSAR_Platform_BaseTypes_boolean 255.0 AUTOSAR_Platform_CompuMethods_boolean 0.0 255. FORMAT "%10.5"
 /begin ANNOTATION ANNOTATION_LABEL "Description (coming from AUTOSAR DESC field)"
  /begin ANNOTATION_TEXT "Flag to allow negative roll off gradient (Start torque higher than end torque.)\r\n" /end ANNOTATION_TEXT
 /end ANNOTATION
/end CHARACTERISTIC
/begin CHARACTERISTIC ENG_EngineInterface_CALIB.ENG_EngineInterface.ENG_GTENGTQCUTMAXTIME "" VALUE 0x80610A48 DefaultValueRecordLayout_AUTOSAR_Platform_BaseTypes_uint16 1.5 RB_PT_PCT_SWC_ENG_CompuMethods_ratio_0p01 0.0 1.5 FORMAT "%10.5"
 /begin ANNOTATION ANNOTATION_LABEL "Description (coming from AUTOSAR DESC field)" /begin ANNOTATION_TEXT "Max time for torque cut off during GT shift.\r\n" /end ANNOTATION_TEXT /end ANNOTATION
/end CHARACTERISTIC
/begin CHARACTERISTIC ENG_EngineInterface_CALIB.ENG_EngineInterface.ENG_GTENGTQREDUCTION "" MAP 0x80610A5C RB_PT_PCT_SWC_ENG_RecordLayouts_RL_Map_sint16_64_uint16_8_uint8_8 4000.0 RB_PT_PCT_SWC_ENG_CompuMethods_ratio_0p1 -2000. 2000. FORMAT "%10.5"
 /begin ANNOTATION ANNOTATION_LABEL "Description (coming from AUTOSAR DESC field)"
  /begin ANNOTATION_TEXT "Map of torque reduction in function of engine speed and throttle pedal.\r\n" /end ANNOTATION_TEXT
 /end ANNOTATION
 /begin AXIS_DESCR STD_AXIS NO_INPUT_QUANTITY RB_PT_PCT_SWC_ENG_CompuMethods_ident 8 0.0 20000. FORMAT "%10.5" DEPOSIT ABSOLUTE /end AXIS_DESCR
 /begin AXIS_DESCR STD_AXIS NO_INPUT_QUANTITY RB_PT_PCT_SWC_ENG_CompuMethods_ratio_0p4 8 0.0 102. FORMAT "%10.5" DEPOSIT ABSOLUTE /end AXIS_DESCR
/end CHARACTERISTIC
/begin CHARACTERISTIC ENG_EngineInterface_CALIB.ENG_EngineInterface.ENG_IDLEACTDRVTQTHRESH "" VALUE 0x80610A4A DefaultValueRecordLayout_AUTOSAR_Platform_BaseTypes_sint16 4000.0 RB_PT_PCT_SWC_ENG_CompuMethods_ratio_0p1 -2000. 2000. FORMAT "%10.5"
 /begin ANNOTATION ANNOTATION_LABEL "Description (coming from AUTOSAR DESC field)" /begin ANNOTATION_TEXT "Idle active driver torque threshold.\r\n" /end ANNOTATION_TEXT /end ANNOTATION
/end CHARACTERISTIC
/begin CHARACTERISTIC ENG_EngineInterface_CALIB.ENG_EngineInterface.ENG_IDLEACTIVELIMON "" VALUE 0x80610A56 DefaultValueRecordLayout_AUTOSAR_Platform_BaseTypes_boolean 255.0 AUTOSAR_Platform_CompuMethods_boolean 0.0 255. FORMAT "%10.5"
 /begin ANNOTATION ANNOTATION_LABEL "Description (coming from AUTOSAR DESC field)" /begin ANNOTATION_TEXT "Turn on idle speed limit for idle active.\r\n" /end ANNOTATION_TEXT /end ANNOTATION
/end CHARACTERISTIC
/begin CHARACTERISTIC ENG_EngineInterface_CALIB.ENG_EngineInterface.ENG_IDLEACTIVEThreshDRVTQ "" VALUE 0x80610A57 DefaultValueRecordLayout_AUTOSAR_Platform_BaseTypes_boolean 255.0 AUTOSAR_Platform_CompuMethods_boolean 0.0 255. FORMAT "%10.5"
 /begin ANNOTATION ANNOTATION_LABEL "Description (coming from AUTOSAR DESC field)"
  /begin ANNOTATION_TEXT "Enable idle active if driver torque is equal or below threshold.\r\n" /end ANNOTATION_TEXT
 /end ANNOTATION
/end CHARACTERISTIC
/begin CHARACTERISTIC ENG_EngineInterface_CALIB.ENG_EngineInterface.ENG_MINIMUMTORQUERESERVE "" VALUE 0x80610A4C DefaultValueRecordLayout_AUTOSAR_Platform_BaseTypes_uint16 2047.75 RB_PT_PCT_SWC_ENG_CompuMethods_torque_0p25_m500 -500. 1547.75 FORMAT "%10.5"
 /begin ANNOTATION ANNOTATION_LABEL "Description (coming from AUTOSAR DESC field)" /begin ANNOTATION_TEXT "Minimum torque reserve request that can be set\r\n" /end ANNOTATION_TEXT /end ANNOTATION
/end CHARACTERISTIC
/begin CHARACTERISTIC ENG_EngineInterface_CALIB.ENG_EngineInterface.ENG_MINIMUMTORQUERESERVEASGDOWN "" VALUE 0x80610A4E DefaultValueRecordLayout_AUTOSAR_Platform_BaseTypes_uint16 2047.75 RB_PT_PCT_SWC_ENG_CompuMethods_torque_0p25_m500 -500. 1547.75 FORMAT "%10.5"
 /begin ANNOTATION ANNOTATION_LABEL "Description (coming from AUTOSAR DESC field)" /begin ANNOTATION_TEXT "Minimum torque reserve request that can be set\r\n" /end ANNOTATION_TEXT /end ANNOTATION
/end CHARACTERISTIC
/begin CHARACTERISTIC ENG_EngineInterface_CALIB.ENG_EngineInterface.ENG_PullawayControl.ENG_FLGDISABLETQRES "" VALUE 0x80610A5A DefaultValueRecordLayout_AUTOSAR_Platform_BaseTypes_boolean 255.0 AUTOSAR_Platform_CompuMethods_boolean 0.0 255. FORMAT "%10.5"
 /begin ANNOTATION ANNOTATION_LABEL "Description (coming from AUTOSAR DESC field)" /begin ANNOTATION_TEXT "Set true to disable torque reserve in pullaway\r\n" /end ANNOTATION_TEXT /end ANNOTATION
/end CHARACTERISTIC
/begin CHARACTERISTIC ENG_EngineInterface_CALIB.ENG_EngineInterface.ENG_PullawayControl.ENG_FLGOVERRIDEMAXTQSLOW "" VALUE 0x80610A5B DefaultValueRecordLayout_AUTOSAR_Platform_BaseTypes_boolean 255.0 AUTOSAR_Platform_CompuMethods_boolean 0.0 255. FORMAT "%10.5"
 /begin ANNOTATION ANNOTATION_LABEL "Description (coming from AUTOSAR DESC field)"
  /begin ANNOTATION_TEXT "Set true to remove impact of max torque slow on torque reserve\r\n" /end ANNOTATION_TEXT
 /end ANNOTATION
/end CHARACTERISTIC
/begin CHARACTERISTIC ENG_EngineInterface_CALIB.ENG_EngineInterface.ENG_SSCONDITIONENABLE "" VALUE 0x80610A58 DefaultValueRecordLayout_AUTOSAR_Platform_BaseTypes_uint8 253.0 RB_PT_PCT_SWC_ENG_CompuMethods_ident 2. 255. FORMAT "%10.5"
 /begin ANNOTATION ANNOTATION_LABEL "Description (coming from AUTOSAR DESC field)"
  /begin ANNOTATION_TEXT "Use to enable logic checks. Bitfield, 1 = enable, 2 =Speed check, 4 = Flexray\r\n" /end ANNOTATION_TEXT
 /end ANNOTATION
/end CHARACTERISTIC
/begin CHARACTERISTIC ENG_EngineInterface_CALIB.ENG_EngineInterface.ENG_SSDBNCETIME "" VALUE 0x80610A50 DefaultValueRecordLayout_AUTOSAR_Platform_BaseTypes_uint16 10.0 RB_PT_PCT_SWC_ENG_CompuMethods_ratio_0p01 0.0 10. FORMAT "%10.5"
 /begin ANNOTATION ANNOTATION_LABEL "Description (coming from AUTOSAR DESC field)"
  /begin ANNOTATION_TEXT "Time above engine threshold for engine to be considered running.\r\n" /end ANNOTATION_TEXT
 /end ANNOTATION
/end CHARACTERISTIC
/begin CHARACTERISTIC ENG_EngineInterface_CALIB.ENG_MAXEXTENDMODULATETIME "" VALUE 0x80610A44 DefaultValueRecordLayout_AUTOSAR_Platform_BaseTypes_uint16 655.35 RB_PT_PCT_SWC_ENG_CompuMethods_DST_Time 0.0 655.35 FORMAT "%10.5"
 /begin ANNOTATION ANNOTATION_LABEL "Description (coming from AUTOSAR DESC field)" /begin ANNOTATION_TEXT "Max extend modulate torque time\r\n" /end ANNOTATION_TEXT /end ANNOTATION
/end CHARACTERISTIC
/begin CHARACTERISTIC ENG_EngineInterface_EFLASHB.ENG_EngineInterface.ENG_ACTIVATESPEEDCONTROLDEBOUNCETIME "" VALUE 0x80610042 DefaultValueRecordLayout_AUTOSAR_Platform_BaseTypes_uint16 655.35 RB_PT_PCT_SWC_ENG_CompuMethods_DST_Time 0.0 655.35 FORMAT "%10.5"
 /begin ANNOTATION ANNOTATION_LABEL "Description (coming from AUTOSAR DESC field)"
  /begin ANNOTATION_TEXT "Debounce time for activation of speed control during torque phase of power-on upshifts\r\n" /end ANNOTATION_TEXT
 /end ANNOTATION
/end CHARACTERISTIC
/begin CHARACTERISTIC ENG_EngineInterface_EFLASHB.ENG_EngineInterface.ENG_ASGDWNENGINENOGEARBOXMAX "" VALUE 0x80610044 DefaultValueRecordLayout_AUTOSAR_Platform_BaseTypes_sint16 4000.0 RB_PT_PCT_SWC_ENG_CompuMethods_ratio_0p1 -2000. 2000. FORMAT "%10.5"
 /begin ANNOTATION ANNOTATION_LABEL "Description (coming from AUTOSAR DESC field)" /begin ANNOTATION_TEXT "Maximum negative start torque\r\n" /end ANNOTATION_TEXT /end ANNOTATION
/end CHARACTERISTIC
/begin CHARACTERISTIC ENG_EngineInterface_EFLASHB.ENG_EngineInterface.ENG_CylinderCut.ENG_ALLOWCYLINDERCUTDURINGBRAKEINTERVENTION "" VALUE 0x8061008C DefaultValueRecordLayout_AUTOSAR_Platform_BaseTypes_boolean 255.0 AUTOSAR_Platform_CompuMethods_boolean 0.0 255. FORMAT "%10.5"
 /begin ANNOTATION ANNOTATION_LABEL "Description (coming from AUTOSAR DESC field)" /begin ANNOTATION_TEXT "Flag to force cylinder cut to be requested\r\n" /end ANNOTATION_TEXT /end ANNOTATION
/end CHARACTERISTIC
/begin CHARACTERISTIC ENG_EngineInterface_EFLASHB.ENG_EngineInterface.ENG_CylinderCut.ENG_CYLINDERCUTDURATION1 "" MAP 0x8061008E RB_PT_PCT_SWC_ENG_RecordLayouts_RL_Map_uint8_64_uint16_8_uint8_8 2.55 RB_PT_PCT_SWC_ENG_CompuMethods_ratio_0p01 0.0 2.55 FORMAT "%10.5"
 /begin ANNOTATION ANNOTATION_LABEL "Description (coming from AUTOSAR DESC field)" /begin ANNOTATION_TEXT "Cylinder cut duration in normal mode\r\n" /end ANNOTATION_TEXT /end ANNOTATION
 /begin AXIS_DESCR STD_AXIS NO_INPUT_QUANTITY RB_PT_PCT_SWC_ENG_CompuMethods_ident 8 0.0 20000. FORMAT "%10.5" DEPOSIT ABSOLUTE /end AXIS_DESCR
 /begin AXIS_DESCR STD_AXIS NO_INPUT_QUANTITY RB_PT_PCT_SWC_ENG_CompuMethods_ident 8 0.0 11. FORMAT "%10.5" DEPOSIT ABSOLUTE /end AXIS_DESCR
/end CHARACTERISTIC
/begin CHARACTERISTIC ENG_EngineInterface_EFLASHB.ENG_EngineInterface.ENG_CylinderCut.ENG_CYLINDERCUTDURATION2 "" MAP 0x806100EA RB_PT_PCT_SWC_ENG_RecordLayouts_RL_Map_uint8_64_uint16_8_uint8_8 2.55 RB_PT_PCT_SWC_ENG_CompuMethods_ratio_0p01 0.0 2.55 FORMAT "%10.5"
 /begin ANNOTATION ANNOTATION_LABEL "Description (coming from AUTOSAR DESC field)" /begin ANNOTATION_TEXT "Cylinder cut duration in sport mode\r\n" /end ANNOTATION_TEXT /end ANNOTATION
 /begin AXIS_DESCR STD_AXIS NO_INPUT_QUANTITY RB_PT_PCT_SWC_ENG_CompuMethods_ident 8 0.0 20000. FORMAT "%10.5" DEPOSIT ABSOLUTE /end AXIS_DESCR
 /begin AXIS_DESCR STD_AXIS NO_INPUT_QUANTITY RB_PT_PCT_SWC_ENG_CompuMethods_ident 8 0.0 11. FORMAT "%10.5" DEPOSIT ABSOLUTE /end AXIS_DESCR
/end CHARACTERISTIC
/begin CHARACTERISTIC ENG_EngineInterface_EFLASHB.ENG_EngineInterface.ENG_CylinderCut.ENG_CYLINDERCUTDURATION3 "" MAP 0x80610146 RB_PT_PCT_SWC_ENG_RecordLayouts_RL_Map_uint8_64_uint16_8_uint8_8 2.55 RB_PT_PCT_SWC_ENG_CompuMethods_ratio_0p01 0.0 2.55 FORMAT "%10.5"
 /begin ANNOTATION ANNOTATION_LABEL "Description (coming from AUTOSAR DESC field)" /begin ANNOTATION_TEXT "Cylinder cut duration in track mode\r\n" /end ANNOTATION_TEXT /end ANNOTATION
 /begin AXIS_DESCR STD_AXIS NO_INPUT_QUANTITY RB_PT_PCT_SWC_ENG_CompuMethods_ident 8 0.0 20000. FORMAT "%10.5" DEPOSIT ABSOLUTE /end AXIS_DESCR
 /begin AXIS_DESCR STD_AXIS NO_INPUT_QUANTITY RB_PT_PCT_SWC_ENG_CompuMethods_ident 8 0.0 11. FORMAT "%10.5" DEPOSIT ABSOLUTE /end AXIS_DESCR
/end CHARACTERISTIC
/begin CHARACTERISTIC ENG_EngineInterface_EFLASHB.ENG_EngineInterface.ENG_CylinderCut.ENG_CYLINDERCUTMAPSELECT "" VAL_BLK 0x80610082 DefaultValueRecordLayout_AUTOSAR_Platform_BaseTypes_uint8 2.0 RB_PT_PCT_SWC_ENG_CompuMethods_ident 1. 3. FORMAT "%10.5"
 /begin ANNOTATION ANNOTATION_LABEL "Description (coming from AUTOSAR DESC field)"
  /begin ANNOTATION_TEXT "Array to select the clinder cut duration map based on DWC_ShiftModeUdisc\r\n" /end ANNOTATION_TEXT
 /end ANNOTATION
 MATRIX_DIM 8 1 1 /end CHARACTERISTIC
/begin CHARACTERISTIC ENG_EngineInterface_EFLASHB.ENG_EngineInterface.ENG_CylinderCut.ENG_CYLINDERCUTONCOMINGUPTARGET "" MAP 0x806101A2 RB_PT_PCT_SWC_ENG_RecordLayouts_RL_Map_uint16_48_uint16_6_sint16_8 20000.0 RB_PT_PCT_SWC_ENG_CompuMethods_ident 0.0 20000. FORMAT "%10.5"
 /begin ANNOTATION ANNOTATION_LABEL "Description (coming from AUTOSAR DESC field)"
  /begin ANNOTATION_TEXT "Maximum slip above oncoming clutch before cylinder cut is forced off\r\n" /end ANNOTATION_TEXT
 /end ANNOTATION
 /begin AXIS_DESCR STD_AXIS NO_INPUT_QUANTITY RB_PT_PCT_SWC_ENG_CompuMethods_ident 6 0.0 20000. FORMAT "%10.5" DEPOSIT ABSOLUTE /end AXIS_DESCR
 /begin AXIS_DESCR STD_AXIS NO_INPUT_QUANTITY RB_PT_PCT_SWC_ENG_CompuMethods_ident 8 -32000. 32000. FORMAT "%10.5" DEPOSIT ABSOLUTE /end AXIS_DESCR
/end CHARACTERISTIC
/begin CHARACTERISTIC ENG_EngineInterface_EFLASHB.ENG_EngineInterface.ENG_CylinderCut.ENG_MAXPUSHFACTORFORCYLCUT "" VALUE 0x8061008A DefaultValueRecordLayout_AUTOSAR_Platform_BaseTypes_uint16 1.0 RB_PT_PCT_SWC_ENG_CompuMethods_ratio_0p001 0.0 1. FORMAT "%10.5"
 /begin ANNOTATION ANNOTATION_LABEL "Description (coming from AUTOSAR DESC field)" /begin ANNOTATION_TEXT "Maximum clutch push factor allowed with cylinder cut\r\n" /end ANNOTATION_TEXT /end ANNOTATION
/end CHARACTERISTIC
/begin CHARACTERISTIC ENG_EngineInterface_EFLASHB.ENG_EngineInterface.ENG_ENABLEMINIDLEREQ "" VALUE 0x80610078 DefaultValueRecordLayout_AUTOSAR_Platform_BaseTypes_boolean 255.0 AUTOSAR_Platform_CompuMethods_boolean 0.0 255. FORMAT "%10.5"
 /begin ANNOTATION ANNOTATION_LABEL "Description (coming from AUTOSAR DESC field)" /begin ANNOTATION_TEXT "TEMPORARY PARAMETER - REMOVE\r\n" /end ANNOTATION_TEXT /end ANNOTATION
/end CHARACTERISTIC
/begin CHARACTERISTIC ENG_EngineInterface_EFLASHB.ENG_EngineInterface.ENG_ENGINESPEEDERRORTHRESHOLD "" VALUE 0x80610046 DefaultValueRecordLayout_AUTOSAR_Platform_BaseTypes_uint16 10.0 RB_PT_PCT_SWC_ENG_CompuMethods_ratio_0p001 0.0 10. FORMAT "%10.5"
 /begin ANNOTATION ANNOTATION_LABEL "Description (coming from AUTOSAR DESC field)" /begin ANNOTATION_TEXT "Threshold for setting a failure\r\n" /end ANNOTATION_TEXT /end ANNOTATION
/end CHARACTERISTIC
/begin CHARACTERISTIC ENG_EngineInterface_EFLASHB.ENG_EngineInterface.ENG_ENGINETORQUESTABLESPEEDMODE "" VAL_BLK 0x80610034 DefaultValueRecordLayout_AUTOSAR_Platform_BaseTypes_uint16 2000.0 RB_PT_PCT_SWC_ENG_CompuMethods_ratio_0p1 0.0 2000. FORMAT "%10.5"
 /begin ANNOTATION ANNOTATION_LABEL "Description (coming from AUTOSAR DESC field)"
  /begin ANNOTATION_TEXT "Complete threshold for engine torque against mode - 0 = AUTONORMAL, 1 = AUTOSPORT, 2 = AUTOTRACK, 3 = MANUALNORMAL, 4 = MANUALSPORT, 5 = MANUALTRACK\r\n" /end ANNOTATION_TEXT
 /end ANNOTATION
 MATRIX_DIM 7 1 1 /end CHARACTERISTIC
/begin CHARACTERISTIC ENG_EngineInterface_EFLASHB.ENG_EngineInterface.ENG_IDLEACTIVESPEEDMARGIN "" VALUE 0x80610048 DefaultValueRecordLayout_AUTOSAR_Platform_BaseTypes_uint16 20000.0 RB_PT_PCT_SWC_ENG_CompuMethods_ident 0.0 20000. FORMAT "%10.5"
 /begin ANNOTATION ANNOTATION_LABEL "Description (coming from AUTOSAR DESC field)"
  /begin ANNOTATION_TEXT "Margin above the idle speed setpoint above which idle is considered inactive\r\n" /end ANNOTATION_TEXT
 /end ANNOTATION
/end CHARACTERISTIC
/begin CHARACTERISTIC ENG_EngineInterface_EFLASHB.ENG_EngineInterface.ENG_INNEUTRALTORQUE "" VALUE 0x8061004A DefaultValueRecordLayout_AUTOSAR_Platform_BaseTypes_sint16 4000.0 RB_PT_PCT_SWC_ENG_CompuMethods_ratio_0p1 -2000. 2000. FORMAT "%10.5"
 /begin ANNOTATION ANNOTATION_LABEL "Description (coming from AUTOSAR DESC field)" /begin ANNOTATION_TEXT "Value of torque to transmit if in Neutral\r\n" /end ANNOTATION_TEXT /end ANNOTATION
/end CHARACTERISTIC
/begin CHARACTERISTIC ENG_EngineInterface_EFLASHB.ENG_EngineInterface.ENG_MAXENGINESPEED "" VALUE 0x8061004C DefaultValueRecordLayout_AUTOSAR_Platform_BaseTypes_uint16 20000.0 RB_PT_PCT_SWC_ENG_CompuMethods_ident 0.0 20000. FORMAT "%10.5"
 /begin ANNOTATION ANNOTATION_LABEL "Description (coming from AUTOSAR DESC field)" /begin ANNOTATION_TEXT "maximum allowable engine speed\r\n" /end ANNOTATION_TEXT /end ANNOTATION
/end CHARACTERISTIC
/begin CHARACTERISTIC ENG_EngineInterface_EFLASHB.ENG_EngineInterface.ENG_MAXENGINESPEEDOFFSET "" VALUE 0x8061004E DefaultValueRecordLayout_AUTOSAR_Platform_BaseTypes_sint16 40000.0 RB_PT_PCT_SWC_ENG_CompuMethods_ident -20000. 20000. FORMAT "%10.5"
 /begin ANNOTATION ANNOTATION_LABEL "Description (coming from AUTOSAR DESC field)"
  /begin ANNOTATION_TEXT "Offset to be applied to maximum engine speed received on CAN for limiting of maximum target engine speed\r\n" /end ANNOTATION_TEXT
 /end ANNOTATION
/end CHARACTERISTIC
/begin CHARACTERISTIC ENG_EngineInterface_EFLASHB.ENG_EngineInterface.ENG_MAXNENGFORNORMALENGAGEMENT "" VALUE 0x80610050 DefaultValueRecordLayout_AUTOSAR_Platform_BaseTypes_sint16 20000.0 RB_PT_PCT_SWC_ENG_CompuMethods_ident 0.0 20000. FORMAT "%10.5"
 /begin ANNOTATION ANNOTATION_LABEL "Description (coming from AUTOSAR DESC field)"
  /begin ANNOTATION_TEXT "Max Engine speed to be used when detecting normal engagement to cancel roll on time\r\n" /end ANNOTATION_TEXT
 /end ANNOTATION
/end CHARACTERISTIC
/begin CHARACTERISTIC ENG_EngineInterface_EFLASHB.ENG_EngineInterface.ENG_MAXOPSPEEDFORNORMALENGAGEMENT "" VALUE 0x80610052 DefaultValueRecordLayout_AUTOSAR_Platform_BaseTypes_sint16 40000.0 RB_PT_PCT_SWC_ENG_CompuMethods_ident -20000. 20000. FORMAT "%10.5"
 /begin ANNOTATION ANNOTATION_LABEL "Description (coming from AUTOSAR DESC field)"
  /begin ANNOTATION_TEXT "Max output shaft speed to be used when detecting normal engagement to cancel roll on time\r\n" /end ANNOTATION_TEXT
 /end ANNOTATION
/end CHARACTERISTIC
/begin CHARACTERISTIC ENG_EngineInterface_EFLASHB.ENG_EngineInterface.ENG_MAXPEDALFORNORMALENGAGEMENT "" VALUE 0x80610079 DefaultValueRecordLayout_AUTOSAR_Platform_BaseTypes_uint8 102.0 RB_PT_PCT_SWC_ENG_CompuMethods_ratio_0p4 0.0 102. FORMAT "%10.5"
 /begin ANNOTATION ANNOTATION_LABEL "Description (coming from AUTOSAR DESC field)"
  /begin ANNOTATION_TEXT "Max throttle pedal to be used when detecting normal engagement to cancel roll on time\r\n" /end ANNOTATION_TEXT
 /end ANNOTATION
/end CHARACTERISTIC
/begin CHARACTERISTIC ENG_EngineInterface_EFLASHB.ENG_EngineInterface.ENG_MAXSPEEDTIME "" VALUE 0x80610054 DefaultValueRecordLayout_AUTOSAR_Platform_BaseTypes_uint16 655.35 RB_PT_PCT_SWC_ENG_CompuMethods_DST_Time 0.0 655.35 FORMAT "%10.5"
 /begin ANNOTATION ANNOTATION_LABEL "Description (coming from AUTOSAR DESC field)" /begin ANNOTATION_TEXT "Maximum speed control time\r\n" /end ANNOTATION_TEXT /end ANNOTATION
/end CHARACTERISTIC
/begin CHARACTERISTIC ENG_EngineInterface_EFLASHB.ENG_EngineInterface.ENG_MAXSPEEDTIMEOFFSET "" VALUE 0x80610056 DefaultValueRecordLayout_AUTOSAR_Platform_BaseTypes_uint16 655.35 RB_PT_PCT_SWC_ENG_CompuMethods_DST_Time 0.0 655.35 FORMAT "%10.5"
 /begin ANNOTATION ANNOTATION_LABEL "Description (coming from AUTOSAR DESC field)"
  /begin ANNOTATION_TEXT "Offset applied to maximum speed control time when calculating minimum speed control gradient\r\n" /end ANNOTATION_TEXT
 /end ANNOTATION
/end CHARACTERISTIC
/begin CHARACTERISTIC ENG_EngineInterface_EFLASHB.ENG_EngineInterface.ENG_MAXSTARTTORQUENEG "" VALUE 0x80610058 DefaultValueRecordLayout_AUTOSAR_Platform_BaseTypes_sint16 4000.0 RB_PT_PCT_SWC_ENG_CompuMethods_ratio_0p1 -2000. 2000. FORMAT "%10.5"
 /begin ANNOTATION ANNOTATION_LABEL "Description (coming from AUTOSAR DESC field)" /begin ANNOTATION_TEXT "Maximum negative start torque\r\n" /end ANNOTATION_TEXT /end ANNOTATION
/end CHARACTERISTIC
/begin CHARACTERISTIC ENG_EngineInterface_EFLASHB.ENG_EngineInterface.ENG_MAXSTARTTORQUEPOS "" VALUE 0x8061005A DefaultValueRecordLayout_AUTOSAR_Platform_BaseTypes_sint16 4000.0 RB_PT_PCT_SWC_ENG_CompuMethods_ratio_0p1 -2000. 2000. FORMAT "%10.5"
 /begin ANNOTATION ANNOTATION_LABEL "Description (coming from AUTOSAR DESC field)" /begin ANNOTATION_TEXT "Maximum positive start torque\r\n" /end ANNOTATION_TEXT /end ANNOTATION
/end CHARACTERISTIC
/begin CHARACTERISTIC ENG_EngineInterface_EFLASHB.ENG_EngineInterface.ENG_MAXTHROTTLEFORROLLTIME "" VALUE 0x8061007A DefaultValueRecordLayout_AUTOSAR_Platform_BaseTypes_uint8 102.0 RB_PT_PCT_SWC_ENG_CompuMethods_ratio_0p4 0.0 102. FORMAT "%10.5"
 /begin ANNOTATION ANNOTATION_LABEL "Description (coming from AUTOSAR DESC field)"
  /begin ANNOTATION_TEXT "Max allowable throttle to allow roll on time to be based on throttle pedal\r\n" /end ANNOTATION_TEXT
 /end ANNOTATION
/end CHARACTERISTIC
/begin CHARACTERISTIC ENG_EngineInterface_EFLASHB.ENG_EngineInterface.ENG_MINBRAKEFORNORMALENGAGEMENT "" VALUE 0x8061005C DefaultValueRecordLayout_AUTOSAR_Platform_BaseTypes_uint16 409.6 RB_PT_PCT_SWC_ENG_CompuMethods_ratio_0p1 0.0 409.6 FORMAT "%10.5"
 /begin ANNOTATION ANNOTATION_LABEL "Description (coming from AUTOSAR DESC field)"
  /begin ANNOTATION_TEXT "Max throttle pedal to be used when detecting normal engagement to cancel roll on time\r\n" /end ANNOTATION_TEXT
 /end ANNOTATION
/end CHARACTERISTIC
/begin CHARACTERISTIC ENG_EngineInterface_EFLASHB.ENG_EngineInterface.ENG_MINCUPOFFUEL "" VALUE 0x8061005E DefaultValueRecordLayout_AUTOSAR_Platform_BaseTypes_sint16 8191.0 RB_PT_PCT_SWC_ENG_CompuMethods_ident 0.0 8191. FORMAT "%10.5"
 /begin ANNOTATION ANNOTATION_LABEL "Description (coming from AUTOSAR DESC field)"
  /begin ANNOTATION_TEXT "Minimum value in te ciup of fuel signal before completing speed control\r\n" /end ANNOTATION_TEXT
 /end ANNOTATION
/end CHARACTERISTIC
/begin CHARACTERISTIC ENG_EngineInterface_EFLASHB.ENG_EngineInterface.ENG_MINSTARTTORQUENEG "" VALUE 0x80610060 DefaultValueRecordLayout_AUTOSAR_Platform_BaseTypes_sint16 4000.0 RB_PT_PCT_SWC_ENG_CompuMethods_ratio_0p1 -2000. 2000. FORMAT "%10.5"
 /begin ANNOTATION ANNOTATION_LABEL "Description (coming from AUTOSAR DESC field)" /begin ANNOTATION_TEXT "Minimum negative start torque\r\n" /end ANNOTATION_TEXT /end ANNOTATION
/end CHARACTERISTIC
/begin CHARACTERISTIC ENG_EngineInterface_EFLASHB.ENG_EngineInterface.ENG_MINSTARTTORQUEPOS "" VALUE 0x80610062 DefaultValueRecordLayout_AUTOSAR_Platform_BaseTypes_sint16 4000.0 RB_PT_PCT_SWC_ENG_CompuMethods_ratio_0p1 -2000. 2000. FORMAT "%10.5"
 /begin ANNOTATION ANNOTATION_LABEL "Description (coming from AUTOSAR DESC field)" /begin ANNOTATION_TEXT "Minimum positive start torque\r\n" /end ANNOTATION_TEXT /end ANNOTATION
/end CHARACTERISTIC
/begin CHARACTERISTIC ENG_EngineInterface_EFLASHB.ENG_EngineInterface.ENG_PEDALTHRESHGRADIENTSELECT "" VALUE 0x8061007B DefaultValueRecordLayout_AUTOSAR_Platform_BaseTypes_uint8 99.45 RB_PT_PCT_SWC_ENG_CompuMethods_ratio_0p39 0.0 99.45 FORMAT "%10.5"
 /begin ANNOTATION ANNOTATION_LABEL "Description (coming from AUTOSAR DESC field)"
  /begin ANNOTATION_TEXT "Threshold throttle position for selection of target engine speed gradient during speed control\r\n" /end ANNOTATION_TEXT
 /end ANNOTATION
/end CHARACTERISTIC
/begin CHARACTERISTIC ENG_EngineInterface_EFLASHB.ENG_EngineInterface.ENG_PullawayControl.ENG_DEFAULTSPEED "" VALUE 0x80610222 DefaultValueRecordLayout_AUTOSAR_Platform_BaseTypes_uint16 20000.0 RB_PT_PCT_SWC_ENG_CompuMethods_ident 0.0 20000. FORMAT "%10.5"
 /begin ANNOTATION ANNOTATION_LABEL "Description (coming from AUTOSAR DESC field)" /begin ANNOTATION_TEXT "Default speed\r\n" /end ANNOTATION_TEXT /end ANNOTATION
/end CHARACTERISTIC
/begin CHARACTERISTIC ENG_EngineInterface_EFLASHB.ENG_EngineInterface.ENG_PullawayControl.ENG_ENABLECLUTCHSTATUSOVERRIDE "" VALUE 0x80610224 DefaultValueRecordLayout_AUTOSAR_Platform_BaseTypes_boolean 255.0 AUTOSAR_Platform_CompuMethods_boolean 0.0 255. FORMAT "%10.5"
 /begin ANNOTATION ANNOTATION_LABEL "Description (coming from AUTOSAR DESC field)" /begin ANNOTATION_TEXT "TEMPORARY PARAMETER - REMOVE\r\n" /end ANNOTATION_TEXT /end ANNOTATION
/end CHARACTERISTIC
/begin CHARACTERISTIC ENG_EngineInterface_EFLASHB.ENG_EngineInterface.ENG_PullawayControl.ENG_ENABLENEWDEADPEDALCOND2 "" VALUE 0x80610225 DefaultValueRecordLayout_AUTOSAR_Platform_BaseTypes_boolean 255.0 AUTOSAR_Platform_CompuMethods_boolean 0.0 255. FORMAT "%10.5"
 /begin ANNOTATION ANNOTATION_LABEL "Description (coming from AUTOSAR DESC field)" /begin ANNOTATION_TEXT "TEMPORARY PARAMETER - REMOVE\r\n" /end ANNOTATION_TEXT /end ANNOTATION
/end CHARACTERISTIC
/begin CHARACTERISTIC ENG_EngineInterface_EFLASHB.ENG_EngineInterface.ENG_PullawayControl.ENG_MAXSLOWTORQUEOFFSET "" VALUE 0x80610226 DefaultValueRecordLayout_AUTOSAR_Platform_BaseTypes_sint8 200.0 RB_PT_PCT_SWC_ENG_CompuMethods_ident -100. 100. FORMAT "%10.5"
 /begin ANNOTATION ANNOTATION_LABEL "Description (coming from AUTOSAR DESC field)"
  /begin ANNOTATION_TEXT "Offset relative to maximum slow torque to define allowed maximum engine torque reserve\r\n" /end ANNOTATION_TEXT
 /end ANNOTATION
/end CHARACTERISTIC
/begin CHARACTERISTIC ENG_EngineInterface_EFLASHB.ENG_EngineInterface.ENG_RESETFAILUREFLAG "" VALUE 0x8061007C DefaultValueRecordLayout_AUTOSAR_Platform_BaseTypes_boolean 255.0 AUTOSAR_Platform_CompuMethods_boolean 0.0 255. FORMAT "%10.5"
 /begin ANNOTATION ANNOTATION_LABEL "Description (coming from AUTOSAR DESC field)" /begin ANNOTATION_TEXT "Set ture to reset the ENG failure flag\r\n" /end ANNOTATION_TEXT /end ANNOTATION
/end CHARACTERISTIC
/begin CHARACTERISTIC ENG_EngineInterface_EFLASHB.ENG_EngineInterface.ENG_ROLLOFFTIMEMAP "" MAP 0x8061027C RB_PT_PCT_SWC_ENG_RecordLayouts_RL_Map_uint16_54_uint16_9_sint16_6 10.0 RB_PT_PCT_SWC_ENG_CompuMethods_ratio_0p01 0.0 10. FORMAT "%10.5"
 /begin ANNOTATION ANNOTATION_LABEL "Description (coming from AUTOSAR DESC field)"
  /begin ANNOTATION_TEXT "Map to drive roll off time based on starting RPM and mode\r\n" /end ANNOTATION_TEXT
 /end ANNOTATION
 /begin AXIS_DESCR STD_AXIS NO_INPUT_QUANTITY RB_PT_PCT_SWC_ENG_CompuMethods_ident 9 0.0 20000. FORMAT "%10.5" DEPOSIT ABSOLUTE /end AXIS_DESCR
 /begin AXIS_DESCR STD_AXIS NO_INPUT_QUANTITY RB_PT_PCT_SWC_ENG_CompuMethods_ratio_0p1 6 -2000. 2000. FORMAT "%10.5" DEPOSIT ABSOLUTE /end AXIS_DESCR
/end CHARACTERISTIC
/begin CHARACTERISTIC ENG_EngineInterface_EFLASHB.ENG_EngineInterface.ENG_ROLLOFFTIMEMAPDRIVERREQUEST "" MAP 0x8061030A RB_PT_PCT_SWC_ENG_RecordLayouts_RL_Map_uint16_54_uint16_9_sint16_6 10.0 RB_PT_PCT_SWC_ENG_CompuMethods_ratio_0p01 0.0 10. FORMAT "%10.5"
 /begin ANNOTATION ANNOTATION_LABEL "Description (coming from AUTOSAR DESC field)"
  /begin ANNOTATION_TEXT "Map to drive roll off time based on starting RPM and mode\r\n" /end ANNOTATION_TEXT
 /end ANNOTATION
 /begin AXIS_DESCR STD_AXIS NO_INPUT_QUANTITY RB_PT_PCT_SWC_ENG_CompuMethods_ident 9 0.0 20000. FORMAT "%10.5" DEPOSIT ABSOLUTE /end AXIS_DESCR
 /begin AXIS_DESCR STD_AXIS NO_INPUT_QUANTITY RB_PT_PCT_SWC_ENG_CompuMethods_ratio_0p1 6 -2000. 2000. FORMAT "%10.5" DEPOSIT ABSOLUTE /end AXIS_DESCR
/end CHARACTERISTIC
/begin CHARACTERISTIC ENG_EngineInterface_EFLASHB.ENG_EngineInterface.ENG_ROLLOFFTIMEMAPUPSHIFTS "" MAP 0x80610398 RB_PT_PCT_SWC_ENG_RecordLayouts_RL_Map_uint16_54_uint16_9_sint16_6 10.0 RB_PT_PCT_SWC_ENG_CompuMethods_ratio_0p01 0.0 10. FORMAT "%10.5"
 /begin ANNOTATION ANNOTATION_LABEL "Description (coming from AUTOSAR DESC field)"
  /begin ANNOTATION_TEXT "Map to drive roll off time based on starting RPM and mode\r\n" /end ANNOTATION_TEXT
 /end ANNOTATION
 /begin AXIS_DESCR STD_AXIS NO_INPUT_QUANTITY RB_PT_PCT_SWC_ENG_CompuMethods_ident 9 0.0 20000. FORMAT "%10.5" DEPOSIT ABSOLUTE /end AXIS_DESCR
 /begin AXIS_DESCR STD_AXIS NO_INPUT_QUANTITY RB_PT_PCT_SWC_ENG_CompuMethods_ratio_0p1 6 -2000. 2000. FORMAT "%10.5" DEPOSIT ABSOLUTE /end AXIS_DESCR
/end CHARACTERISTIC
/begin CHARACTERISTIC ENG_EngineInterface_EFLASHB.ENG_EngineInterface.ENG_ROLLOFFTIMESHUTTLE "" VALUE 0x80610064 DefaultValueRecordLayout_AUTOSAR_Platform_BaseTypes_uint16 10.0 RB_PT_PCT_SWC_ENG_CompuMethods_ratio_0p01 0.0 10. FORMAT "%10.5"
 /begin ANNOTATION ANNOTATION_LABEL "Description (coming from AUTOSAR DESC field)" /begin ANNOTATION_TEXT "Time ofr the Roll Off / On phase to operate for\r\n" /end ANNOTATION_TEXT /end ANNOTATION
/end CHARACTERISTIC
/begin CHARACTERISTIC ENG_EngineInterface_EFLASHB.ENG_EngineInterface.ENG_ROLLOFFTIMEVALUE "" VALUE 0x80610066 DefaultValueRecordLayout_AUTOSAR_Platform_BaseTypes_uint16 10.0 RB_PT_PCT_SWC_ENG_CompuMethods_ratio_0p01 0.0 10. FORMAT "%10.5"
 /begin ANNOTATION ANNOTATION_LABEL "Description (coming from AUTOSAR DESC field)" /begin ANNOTATION_TEXT "Time ofr the Roll Off / On phase to operate for\r\n" /end ANNOTATION_TEXT /end ANNOTATION
/end CHARACTERISTIC
/begin CHARACTERISTIC ENG_EngineInterface_EFLASHB.ENG_EngineInterface.ENG_ROLLOFFTORQUEOFFSET "" VALUE 0x80610068 DefaultValueRecordLayout_AUTOSAR_Platform_BaseTypes_sint16 4000.0 RB_PT_PCT_SWC_ENG_CompuMethods_ratio_0p1 -2000. 2000. FORMAT "%10.5"
 /begin ANNOTATION ANNOTATION_LABEL "Description (coming from AUTOSAR DESC field)"
  /begin ANNOTATION_TEXT "Torque offset to be applied to the target torue at the start of the roll off to try and get the engine to wake up\r\n" /end ANNOTATION_TEXT
 /end ANNOTATION
/end CHARACTERISTIC
/begin CHARACTERISTIC ENG_EngineInterface_EFLASHB.ENG_EngineInterface.ENG_ROLLONTIMEVALUEENGAGMENT "" VALUE 0x8061006A DefaultValueRecordLayout_AUTOSAR_Platform_BaseTypes_uint16 10.0 RB_PT_PCT_SWC_ENG_CompuMethods_ratio_0p01 0.0 10. FORMAT "%10.5"
 /begin ANNOTATION ANNOTATION_LABEL "Description (coming from AUTOSAR DESC field)"
  /begin ANNOTATION_TEXT "Time ofr the Roll Off / On phase to operate for during an engagment\r\n" /end ANNOTATION_TEXT
 /end ANNOTATION
/end CHARACTERISTIC
/begin CHARACTERISTIC ENG_EngineInterface_EFLASHB.ENG_EngineInterface.ENG_ROLLONTIMEVSGEAR "" MAP 0x80610426 RB_PT_PCT_SWC_ENG_RecordLayouts_RL_Map_uint16_28_sint16_7_uint8_4 10.0 RB_PT_PCT_SWC_ENG_CompuMethods_ratio_0p01 0.0 10. FORMAT "%10.5"
 /begin ANNOTATION ANNOTATION_LABEL "Description (coming from AUTOSAR DESC field)"
  /begin ANNOTATION_TEXT "Roll on time for ASG shift vs aggression and demanded gear\r\n" /end ANNOTATION_TEXT
 /end ANNOTATION
 /begin AXIS_DESCR STD_AXIS NO_INPUT_QUANTITY RB_PT_PCT_SWC_ENG_CompuMethods_ratio_0p1 7 -2000. 2000. FORMAT "%10.5" DEPOSIT ABSOLUTE /end AXIS_DESCR
 /begin AXIS_DESCR STD_AXIS NO_INPUT_QUANTITY RB_PT_PCT_SWC_ENG_CompuMethods_ident 4 0.0 11. FORMAT "%10.5" DEPOSIT ABSOLUTE /end AXIS_DESCR
/end CHARACTERISTIC
/begin CHARACTERISTIC ENG_EngineInterface_EFLASHB.ENG_EngineInterface.ENG_ROLLONTIMEVSGEARDRIVER "" MAP 0x80610474 RB_PT_PCT_SWC_ENG_RecordLayouts_RL_Map_uint16_28_sint16_7_uint8_4 10.0 RB_PT_PCT_SWC_ENG_CompuMethods_ratio_0p01 0.0 10. FORMAT "%10.5"
 /begin ANNOTATION ANNOTATION_LABEL "Description (coming from AUTOSAR DESC field)"
  /begin ANNOTATION_TEXT "Roll on time for ASG shift vs aggression and demanded gear - Driver requested shift\r\n" /end ANNOTATION_TEXT
 /end ANNOTATION
 /begin AXIS_DESCR STD_AXIS NO_INPUT_QUANTITY RB_PT_PCT_SWC_ENG_CompuMethods_ratio_0p1 7 -2000. 2000. FORMAT "%10.5" DEPOSIT ABSOLUTE /end AXIS_DESCR
 /begin AXIS_DESCR STD_AXIS NO_INPUT_QUANTITY RB_PT_PCT_SWC_ENG_CompuMethods_ident 4 0.0 11. FORMAT "%10.5" DEPOSIT ABSOLUTE /end AXIS_DESCR
/end CHARACTERISTIC
/begin CHARACTERISTIC ENG_EngineInterface_EFLASHB.ENG_EngineInterface.ENG_RollTorque.ENG_TQUPPROFILE "" CURVE 0x80610228 RB_PT_PCT_SWC_ENG_RecordLayouts_RL_Curve_uint16_10_uint16_10 1.0 RB_PT_PCT_SWC_ENG_CompuMethods_ratio_0p001 0.0 1. FORMAT "%10.5"
 /begin ANNOTATION ANNOTATION_LABEL "Description (coming from AUTOSAR DESC field)" /begin ANNOTATION_TEXT "Torque roll on profile for a postive end torque.\r\n" /end ANNOTATION_TEXT /end ANNOTATION
 /begin AXIS_DESCR STD_AXIS NO_INPUT_QUANTITY RB_PT_PCT_SWC_ENG_CompuMethods_ratio_0p001 10 0.0 1. FORMAT "%10.5" DEPOSIT ABSOLUTE /end AXIS_DESCR
/end CHARACTERISTIC
/begin CHARACTERISTIC ENG_EngineInterface_EFLASHB.ENG_EngineInterface.ENG_RollTorque.ENG_TQUPPROFILE2NEG "" CURVE 0x80610252 RB_PT_PCT_SWC_ENG_RecordLayouts_RL_Curve_uint16_10_uint16_10 1.0 RB_PT_PCT_SWC_ENG_CompuMethods_ratio_0p001 0.0 1. FORMAT "%10.5"
 /begin ANNOTATION ANNOTATION_LABEL "Description (coming from AUTOSAR DESC field)" /begin ANNOTATION_TEXT "Torque roll on profile for a negative end torque.\r\n" /end ANNOTATION_TEXT /end ANNOTATION
 /begin AXIS_DESCR STD_AXIS NO_INPUT_QUANTITY RB_PT_PCT_SWC_ENG_CompuMethods_ratio_0p001 10 0.0 1. FORMAT "%10.5" DEPOSIT ABSOLUTE /end AXIS_DESCR
/end CHARACTERISTIC
/begin CHARACTERISTIC ENG_EngineInterface_EFLASHB.ENG_EngineInterface.ENG_ROLLTORQUETONOINTERVENTION "" VALUE 0x8061007D DefaultValueRecordLayout_AUTOSAR_Platform_BaseTypes_boolean 255.0 AUTOSAR_Platform_CompuMethods_boolean 0.0 255. FORMAT "%10.5"
 /begin ANNOTATION ANNOTATION_LABEL "Description (coming from AUTOSAR DESC field)"
  /begin ANNOTATION_TEXT "Flag to roll the torque back to the torque no intervention signal and not driver demand torque\r\n" /end ANNOTATION_TEXT
 /end ANNOTATION
/end CHARACTERISTIC
/begin CHARACTERISTIC ENG_EngineInterface_EFLASHB.ENG_EngineInterface.ENG_RPMFLAREACTIVATESPEEDCONTROLTRACTION "" VALUE 0x8061006C DefaultValueRecordLayout_AUTOSAR_Platform_BaseTypes_uint16 20000.0 RB_PT_PCT_SWC_ENG_CompuMethods_ident 0.0 20000. FORMAT "%10.5"
 /begin ANNOTATION ANNOTATION_LABEL "Description (coming from AUTOSAR DESC field)"
  /begin ANNOTATION_TEXT "Offset above target engine speed that results in speed control being activated when brake intervention is active\r\n" /end ANNOTATION_TEXT
 /end ANNOTATION
/end CHARACTERISTIC
/begin CHARACTERISTIC ENG_EngineInterface_EFLASHB.ENG_EngineInterface.ENG_SLIPFOREARLYSPEEDCONTROL "" CURVE 0x806104C2 RB_PT_PCT_SWC_ENG_RecordLayouts_RL_Curve_uint16_6_sint8_6 20000.0 RB_PT_PCT_SWC_ENG_CompuMethods_ident 0.0 20000. FORMAT "%10.5"
 /begin ANNOTATION ANNOTATION_LABEL "Description (coming from AUTOSAR DESC field)"
  /begin ANNOTATION_TEXT "Engine speed flare above offgoing input shaft speed to start speed control (0 is immediate start)\r\n" /end ANNOTATION_TEXT
 /end ANNOTATION
 /begin AXIS_DESCR STD_AXIS NO_INPUT_QUANTITY RB_PT_PCT_SWC_ENG_CompuMethods_ratio_0p01 6 -1. 1. FORMAT "%10.5" DEPOSIT ABSOLUTE /end AXIS_DESCR
/end CHARACTERISTIC
/begin CHARACTERISTIC ENG_EngineInterface_EFLASHB.ENG_EngineInterface.ENG_SPDCONTROLTHRESTORQUEANDSPD "" MAP 0x806104D6 RB_PT_PCT_SWC_ENG_RecordLayouts_RL_Map_uint16_54_uint16_9_sint16_6 20000.0 RB_PT_PCT_SWC_ENG_CompuMethods_ident 0.0 20000. FORMAT "%10.5"
 /begin ANNOTATION ANNOTATION_LABEL "Description (coming from AUTOSAR DESC field)"
  /begin ANNOTATION_TEXT "Torque and engine speed related speed control complete threshold\r\n" /end ANNOTATION_TEXT
 /end ANNOTATION
 /begin AXIS_DESCR STD_AXIS NO_INPUT_QUANTITY RB_PT_PCT_SWC_ENG_CompuMethods_ident 9 0.0 20000. FORMAT "%10.5" DEPOSIT ABSOLUTE /end AXIS_DESCR
 /begin AXIS_DESCR STD_AXIS NO_INPUT_QUANTITY RB_PT_PCT_SWC_ENG_CompuMethods_ratio_0p1 6 -2000. 2000. FORMAT "%10.5" DEPOSIT ABSOLUTE /end AXIS_DESCR
/end CHARACTERISTIC
/begin CHARACTERISTIC ENG_EngineInterface_EFLASHB.ENG_EngineInterface.ENG_SPEEDCONTROLCOMPLETETHRESHOLDWIDE "" VALUE 0x8061006E DefaultValueRecordLayout_AUTOSAR_Platform_BaseTypes_uint16 20000.0 RB_PT_PCT_SWC_ENG_CompuMethods_ident 0.0 20000. FORMAT "%10.5"
 /begin ANNOTATION ANNOTATION_LABEL "Description (coming from AUTOSAR DESC field)"
  /begin ANNOTATION_TEXT "Speed error allowable before speed control completed if speed timer has exceeded a set value (relaxing the limit)\r\n" /end ANNOTATION_TEXT
 /end ANNOTATION
/end CHARACTERISTIC
/begin CHARACTERISTIC ENG_EngineInterface_EFLASHB.ENG_EngineInterface.ENG_SPEEDTIMEWIDENTHRESHOLD "" VALUE 0x80610070 DefaultValueRecordLayout_AUTOSAR_Platform_BaseTypes_uint16 655.35 RB_PT_PCT_SWC_ENG_CompuMethods_DST_Time 0.0 655.35 FORMAT "%10.5"
 /begin ANNOTATION ANNOTATION_LABEL "Description (coming from AUTOSAR DESC field)"
  /begin ANNOTATION_TEXT "Speed control time before complete threshold is widened\r\n" /end ANNOTATION_TEXT
 /end ANNOTATION
/end CHARACTERISTIC
/begin CHARACTERISTIC ENG_EngineInterface_EFLASHB.ENG_EngineInterface.ENG_TARGETOFFSETEARLYSPEEDCONTROL "" VALUE 0x80610072 DefaultValueRecordLayout_AUTOSAR_Platform_BaseTypes_uint16 20000.0 RB_PT_PCT_SWC_ENG_CompuMethods_ident 0.0 20000. FORMAT "%10.5"
 /begin ANNOTATION ANNOTATION_LABEL "Description (coming from AUTOSAR DESC field)"
  /begin ANNOTATION_TEXT "Speed target offset above offgoing input shaft speed if speed control is activated early\r\n" /end ANNOTATION_TEXT
 /end ANNOTATION
/end CHARACTERISTIC
/begin CHARACTERISTIC ENG_EngineInterface_EFLASHB.ENG_EngineInterface.ENG_TARGETSPEEDBLENDGAINDOWN "" CURVE 0x80610564 RB_PT_PCT_SWC_ENG_RecordLayouts_RL_Curve_sint16_8_uint16_8 100.0 RB_PT_PCT_SWC_ENG_CompuMethods_ratio_0p01 -100. 0.0 FORMAT "%10.5"
 /begin ANNOTATION ANNOTATION_LABEL "Description (coming from AUTOSAR DESC field)"
  /begin ANNOTATION_TEXT "Map of blend gain to apply for down shifts to target engine speed as target slip reduces - vs engine speed.\r\n" /end ANNOTATION_TEXT
 /end ANNOTATION
 /begin AXIS_DESCR STD_AXIS NO_INPUT_QUANTITY RB_PT_PCT_SWC_ENG_CompuMethods_ident 8 0.0 20000. FORMAT "%10.5" DEPOSIT ABSOLUTE /end AXIS_DESCR
/end CHARACTERISTIC
/begin CHARACTERISTIC ENG_EngineInterface_EFLASHB.ENG_EngineInterface.ENG_TARGETSPEEDBLENDGAINUP "" CURVE 0x80610586 RB_PT_PCT_SWC_ENG_RecordLayouts_RL_Curve_sint16_8_uint16_8 100.0 RB_PT_PCT_SWC_ENG_CompuMethods_ratio_0p01 -100. 0.0 FORMAT "%10.5"
 /begin ANNOTATION ANNOTATION_LABEL "Description (coming from AUTOSAR DESC field)"
  /begin ANNOTATION_TEXT "Map of blend gain to apply for up shifts to target engine speed as target slip reduces - vs engine speed.\r\n" /end ANNOTATION_TEXT
 /end ANNOTATION
 /begin AXIS_DESCR STD_AXIS NO_INPUT_QUANTITY RB_PT_PCT_SWC_ENG_CompuMethods_ident 8 0.0 20000. FORMAT "%10.5" DEPOSIT ABSOLUTE /end AXIS_DESCR
/end CHARACTERISTIC
/begin CHARACTERISTIC ENG_EngineInterface_EFLASHB.ENG_EngineInterface.ENG_TARGETSPEEDGRADIENT "" MAP 0x806105A8 RB_PT_PCT_SWC_ENG_RecordLayouts_RL_Map_uint16_63_uint16_9_uint8_7 31900.0 RB_PT_PCT_SWC_ENG_CompuMethods_ident 100. 32000. FORMAT "%10.5"
 /begin ANNOTATION ANNOTATION_LABEL "Description (coming from AUTOSAR DESC field)"
  /begin ANNOTATION_TEXT "Map to drive roll off time based on starting RPM and mode\r\n" /end ANNOTATION_TEXT
 /end ANNOTATION
 /begin AXIS_DESCR STD_AXIS NO_INPUT_QUANTITY RB_PT_PCT_SWC_ENG_CompuMethods_ident 9 0.0 20000. FORMAT "%10.5" DEPOSIT ABSOLUTE /end AXIS_DESCR
 /begin AXIS_DESCR STD_AXIS NO_INPUT_QUANTITY RB_PT_PCT_SWC_ENG_CompuMethods_ident 7 0.0 6. FORMAT "%10.5" DEPOSIT ABSOLUTE /end AXIS_DESCR
/end CHARACTERISTIC
/begin CHARACTERISTIC ENG_EngineInterface_EFLASHB.ENG_EngineInterface.ENG_TARGETSPEEDGRADIENTNOPSG "" MAP 0x80610644 RB_PT_PCT_SWC_ENG_RecordLayouts_RL_Map_uint16_63_uint16_9_uint8_7 31900.0 RB_PT_PCT_SWC_ENG_CompuMethods_ident 100. 32000. FORMAT "%10.5"
 /begin ANNOTATION ANNOTATION_LABEL "Description (coming from AUTOSAR DESC field)"
  /begin ANNOTATION_TEXT "Map to drive roll off time based on starting RPM and mode if no preselect is engaged\r\n" /end ANNOTATION_TEXT
 /end ANNOTATION
 /begin AXIS_DESCR STD_AXIS NO_INPUT_QUANTITY RB_PT_PCT_SWC_ENG_CompuMethods_ident 9 0.0 20000. FORMAT "%10.5" DEPOSIT ABSOLUTE /end AXIS_DESCR
 /begin AXIS_DESCR STD_AXIS NO_INPUT_QUANTITY RB_PT_PCT_SWC_ENG_CompuMethods_ident 7 0.0 6. FORMAT "%10.5" DEPOSIT ABSOLUTE /end AXIS_DESCR
/end CHARACTERISTIC
/begin CHARACTERISTIC ENG_EngineInterface_EFLASHB.ENG_EngineInterface.ENG_TARGETSPEEDGRADIENTNOPSGONTHROTTLE "" MAP 0x806106E0 RB_PT_PCT_SWC_ENG_RecordLayouts_RL_Map_uint16_63_uint16_9_uint8_7 31900.0 RB_PT_PCT_SWC_ENG_CompuMethods_ident 100. 32000. FORMAT "%10.5"
 /begin ANNOTATION ANNOTATION_LABEL "Description (coming from AUTOSAR DESC field)"
  /begin ANNOTATION_TEXT "Map to drive roll off time based on starting RPM and mode if no preselect is engaged\r\n" /end ANNOTATION_TEXT
 /end ANNOTATION
 /begin AXIS_DESCR STD_AXIS NO_INPUT_QUANTITY RB_PT_PCT_SWC_ENG_CompuMethods_ident 9 0.0 20000. FORMAT "%10.5" DEPOSIT ABSOLUTE /end AXIS_DESCR
 /begin AXIS_DESCR STD_AXIS NO_INPUT_QUANTITY RB_PT_PCT_SWC_ENG_CompuMethods_ident 7 0.0 6. FORMAT "%10.5" DEPOSIT ABSOLUTE /end AXIS_DESCR
/end CHARACTERISTIC
/begin CHARACTERISTIC ENG_EngineInterface_EFLASHB.ENG_EngineInterface.ENG_TARGETSPEEDGRADIENTONTHROTTLE "" MAP 0x8061077C RB_PT_PCT_SWC_ENG_RecordLayouts_RL_Map_uint16_63_uint16_9_uint8_7 31900.0 RB_PT_PCT_SWC_ENG_CompuMethods_ident 100. 32000. FORMAT "%10.5"
 /begin ANNOTATION ANNOTATION_LABEL "Description (coming from AUTOSAR DESC field)"
  /begin ANNOTATION_TEXT "Map to drive roll off time based on starting RPM and mode\r\n" /end ANNOTATION_TEXT
 /end ANNOTATION
 /begin AXIS_DESCR STD_AXIS NO_INPUT_QUANTITY RB_PT_PCT_SWC_ENG_CompuMethods_ident 9 0.0 20000. FORMAT "%10.5" DEPOSIT ABSOLUTE /end AXIS_DESCR
 /begin AXIS_DESCR STD_AXIS NO_INPUT_QUANTITY RB_PT_PCT_SWC_ENG_CompuMethods_ident 7 0.0 6. FORMAT "%10.5" DEPOSIT ABSOLUTE /end AXIS_DESCR
/end CHARACTERISTIC
/begin CHARACTERISTIC ENG_EngineInterface_EFLASHB.ENG_EngineInterface.ENG_TARGETSPEEDGRADIENTSTARTSTOP "" MAP 0x80610818 RB_PT_PCT_SWC_ENG_RecordLayouts_RL_Map_uint16_72_uint16_9_uint8_8 31900.0 RB_PT_PCT_SWC_ENG_CompuMethods_ident 100. 32000. FORMAT "%10.5"
 /begin ANNOTATION ANNOTATION_LABEL "Description (coming from AUTOSAR DESC field)"
  /begin ANNOTATION_TEXT "Unique ASG target engine speed gradient to use for start stop.\r\n" /end ANNOTATION_TEXT
 /end ANNOTATION
 /begin AXIS_DESCR STD_AXIS NO_INPUT_QUANTITY RB_PT_PCT_SWC_ENG_CompuMethods_ident 9 0.0 20000. FORMAT "%10.5" DEPOSIT ABSOLUTE /end AXIS_DESCR
 /begin AXIS_DESCR STD_AXIS NO_INPUT_QUANTITY RB_PT_PCT_SWC_ENG_CompuMethods_ident 8 0.0 11. FORMAT "%10.5" DEPOSIT ABSOLUTE /end AXIS_DESCR
/end CHARACTERISTIC
/begin CHARACTERISTIC ENG_EngineInterface_EFLASHB.ENG_EngineInterface.ENG_TARGETSPEEDGRADIENTUPSHIFT "" MAP 0x806108C6 RB_PT_PCT_SWC_ENG_RecordLayouts_RL_Map_sint16_63_uint16_9_uint8_7 31900.0 RB_PT_PCT_SWC_ENG_CompuMethods_ident -32000. -100. FORMAT "%10.5"
 /begin ANNOTATION ANNOTATION_LABEL "Description (coming from AUTOSAR DESC field)"
  /begin ANNOTATION_TEXT "Map to drive roll off time based on starting RPM and mode\r\n" /end ANNOTATION_TEXT
 /end ANNOTATION
 /begin AXIS_DESCR STD_AXIS NO_INPUT_QUANTITY RB_PT_PCT_SWC_ENG_CompuMethods_ident 9 0.0 20000. FORMAT "%10.5" DEPOSIT ABSOLUTE /end AXIS_DESCR
 /begin AXIS_DESCR STD_AXIS NO_INPUT_QUANTITY RB_PT_PCT_SWC_ENG_CompuMethods_ident 7 0.0 6. FORMAT "%10.5" DEPOSIT ABSOLUTE /end AXIS_DESCR
/end CHARACTERISTIC
/begin CHARACTERISTIC ENG_EngineInterface_EFLASHB.ENG_EngineInterface.ENG_TARGETSPEEDOFFSET "" MAP 0x80610962 RB_PT_PCT_SWC_ENG_RecordLayouts_RL_Map_sint16_81_uint16_9_sint16_9 40000.0 RB_PT_PCT_SWC_ENG_CompuMethods_ident -20000. 20000. FORMAT "%10.5"
 /begin ANNOTATION ANNOTATION_LABEL "Description (coming from AUTOSAR DESC field)"
  /begin ANNOTATION_TEXT "Target engine speed offset as a function of engine speed and driver demand torque\r\n" /end ANNOTATION_TEXT
 /end ANNOTATION
 /begin AXIS_DESCR STD_AXIS NO_INPUT_QUANTITY RB_PT_PCT_SWC_ENG_CompuMethods_ident 9 0.0 20000. FORMAT "%10.5" DEPOSIT ABSOLUTE /end AXIS_DESCR
 /begin AXIS_DESCR STD_AXIS NO_INPUT_QUANTITY RB_PT_PCT_SWC_ENG_CompuMethods_ratio_0p1 9 -2000. 2000. FORMAT "%10.5" DEPOSIT ABSOLUTE /end AXIS_DESCR
/end CHARACTERISTIC
/begin CHARACTERISTIC ENG_EngineInterface_EFLASHB.ENG_EngineInterface.ENG_TARGETSPEEDREACHEDTHRES "" VALUE 0x80610074 DefaultValueRecordLayout_AUTOSAR_Platform_BaseTypes_uint16 20000.0 RB_PT_PCT_SWC_ENG_CompuMethods_ident 0.0 20000. FORMAT "%10.5"
 /begin ANNOTATION ANNOTATION_LABEL "Description (coming from AUTOSAR DESC field)"
  /begin ANNOTATION_TEXT "Threshold used to detect if you have reached the target speed\r\n" /end ANNOTATION_TEXT
 /end ANNOTATION
/end CHARACTERISTIC
/begin CHARACTERISTIC ENG_EngineInterface_EFLASHB.ENG_EngineInterface.ENG_TORQUEROLLOFFCOMPLETETHRESHOLDDOWN "" CURVE 0x80610A2C RB_PT_PCT_SWC_ENG_RecordLayouts_RL_Curve_uint16_5_uint16_5 2000.0 RB_PT_PCT_SWC_ENG_CompuMethods_ratio_0p1 0.0 2000. FORMAT "%10.5"
 /begin ANNOTATION ANNOTATION_LABEL "Description (coming from AUTOSAR DESC field)"
  /begin ANNOTATION_TEXT "Torque error allowable before torque roll off completed for downshifts - function of engine speed\r\n" /end ANNOTATION_TEXT
 /end ANNOTATION
 /begin AXIS_DESCR STD_AXIS NO_INPUT_QUANTITY RB_PT_PCT_SWC_ENG_CompuMethods_ident 5 0.0 20000. FORMAT "%10.5" DEPOSIT ABSOLUTE /end AXIS_DESCR
/end CHARACTERISTIC
/begin CHARACTERISTIC ENG_EngineInterface_EFLASHB.ENG_EngineInterface.ENG_TORQUEROLLOFFCOMPLETETHRESHOLDUP "" VALUE 0x80610076 DefaultValueRecordLayout_AUTOSAR_Platform_BaseTypes_uint16 2000.0 RB_PT_PCT_SWC_ENG_CompuMethods_ratio_0p1 0.0 2000. FORMAT "%10.5"
 /begin ANNOTATION ANNOTATION_LABEL "Description (coming from AUTOSAR DESC field)"
  /begin ANNOTATION_TEXT "Torque error allowable before torque roll off completed for upshifts\r\n" /end ANNOTATION_TEXT
 /end ANNOTATION
/end CHARACTERISTIC
/begin CHARACTERISTIC ENG_EngineInterface_EFLASHB.ENG_EngineInterface.ENG_USECANMAXENGINESPEED "" VALUE 0x8061007E DefaultValueRecordLayout_AUTOSAR_Platform_BaseTypes_boolean 255.0 AUTOSAR_Platform_CompuMethods_boolean 0.0 255. FORMAT "%10.5"
 /begin ANNOTATION ANNOTATION_LABEL "Description (coming from AUTOSAR DESC field)"
  /begin ANNOTATION_TEXT "Parameter to enable maximum engine speed request to be defined by CAN value\r\n" /end ANNOTATION_TEXT
 /end ANNOTATION
/end CHARACTERISTIC
/begin CHARACTERISTIC ENG_EngineInterface_EFLASHB.ENG_EngineInterface.ENG_USENEUTRALTQROLLOFF "" VALUE 0x8061007F DefaultValueRecordLayout_AUTOSAR_Platform_BaseTypes_boolean 255.0 AUTOSAR_Platform_CompuMethods_boolean 0.0 255. FORMAT "%10.5"
 /begin ANNOTATION ANNOTATION_LABEL "Description (coming from AUTOSAR DESC field)" /begin ANNOTATION_TEXT "TEMPORARY PARAMETER - REMOVE\r\n" /end ANNOTATION_TEXT /end ANNOTATION
/end CHARACTERISTIC
/begin CHARACTERISTIC ENG_EngineInterface_EFLASHB.ENG_EngineInterface.ENG_USESPEEDCONTACTIVETQRESERVE "" VALUE 0x80610080 DefaultValueRecordLayout_AUTOSAR_Platform_BaseTypes_boolean 255.0 AUTOSAR_Platform_CompuMethods_boolean 0.0 255. FORMAT "%10.5"
 /begin ANNOTATION ANNOTATION_LABEL "Description (coming from AUTOSAR DESC field)" /begin ANNOTATION_TEXT "TEMPORARY PARAMETER - REMOVE\r\n" /end ANNOTATION_TEXT /end ANNOTATION
/end CHARACTERISTIC
/begin CHARACTERISTIC GAC_AGGGRACGRRETRY "" VALUE 0x806040AA DefaultValueRecordLayout_AUTOSAR_Platform_BaseTypes_uint8 3.0 RB_PT_PCT_SWC_GAC_CompuMethods_Enumerations_GAC_ActuatorSpeedTypes 0.0 3. FORMAT "%10.5"
 /begin ANNOTATION ANNOTATION_LABEL "Description (coming from AUTOSAR DESC field)" /begin ANNOTATION_TEXT "Actuation aggression for engagement retry.\r\n" /end ANNOTATION_TEXT /end ANNOTATION
/end CHARACTERISTIC
/begin CHARACTERISTIC GAC_CALIB.GAC_AGGEOLCMD "" VALUE 0x80610D1A DefaultValueRecordLayout_AUTOSAR_Platform_BaseTypes_uint8 3.0 RB_PT_PCT_SWC_GAC_CompuMethods_Enumerations_GAC_ActuatorSpeedTypes 0.0 3. FORMAT "%10.5"
 /begin ANNOTATION ANNOTATION_LABEL "Description (coming from AUTOSAR DESC field)" /begin ANNOTATION_TEXT "Aggression of the EOL commands\r\n" /end ANNOTATION_TEXT /end ANNOTATION
/end CHARACTERISTIC
/begin CHARACTERISTIC GAC_CALIB.GAC_AGGGRACBOBRQ "" VALUE 0x80610D1B DefaultValueRecordLayout_AUTOSAR_Platform_BaseTypes_uint8 3.0 RB_PT_PCT_SWC_GAC_CompuMethods_Enumerations_GAC_ActuatorSpeedTypes 0.0 3. FORMAT "%10.5"
 /begin ANNOTATION ANNOTATION_LABEL "Description (coming from AUTOSAR DESC field)"
  /begin ANNOTATION_TEXT "Selection aggression (internal manual intervention) request.\r\n" /end ANNOTATION_TEXT
 /end ANNOTATION
/end CHARACTERISTIC
/begin CHARACTERISTIC GAC_CALIB.GAC_AGGGRACENGINEOFF "" VALUE 0x80610D1C DefaultValueRecordLayout_AUTOSAR_Platform_BaseTypes_uint8 3.0 RB_PT_PCT_SWC_GAC_CompuMethods_Enumerations_GAC_ActuatorSpeedTypes 0.0 3. FORMAT "%10.5"
 /begin ANNOTATION ANNOTATION_LABEL "Description (coming from AUTOSAR DESC field)"
  /begin ANNOTATION_TEXT "Selection aggression (internal manual intervention) request.\r\n" /end ANNOTATION_TEXT
 /end ANNOTATION
/end CHARACTERISTIC
/begin CHARACTERISTIC GAC_CALIB.GAC_BOBEDRIVEOUTPUTNOTREADY "" VALUE 0x80610D1D DefaultValueRecordLayout_AUTOSAR_Platform_BaseTypes_uint8 255.0 DefaultIdenticalCompu 0.0 255. FORMAT "%10.5"
 /begin ANNOTATION ANNOTATION_LABEL "Description (coming from AUTOSAR DESC field)" /begin ANNOTATION_TEXT "BOB for the drive output not ready signal\r\n" /end ANNOTATION_TEXT /end ANNOTATION
/end CHARACTERISTIC
/begin CHARACTERISTIC GAC_CALIB.GAC_BOBENBLDRIVEOUTPUTNOTREADY "" VALUE 0x80610D1E DefaultValueRecordLayout_AUTOSAR_Platform_BaseTypes_uint8 255.0 DefaultIdenticalCompu 0.0 255. FORMAT "%10.5"
 /begin ANNOTATION ANNOTATION_LABEL "Description (coming from AUTOSAR DESC field)" /begin ANNOTATION_TEXT "BOB enable for the drive output not ready signal\r\n" /end ANNOTATION_TEXT /end ANNOTATION
/end CHARACTERISTIC
/begin CHARACTERISTIC GAC_CALIB.GAC_BOBENBLIONOTREADY "" VALUE 0x80610D1F DefaultValueRecordLayout_AUTOSAR_Platform_BaseTypes_uint8 255.0 DefaultIdenticalCompu 0.0 255. FORMAT "%10.5"
 /begin ANNOTATION ANNOTATION_LABEL "Description (coming from AUTOSAR DESC field)" /begin ANNOTATION_TEXT "BOB for the IO not ready signal\r\n" /end ANNOTATION_TEXT /end ANNOTATION
/end CHARACTERISTIC
/begin CHARACTERISTIC GAC_CALIB.GAC_BOBENBLIOSTATUS "" VALUE 0x80610C5C DefaultValueRecordLayout_AUTOSAR_Platform_BaseTypes_uint32 4.294967295E9 RB_PT_PCT_SWC_GAC_CompuMethods_ident 0.0 4.294967295E9 FORMAT "%10.5"
 /begin ANNOTATION ANNOTATION_LABEL "Description (coming from AUTOSAR DESC field)" /begin ANNOTATION_TEXT "BOB enable for the IO status override\r\n" /end ANNOTATION_TEXT /end ANNOTATION
/end CHARACTERISTIC
/begin CHARACTERISTIC GAC_CALIB.GAC_BOBENBLMOTORSPEEDSTATUS "" VALUE 0x80610D20 DefaultValueRecordLayout_AUTOSAR_Platform_BaseTypes_uint8 255.0 DefaultIdenticalCompu 0.0 255. FORMAT "%10.5"
 /begin ANNOTATION ANNOTATION_LABEL "Description (coming from AUTOSAR DESC field)" /begin ANNOTATION_TEXT "BOB enable for the moter speed status override\r\n" /end ANNOTATION_TEXT /end ANNOTATION
/end CHARACTERISTIC
/begin CHARACTERISTIC GAC_CALIB.GAC_BOBENBLPRESSUREAVAILABLE "" VALUE 0x80610D21 DefaultValueRecordLayout_AUTOSAR_Platform_BaseTypes_uint8 255.0 DefaultIdenticalCompu 0.0 255. FORMAT "%10.5"
 /begin ANNOTATION ANNOTATION_LABEL "Description (coming from AUTOSAR DESC field)" /begin ANNOTATION_TEXT "BOB enable for the pressure available override\r\n" /end ANNOTATION_TEXT /end ANNOTATION
/end CHARACTERISTIC
/begin CHARACTERISTIC GAC_CALIB.GAC_BOBENBLSEQINITIALISED "" VALUE 0x80610D22 DefaultValueRecordLayout_AUTOSAR_Platform_BaseTypes_uint8 255.0 DefaultIdenticalCompu 0.0 255. FORMAT "%10.5"
 /begin ANNOTATION ANNOTATION_LABEL "Description (coming from AUTOSAR DESC field)" /begin ANNOTATION_TEXT "Bob to simulate KL15 being off\r\n" /end ANNOTATION_TEXT /end ANNOTATION
/end CHARACTERISTIC
/begin CHARACTERISTIC GAC_CALIB.GAC_BOBENBLVEHSPEED "" VALUE 0x80610D23 DefaultValueRecordLayout_AUTOSAR_Platform_BaseTypes_uint8 255.0 DefaultIdenticalCompu 0.0 255. FORMAT "%10.5"
 /begin ANNOTATION ANNOTATION_LABEL "Description (coming from AUTOSAR DESC field)" /begin ANNOTATION_TEXT "BOB enable for the vehicle speed override\r\n" /end ANNOTATION_TEXT /end ANNOTATION
/end CHARACTERISTIC
/begin CHARACTERISTIC GAC_CALIB.GAC_BOBFLGIDFAILEDEXTSYS "" VALUE 0x80610D24 DefaultValueRecordLayout_AUTOSAR_Platform_BaseTypes_uint8 255.0 DefaultIdenticalCompu 0.0 255. FORMAT "%10.5"
 /begin ANNOTATION ANNOTATION_LABEL "Description (coming from AUTOSAR DESC field)"
  /begin ANNOTATION_TEXT "Enable flag for the bob to override the external failure bit field\r\n" /end ANNOTATION_TEXT
 /end ANNOTATION
/end CHARACTERISTIC
/begin CHARACTERISTIC GAC_CALIB.GAC_BOBFLGKL15 "" VALUE 0x80610D25 DefaultValueRecordLayout_AUTOSAR_Platform_BaseTypes_uint8 255.0 DefaultIdenticalCompu 0.0 255. FORMAT "%10.5"
 /begin ANNOTATION ANNOTATION_LABEL "Description (coming from AUTOSAR DESC field)" /begin ANNOTATION_TEXT "Bob to simulate KL15 being off\r\n" /end ANNOTATION_TEXT /end ANNOTATION
/end CHARACTERISTIC
/begin CHARACTERISTIC GAC_CALIB.GAC_BOBFLGSEQINITIALISED "" VALUE 0x80610D26 DefaultValueRecordLayout_AUTOSAR_Platform_BaseTypes_uint8 255.0 DefaultIdenticalCompu 0.0 255. FORMAT "%10.5"
 /begin ANNOTATION ANNOTATION_LABEL "Description (coming from AUTOSAR DESC field)" /begin ANNOTATION_TEXT "Bob to simulate KL15 being off\r\n" /end ANNOTATION_TEXT /end ANNOTATION
/end CHARACTERISTIC
/begin CHARACTERISTIC GAC_CALIB.GAC_BOBIDFAILEDEXTSYS "" VALUE 0x80610C60 DefaultValueRecordLayout_AUTOSAR_Platform_BaseTypes_uint32 4.294967295E9 RB_PT_PCT_SWC_GAC_CompuMethods_ident 0.0 4.294967295E9 FORMAT "%10.5"
 /begin ANNOTATION ANNOTATION_LABEL "Description (coming from AUTOSAR DESC field)" /begin ANNOTATION_TEXT "BOB override for the external sys failed bit id\r\n" /end ANNOTATION_TEXT /end ANNOTATION
/end CHARACTERISTIC
/begin CHARACTERISTIC GAC_CALIB.GAC_BOBIDFAILEDVGP "" VALUE 0x80610D27 DefaultValueRecordLayout_AUTOSAR_Platform_BaseTypes_uint8 255.0 RB_PT_PCT_SWC_GAC_CompuMethods_ident 0.0 255. FORMAT "%10.5"
 /begin ANNOTATION ANNOTATION_LABEL "Description (coming from AUTOSAR DESC field)" /begin ANNOTATION_TEXT "BOB for the failed VGP ID\r\n" /end ANNOTATION_TEXT /end ANNOTATION
/end CHARACTERISTIC
/begin CHARACTERISTIC GAC_CALIB.GAC_BOBIDFAILEDVGQA "" VALUE 0x80610D28 DefaultValueRecordLayout_AUTOSAR_Platform_BaseTypes_uint8 255.0 RB_PT_PCT_SWC_GAC_CompuMethods_ident 0.0 255. FORMAT "%10.5"
 /begin ANNOTATION ANNOTATION_LABEL "Description (coming from AUTOSAR DESC field)" /begin ANNOTATION_TEXT "BOB for the failed VGQA override\r\n" /end ANNOTATION_TEXT /end ANNOTATION
/end CHARACTERISTIC
/begin CHARACTERISTIC GAC_CALIB.GAC_BOBIDFAILEDVGQB "" VALUE 0x80610D29 DefaultValueRecordLayout_AUTOSAR_Platform_BaseTypes_uint8 255.0 RB_PT_PCT_SWC_GAC_CompuMethods_ident 0.0 255. FORMAT "%10.5"
 /begin ANNOTATION ANNOTATION_LABEL "Description (coming from AUTOSAR DESC field)" /begin ANNOTATION_TEXT "BOB for the failed VGQB override\r\n" /end ANNOTATION_TEXT /end ANNOTATION
/end CHARACTERISTIC
/begin CHARACTERISTIC GAC_CALIB.GAC_BOBIDFAILEDVGQC "" VALUE 0x80610D2A DefaultValueRecordLayout_AUTOSAR_Platform_BaseTypes_uint8 255.0 RB_PT_PCT_SWC_GAC_CompuMethods_ident 0.0 255. FORMAT "%10.5"
 /begin ANNOTATION ANNOTATION_LABEL "Description (coming from AUTOSAR DESC field)" /begin ANNOTATION_TEXT "BOB for the failed VGQC override\r\n" /end ANNOTATION_TEXT /end ANNOTATION
/end CHARACTERISTIC
/begin CHARACTERISTIC GAC_CALIB.GAC_BOBIDFAILEDVGQD "" VALUE 0x80610D2B DefaultValueRecordLayout_AUTOSAR_Platform_BaseTypes_uint8 255.0 RB_PT_PCT_SWC_GAC_CompuMethods_ident 0.0 255. FORMAT "%10.5"
 /begin ANNOTATION ANNOTATION_LABEL "Description (coming from AUTOSAR DESC field)" /begin ANNOTATION_TEXT "BOB for the failed VGQD override\r\n" /end ANNOTATION_TEXT /end ANNOTATION
/end CHARACTERISTIC
/begin CHARACTERISTIC GAC_CALIB.GAC_BOBIDFAILEDVGQF "" VALUE 0x80610D2C DefaultValueRecordLayout_AUTOSAR_Platform_BaseTypes_uint8 255.0 RB_PT_PCT_SWC_GAC_CompuMethods_ident 0.0 255. FORMAT "%10.5"
 /begin ANNOTATION ANNOTATION_LABEL "Description (coming from AUTOSAR DESC field)" /begin ANNOTATION_TEXT "BOB for the failed VGQF override\r\n" /end ANNOTATION_TEXT /end ANNOTATION
/end CHARACTERISTIC
/begin CHARACTERISTIC GAC_CALIB.GAC_BOBIDFAILEDVGQPLAC "" VALUE 0x80610D2D DefaultValueRecordLayout_AUTOSAR_Platform_BaseTypes_uint8 255.0 RB_PT_PCT_SWC_GAC_CompuMethods_ident 0.0 255. FORMAT "%10.5"
 /begin ANNOTATION ANNOTATION_LABEL "Description (coming from AUTOSAR DESC field)" /begin ANNOTATION_TEXT "BOB for the failed park lock VGQ override\r\n" /end ANNOTATION_TEXT /end ANNOTATION
/end CHARACTERISTIC
/begin CHARACTERISTIC GAC_CALIB.GAC_BOBIONOTREADY "" VALUE 0x80610D2E DefaultValueRecordLayout_AUTOSAR_Platform_BaseTypes_uint8 255.0 DefaultIdenticalCompu 0.0 255. FORMAT "%10.5"
 /begin ANNOTATION ANNOTATION_LABEL "Description (coming from AUTOSAR DESC field)" /begin ANNOTATION_TEXT "BOB for IO not ready signal\r\n" /end ANNOTATION_TEXT /end ANNOTATION
/end CHARACTERISTIC
/begin CHARACTERISTIC GAC_CALIB.GAC_BOBKL15 "" VALUE 0x80610D2F DefaultValueRecordLayout_AUTOSAR_Platform_BaseTypes_uint8 255.0 DefaultIdenticalCompu 0.0 255. FORMAT "%10.5"
 /begin ANNOTATION ANNOTATION_LABEL "Description (coming from AUTOSAR DESC field)" /begin ANNOTATION_TEXT "Bob to simulate KL15 being off\r\n" /end ANNOTATION_TEXT /end ANNOTATION
/end CHARACTERISTIC
/begin CHARACTERISTIC GAC_CALIB.GAC_BOBMOTORSPEEDSTATUS "" VALUE 0x80610D30 DefaultValueRecordLayout_AUTOSAR_Platform_BaseTypes_uint8 255.0 DefaultIdenticalCompu 0.0 255. FORMAT "%10.5"
 /begin ANNOTATION ANNOTATION_LABEL "Description (coming from AUTOSAR DESC field)" /begin ANNOTATION_TEXT "BOB for the motor speed status signal\r\n" /end ANNOTATION_TEXT /end ANNOTATION
/end CHARACTERISTIC
/begin CHARACTERISTIC GAC_CALIB.GAC_BOBPRESSUREAVAILABLE "" VALUE 0x80610D31 DefaultValueRecordLayout_AUTOSAR_Platform_BaseTypes_uint8 255.0 DefaultIdenticalCompu 0.0 255. FORMAT "%10.5"
 /begin ANNOTATION ANNOTATION_LABEL "Description (coming from AUTOSAR DESC field)" /begin ANNOTATION_TEXT "BOB override for the pressure available signal\r\n" /end ANNOTATION_TEXT /end ANNOTATION
/end CHARACTERISTIC
/begin CHARACTERISTIC GAC_CALIB.GAC_BOBSTATUSPOSNPLAC "" VALUE 0x80610D32 DefaultValueRecordLayout_AUTOSAR_Platform_BaseTypes_uint8 255.0 DefaultIdenticalCompu 0.0 255. FORMAT "%10.5"
 /begin ANNOTATION ANNOTATION_LABEL "Description (coming from AUTOSAR DESC field)"
  /begin ANNOTATION_TEXT "BOB override for the position status of the park lock\r\n" /end ANNOTATION_TEXT
 /end ANNOTATION
/end CHARACTERISTIC
/begin CHARACTERISTIC GAC_CALIB.GAC_BOBSTATUSPOSNSYNCHROA "" VALUE 0x80610D33 DefaultValueRecordLayout_AUTOSAR_Platform_BaseTypes_uint8 255.0 DefaultIdenticalCompu 0.0 255. FORMAT "%10.5"
 /begin ANNOTATION ANNOTATION_LABEL "Description (coming from AUTOSAR DESC field)" /begin ANNOTATION_TEXT "BOB override for the position status of synchro A\r\n" /end ANNOTATION_TEXT /end ANNOTATION
/end CHARACTERISTIC
/begin CHARACTERISTIC GAC_CALIB.GAC_BOBSTATUSPOSNSYNCHROB "" VALUE 0x80610D34 DefaultValueRecordLayout_AUTOSAR_Platform_BaseTypes_uint8 255.0 DefaultIdenticalCompu 0.0 255. FORMAT "%10.5"
 /begin ANNOTATION ANNOTATION_LABEL "Description (coming from AUTOSAR DESC field)" /begin ANNOTATION_TEXT "BOB override for the position status of synchro B\r\n" /end ANNOTATION_TEXT /end ANNOTATION
/end CHARACTERISTIC
/begin CHARACTERISTIC GAC_CALIB.GAC_BOBSTATUSPOSNSYNCHROC "" VALUE 0x80610D35 DefaultValueRecordLayout_AUTOSAR_Platform_BaseTypes_uint8 255.0 DefaultIdenticalCompu 0.0 255. FORMAT "%10.5"
 /begin ANNOTATION ANNOTATION_LABEL "Description (coming from AUTOSAR DESC field)" /begin ANNOTATION_TEXT "BOB override for the position status of synchro C\r\n" /end ANNOTATION_TEXT /end ANNOTATION
/end CHARACTERISTIC
/begin CHARACTERISTIC GAC_CALIB.GAC_BOBSTATUSPOSNSYNCHROD "" VALUE 0x80610D36 DefaultValueRecordLayout_AUTOSAR_Platform_BaseTypes_uint8 255.0 DefaultIdenticalCompu 0.0 255. FORMAT "%10.5"
 /begin ANNOTATION ANNOTATION_LABEL "Description (coming from AUTOSAR DESC field)" /begin ANNOTATION_TEXT "BOB override for the position status of synchro D\r\n" /end ANNOTATION_TEXT /end ANNOTATION
/end CHARACTERISTIC
/begin CHARACTERISTIC GAC_CALIB.GAC_BOBSTATUSPOSNSYNCHROF "" VALUE 0x80610D37 DefaultValueRecordLayout_AUTOSAR_Platform_BaseTypes_uint8 255.0 DefaultIdenticalCompu 0.0 255. FORMAT "%10.5"
 /begin ANNOTATION ANNOTATION_LABEL "Description (coming from AUTOSAR DESC field)" /begin ANNOTATION_TEXT "BOB override for the position status of synchro F\r\n" /end ANNOTATION_TEXT /end ANNOTATION
/end CHARACTERISTIC
/begin CHARACTERISTIC GAC_CALIB.GAC_BOBSTATUSVGP "" VALUE 0x80610D38 DefaultValueRecordLayout_AUTOSAR_Platform_BaseTypes_uint8 255.0 DefaultIdenticalCompu 0.0 255. FORMAT "%10.5"
 /begin ANNOTATION ANNOTATION_LABEL "Description (coming from AUTOSAR DESC field)" /begin ANNOTATION_TEXT "BOB override for the failure status of the VGP valve\r\n" /end ANNOTATION_TEXT /end ANNOTATION
/end CHARACTERISTIC
/begin CHARACTERISTIC GAC_CALIB.GAC_BOBSTATUSVGQ0 "" VALUE 0x80610D39 DefaultValueRecordLayout_AUTOSAR_Platform_BaseTypes_uint8 255.0 DefaultIdenticalCompu 0.0 255. FORMAT "%10.5"
 /begin ANNOTATION ANNOTATION_LABEL "Description (coming from AUTOSAR DESC field)"
  /begin ANNOTATION_TEXT "BOB override for the failure status of the VGQ0 valve\r\n" /end ANNOTATION_TEXT
 /end ANNOTATION
/end CHARACTERISTIC
/begin CHARACTERISTIC GAC_CALIB.GAC_BOBSTATUSVGQ1 "" VALUE 0x80610D3A DefaultValueRecordLayout_AUTOSAR_Platform_BaseTypes_uint8 255.0 DefaultIdenticalCompu 0.0 255. FORMAT "%10.5"
 /begin ANNOTATION ANNOTATION_LABEL "Description (coming from AUTOSAR DESC field)"
  /begin ANNOTATION_TEXT "BOB override for the failure status of the VGQ1 valve\r\n" /end ANNOTATION_TEXT
 /end ANNOTATION
/end CHARACTERISTIC
/begin CHARACTERISTIC GAC_CALIB.GAC_BOBSTATUSVGQ2 "" VALUE 0x80610D3B DefaultValueRecordLayout_AUTOSAR_Platform_BaseTypes_uint8 255.0 DefaultIdenticalCompu 0.0 255. FORMAT "%10.5"
 /begin ANNOTATION ANNOTATION_LABEL "Description (coming from AUTOSAR DESC field)"
  /begin ANNOTATION_TEXT "BOB override for the failure status of the VGQ2 valve\r\n" /end ANNOTATION_TEXT
 /end ANNOTATION
/end CHARACTERISTIC
/begin CHARACTERISTIC GAC_CALIB.GAC_BOBSTATUSVGQ3 "" VALUE 0x80610D3C DefaultValueRecordLayout_AUTOSAR_Platform_BaseTypes_uint8 255.0 DefaultIdenticalCompu 0.0 255. FORMAT "%10.5"
 /begin ANNOTATION ANNOTATION_LABEL "Description (coming from AUTOSAR DESC field)"
  /begin ANNOTATION_TEXT "BOB override for the failure status of the VGQ3 valve\r\n" /end ANNOTATION_TEXT
 /end ANNOTATION
/end CHARACTERISTIC
/begin CHARACTERISTIC GAC_CALIB.GAC_BOBSTATUSVGQ4 "" VALUE 0x80610D3D DefaultValueRecordLayout_AUTOSAR_Platform_BaseTypes_uint8 255.0 DefaultIdenticalCompu 0.0 255. FORMAT "%10.5"
 /begin ANNOTATION ANNOTATION_LABEL "Description (coming from AUTOSAR DESC field)"
  /begin ANNOTATION_TEXT "BOB override for the failure status of the VGQ4 valve\r\n" /end ANNOTATION_TEXT
 /end ANNOTATION
/end CHARACTERISTIC
/begin CHARACTERISTIC GAC_CALIB.GAC_BOBSTATUSVGQ5 "" VALUE 0x80610D3E DefaultValueRecordLayout_AUTOSAR_Platform_BaseTypes_uint8 255.0 DefaultIdenticalCompu 0.0 255. FORMAT "%10.5"
 /begin ANNOTATION ANNOTATION_LABEL "Description (coming from AUTOSAR DESC field)"
  /begin ANNOTATION_TEXT "BOB override for the failure status of the VGQ5 valve\r\n" /end ANNOTATION_TEXT
 /end ANNOTATION
/end CHARACTERISTIC
/begin CHARACTERISTIC GAC_CALIB.GAC_BOBVEHICLESPEED "" VALUE 0x80610C68 DefaultValueRecordLayout_AUTOSAR_Platform_BaseTypes_uint16 500.0 RB_PT_PCT_SWC_GAC_CompuMethods_ratio_0p01 0.0 500. FORMAT "%10.5"
 /begin ANNOTATION ANNOTATION_LABEL "Description (coming from AUTOSAR DESC field)" /begin ANNOTATION_TEXT "Bob override for vehicle speed\r\n" /end ANNOTATION_TEXT /end ANNOTATION
/end CHARACTERISTIC
/begin CHARACTERISTIC GAC_CALIB.GAC_ClCoolCutHoldTmr.LIB_DT "" VALUE 0x80610D7A DefaultValueRecordLayout_AUTOSAR_Platform_BaseTypes_uint16 65.535 RB_PT_PCT_SWC_GAC_CompuMethods_ratio_0p001 0.0 65.535 FORMAT "%10.5"
 /begin ANNOTATION ANNOTATION_LABEL "Description (coming from AUTOSAR DESC field)" /begin ANNOTATION_TEXT "Timer decrement value.\r\n" /end ANNOTATION_TEXT /end ANNOTATION
/end CHARACTERISTIC
/begin CHARACTERISTIC GAC_CALIB.GAC_ClCoolCutTmr.LIB_DT "" VALUE 0x80610D7C DefaultValueRecordLayout_AUTOSAR_Platform_BaseTypes_uint16 65.535 RB_PT_PCT_SWC_GAC_CompuMethods_ratio_0p001 0.0 65.535 FORMAT "%10.5"
 /begin ANNOTATION ANNOTATION_LABEL "Description (coming from AUTOSAR DESC field)" /begin ANNOTATION_TEXT "Timer decrement value.\r\n" /end ANNOTATION_TEXT /end ANNOTATION
/end CHARACTERISTIC
/begin CHARACTERISTIC GAC_CALIB.GAC_COEFCDEBINNTM "" VALUE 0x80610C6A DefaultValueRecordLayout_AUTOSAR_Platform_BaseTypes_sint16 2.0 RB_PT_PCT_SWC_GAC_CompuMethods_ratio_0p0001 -1. 1. FORMAT "%10.5"
 /begin ANNOTATION ANNOTATION_LABEL "Description (coming from AUTOSAR DESC field)" /begin ANNOTATION_TEXT "C coefficient for in Neutral debounce time.\r\n" /end ANNOTATION_TEXT /end ANNOTATION
/end CHARACTERISTIC
/begin CHARACTERISTIC GAC_CALIB.GAC_COEFCFLWVLVSETUPTM "" VALUE 0x80610C6C DefaultValueRecordLayout_AUTOSAR_Platform_BaseTypes_sint16 2.0 RB_PT_PCT_SWC_GAC_CompuMethods_ratio_0p0001 -1. 1. FORMAT "%10.5"
 /begin ANNOTATION ANNOTATION_LABEL "Description (coming from AUTOSAR DESC field)" /begin ANNOTATION_TEXT "C coefficient for flow valve setup time.\r\n" /end ANNOTATION_TEXT /end ANNOTATION
/end CHARACTERISTIC
/begin CHARACTERISTIC GAC_CALIB.GAC_COEFCPVLVDIAGDLYTM "" VALUE 0x80610C6E DefaultValueRecordLayout_AUTOSAR_Platform_BaseTypes_sint16 2.0 RB_PT_PCT_SWC_GAC_CompuMethods_ratio_0p0001 -1. 1. FORMAT "%10.5"
 /begin ANNOTATION ANNOTATION_LABEL "Description (coming from AUTOSAR DESC field)"
  /begin ANNOTATION_TEXT "C coefficient for pressure valve diagnostic delay time.\r\n" /end ANNOTATION_TEXT
 /end ANNOTATION
/end CHARACTERISTIC
/begin CHARACTERISTIC GAC_CALIB.GAC_COEFCPVLVDRAINTM "" VALUE 0x80610C70 DefaultValueRecordLayout_AUTOSAR_Platform_BaseTypes_sint16 2.0 RB_PT_PCT_SWC_GAC_CompuMethods_ratio_0p0001 -1. 1. FORMAT "%10.5"
 /begin ANNOTATION ANNOTATION_LABEL "Description (coming from AUTOSAR DESC field)" /begin ANNOTATION_TEXT "C coefficient for flow valve setup time.\r\n" /end ANNOTATION_TEXT /end ANNOTATION
/end CHARACTERISTIC
/begin CHARACTERISTIC GAC_CALIB.GAC_COEFCPVLVRMPDWNTM "" VALUE 0x80610C72 DefaultValueRecordLayout_AUTOSAR_Platform_BaseTypes_sint16 2.0 RB_PT_PCT_SWC_GAC_CompuMethods_ratio_0p0001 -1. 1. FORMAT "%10.5"
 /begin ANNOTATION ANNOTATION_LABEL "Description (coming from AUTOSAR DESC field)" /begin ANNOTATION_TEXT "C coefficient for pressure valve ramp down time.\r\n" /end ANNOTATION_TEXT /end ANNOTATION
/end CHARACTERISTIC
/begin CHARACTERISTIC GAC_CALIB.GAC_COEFCSELGRTM "" VALUE 0x80610C74 DefaultValueRecordLayout_AUTOSAR_Platform_BaseTypes_sint16 2.0 RB_PT_PCT_SWC_GAC_CompuMethods_ratio_0p0001 -1. 1. FORMAT "%10.5"
 /begin ANNOTATION ANNOTATION_LABEL "Description (coming from AUTOSAR DESC field)"
  /begin ANNOTATION_TEXT "C coefficient for (single) engagement actuation time.\r\n" /end ANNOTATION_TEXT
 /end ANNOTATION
/end CHARACTERISTIC
/begin CHARACTERISTIC GAC_CALIB.GAC_COEFCVLVNOMOVETM "" VALUE 0x80610C76 DefaultValueRecordLayout_AUTOSAR_Platform_BaseTypes_sint16 2.0 RB_PT_PCT_SWC_GAC_CompuMethods_ratio_0p0001 -1. 1. FORMAT "%10.5"
 /begin ANNOTATION ANNOTATION_LABEL "Description (coming from AUTOSAR DESC field)" /begin ANNOTATION_TEXT "C coefficient for actuator no move diagnostic time.\r\n" /end ANNOTATION_TEXT /end ANNOTATION
/end CHARACTERISTIC
/begin CHARACTERISTIC GAC_CALIB.GAC_COEFMDEBINNTM "" VALUE 0x80610C78 DefaultValueRecordLayout_AUTOSAR_Platform_BaseTypes_sint16 2.0 RB_PT_PCT_SWC_GAC_CompuMethods_ratio_0p0001 -1. 1. FORMAT "%10.5"
 /begin ANNOTATION ANNOTATION_LABEL "Description (coming from AUTOSAR DESC field)" /begin ANNOTATION_TEXT "M coefficient for in Neutral debounce time.\r\n" /end ANNOTATION_TEXT /end ANNOTATION
/end CHARACTERISTIC
/begin CHARACTERISTIC GAC_CALIB.GAC_COEFMFLWVLVSETUPTM "" VALUE 0x80610C7A DefaultValueRecordLayout_AUTOSAR_Platform_BaseTypes_sint16 2.0 RB_PT_PCT_SWC_GAC_CompuMethods_ratio_0p0001 -1. 1. FORMAT "%10.5"
 /begin ANNOTATION ANNOTATION_LABEL "Description (coming from AUTOSAR DESC field)" /begin ANNOTATION_TEXT "M coefficient for flow valve setup time.\r\n" /end ANNOTATION_TEXT /end ANNOTATION
/end CHARACTERISTIC
/begin CHARACTERISTIC GAC_CALIB.GAC_COEFMPVLVDIAGDLYTM "" VALUE 0x80610C7C DefaultValueRecordLayout_AUTOSAR_Platform_BaseTypes_sint16 2.0 RB_PT_PCT_SWC_GAC_CompuMethods_ratio_0p0001 -1. 1. FORMAT "%10.5"
 /begin ANNOTATION ANNOTATION_LABEL "Description (coming from AUTOSAR DESC field)"
  /begin ANNOTATION_TEXT "M coefficient for pressure valve diagnostic delay time.\r\n" /end ANNOTATION_TEXT
 /end ANNOTATION
/end CHARACTERISTIC
/begin CHARACTERISTIC GAC_CALIB.GAC_COEFMPVLVDRAINTM "" VALUE 0x80610C7E DefaultValueRecordLayout_AUTOSAR_Platform_BaseTypes_sint16 2.0 RB_PT_PCT_SWC_GAC_CompuMethods_ratio_0p0001 -1. 1. FORMAT "%10.5"
 /begin ANNOTATION ANNOTATION_LABEL "Description (coming from AUTOSAR DESC field)" /begin ANNOTATION_TEXT "M coefficient for pressure valve drain time.\r\n" /end ANNOTATION_TEXT /end ANNOTATION
/end CHARACTERISTIC
/begin CHARACTERISTIC GAC_CALIB.GAC_COEFMPVLVRMPDWNTM "" VALUE 0x80610C80 DefaultValueRecordLayout_AUTOSAR_Platform_BaseTypes_sint16 2.0 RB_PT_PCT_SWC_GAC_CompuMethods_ratio_0p0001 -1. 1. FORMAT "%10.5"
 /begin ANNOTATION ANNOTATION_LABEL "Description (coming from AUTOSAR DESC field)" /begin ANNOTATION_TEXT "M coefficient for pressure valve ramp down time.\r\n" /end ANNOTATION_TEXT /end ANNOTATION
/end CHARACTERISTIC
/begin CHARACTERISTIC GAC_CALIB.GAC_COEFMSELGRTM "" VALUE 0x80610C82 DefaultValueRecordLayout_AUTOSAR_Platform_BaseTypes_sint16 2.0 RB_PT_PCT_SWC_GAC_CompuMethods_ratio_0p0001 -1. 1. FORMAT "%10.5"
 /begin ANNOTATION ANNOTATION_LABEL "Description (coming from AUTOSAR DESC field)"
  /begin ANNOTATION_TEXT "M coefficient for (single) engagement actuation time.\r\n" /end ANNOTATION_TEXT
 /end ANNOTATION
/end CHARACTERISTIC
/end MODULE
/end PROJECT
