ASAP2_VERSION 1 60
/begin PROJECT LB74x_TCU "5201C621"
/begin HEADER "" VERSION "5201C621" PROJECT_NO LB74x_TCU /end HEADER
/begin MODULE DIM ""
/begin MOD_COMMON "" BYTE_ORDER MSB_LAST ALIGNMENT_BYTE 1 ALIGNMENT_WORD 2 ALIGNMENT_LONG 4 ALIGNMENT_INT64 4 ALIGNMENT_FLOAT32_IEEE 4 ALIGNMENT_FLOAT64_IEEE 4 DATA_SIZE 32 /end MOD_COMMON
/begin CHARACTERISTIC DST_EFLASHB.DST_DG.DST_DGSelect.DST_BELOWLIMiTUPSHIFTLIGHT "" VAL_BLK 0x8060617A DefaultValueRecordLayout_AUTOSAR_Platform_BaseTypes_sint16 20000.0 RB_PT_PCT_SWC_DST_CompuMethods_DST_Ident 0.0 20000. FORMAT "%10.5"
 /begin ANNOTATION ANNOTATION_LABEL "Description (coming from AUTOSAR DESC field)"
  /begin ANNOTATION_TEXT "Rpm below the upshift limit to put the up-shift now light on\r\n" /end ANNOTATION_TEXT
 /end ANNOTATION
 MATRIX_DIM 12 1 1 /end CHARACTERISTIC
/begin CHARACTERISTIC DST_EFLASHB.DST_DG.DST_DGSelect.DST_DAVOLI "" VALUE 0x80606257 DefaultValueRecordLayout_AUTOSAR_Platform_BaseTypes_boolean 255.0 AUTOSAR_Platform_CompuMethods_boolean 0.0 255. FORMAT "%10.5"
 /begin ANNOTATION ANNOTATION_LABEL "Description (coming from AUTOSAR DESC field)" /begin ANNOTATION_TEXT "Project specific flag\r\n" /end ANNOTATION_TEXT /end ANNOTATION
/end CHARACTERISTIC
/begin CHARACTERISTIC DST_EFLASHB.DST_DG.DST_DGSelect.DST_DISABLEPSGDURINGPOWONDN "" VALUE 0x80606258 DefaultValueRecordLayout_AUTOSAR_Platform_BaseTypes_boolean 255.0 AUTOSAR_Platform_CompuMethods_boolean 0.0 255. FORMAT "%10.5"
 /begin ANNOTATION ANNOTATION_LABEL "Description (coming from AUTOSAR DESC field)"
  /begin ANNOTATION_TEXT "If set to true, during a power on down sequence, the preselect gear will not be set until the final target gear is requested\r\n" /end ANNOTATION_TEXT
 /end ANNOTATION
/end CHARACTERISTIC
/begin CHARACTERISTIC DST_EFLASHB.DST_DG.DST_DGSelect.DST_DONTWAITFORSEQ2UPSHIFT "" VALUE 0x80606259 DefaultValueRecordLayout_AUTOSAR_Platform_BaseTypes_boolean 255.0 AUTOSAR_Platform_CompuMethods_boolean 0.0 255. FORMAT "%10.5"
 /begin ANNOTATION ANNOTATION_LABEL "Description (coming from AUTOSAR DESC field)"
  /begin ANNOTATION_TEXT "If true, upshifts will be requested even if SEQ has not made it to the currently requested gear\r\n" /end ANNOTATION_TEXT
 /end ANNOTATION
/end CHARACTERISTIC
/begin CHARACTERISTIC DST_EFLASHB.DST_DG.DST_DGSelect.DST_DOWNSHIFTLIMITS "" VAL_BLK 0x80606192 DefaultValueRecordLayout_AUTOSAR_Platform_BaseTypes_sint16 20000.0 RB_PT_PCT_SWC_DST_CompuMethods_DST_Ident 0.0 20000. FORMAT "%10.5"
 /begin ANNOTATION ANNOTATION_LABEL "Description (coming from AUTOSAR DESC field)"
  /begin ANNOTATION_TEXT "Engine speed in lowest gear before a downshift will be requested\r\n" /end ANNOTATION_TEXT
 /end ANNOTATION
 MATRIX_DIM 12 1 1 /end CHARACTERISTIC
/begin CHARACTERISTIC DST_EFLASHB.DST_DG.DST_DGSelect.DST_ENABLEHDASTARTLOGIC "" VALUE 0x8060625A DefaultValueRecordLayout_AUTOSAR_Platform_BaseTypes_boolean 255.0 AUTOSAR_Platform_CompuMethods_boolean 0.0 255. FORMAT "%10.5"
 /begin ANNOTATION ANNOTATION_LABEL "Description (coming from AUTOSAR DESC field)" /begin ANNOTATION_TEXT "Only enable for HDA starting\r\n" /end ANNOTATION_TEXT /end ANNOTATION
/end CHARACTERISTIC
/begin CHARACTERISTIC DST_EFLASHB.DST_DG.DST_DGSelect.DST_FORWARD2LOWGEAR "" VALUE 0x80606224 DefaultValueRecordLayout_AUTOSAR_Platform_BaseTypes_uint16 500.0 RB_PT_PCT_SWC_DST_CompuMethods_kph_0p1 0.0 500. FORMAT "%10.5"
 /begin ANNOTATION ANNOTATION_LABEL "Description (coming from AUTOSAR DESC field)"
  /begin ANNOTATION_TEXT "Vehicle speed forward below which the low gear will be engaged when selecting forward from Neutral or reverse\r\n" /end ANNOTATION_TEXT
 /end ANNOTATION
/end CHARACTERISTIC
/begin CHARACTERISTIC DST_EFLASHB.DST_DG.DST_DGSelect.DST_HDASTARTPOSTGEARSTRATEGY "" VALUE 0x8060625B DefaultValueRecordLayout_AUTOSAR_Platform_BaseTypes_uint8 2.0 RB_PT_PCT_SWC_DST_CompuMethods_ident 0.0 2. FORMAT "%10.5"
 /begin ANNOTATION ANNOTATION_LABEL "Description (coming from AUTOSAR DESC field)"
  /begin ANNOTATION_TEXT "Gear selection after HDA start. 0 = Freeze Gears, 1 = Increase gear by 1,  2 = go directly to target gear\r\n" /end ANNOTATION_TEXT
 /end ANNOTATION
/end CHARACTERISTIC
/begin CHARACTERISTIC DST_EFLASHB.DST_DG.DST_DGSelect.DST_HIGHRPMIMMEDIATEUPSHIFT "" VALUE 0x8060625C DefaultValueRecordLayout_AUTOSAR_Platform_BaseTypes_boolean 255.0 AUTOSAR_Platform_CompuMethods_boolean 0.0 255. FORMAT "%10.5"
 /begin ANNOTATION ANNOTATION_LABEL "Description (coming from AUTOSAR DESC field)"
  /begin ANNOTATION_TEXT "If true, high rpm reapplication of throttle can request an immediate up-shift\r\n" /end ANNOTATION_TEXT
 /end ANNOTATION
/end CHARACTERISTIC
/begin CHARACTERISTIC DST_EFLASHB.DST_DG.DST_DGSelect.DST_LIFTOFFGEARSTRATEGY "" VALUE 0x80606226 DefaultValueRecordLayout_AUTOSAR_Platform_BaseTypes_uint16 5.0 RB_PT_PCT_SWC_DST_CompuMethods_ident 0.0 5. FORMAT "%10.5"
 /begin ANNOTATION ANNOTATION_LABEL "Description (coming from AUTOSAR DESC field)"
  /begin ANNOTATION_TEXT "Defines the gear selected during an aborted Kick-down\r\n" /end ANNOTATION_TEXT
 /end ANNOTATION
/end CHARACTERISTIC
/begin CHARACTERISTIC DST_EFLASHB.DST_DG.DST_DGSelect.DST_LIFTOFFPEDALTHRESH "" VALUE 0x8060625D DefaultValueRecordLayout_AUTOSAR_Platform_BaseTypes_uint8 102.0 RB_PT_PCT_SWC_DST_CompuMethods_ratio_0p4 0.0 102. FORMAT "%10.5"
 /begin ANNOTATION ANNOTATION_LABEL "Description (coming from AUTOSAR DESC field)"
  /begin ANNOTATION_TEXT "Maximum pedal allowed to trigger lift off B4 downshift complete\r\n" /end ANNOTATION_TEXT
 /end ANNOTATION
/end CHARACTERISTIC
/begin CHARACTERISTIC DST_EFLASHB.DST_DG.DST_DGSelect.DST_MANUALDIRECTKMH "" VALUE 0x80606228 DefaultValueRecordLayout_AUTOSAR_Platform_BaseTypes_uint16 500.0 RB_PT_PCT_SWC_DST_CompuMethods_kph_0p1 0.0 500. FORMAT "%10.5"
 /begin ANNOTATION ANNOTATION_LABEL "Description (coming from AUTOSAR DESC field)"
  /begin ANNOTATION_TEXT "Vehicle speed below which manual down-shifts can go directly to a direct gear\r\n" /end ANNOTATION_TEXT
 /end ANNOTATION
/end CHARACTERISTIC
/begin CHARACTERISTIC DST_EFLASHB.DST_DG.DST_DGSelect.DST_MANUALDIRECTTHROTTLE "" VALUE 0x8060625E DefaultValueRecordLayout_AUTOSAR_Platform_BaseTypes_uint8 102.0 RB_PT_PCT_SWC_DST_CompuMethods_ratio_0p4 0.0 102. FORMAT "%10.5"
 /begin ANNOTATION ANNOTATION_LABEL "Description (coming from AUTOSAR DESC field)"
  /begin ANNOTATION_TEXT "Throttle pedal above which manual downshift will target direct shift gear\r\n" /end ANNOTATION_TEXT
 /end ANNOTATION
/end CHARACTERISTIC
/begin CHARACTERISTIC DST_EFLASHB.DST_DG.DST_DGSelect.DST_MANUALPWRONDNLOGIC "" VALUE 0x8060625F DefaultValueRecordLayout_AUTOSAR_Platform_BaseTypes_boolean 255.0 AUTOSAR_Platform_CompuMethods_boolean 0.0 255. FORMAT "%10.5"
 /begin ANNOTATION ANNOTATION_LABEL "Description (coming from AUTOSAR DESC field)"
  /begin ANNOTATION_TEXT "Function in developement for downshift gear based on torque path\r\n" /end ANNOTATION_TEXT
 /end ANNOTATION
/end CHARACTERISTIC
/begin CHARACTERISTIC DST_EFLASHB.DST_DG.DST_DGSelect.DST_MAXTIMEINDOWNSHIFTSINGLE "" VALUE 0x8060622A DefaultValueRecordLayout_AUTOSAR_Platform_BaseTypes_uint16 655.35 RB_PT_PCT_SWC_DST_CompuMethods_DST_Time 0.0 655.35 FORMAT "%10.5"
 /begin ANNOTATION ANNOTATION_LABEL "Description (coming from AUTOSAR DESC field)"
  /begin ANNOTATION_TEXT "Maximum time allowed in downshift single - prevent getting stuck if engine speed does not respond\r\n" /end ANNOTATION_TEXT
 /end ANNOTATION
/end CHARACTERISTIC
/begin CHARACTERISTIC DST_EFLASHB.DST_DG.DST_DGSelect.DST_MAXTIMEINDOWNSHIFTSINGLETIMOUT "" VALUE 0x8060622C DefaultValueRecordLayout_AUTOSAR_Platform_BaseTypes_uint16 655.35 RB_PT_PCT_SWC_DST_CompuMethods_DST_Time 0.0 655.35 FORMAT "%10.5"
 /begin ANNOTATION ANNOTATION_LABEL "Description (coming from AUTOSAR DESC field)"
  /begin ANNOTATION_TEXT "Maximum time allowed in downshift single - prevent getting stuck if engine speed does not respond\r\n" /end ANNOTATION_TEXT
 /end ANNOTATION
/end CHARACTERISTIC
/begin CHARACTERISTIC DST_EFLASHB.DST_DG.DST_DGSelect.DST_MINENGSPDINCMANDOWNSEQ "" VALUE 0x8060622E DefaultValueRecordLayout_AUTOSAR_Platform_BaseTypes_uint16 20000.0 RB_PT_PCT_SWC_DST_CompuMethods_ident 0.0 20000. FORMAT "%10.5"
 /begin ANNOTATION ANNOTATION_LABEL "Description (coming from AUTOSAR DESC field)"
  /begin ANNOTATION_TEXT "Minimum engine speed increase to select manual gear if an upshift is in progress\r\n" /end ANNOTATION_TEXT
 /end ANNOTATION
/end CHARACTERISTIC
/begin CHARACTERISTIC DST_EFLASHB.DST_DG.DST_DGSelect.DST_MINPEDAL2ALLOWUPSHIFT "" VALUE 0x80606260 DefaultValueRecordLayout_AUTOSAR_Platform_BaseTypes_uint8 102.0 RB_PT_PCT_SWC_DST_CompuMethods_ratio_0p4 0.0 102. FORMAT "%10.5"
 /begin ANNOTATION ANNOTATION_LABEL "Description (coming from AUTOSAR DESC field)" /begin ANNOTATION_TEXT "Pedal above which up-shifts are allowed\r\n" /end ANNOTATION_TEXT /end ANNOTATION
/end CHARACTERISTIC
/begin CHARACTERISTIC DST_EFLASHB.DST_DG.DST_DGSelect.DST_MINRPMBSPDPHSECOMPLETE "" VALUE 0x80606230 DefaultValueRecordLayout_AUTOSAR_Platform_BaseTypes_uint16 20000.0 RB_PT_PCT_SWC_DST_CompuMethods_ident 0.0 20000. FORMAT "%10.5"
 /begin ANNOTATION ANNOTATION_LABEL "Description (coming from AUTOSAR DESC field)"
  /begin ANNOTATION_TEXT "Engine speed below the new shaft speed when the speed phase can be considered to be close to ending\r\n" /end ANNOTATION_TEXT
 /end ANNOTATION
/end CHARACTERISTIC
/begin CHARACTERISTIC DST_EFLASHB.DST_DG.DST_DGSelect.DST_MINRPMMANUPSHIFTENGTEMP "" CURVE 0x806062D0 RB_PT_PCT_SWC_DST_RecordLayouts_RL_Curve_sint16_5_sint16_5 20000.0 RB_PT_PCT_SWC_DST_CompuMethods_DST_Ident 0.0 20000. FORMAT "%10.5"
 /begin ANNOTATION ANNOTATION_LABEL "Description (coming from AUTOSAR DESC field)"
  /begin ANNOTATION_TEXT "Minimum engine speed in the next highest gear after a manual upshift based on engine temperature\r\n" /end ANNOTATION_TEXT
 /end ANNOTATION
 /begin AXIS_DESCR STD_AXIS NO_INPUT_QUANTITY RB_PT_PCT_SWC_DST_CompuMethods_ident 5 -60. 200. FORMAT "%10.5" DEPOSIT ABSOLUTE /end AXIS_DESCR
/end CHARACTERISTIC
/begin CHARACTERISTIC DST_EFLASHB.DST_DG.DST_DGSelect.DST_MINTIMEBETWEENMANDOWNS "" VALUE 0x80606232 DefaultValueRecordLayout_AUTOSAR_Platform_BaseTypes_uint16 655.35 RB_PT_PCT_SWC_DST_CompuMethods_DST_Time 0.0 655.35 FORMAT "%10.5"
 /begin ANNOTATION ANNOTATION_LABEL "Description (coming from AUTOSAR DESC field)"
  /begin ANNOTATION_TEXT "Minimum time beteen driver requested manual downshifts\r\n" /end ANNOTATION_TEXT
 /end ANNOTATION
/end CHARACTERISTIC
/begin CHARACTERISTIC DST_EFLASHB.DST_DG.DST_DGSelect.DST_MINTIMEBETWEENMANUPS "" VALUE 0x80606234 DefaultValueRecordLayout_AUTOSAR_Platform_BaseTypes_uint16 655.35 RB_PT_PCT_SWC_DST_CompuMethods_DST_Time 0.0 655.35 FORMAT "%10.5"
 /begin ANNOTATION ANNOTATION_LABEL "Description (coming from AUTOSAR DESC field)"
  /begin ANNOTATION_TEXT "Minimum time beteen driver requested manual downshifts\r\n" /end ANNOTATION_TEXT
 /end ANNOTATION
/end CHARACTERISTIC
/begin CHARACTERISTIC DST_EFLASHB.DST_DG.DST_DGSelect.DST_MODECHANGEDOWNGEARTHRESH "" VALUE 0x80606261 DefaultValueRecordLayout_AUTOSAR_Platform_BaseTypes_uint8 11.0 RB_PT_PCT_SWC_DST_CompuMethods_ident 0.0 11. FORMAT "%10.5"
 /begin ANNOTATION ANNOTATION_LABEL "Description (coming from AUTOSAR DESC field)"
  /begin ANNOTATION_TEXT "Lowest gear a downshift will be requested from during a mode change\r\n" /end ANNOTATION_TEXT
 /end ANNOTATION
/end CHARACTERISTIC
/begin CHARACTERISTIC DST_EFLASHB.DST_DG.DST_DGSelect.DST_MODECHANGEDOWNRPMTHRESH "" VALUE 0x80606236 DefaultValueRecordLayout_AUTOSAR_Platform_BaseTypes_sint16 20000.0 RB_PT_PCT_SWC_DST_CompuMethods_DST_Ident 0.0 20000. FORMAT "%10.5"
 /begin ANNOTATION ANNOTATION_LABEL "Description (coming from AUTOSAR DESC field)"
  /begin ANNOTATION_TEXT "Rpm in demand gear above which downshifts will not be requested when the mode is changed\r\n" /end ANNOTATION_TEXT
 /end ANNOTATION
/end CHARACTERISTIC
/begin CHARACTERISTIC DST_EFLASHB.DST_DG.DST_DGSelect.DST_PERFORMSTAGEDPOWERONDOWNS "" VALUE 0x80606262 DefaultValueRecordLayout_AUTOSAR_Platform_BaseTypes_boolean 255.0 AUTOSAR_Platform_CompuMethods_boolean 0.0 255. FORMAT "%10.5"
 /begin ANNOTATION ANNOTATION_LABEL "Description (coming from AUTOSAR DESC field)" /begin ANNOTATION_TEXT "If true, the transmission is a DCT\r\n" /end ANNOTATION_TEXT /end ANNOTATION
/end CHARACTERISTIC
/begin CHARACTERISTIC DST_EFLASHB.DST_DG.DST_DGSelect.DST_PHBRAKEPRESSUREDISABLE "" VALUE 0x80606263 DefaultValueRecordLayout_AUTOSAR_Platform_BaseTypes_boolean 255.0 AUTOSAR_Platform_CompuMethods_boolean 0.0 255. FORMAT "%10.5"
 /begin ANNOTATION ANNOTATION_LABEL "Description (coming from AUTOSAR DESC field)"
  /begin ANNOTATION_TEXT "If true, the brake pressure will not be used independantly for pull and hold manual downshifts\r\n" /end ANNOTATION_TEXT
 /end ANNOTATION
/end CHARACTERISTIC
/begin CHARACTERISTIC DST_EFLASHB.DST_DG.DST_DGSelect.DST_PHBRAKEPRESSUREHYST "" VALUE 0x80606238 DefaultValueRecordLayout_AUTOSAR_Platform_BaseTypes_uint16 409.5 RB_PT_PCT_SWC_DST_CompuMethods_ratio_0p1 0.0 409.5 FORMAT "%10.5"
 /begin ANNOTATION ANNOTATION_LABEL "Description (coming from AUTOSAR DESC field)"
  /begin ANNOTATION_TEXT "Brake pressure hyseresis before pull and hold is cancelled\r\n" /end ANNOTATION_TEXT
 /end ANNOTATION
/end CHARACTERISTIC
/begin CHARACTERISTIC DST_EFLASHB.DST_DG.DST_DGSelect.DST_PHBRAKEPRESSURETRIGGER "" VALUE 0x8060623A DefaultValueRecordLayout_AUTOSAR_Platform_BaseTypes_uint16 409.5 RB_PT_PCT_SWC_DST_CompuMethods_ratio_0p1 0.0 409.5 FORMAT "%10.5"
 /begin ANNOTATION ANNOTATION_LABEL "Description (coming from AUTOSAR DESC field)"
  /begin ANNOTATION_TEXT "Minimum brake pressure to enable pull and hold strategy\r\n" /end ANNOTATION_TEXT
 /end ANNOTATION
/end CHARACTERISTIC
/begin CHARACTERISTIC DST_EFLASHB.DST_DG.DST_DGSelect.DST_PHCHANGE2DOWNSHIFTTRIGGER "" MAP 0x806062E6 RB_PT_PCT_SWC_DST_RecordLayouts_RL_Map_sint16_20_uint16_4_uint16_5 20000.0 RB_PT_PCT_SWC_DST_CompuMethods_ident -10000. 10000. FORMAT "%10.5"
 /begin ANNOTATION ANNOTATION_LABEL "Description (coming from AUTOSAR DESC field)"
  /begin ANNOTATION_TEXT "Change to pull and hold trigger value per second based on PHStartRpm and Brake Pressure\r\n" /end ANNOTATION_TEXT
 /end ANNOTATION
 /begin AXIS_DESCR STD_AXIS NO_INPUT_QUANTITY RB_PT_PCT_SWC_DST_CompuMethods_ident 4 0.0 20000. FORMAT "%10.5" DEPOSIT ABSOLUTE /end AXIS_DESCR
 /begin AXIS_DESCR STD_AXIS NO_INPUT_QUANTITY RB_PT_PCT_SWC_DST_CompuMethods_ratio_0p1 5 0.0 409.5 FORMAT "%10.5" DEPOSIT ABSOLUTE /end AXIS_DESCR
/end CHARACTERISTIC
/begin CHARACTERISTIC DST_EFLASHB.DST_DG.DST_DGSelect.DST_PHDECELDISABLE "" VALUE 0x80606264 DefaultValueRecordLayout_AUTOSAR_Platform_BaseTypes_boolean 255.0 AUTOSAR_Platform_CompuMethods_boolean 0.0 255. FORMAT "%10.5"
 /begin ANNOTATION ANNOTATION_LABEL "Description (coming from AUTOSAR DESC field)"
  /begin ANNOTATION_TEXT "Flag to enable longitudinal acceleration to trigger/enable brake pull and hold\r\n" /end ANNOTATION_TEXT
 /end ANNOTATION
/end CHARACTERISTIC
/begin CHARACTERISTIC DST_EFLASHB.DST_DG.DST_DGSelect.DST_PHDECELHYST "" VALUE 0x8060623C DefaultValueRecordLayout_AUTOSAR_Platform_BaseTypes_sint16 4.0 RB_PT_PCT_SWC_DST_CompuMethods_ratio_0p01 -2. 2. FORMAT "%10.5"
 /begin ANNOTATION ANNOTATION_LABEL "Description (coming from AUTOSAR DESC field)" /begin ANNOTATION_TEXT "Hysteresis band to disable pull and hold\r\n" /end ANNOTATION_TEXT /end ANNOTATION
/end CHARACTERISTIC
/begin CHARACTERISTIC DST_EFLASHB.DST_DG.DST_DGSelect.DST_PHDEELTRIGGER "" VALUE 0x8060623E DefaultValueRecordLayout_AUTOSAR_Platform_BaseTypes_sint16 4.0 RB_PT_PCT_SWC_DST_CompuMethods_ratio_0p01 -2. 2. FORMAT "%10.5"
 /begin ANNOTATION ANNOTATION_LABEL "Description (coming from AUTOSAR DESC field)"
  /begin ANNOTATION_TEXT "Longitudinal acceleration to trigger pull and hold braking\r\n" /end ANNOTATION_TEXT
 /end ANNOTATION
/end CHARACTERISTIC
/begin CHARACTERISTIC DST_EFLASHB.DST_DG.DST_DGSelect.DST_PHDONTUSETIMESINCEBRAKE "" VALUE 0x80606265 DefaultValueRecordLayout_AUTOSAR_Platform_BaseTypes_boolean 255.0 AUTOSAR_Platform_CompuMethods_boolean 0.0 255. FORMAT "%10.5"
 /begin ANNOTATION ANNOTATION_LABEL "Description (coming from AUTOSAR DESC field)"
  /begin ANNOTATION_TEXT "If true, the brake signal will not be used when counting the held time\r\n" /end ANNOTATION_TEXT
 /end ANNOTATION
/end CHARACTERISTIC
/begin CHARACTERISTIC DST_EFLASHB.DST_DG.DST_DGSelect.DST_PHDOWNSHIFTRPMLIMIT "" VAL_BLK 0x806061C2 DefaultValueRecordLayout_AUTOSAR_Platform_BaseTypes_sint16 20000.0 RB_PT_PCT_SWC_DST_CompuMethods_DST_Ident 0.0 20000. FORMAT "%10.5"
 /begin ANNOTATION ANNOTATION_LABEL "Description (coming from AUTOSAR DESC field)"
  /begin ANNOTATION_TEXT "Engine speed in lowest gear before a downshift will be requested\r\n" /end ANNOTATION_TEXT
 /end ANNOTATION
 MATRIX_DIM 11 1 1 /end CHARACTERISTIC
/begin CHARACTERISTIC DST_EFLASHB.DST_DG.DST_DGSelect.DST_PHINITIALMAXRPMOFFSET "" VALUE 0x80606240 DefaultValueRecordLayout_AUTOSAR_Platform_BaseTypes_sint16 20000.0 RB_PT_PCT_SWC_DST_CompuMethods_ident -10000. 10000. FORMAT "%10.5"
 /begin ANNOTATION ANNOTATION_LABEL "Description (coming from AUTOSAR DESC field)"
  /begin ANNOTATION_TEXT "Offset added to the resulting rpm after a pull and hold downshift\r\n" /end ANNOTATION_TEXT
 /end ANNOTATION
/end CHARACTERISTIC
/begin CHARACTERISTIC DST_EFLASHB.DST_DG.DST_DGSelect.DST_PHINITIALMINRPMOFFSET "" CURVE 0x80606324 RB_PT_PCT_SWC_DST_RecordLayouts_RL_Curve_sint16_4_uint16_4 20000.0 RB_PT_PCT_SWC_DST_CompuMethods_ident -10000. 10000. FORMAT "%10.5"
 /begin ANNOTATION ANNOTATION_LABEL "Description (coming from AUTOSAR DESC field)" /begin ANNOTATION_TEXT "Offset from initial pull and down rpm trigger\r\n" /end ANNOTATION_TEXT /end ANNOTATION
 /begin AXIS_DESCR STD_AXIS NO_INPUT_QUANTITY RB_PT_PCT_SWC_DST_CompuMethods_ident 4 0.0 20000. FORMAT "%10.5" DEPOSIT ABSOLUTE /end AXIS_DESCR
/end CHARACTERISTIC
/begin CHARACTERISTIC DST_EFLASHB.DST_DG.DST_DGSelect.DST_PHLATACCDISABLE "" VALUE 0x80606266 DefaultValueRecordLayout_AUTOSAR_Platform_BaseTypes_boolean 255.0 AUTOSAR_Platform_CompuMethods_boolean 0.0 255. FORMAT "%10.5"
 /begin ANNOTATION ANNOTATION_LABEL "Description (coming from AUTOSAR DESC field)"
  /begin ANNOTATION_TEXT "Flag to use Lateral acceleration to enable / disable pull and hold down-shifts\r\n" /end ANNOTATION_TEXT
 /end ANNOTATION
/end CHARACTERISTIC
/begin CHARACTERISTIC DST_EFLASHB.DST_DG.DST_DGSelect.DST_PHLATACCTRIGGER "" VALUE 0x80606267 DefaultValueRecordLayout_AUTOSAR_Platform_BaseTypes_uint8 1.27 RB_PT_PCT_SWC_DST_CompuMethods_ratio_0p01 0.0 1.27 FORMAT "%10.5"
 /begin ANNOTATION ANNOTATION_LABEL "Description (coming from AUTOSAR DESC field)"
  /begin ANNOTATION_TEXT "Lateral acceleration to enable pull and hold downshifts\r\n" /end ANNOTATION_TEXT
 /end ANNOTATION
/end CHARACTERISTIC
/begin CHARACTERISTIC DST_EFLASHB.DST_DG.DST_DGSelect.DST_PHLATTACCHYST "" VALUE 0x80606268 DefaultValueRecordLayout_AUTOSAR_Platform_BaseTypes_uint8 1.27 RB_PT_PCT_SWC_DST_CompuMethods_ratio_0p01 0.0 1.27 FORMAT "%10.5"
 /begin ANNOTATION ANNOTATION_LABEL "Description (coming from AUTOSAR DESC field)"
  /begin ANNOTATION_TEXT "Lateral acceleration to enable pull and hold downshifts\r\n" /end ANNOTATION_TEXT
 /end ANNOTATION
/end CHARACTERISTIC
/begin CHARACTERISTIC DST_EFLASHB.DST_DG.DST_DGSelect.DST_PHMAXENGSPEEDOFFSET "" VAL_BLK 0x806061D8 DefaultValueRecordLayout_AUTOSAR_Platform_BaseTypes_sint16 10000.0 RB_PT_PCT_SWC_DST_CompuMethods_ident -5000. 5000. FORMAT "%10.5"
 /begin ANNOTATION ANNOTATION_LABEL "Description (coming from AUTOSAR DESC field)"
  /begin ANNOTATION_TEXT "Offset (can be positive or negative) from maximum engine speed, based on next lowest gear\r\n" /end ANNOTATION_TEXT
 /end ANNOTATION
 MATRIX_DIM 11 1 1 /end CHARACTERISTIC
/begin CHARACTERISTIC DST_EFLASHB.DST_DG.DST_DGSelect.DST_PHMAXRPMIMIT "" VAL_BLK 0x806061AA DefaultValueRecordLayout_AUTOSAR_Platform_BaseTypes_uint16 20000.0 RB_PT_PCT_SWC_DST_CompuMethods_ident 0.0 20000. FORMAT "%10.5"
 /begin ANNOTATION ANNOTATION_LABEL "Description (coming from AUTOSAR DESC field)" /begin ANNOTATION_TEXT "upper limit of rpm in lower gear to shift down to\r\n" /end ANNOTATION_TEXT /end ANNOTATION
 MATRIX_DIM 12 1 1 /end CHARACTERISTIC
/begin CHARACTERISTIC DST_EFLASHB.DST_DG.DST_DGSelect.DST_PHMAXRPMRAMPMAX "" VALUE 0x8060621C DefaultValueRecordLayout_AUTOSAR_Platform_BaseTypes_uint32 20000.0 RB_PT_PCT_SWC_DST_CompuMethods_ident 0.0 20000. FORMAT "%10.5"
 /begin ANNOTATION ANNOTATION_LABEL "Description (coming from AUTOSAR DESC field)"
  /begin ANNOTATION_TEXT "Maximum increase of the resultant rpm when performing a pull and hold downshift\r\n" /end ANNOTATION_TEXT
 /end ANNOTATION
/end CHARACTERISTIC
/begin CHARACTERISTIC DST_EFLASHB.DST_DG.DST_DGSelect.DST_PHMINRPMLIMIT "" VAL_BLK 0x806061EE DefaultValueRecordLayout_AUTOSAR_Platform_BaseTypes_uint16 20000.0 RB_PT_PCT_SWC_DST_CompuMethods_ident 0.0 20000. FORMAT "%10.5"
 /begin ANNOTATION ANNOTATION_LABEL "Description (coming from AUTOSAR DESC field)" /begin ANNOTATION_TEXT "Upper limit of minimum rpm to request downshift\r\n" /end ANNOTATION_TEXT /end ANNOTATION
 MATRIX_DIM 11 1 1 /end CHARACTERISTIC
/begin CHARACTERISTIC DST_EFLASHB.DST_DG.DST_DGSelect.DST_PHMINRPMRAMPMAX "" VALUE 0x80606220 DefaultValueRecordLayout_AUTOSAR_Platform_BaseTypes_uint32 20000.0 RB_PT_PCT_SWC_DST_CompuMethods_ident 0.0 20000. FORMAT "%10.5"
 /begin ANNOTATION ANNOTATION_LABEL "Description (coming from AUTOSAR DESC field)"
  /begin ANNOTATION_TEXT "Maximum increase of the rpm that will trigger the downshifts\r\n" /end ANNOTATION_TEXT
 /end ANNOTATION
/end CHARACTERISTIC
/begin CHARACTERISTIC DST_EFLASHB.DST_DG.DST_DGSelect.DST_PHSHIFTMODESTRATEGY "" VAL_BLK 0x80606158 DefaultValueRecordLayout_AUTOSAR_Platform_BaseTypes_uint8 3.0 RB_PT_PCT_SWC_DST_CompuMethods_ident 0.0 3. FORMAT "%10.5"
 /begin ANNOTATION ANNOTATION_LABEL "Description (coming from AUTOSAR DESC field)"
  /begin ANNOTATION_TEXT "0 = Disabled, 1 = Select Lowest Gear, 2 = Downshift at first min rpm with ramp, 3 = Downshift to resultant rpm with ramp\r\n" /end ANNOTATION_TEXT
 /end ANNOTATION
 MATRIX_DIM 17 1 1 /end CHARACTERISTIC
/begin CHARACTERISTIC DST_EFLASHB.DST_DG.DST_DGSelect.DST_PHTIMESINCEBRAKE "" VALUE 0x80606242 DefaultValueRecordLayout_AUTOSAR_Platform_BaseTypes_uint16 655.35 RB_PT_PCT_SWC_DST_CompuMethods_DST_Time 0.0 655.35 FORMAT "%10.5"
 /begin ANNOTATION ANNOTATION_LABEL "Description (coming from AUTOSAR DESC field)"
  /begin ANNOTATION_TEXT "If time since the brake was pressed is equal to or less than this value, aggressive downshifts by holding the down paddle will be enabled\r\n" /end ANNOTATION_TEXT
 /end ANNOTATION
/end CHARACTERISTIC
/begin CHARACTERISTIC DST_EFLASHB.DST_DG.DST_DGSelect.DST_PHTRIGGERPADDLEBRAKETIME "" VALUE 0x80606244 DefaultValueRecordLayout_AUTOSAR_Platform_BaseTypes_uint16 65.535 RB_PT_PCT_SWC_DST_CompuMethods_ratio_0p001 0.0 65.535 FORMAT "%10.5"
 /begin ANNOTATION ANNOTATION_LABEL "Description (coming from AUTOSAR DESC field)"
  /begin ANNOTATION_TEXT "This is the time the brake (depending on cal) and the down paddle have to be held to select the lowest possible gear\r\n" /end ANNOTATION_TEXT
 /end ANNOTATION
/end CHARACTERISTIC
/begin CHARACTERISTIC DST_EFLASHB.DST_DG.DST_DGSelect.DST_PULLAWAY2ND1TO2KMHTHRESH "" VALUE 0x80606246 DefaultValueRecordLayout_AUTOSAR_Platform_BaseTypes_uint16 500.0 RB_PT_PCT_SWC_DST_CompuMethods_kph_0p1 0.0 500. FORMAT "%10.5"
 /begin ANNOTATION ANNOTATION_LABEL "Description (coming from AUTOSAR DESC field)"
  /begin ANNOTATION_TEXT "Maximum speed to allow 1 to 2 upshift due to 2nd gear pullaway logic\r\n" /end ANNOTATION_TEXT
 /end ANNOTATION
/end CHARACTERISTIC
/begin CHARACTERISTIC DST_EFLASHB.DST_DG.DST_DGSelect.DST_PULLAWAY2ND1TO2PEDALTHRESH "" VALUE 0x80606269 DefaultValueRecordLayout_AUTOSAR_Platform_BaseTypes_uint8 102.0 RB_PT_PCT_SWC_DST_CompuMethods_ratio_0p4 0.0 102. FORMAT "%10.5"
 /begin ANNOTATION ANNOTATION_LABEL "Description (coming from AUTOSAR DESC field)"
  /begin ANNOTATION_TEXT "Maximum throttle angle to enable 1 to 2 upshift if pullaway second is true\r\n" /end ANNOTATION_TEXT
 /end ANNOTATION
/end CHARACTERISTIC
/begin CHARACTERISTIC DST_EFLASHB.DST_DG.DST_DGSelect.DST_REMAINRPMSPEEDPHASEDONE "" CURVE 0x80606336 RB_PT_PCT_SWC_DST_RecordLayouts_RL_Curve_uint16_6_uint16_6 20000.0 RB_PT_PCT_SWC_DST_CompuMethods_ident 0.0 20000. FORMAT "%10.5"
 /begin ANNOTATION ANNOTATION_LABEL "Description (coming from AUTOSAR DESC field)"
  /begin ANNOTATION_TEXT "Input = Rpm for 1st speed phase, Output = Rpm below target rpm to abort speed phase and select final target gear\r\n" /end ANNOTATION_TEXT
 /end ANNOTATION
 /begin AXIS_DESCR STD_AXIS NO_INPUT_QUANTITY RB_PT_PCT_SWC_DST_CompuMethods_ident 6 0.0 20000. FORMAT "%10.5" DEPOSIT ABSOLUTE /end AXIS_DESCR
/end CHARACTERISTIC
/begin CHARACTERISTIC DST_EFLASHB.DST_DG.DST_DGSelect.DST_REVERSEKMHTOSELECT "" VALUE 0x80606248 DefaultValueRecordLayout_AUTOSAR_Platform_BaseTypes_uint16 500.0 RB_PT_PCT_SWC_DST_CompuMethods_kph_0p1 0.0 500. FORMAT "%10.5"
 /begin ANNOTATION ANNOTATION_LABEL "Description (coming from AUTOSAR DESC field)" /begin ANNOTATION_TEXT "Vehicle speed below which reverse was selectable\r\n" /end ANNOTATION_TEXT /end ANNOTATION
/end CHARACTERISTIC
/begin CHARACTERISTIC DST_EFLASHB.DST_DG.DST_DGSelect.DST_REVERSING2LOWGEAR "" VALUE 0x8060624A DefaultValueRecordLayout_AUTOSAR_Platform_BaseTypes_uint16 500.0 RB_PT_PCT_SWC_DST_CompuMethods_kph_0p1 0.0 500. FORMAT "%10.5"
 /begin ANNOTATION ANNOTATION_LABEL "Description (coming from AUTOSAR DESC field)"
  /begin ANNOTATION_TEXT "Vehicle speed in reverse below which the low gear will be engaged when selecting forward from Neutral or reverse\r\n" /end ANNOTATION_TEXT
 /end ANNOTATION
/end CHARACTERISTIC
/begin CHARACTERISTIC DST_EFLASHB.DST_DG.DST_DGSelect.DST_REVERSINGENGAGESPEED "" VALUE 0x8060624C DefaultValueRecordLayout_AUTOSAR_Platform_BaseTypes_uint16 500.0 RB_PT_PCT_SWC_DST_CompuMethods_kph_0p1 0.0 500. FORMAT "%10.5"
 /begin ANNOTATION ANNOTATION_LABEL "Description (coming from AUTOSAR DESC field)"
  /begin ANNOTATION_TEXT "When reversing below this speed, on entry to forward gear, DST_REVERSINGFWDGEAR will be engaged\r\n" /end ANNOTATION_TEXT
 /end ANNOTATION
/end CHARACTERISTIC
/begin CHARACTERISTIC DST_EFLASHB.DST_DG.DST_DGSelect.DST_REVERSINGFWDGEAR "" VALUE 0x8060626A DefaultValueRecordLayout_AUTOSAR_Platform_BaseTypes_uint8 11.0 RB_PT_PCT_SWC_DST_CompuMethods_ident 0.0 11. FORMAT "%10.5"
 /begin ANNOTATION ANNOTATION_LABEL "Description (coming from AUTOSAR DESC field)"
  /begin ANNOTATION_TEXT "If reversing less than DST_REVERSINGENGAGESPEED, this gear will be selected when forward is requested\r\n" /end ANNOTATION_TEXT
 /end ANNOTATION
/end CHARACTERISTIC
/begin CHARACTERISTIC DST_EFLASHB.DST_DG.DST_DGSelect.DST_RpmInGears.DST_MAXRPMINGEARS "" VALUE 0x8060626C DefaultValueRecordLayout_AUTOSAR_Platform_BaseTypes_sint16 20000.0 RB_PT_PCT_SWC_DST_CompuMethods_DST_Ident 0.0 20000. FORMAT "%10.5"
 /begin ANNOTATION ANNOTATION_LABEL "Description (coming from AUTOSAR DESC field)"
  /begin ANNOTATION_TEXT "maximum engine speed in each gear to generate Available gears array\r\n" /end ANNOTATION_TEXT
 /end ANNOTATION
/end CHARACTERISTIC
/begin CHARACTERISTIC DST_EFLASHB.DST_DG.DST_DGSelect.DST_ShiftTimeComp_Demand.DST_MAXRPM2DOWNSHIFT "" VAL_BLK 0x80606290 DefaultValueRecordLayout_AUTOSAR_Platform_BaseTypes_uint16 5000.0 RB_PT_PCT_SWC_DST_CompuMethods_ident 0.0 5000. FORMAT "%10.5"
 /begin ANNOTATION ANNOTATION_LABEL "Description (coming from AUTOSAR DESC field)" /begin ANNOTATION_TEXT "Maximum rpm to shift for the current gear\r\n" /end ANNOTATION_TEXT /end ANNOTATION
 MATRIX_DIM 11 1 1 /end CHARACTERISTIC
/begin CHARACTERISTIC DST_EFLASHB.DST_DG.DST_DGSelect.DST_ShiftTimeComp_Demand.DST_MINABOVEIDLEDOTORQUEPHASE "" VALUE 0x806062A6 DefaultValueRecordLayout_AUTOSAR_Platform_BaseTypes_uint16 20000.0 RB_PT_PCT_SWC_DST_CompuMethods_ident 0.0 20000. FORMAT "%10.5"
 /begin ANNOTATION ANNOTATION_LABEL "Description (coming from AUTOSAR DESC field)"
  /begin ANNOTATION_TEXT "Minimum rpm above idle speed in target gear when a torque phase will be completed\r\n" /end ANNOTATION_TEXT
 /end ANNOTATION
/end CHARACTERISTIC
/begin CHARACTERISTIC DST_EFLASHB.DST_DG.DST_DGSelect.DST_ShiftTimeComp_Demand.DST_OSHAFTSPDAPPLYT2SACC "" VALUE 0x806062A8 DefaultValueRecordLayout_AUTOSAR_Platform_BaseTypes_sint16 2000.0 RB_PT_PCT_SWC_DST_CompuMethods_ratio_0p1 -1000. 1000. FORMAT "%10.5"
 /begin ANNOTATION ANNOTATION_LABEL "Description (coming from AUTOSAR DESC field)"
  /begin ANNOTATION_TEXT "Minimum output shaft acceleration before time to shift is applied to max rpm\r\n" /end ANNOTATION_TEXT
 /end ANNOTATION
/end CHARACTERISTIC
/begin CHARACTERISTIC DST_EFLASHB.DST_DG.DST_DGSelect.DST_ShiftTimeComp_Demand.DST_OSHAFTSPDAPPLYT2SDEC "" VALUE 0x806062AA DefaultValueRecordLayout_AUTOSAR_Platform_BaseTypes_sint16 2000.0 RB_PT_PCT_SWC_DST_CompuMethods_ratio_0p1 -1000. 1000. FORMAT "%10.5"
 /begin ANNOTATION ANNOTATION_LABEL "Description (coming from AUTOSAR DESC field)"
  /begin ANNOTATION_TEXT "Minimum output shaft acceleration before time to shift is applied to max rpm\r\n" /end ANNOTATION_TEXT
 /end ANNOTATION
/end CHARACTERISTIC
/begin CHARACTERISTIC DST_EFLASHB.DST_DG.DST_DGSelect.DST_ShiftTimeComp_Demand.DST_SHIFTMODEENABLEAGGDOWNS "" VAL_BLK 0x8060626E DefaultValueRecordLayout_AUTOSAR_Platform_BaseTypes_boolean 255.0 AUTOSAR_Platform_CompuMethods_boolean 0.0 255. FORMAT "%10.5"
 /begin ANNOTATION ANNOTATION_LABEL "Description (coming from AUTOSAR DESC field)" /begin ANNOTATION_TEXT "Enable very agressive downshifts to the rev limit\r\n" /end ANNOTATION_TEXT /end ANNOTATION
 MATRIX_DIM 17 1 1 /end CHARACTERISTIC
/begin CHARACTERISTIC DST_EFLASHB.DST_DG.DST_DGSelect.DST_ShiftTimeComp_Demand.DST_SHIFTTIMEFACT2USE "" VAL_BLK 0x8060627F DefaultValueRecordLayout_AUTOSAR_Platform_BaseTypes_uint8 2.0 RB_PT_PCT_SWC_DST_CompuMethods_ident 0.0 2. FORMAT "%10.5"
 /begin ANNOTATION ANNOTATION_LABEL "Description (coming from AUTOSAR DESC field)"
  /begin ANNOTATION_TEXT "0 = No shift time, 1 = Reduced, 2 = Full shift time at higher rpm\r\n" /end ANNOTATION_TEXT
 /end ANNOTATION
 MATRIX_DIM 17 1 1 /end CHARACTERISTIC
/begin CHARACTERISTIC DST_EFLASHB.DST_DG.DST_DGSelect.DST_ShiftTimeComp_Demand.DST_SHIFTTIMEFACTVSRPM "" MAP 0x806062B4 RB_PT_PCT_SWC_DST_RecordLayouts_RL_Map_uint8_12_uint16_4_uint8_3 1.0 RB_PT_PCT_SWC_DST_CompuMethods_ratio_0p01 0.0 1. FORMAT "%10.5"
 /begin ANNOTATION ANNOTATION_LABEL "Description (coming from AUTOSAR DESC field)"
  /begin ANNOTATION_TEXT "Allows reduced impact of shift time at low rpm to maintain shift map hysteresis\r\n" /end ANNOTATION_TEXT
 /end ANNOTATION
 /begin AXIS_DESCR STD_AXIS NO_INPUT_QUANTITY RB_PT_PCT_SWC_DST_CompuMethods_DST_Ident 4 0.0 20000. FORMAT "%10.5" DEPOSIT ABSOLUTE /end AXIS_DESCR
 /begin AXIS_DESCR STD_AXIS NO_INPUT_QUANTITY RB_PT_PCT_SWC_DST_CompuMethods_ident 3 0.0 2. FORMAT "%10.5" DEPOSIT ABSOLUTE /end AXIS_DESCR
/end CHARACTERISTIC
/begin CHARACTERISTIC DST_EFLASHB.DST_DG.DST_DGSelect.DST_ShiftTimeComp_Demand.DST_THROTTLEINCRPMACTIVE "" VALUE 0x806062AC DefaultValueRecordLayout_AUTOSAR_Platform_BaseTypes_sint16 20000.0 RB_PT_PCT_SWC_DST_CompuMethods_DST_Ident 0.0 20000. FORMAT "%10.5"
 /begin ANNOTATION ANNOTATION_LABEL "Description (coming from AUTOSAR DESC field)"
  /begin ANNOTATION_TEXT "Rpm below rev limit to monitor changes in pedal angle\r\n" /end ANNOTATION_TEXT
 /end ANNOTATION
/end CHARACTERISTIC
/begin CHARACTERISTIC DST_EFLASHB.DST_DG.DST_DGSelect.DST_ShiftTimeComp_Demand.DST_THROTTLEINCSHIFTRPM "" VALUE 0x806062AE DefaultValueRecordLayout_AUTOSAR_Platform_BaseTypes_uint16 5000.0 RB_PT_PCT_SWC_DST_CompuMethods_ident 0.0 5000. FORMAT "%10.5"
 /begin ANNOTATION ANNOTATION_LABEL "Description (coming from AUTOSAR DESC field)"
  /begin ANNOTATION_TEXT "If throttle applied quickly at high rpm, this is rpm to force immediate up-shift\r\n" /end ANNOTATION_TEXT
 /end ANNOTATION
/end CHARACTERISTIC
/begin CHARACTERISTIC DST_EFLASHB.DST_DG.DST_DGSelect.DST_ShiftTimeComp_Demand.DST_THROTTLEINCTRIGTHRESH "" VALUE 0x806062B2 DefaultValueRecordLayout_AUTOSAR_Platform_BaseTypes_uint8 102.0 RB_PT_PCT_SWC_DST_CompuMethods_ratio_0p4 0.0 102. FORMAT "%10.5"
 /begin ANNOTATION ANNOTATION_LABEL "Description (coming from AUTOSAR DESC field)" /begin ANNOTATION_TEXT "Increase in throttle to trigger min time to shift\r\n" /end ANNOTATION_TEXT /end ANNOTATION
/end CHARACTERISTIC
/begin CHARACTERISTIC DST_EFLASHB.DST_DG.DST_DGSelect.DST_ShiftTimeComp_Demand.DST_TIME2REVUPENGINE "" VALUE 0x806062B0 DefaultValueRecordLayout_AUTOSAR_Platform_BaseTypes_uint16 1.0 RB_PT_PCT_SWC_DST_CompuMethods_ratio_0p001 0.0 1. FORMAT "%10.5"
 /begin ANNOTATION ANNOTATION_LABEL "Description (coming from AUTOSAR DESC field)"
  /begin ANNOTATION_TEXT "Estimate of how long it takes to rev up the engine during an aggressive ASG downshift\r\n" /end ANNOTATION_TEXT
 /end ANNOTATION
/end CHARACTERISTIC
/begin CHARACTERISTIC DST_EFLASHB.DST_DG.DST_DGSelect.DST_SHIFTTIMEOUT "" VALUE 0x8060624E DefaultValueRecordLayout_AUTOSAR_Platform_BaseTypes_uint16 655.35 RB_PT_PCT_SWC_DST_CompuMethods_DST_Time 0.0 655.35 FORMAT "%10.5"
 /begin ANNOTATION ANNOTATION_LABEL "Description (coming from AUTOSAR DESC field)"
  /begin ANNOTATION_TEXT "Time to ingore sequential shifts and go to target if Current Gear has not got to demand gear\r\n" /end ANNOTATION_TEXT
 /end ANNOTATION
/end CHARACTERISTIC
/begin CHARACTERISTIC DST_EFLASHB.DST_DG.DST_DGSelect.DST_THROTTLE4PWRONDN "" VALUE 0x8060626B DefaultValueRecordLayout_AUTOSAR_Platform_BaseTypes_uint8 102.0 RB_PT_PCT_SWC_DST_CompuMethods_ratio_0p4 0.0 102. FORMAT "%10.5"
 /begin ANNOTATION ANNOTATION_LABEL "Description (coming from AUTOSAR DESC field)"
  /begin ANNOTATION_TEXT "Percentage above which DST considers a downshift to be a power-on\r\n" /end ANNOTATION_TEXT
 /end ANNOTATION
/end CHARACTERISTIC
/begin CHARACTERISTIC DST_EFLASHB.DST_DG.DST_DGSelect.DST_TIME_IGNOREPADDN "" VALUE 0x80606252 DefaultValueRecordLayout_AUTOSAR_Platform_BaseTypes_uint16 655.35 RB_PT_PCT_SWC_DST_CompuMethods_DST_Time 0.0 655.35 FORMAT "%10.5"
 /begin ANNOTATION ANNOTATION_LABEL "Description (coming from AUTOSAR DESC field)"
  /begin ANNOTATION_TEXT "Time after an automatic downshift in manual mode before a driver downshift request will be requested\r\n" /end ANNOTATION_TEXT
 /end ANNOTATION
/end CHARACTERISTIC
/begin CHARACTERISTIC DST_EFLASHB.DST_DG.DST_DGSelect.DST_TIME_IGNOREPADUP "" VALUE 0x80606254 DefaultValueRecordLayout_AUTOSAR_Platform_BaseTypes_uint16 655.35 RB_PT_PCT_SWC_DST_CompuMethods_DST_Time 0.0 655.35 FORMAT "%10.5"
 /begin ANNOTATION ANNOTATION_LABEL "Description (coming from AUTOSAR DESC field)"
  /begin ANNOTATION_TEXT "Time to ignore driver upshift request after an automatic upshift has been requested\r\n" /end ANNOTATION_TEXT
 /end ANNOTATION
/end CHARACTERISTIC
/begin CHARACTERISTIC DST_EFLASHB.DST_DG.DST_DGSelect.DST_TIMEAFTERMODECHNGDOLIFTOFF "" VALUE 0x80606250 DefaultValueRecordLayout_AUTOSAR_Platform_BaseTypes_uint16 655.35 RB_PT_PCT_SWC_DST_CompuMethods_DST_Time 0.0 655.35 FORMAT "%10.5"
 /begin ANNOTATION ANNOTATION_LABEL "Description (coming from AUTOSAR DESC field)"
  /begin ANNOTATION_TEXT "After a mode change, this is the min time before lift off before downshift complete can be active\r\n" /end ANNOTATION_TEXT
 /end ANNOTATION
/end CHARACTERISTIC
/begin CHARACTERISTIC DST_EFLASHB.DST_DG.DST_DGSelect.DST_UPSHIFTLAMPENABLE "" VAL_BLK 0x80606169 DefaultValueRecordLayout_AUTOSAR_Platform_BaseTypes_boolean 255.0 AUTOSAR_Platform_CompuMethods_boolean 0.0 255. FORMAT "%10.5"
 /begin ANNOTATION ANNOTATION_LABEL "Description (coming from AUTOSAR DESC field)" /begin ANNOTATION_TEXT "Modes the up-shift light will be active\r\n" /end ANNOTATION_TEXT /end ANNOTATION
 MATRIX_DIM 17 1 1 /end CHARACTERISTIC
/begin CHARACTERISTIC DST_EFLASHB.DST_DG.DST_DGSelect.DST_UPSHIFTTIMEBRAKE "" VAL_BLK 0x806060D0 DefaultValueRecordLayout_AUTOSAR_Platform_BaseTypes_uint16 655.35 RB_PT_PCT_SWC_DST_CompuMethods_DST_Time 0.0 655.35 FORMAT "%10.5"
 /begin ANNOTATION ANNOTATION_LABEL "Description (coming from AUTOSAR DESC field)" /begin ANNOTATION_TEXT "Time to allow upshifts after brake released\r\n" /end ANNOTATION_TEXT /end ANNOTATION
 MATRIX_DIM 17 1 1 /end CHARACTERISTIC
/begin CHARACTERISTIC DST_EFLASHB.DST_DG.DST_DGSelect.DST_UPSHIFTTIMEDECEL "" VAL_BLK 0x806060F2 DefaultValueRecordLayout_AUTOSAR_Platform_BaseTypes_uint16 655.35 RB_PT_PCT_SWC_DST_CompuMethods_DST_Time 0.0 655.35 FORMAT "%10.5"
 /begin ANNOTATION ANNOTATION_LABEL "Description (coming from AUTOSAR DESC field)" /begin ANNOTATION_TEXT "Time to allow upshifts after brake released\r\n" /end ANNOTATION_TEXT /end ANNOTATION
 MATRIX_DIM 17 1 1 /end CHARACTERISTIC
/begin CHARACTERISTIC DST_EFLASHB.DST_DG.DST_DGSelect.DST_UPSHIFTTIMESEQUENTIAL "" VAL_BLK 0x80606204 DefaultValueRecordLayout_AUTOSAR_Platform_BaseTypes_uint16 655.35 RB_PT_PCT_SWC_DST_CompuMethods_DST_Time 0.0 655.35 FORMAT "%10.5"
 /begin ANNOTATION ANNOTATION_LABEL "Description (coming from AUTOSAR DESC field)" /begin ANNOTATION_TEXT "Time between sequential upshifts\r\n" /end ANNOTATION_TEXT /end ANNOTATION
 MATRIX_DIM 11 1 1 /end CHARACTERISTIC
/begin CHARACTERISTIC DST_EFLASHB.DST_DG.DST_DGSelect.DST_UPSHIFTTIMESHIFTMODE "" VAL_BLK 0x80606114 DefaultValueRecordLayout_AUTOSAR_Platform_BaseTypes_uint16 655.35 RB_PT_PCT_SWC_DST_CompuMethods_DST_Time 0.0 655.35 FORMAT "%10.5"
 /begin ANNOTATION ANNOTATION_LABEL "Description (coming from AUTOSAR DESC field)" /begin ANNOTATION_TEXT "Minimum time between sequential upshifts\r\n" /end ANNOTATION_TEXT /end ANNOTATION
 MATRIX_DIM 17 1 1 /end CHARACTERISTIC
/begin CHARACTERISTIC DST_EFLASHB.DST_DG.DST_DGSelect.DST_UPSHIFTTIMETHROTTLE "" VAL_BLK 0x80606136 DefaultValueRecordLayout_AUTOSAR_Platform_BaseTypes_uint16 655.35 RB_PT_PCT_SWC_DST_CompuMethods_DST_Time 0.0 655.35 FORMAT "%10.5"
 /begin ANNOTATION ANNOTATION_LABEL "Description (coming from AUTOSAR DESC field)"
  /begin ANNOTATION_TEXT "Minimum time after throttle is applied before an upshift is requested\r\n" /end ANNOTATION_TEXT
 /end ANNOTATION
 MATRIX_DIM 17 1 1 /end CHARACTERISTIC
/begin CHARACTERISTIC DST_EFLASHB.DST_DG.DST_FREEZEGEARSRPMLIMITS "" VALUE 0x806060C8 DefaultValueRecordLayout_AUTOSAR_Platform_BaseTypes_boolean 255.0 AUTOSAR_Platform_CompuMethods_boolean 0.0 255. FORMAT "%10.5"
 /begin ANNOTATION ANNOTATION_LABEL "Description (coming from AUTOSAR DESC field)"
  /begin ANNOTATION_TEXT "If true, the gears will be frozen using high and low rpm limits\r\n" /end ANNOTATION_TEXT
 /end ANNOTATION
/end CHARACTERISTIC
/begin CHARACTERISTIC DST_EFLASHB.DST_DG.DST_HARDPREVENTUPSHIFT "" VALUE 0x806060C9 DefaultValueRecordLayout_AUTOSAR_Platform_BaseTypes_boolean 255.0 AUTOSAR_Platform_CompuMethods_boolean 0.0 255. FORMAT "%10.5"
 /begin ANNOTATION ANNOTATION_LABEL "Description (coming from AUTOSAR DESC field)"
  /begin ANNOTATION_TEXT "If true, upshifts can be prevented in DGSelect.  THis should not be required and should be left falise.  If all OK, this input and associated logic in DGSelect can be deleted\r\n" /end ANNOTATION_TEXT
 /end ANNOTATION
/end CHARACTERISTIC
/begin CHARACTERISTIC DST_EFLASHB.DST_DG.DST_RpmInGears.DST_MAXRPMINGEARS "" VALUE 0x80606350 DefaultValueRecordLayout_AUTOSAR_Platform_BaseTypes_sint16 20000.0 RB_PT_PCT_SWC_DST_CompuMethods_DST_Ident 0.0 20000. FORMAT "%10.5"
 /begin ANNOTATION ANNOTATION_LABEL "Description (coming from AUTOSAR DESC field)"
  /begin ANNOTATION_TEXT "maximum engine speed in each gear to generate Available gears array\r\n" /end ANNOTATION_TEXT
 /end ANNOTATION
/end CHARACTERISTIC
/begin CHARACTERISTIC DST_EFLASHB.DST_DG.DST_ShiftPointsAndComp.DST_CompensationManager.DST_BELOWMAXCANCELCORNER "" VALUE 0x80606396 DefaultValueRecordLayout_AUTOSAR_Platform_BaseTypes_sint16 20500.0 RB_PT_PCT_SWC_DST_CompuMethods_ident -500. 20000. FORMAT "%10.5"
 /begin ANNOTATION ANNOTATION_LABEL "Description (coming from AUTOSAR DESC field)"
  /begin ANNOTATION_TEXT "Engine speed threshold below the maximum engine speed limit above which corner comensation will be cancelled\r\n" /end ANNOTATION_TEXT
 /end ANNOTATION
/end CHARACTERISTIC
/begin CHARACTERISTIC DST_EFLASHB.DST_DG.DST_ShiftPointsAndComp.DST_CompensationManager.DST_BELOWMAXENABLEDECELHOLD "" VALUE 0x80606398 DefaultValueRecordLayout_AUTOSAR_Platform_BaseTypes_uint16 20000.0 RB_PT_PCT_SWC_DST_CompuMethods_ident 0.0 20000. FORMAT "%10.5"
 /begin ANNOTATION ANNOTATION_LABEL "Description (coming from AUTOSAR DESC field)"
  /begin ANNOTATION_TEXT "ENgine speed must be below this value from the rev limit in order to set the decel hold timer\r\n" /end ANNOTATION_TEXT
 /end ANNOTATION
/end CHARACTERISTIC
/begin CHARACTERISTIC DST_EFLASHB.DST_DG.DST_ShiftPointsAndComp.DST_CompensationManager.DST_BOBENGHOT "" VALUE 0x806063A0 DefaultValueRecordLayout_AUTOSAR_Platform_BaseTypes_boolean 255.0 AUTOSAR_Platform_CompuMethods_boolean 0.0 255. FORMAT "%10.5"
 /begin ANNOTATION ANNOTATION_LABEL "Description (coming from AUTOSAR DESC field)" /begin ANNOTATION_TEXT "To test latina project overheat function\r\n" /end ANNOTATION_TEXT /end ANNOTATION
/end CHARACTERISTIC
/begin CHARACTERISTIC DST_EFLASHB.DST_DG.DST_ShiftPointsAndComp.DST_CompensationManager.DST_CORNERHOLDTIME2D "" MAP 0x806063AA RB_PT_PCT_SWC_DST_RecordLayouts_RL_Map_sint16_10_uint8_5_uint8_2 10.0 RB_PT_PCT_SWC_DST_CompuMethods_DST_Time 0.0 10. FORMAT "%10.5"
 /begin ANNOTATION ANNOTATION_LABEL "Description (coming from AUTOSAR DESC field)" /begin ANNOTATION_TEXT "Time to keep corner compensation active\r\n" /end ANNOTATION_TEXT /end ANNOTATION
 /begin AXIS_DESCR STD_AXIS NO_INPUT_QUANTITY RB_PT_PCT_SWC_DST_CompuMethods_ratio_0p01 5 0.0 1.27 FORMAT "%10.5" DEPOSIT ABSOLUTE /end AXIS_DESCR
 /begin AXIS_DESCR STD_AXIS NO_INPUT_QUANTITY RB_PT_PCT_SWC_DST_CompuMethods_ident 2 0.0 1. FORMAT "%10.5" DEPOSIT ABSOLUTE /end AXIS_DESCR
/end CHARACTERISTIC
/begin CHARACTERISTIC DST_EFLASHB.DST_DG.DST_ShiftPointsAndComp.DST_CompensationManager.DST_CORNERHOLDTIMEUPPERLIMIT2D "" MAP 0x806063CA RB_PT_PCT_SWC_DST_RecordLayouts_RL_Map_sint16_10_uint16_5_uint8_2 10.0 RB_PT_PCT_SWC_DST_CompuMethods_DST_Time 0.0 10. FORMAT "%10.5"
 /begin ANNOTATION ANNOTATION_LABEL "Description (coming from AUTOSAR DESC field)" /begin ANNOTATION_TEXT "Upper limits of corner hold time, mode based\r\n" /end ANNOTATION_TEXT /end ANNOTATION
 /begin AXIS_DESCR STD_AXIS NO_INPUT_QUANTITY RB_PT_PCT_SWC_DST_CompuMethods_kph_0p1 5 0.0 500. FORMAT "%10.5" DEPOSIT ABSOLUTE /end AXIS_DESCR
 /begin AXIS_DESCR STD_AXIS NO_INPUT_QUANTITY RB_PT_PCT_SWC_DST_CompuMethods_ident 2 0.0 1. FORMAT "%10.5" DEPOSIT ABSOLUTE /end AXIS_DESCR
/end CHARACTERISTIC
/begin CHARACTERISTIC DST_EFLASHB.DST_DG.DST_ShiftPointsAndComp.DST_CompensationManager.DST_DECELCANCELCORNERLATACC "" VAL_BLK 0x80606352 DefaultValueRecordLayout_AUTOSAR_Platform_BaseTypes_uint8 1.27 RB_PT_PCT_SWC_DST_CompuMethods_ratio_0p01 0.0 1.27 FORMAT "%10.5"
 /begin ANNOTATION ANNOTATION_LABEL "Description (coming from AUTOSAR DESC field)"
  /begin ANNOTATION_TEXT "Lateral g above which decel compensation will be disabled\r\n" /end ANNOTATION_TEXT
 /end ANNOTATION
 MATRIX_DIM 17 1 1 /end CHARACTERISTIC
/begin CHARACTERISTIC DST_EFLASHB.DST_DG.DST_ShiftPointsAndComp.DST_CompensationManager.DST_DECELCANCELSPDINCREASE "" VALUE 0x8060639A DefaultValueRecordLayout_AUTOSAR_Platform_BaseTypes_uint16 500.0 RB_PT_PCT_SWC_DST_CompuMethods_kph_0p1 0.0 500. FORMAT "%10.5"
 /begin ANNOTATION ANNOTATION_LABEL "Description (coming from AUTOSAR DESC field)" /begin ANNOTATION_TEXT "Vehicle speed increase to cancel decel\r\n" /end ANNOTATION_TEXT /end ANNOTATION
/end CHARACTERISTIC
/begin CHARACTERISTIC DST_EFLASHB.DST_DG.DST_ShiftPointsAndComp.DST_CompensationManager.DST_DECELHOLDTIME2D "" MAP 0x806063EE RB_PT_PCT_SWC_DST_RecordLayouts_RL_Map_sint16_10_sint16_5_uint8_2 10.0 RB_PT_PCT_SWC_DST_CompuMethods_DST_Time 0.0 10. FORMAT "%10.5"
 /begin ANNOTATION ANNOTATION_LABEL "Description (coming from AUTOSAR DESC field)" /begin ANNOTATION_TEXT "Time to maintain Decel comp for after braking ends\r\n" /end ANNOTATION_TEXT /end ANNOTATION
 /begin AXIS_DESCR STD_AXIS NO_INPUT_QUANTITY RB_PT_PCT_SWC_DST_CompuMethods_ratio_0p01 5 -5. 5. FORMAT "%10.5" DEPOSIT ABSOLUTE /end AXIS_DESCR
 /begin AXIS_DESCR STD_AXIS NO_INPUT_QUANTITY RB_PT_PCT_SWC_DST_CompuMethods_ident 2 0.0 1. FORMAT "%10.5" DEPOSIT ABSOLUTE /end AXIS_DESCR
/end CHARACTERISTIC
/begin CHARACTERISTIC DST_EFLASHB.DST_DG.DST_ShiftPointsAndComp.DST_CompensationManager.DST_DECELHOLDTIMELIMIT_KMH "" CURVE 0x80606412 RB_PT_PCT_SWC_DST_RecordLayouts_RL_Curve_sint16_5_uint16_5 10.0 RB_PT_PCT_SWC_DST_CompuMethods_DST_Time 0.0 10. FORMAT "%10.5"
 /begin ANNOTATION ANNOTATION_LABEL "Description (coming from AUTOSAR DESC field)" /begin ANNOTATION_TEXT "Upper limit of decel hold time\r\n" /end ANNOTATION_TEXT /end ANNOTATION
 /begin AXIS_DESCR STD_AXIS NO_INPUT_QUANTITY RB_PT_PCT_SWC_DST_CompuMethods_kph_0p1 5 0.0 500. FORMAT "%10.5" DEPOSIT ABSOLUTE /end AXIS_DESCR
/end CHARACTERISTIC
/begin CHARACTERISTIC DST_EFLASHB.DST_DG.DST_ShiftPointsAndComp.DST_CompensationManager.DST_DECELHOLDTIMELIMIT_NEARREDLINE "" CURVE 0x80606428 RB_PT_PCT_SWC_DST_RecordLayouts_RL_Curve_sint16_4_uint16_4 10.0 RB_PT_PCT_SWC_DST_CompuMethods_DST_Time 0.0 10. FORMAT "%10.5"
 /begin ANNOTATION ANNOTATION_LABEL "Description (coming from AUTOSAR DESC field)"
  /begin ANNOTATION_TEXT "Upper limit of Decel hold time based on Driver demand\r\n" /end ANNOTATION_TEXT
 /end ANNOTATION
 /begin AXIS_DESCR STD_AXIS NO_INPUT_QUANTITY RB_PT_PCT_SWC_DST_CompuMethods_ident 4 0.0 3000. FORMAT "%10.5" DEPOSIT ABSOLUTE /end AXIS_DESCR
/end CHARACTERISTIC
/begin CHARACTERISTIC DST_EFLASHB.DST_DG.DST_ShiftPointsAndComp.DST_CompensationManager.DST_ENABLECOMPCORNER "" VAL_BLK 0x80606363 DefaultValueRecordLayout_AUTOSAR_Platform_BaseTypes_boolean 255.0 AUTOSAR_Platform_CompuMethods_boolean 0.0 255. FORMAT "%10.5"
 /begin ANNOTATION ANNOTATION_LABEL "Description (coming from AUTOSAR DESC field)"
  /begin ANNOTATION_TEXT "Flags to enable gradient compensation based on driving mode\r\n" /end ANNOTATION_TEXT
 /end ANNOTATION
 MATRIX_DIM 17 1 1 /end CHARACTERISTIC
/begin CHARACTERISTIC DST_EFLASHB.DST_DG.DST_ShiftPointsAndComp.DST_CompensationManager.DST_ENABLECOMPDECEL "" VAL_BLK 0x80606374 DefaultValueRecordLayout_AUTOSAR_Platform_BaseTypes_boolean 255.0 AUTOSAR_Platform_CompuMethods_boolean 0.0 255. FORMAT "%10.5"
 /begin ANNOTATION ANNOTATION_LABEL "Description (coming from AUTOSAR DESC field)"
  /begin ANNOTATION_TEXT "Flags to enable gradient compensation based on driving mode\r\n" /end ANNOTATION_TEXT
 /end ANNOTATION
 MATRIX_DIM 17 1 1 /end CHARACTERISTIC
/begin CHARACTERISTIC DST_EFLASHB.DST_DG.DST_ShiftPointsAndComp.DST_CompensationManager.DST_ENABLECOMPFAILED "" VALUE 0x806063A1 DefaultValueRecordLayout_AUTOSAR_Platform_BaseTypes_boolean 255.0 AUTOSAR_Platform_CompuMethods_boolean 0.0 255. FORMAT "%10.5"
 /begin ANNOTATION ANNOTATION_LABEL "Description (coming from AUTOSAR DESC field)"
  /begin ANNOTATION_TEXT "Flag to disable or ennable specific shift compensation\r\n" /end ANNOTATION_TEXT
 /end ANNOTATION
/end CHARACTERISTIC
/begin CHARACTERISTIC DST_EFLASHB.DST_DG.DST_ShiftPointsAndComp.DST_CompensationManager.DST_ENABLECOMPINHIBITDNS "" VALUE 0x806063A2 DefaultValueRecordLayout_AUTOSAR_Platform_BaseTypes_boolean 255.0 AUTOSAR_Platform_CompuMethods_boolean 0.0 255. FORMAT "%10.5"
 /begin ANNOTATION ANNOTATION_LABEL "Description (coming from AUTOSAR DESC field)"
  /begin ANNOTATION_TEXT "Flag to disable or ennable specific shift compensation\r\n" /end ANNOTATION_TEXT
 /end ANNOTATION
/end CHARACTERISTIC
/begin CHARACTERISTIC DST_EFLASHB.DST_DG.DST_ShiftPointsAndComp.DST_CompensationManager.DST_ENABLECOMPINHIBITUP "" VALUE 0x806063A3 DefaultValueRecordLayout_AUTOSAR_Platform_BaseTypes_boolean 255.0 AUTOSAR_Platform_CompuMethods_boolean 0.0 255. FORMAT "%10.5"
 /begin ANNOTATION ANNOTATION_LABEL "Description (coming from AUTOSAR DESC field)"
  /begin ANNOTATION_TEXT "Flag to disable or ennable specific shift compensation\r\n" /end ANNOTATION_TEXT
 /end ANNOTATION
/end CHARACTERISTIC
/begin CHARACTERISTIC DST_EFLASHB.DST_DG.DST_ShiftPointsAndComp.DST_CompensationManager.DST_ENABLECOMPLEVERPULLBK "" VALUE 0x806063A4 DefaultValueRecordLayout_AUTOSAR_Platform_BaseTypes_boolean 255.0 AUTOSAR_Platform_CompuMethods_boolean 0.0 255. FORMAT "%10.5"
 /begin ANNOTATION ANNOTATION_LABEL "Description (coming from AUTOSAR DESC field)"
  /begin ANNOTATION_TEXT "Flag to disable or ennable specific shift compensation\r\n" /end ANNOTATION_TEXT
 /end ANNOTATION
/end CHARACTERISTIC
/begin CHARACTERISTIC DST_EFLASHB.DST_DG.DST_ShiftPointsAndComp.DST_CompensationManager.DST_ENABLECOMPRAISEDIDLE "" VALUE 0x806063A5 DefaultValueRecordLayout_AUTOSAR_Platform_BaseTypes_boolean 255.0 AUTOSAR_Platform_CompuMethods_boolean 0.0 255. FORMAT "%10.5"
 /begin ANNOTATION ANNOTATION_LABEL "Description (coming from AUTOSAR DESC field)"
  /begin ANNOTATION_TEXT "Flag to disable or ennable specific shift compensation\r\n" /end ANNOTATION_TEXT
 /end ANNOTATION
/end CHARACTERISTIC
/begin CHARACTERISTIC DST_EFLASHB.DST_DG.DST_ShiftPointsAndComp.DST_CompensationManager.DST_ENABLEGRADIENT "" VAL_BLK 0x80606385 DefaultValueRecordLayout_AUTOSAR_Platform_BaseTypes_boolean 255.0 AUTOSAR_Platform_CompuMethods_boolean 0.0 255. FORMAT "%10.5"
 /begin ANNOTATION ANNOTATION_LABEL "Description (coming from AUTOSAR DESC field)"
  /begin ANNOTATION_TEXT "Flags to enable gradient compensation based on driving mode\r\n" /end ANNOTATION_TEXT
 /end ANNOTATION
 MATRIX_DIM 17 1 1 /end CHARACTERISTIC
/begin CHARACTERISTIC DST_EFLASHB.DST_DG.DST_ShiftPointsAndComp.DST_CompensationManager.DST_LATACCDECRAMP "" VALUE 0x8060639C DefaultValueRecordLayout_AUTOSAR_Platform_BaseTypes_uint16 1.27 RB_PT_PCT_SWC_DST_CompuMethods_Ratio_0p001__1 0.0 1.27 FORMAT "%10.5"
 /begin ANNOTATION ANNOTATION_LABEL "Description (coming from AUTOSAR DESC field)"
  /begin ANNOTATION_TEXT "Decrease in lateral acceleration for internal signal per program loop\r\n" /end ANNOTATION_TEXT
 /end ANNOTATION
/end CHARACTERISTIC
/begin CHARACTERISTIC DST_EFLASHB.DST_DG.DST_ShiftPointsAndComp.DST_CompensationManager.DST_LATACCPRELOADVALUE "" VALUE 0x8060639E DefaultValueRecordLayout_AUTOSAR_Platform_BaseTypes_uint16 1.27 RB_PT_PCT_SWC_DST_CompuMethods_Ratio_0p001__1 0.0 1.27 FORMAT "%10.5"
 /begin ANNOTATION ANNOTATION_LABEL "Description (coming from AUTOSAR DESC field)"
  /begin ANNOTATION_TEXT "When Corner comp first becomes true, this is the value to load into the DST Lat acc vcalue\r\n" /end ANNOTATION_TEXT
 /end ANNOTATION
/end CHARACTERISTIC
/begin CHARACTERISTIC DST_EFLASHB.DST_DG.DST_ShiftPointsAndComp.DST_CompensationManager.DST_LATACCTRIGGERCORNER "" VALUE 0x806063A6 DefaultValueRecordLayout_AUTOSAR_Platform_BaseTypes_uint8 1.27 RB_PT_PCT_SWC_DST_CompuMethods_ratio_0p01 0.0 1.27 FORMAT "%10.5"
 /begin ANNOTATION ANNOTATION_LABEL "Description (coming from AUTOSAR DESC field)" /begin ANNOTATION_TEXT "Lateral acceleration to trigger corner shift inhibit\r\n" /end ANNOTATION_TEXT /end ANNOTATION
/end CHARACTERISTIC
/begin CHARACTERISTIC DST_EFLASHB.DST_DG.DST_ShiftPointsAndComp.DST_CompensationManager.DST_LATINAPROJECT "" VALUE 0x806063A7 DefaultValueRecordLayout_AUTOSAR_Platform_BaseTypes_boolean 255.0 AUTOSAR_Platform_CompuMethods_boolean 0.0 255. FORMAT "%10.5"
 /begin ANNOTATION ANNOTATION_LABEL "Description (coming from AUTOSAR DESC field)"
  /begin ANNOTATION_TEXT "Specific overheat function for Latina - see customer request 33\r\n" /end ANNOTATION_TEXT
 /end ANNOTATION
/end CHARACTERISTIC
/begin CHARACTERISTIC DST_EFLASHB.DST_DG.DST_ShiftPointsAndComp.DST_CompensationManager.DST_TIMELATACCPEAKHOLD "" VALUE 0x806063A8 DefaultValueRecordLayout_AUTOSAR_Platform_BaseTypes_uint8 2.55 RB_PT_PCT_SWC_DST_CompuMethods_DST_Time 0.0 2.55 FORMAT "%10.5"
 /begin ANNOTATION ANNOTATION_LABEL "Description (coming from AUTOSAR DESC field)"
  /begin ANNOTATION_TEXT "After the Lateral acceleration has increased, this is the time before it can decrease\r\n" /end ANNOTATION_TEXT
 /end ANNOTATION
/end CHARACTERISTIC
/begin CHARACTERISTIC DST_EFLASHB.DST_DG.DST_ShiftPointsAndComp.DST_CompensationManager.DST_TIMELATACCPEAKHOLDINITIAL "" VALUE 0x806063A9 DefaultValueRecordLayout_AUTOSAR_Platform_BaseTypes_uint8 2.55 RB_PT_PCT_SWC_DST_CompuMethods_DST_Time 0.0 2.55 FORMAT "%10.5"
 /begin ANNOTATION ANNOTATION_LABEL "Description (coming from AUTOSAR DESC field)"
  /begin ANNOTATION_TEXT "After the Lateral acceleration has increased, this is the time before it can decrease\r\n" /end ANNOTATION_TEXT
 /end ANNOTATION
/end CHARACTERISTIC
/begin CHARACTERISTIC DST_EFLASHB.DST_DG.DST_ShiftPointsAndComp.DST_ShiftCompensation.DST_CLUTCHOPENSPEEDOFFSET "" VAL_BLK 0x806064A0 DefaultValueRecordLayout_AUTOSAR_Platform_BaseTypes_sint16 5000.0 RB_PT_PCT_SWC_DST_CompuMethods_ident -2500. 2500. FORMAT "%10.5"
 /begin ANNOTATION ANNOTATION_LABEL "Description (coming from AUTOSAR DESC field)" /begin ANNOTATION_TEXT "Offset applied to XXC_ClutchOpenSpeed\r\n" /end ANNOTATION_TEXT /end ANNOTATION
 MATRIX_DIM 12 1 1 /end CHARACTERISTIC
/begin CHARACTERISTIC DST_EFLASHB.DST_DG.DST_ShiftPointsAndComp.DST_ShiftCompensation.DST_DECELDEMANDRPMPEAKOFFSET "" VALUE 0x80606508 DefaultValueRecordLayout_AUTOSAR_Platform_BaseTypes_sint16 8000.0 RB_PT_PCT_SWC_DST_CompuMethods_ident -4000. 4000. FORMAT "%10.5"
 /begin ANNOTATION ANNOTATION_LABEL "Description (coming from AUTOSAR DESC field)"
  /begin ANNOTATION_TEXT "Offset added to DST_RpmInDemandPH.  When peak is stored, this can be used to apply an immediate offset\r\n" /end ANNOTATION_TEXT
 /end ANNOTATION
/end CHARACTERISTIC
/begin CHARACTERISTIC DST_EFLASHB.DST_DG.DST_ShiftPointsAndComp.DST_ShiftCompensation.DST_DECELFIRSTDOWNRAMPLIMIT "" VALUE 0x8060650A DefaultValueRecordLayout_AUTOSAR_Platform_BaseTypes_sint16 20000.0 RB_PT_PCT_SWC_DST_CompuMethods_DST_Ident 0.0 20000. FORMAT "%10.5"
 /begin ANNOTATION ANNOTATION_LABEL "Description (coming from AUTOSAR DESC field)" /begin ANNOTATION_TEXT "Maximum value ramp can increase up to\r\n" /end ANNOTATION_TEXT /end ANNOTATION
/end CHARACTERISTIC
/begin CHARACTERISTIC DST_EFLASHB.DST_DG.DST_ShiftPointsAndComp.DST_ShiftCompensation.DST_DECELFIRSTRPMUPRAMP "" VALUE 0x8060650C DefaultValueRecordLayout_AUTOSAR_Platform_BaseTypes_sint16 20000.0 RB_PT_PCT_SWC_DST_CompuMethods_DST_Ident 0.0 20000. FORMAT "%10.5"
 /begin ANNOTATION ANNOTATION_LABEL "Description (coming from AUTOSAR DESC field)"
  /begin ANNOTATION_TEXT "Gives the ability to increase the decel limitfrom the first down-shift\r\n" /end ANNOTATION_TEXT
 /end ANNOTATION
/end CHARACTERISTIC
/begin CHARACTERISTIC DST_EFLASHB.DST_DG.DST_ShiftPointsAndComp.DST_ShiftCompensation.DST_DECELGDEADBANDENABLE "" VALUE 0x8060652A DefaultValueRecordLayout_AUTOSAR_Platform_BaseTypes_boolean 255.0 AUTOSAR_Platform_CompuMethods_boolean 0.0 255. FORMAT "%10.5"
 /begin ANNOTATION ANNOTATION_LABEL "Description (coming from AUTOSAR DESC field)"
  /begin ANNOTATION_TEXT "If true, DECELDOWNSHIFTRPM uses DST_DecelGDeadBand as its acceleration input\r\n" /end ANNOTATION_TEXT
 /end ANNOTATION
/end CHARACTERISTIC
/begin CHARACTERISTIC DST_EFLASHB.DST_DG.DST_ShiftPointsAndComp.DST_ShiftCompensation.DST_DECELGDEADBANDSIZE "" VALUE 0x8060650E DefaultValueRecordLayout_AUTOSAR_Platform_BaseTypes_uint16 5.0 RB_PT_PCT_SWC_DST_CompuMethods_ratio_0p01 0.0 5. FORMAT "%10.5"
 /begin ANNOTATION ANNOTATION_LABEL "Description (coming from AUTOSAR DESC field)" /begin ANNOTATION_TEXT "Size of deadband for Decel calc\r\n" /end ANNOTATION_TEXT /end ANNOTATION
/end CHARACTERISTIC
/begin CHARACTERISTIC DST_EFLASHB.DST_DG.DST_ShiftPointsAndComp.DST_ShiftCompensation.DST_DECELGEARSPECIFICMINSDISABLE "" VALUE 0x80606510 DefaultValueRecordLayout_AUTOSAR_Platform_BaseTypes_sint16 10.0 RB_PT_PCT_SWC_DST_CompuMethods_ratio_0p01 -5. 5. FORMAT "%10.5"
 /begin ANNOTATION ANNOTATION_LABEL "Description (coming from AUTOSAR DESC field)"
  /begin ANNOTATION_TEXT "Acceleration above which specific gear min rpms are disabled\r\n" /end ANNOTATION_TEXT
 /end ANNOTATION
/end CHARACTERISTIC
/begin CHARACTERISTIC DST_EFLASHB.DST_DG.DST_ShiftPointsAndComp.DST_ShiftCompensation.DST_DECELGEARSPECIFICMINSENABLE "" VALUE 0x80606512 DefaultValueRecordLayout_AUTOSAR_Platform_BaseTypes_sint16 10.0 RB_PT_PCT_SWC_DST_CompuMethods_ratio_0p01 -5. 5. FORMAT "%10.5"
 /begin ANNOTATION ANNOTATION_LABEL "Description (coming from AUTOSAR DESC field)" /begin ANNOTATION_TEXT "Decel below which gear speicifc min rpms are enabled\r\n" /end ANNOTATION_TEXT /end ANNOTATION
/end CHARACTERISTIC
/begin CHARACTERISTIC DST_EFLASHB.DST_DG.DST_ShiftPointsAndComp.DST_ShiftCompensation.DST_DECELLIMITGEARFACTOR "" VAL_BLK 0x806064B8 DefaultValueRecordLayout_AUTOSAR_Platform_BaseTypes_uint8 2.55 RB_PT_PCT_SWC_DST_CompuMethods_ratio_0p01 0.0 2.55 FORMAT "%10.5"
 /begin ANNOTATION ANNOTATION_LABEL "Description (coming from AUTOSAR DESC field)"
  /begin ANNOTATION_TEXT "Gain x DST_DecelRpmInDemandHeld to reduce effect of deceleration through lower gears\r\n" /end ANNOTATION_TEXT
 /end ANNOTATION
 MATRIX_DIM 11 1 1 /end CHARACTERISTIC
/begin CHARACTERISTIC DST_EFLASHB.DST_DG.DST_ShiftPointsAndComp.DST_ShiftCompensation.DST_DECELMAPSELECT "" VAL_BLK 0x806064C3 DefaultValueRecordLayout_AUTOSAR_Platform_BaseTypes_uint8 5.0 RB_PT_PCT_SWC_DST_CompuMethods_ident 0.0 5. FORMAT "%10.5"
 /begin ANNOTATION ANNOTATION_LABEL "Description (coming from AUTOSAR DESC field)"
  /begin ANNOTATION_TEXT "Output of Matrix determines which level of Decel map to use\r\n" /end ANNOTATION_TEXT
 /end ANNOTATION
 MATRIX_DIM 4 17 1 /end CHARACTERISTIC
/begin CHARACTERISTIC DST_EFLASHB.DST_DG.DST_ShiftPointsAndComp.DST_ShiftCompensation.DST_DECELPEAKDECAY "" VALUE 0x80606514 DefaultValueRecordLayout_AUTOSAR_Platform_BaseTypes_sint16 20000.0 RB_PT_PCT_SWC_DST_CompuMethods_DST_Ident 0.0 20000. FORMAT "%10.5"
 /begin ANNOTATION ANNOTATION_LABEL "Description (coming from AUTOSAR DESC field)" /begin ANNOTATION_TEXT "Rate of decay of peak hold of rpm in demand\r\n" /end ANNOTATION_TEXT /end ANNOTATION
/end CHARACTERISTIC
/begin CHARACTERISTIC DST_EFLASHB.DST_DG.DST_ShiftPointsAndComp.DST_ShiftCompensation.DST_DECELRPMPEAKHOLDTIME "" VALUE 0x80606516 DefaultValueRecordLayout_AUTOSAR_Platform_BaseTypes_uint16 655.35 RB_PT_PCT_SWC_DST_CompuMethods_DST_Time 0.0 655.35 FORMAT "%10.5"
 /begin ANNOTATION ANNOTATION_LABEL "Description (coming from AUTOSAR DESC field)" /begin ANNOTATION_TEXT "Time in seconds to hold the rpm in demand high\r\n" /end ANNOTATION_TEXT /end ANNOTATION
/end CHARACTERISTIC
/begin CHARACTERISTIC DST_EFLASHB.DST_DG.DST_ShiftPointsAndComp.DST_ShiftCompensation.DST_DECELRPMPEAKMIN "" VALUE 0x80606518 DefaultValueRecordLayout_AUTOSAR_Platform_BaseTypes_uint16 20000.0 RB_PT_PCT_SWC_DST_CompuMethods_DST_Ident 0.0 20000. FORMAT "%10.5"
 /begin ANNOTATION ANNOTATION_LABEL "Description (coming from AUTOSAR DESC field)" /begin ANNOTATION_TEXT "Minimum value of rpm in demand peak hold\r\n" /end ANNOTATION_TEXT /end ANNOTATION
/end CHARACTERISTIC
/begin CHARACTERISTIC DST_EFLASHB.DST_DG.DST_ShiftPointsAndComp.DST_ShiftCompensation.DST_DECELRPMSTARTOFFSET "" VAL_BLK 0x8060643A DefaultValueRecordLayout_AUTOSAR_Platform_BaseTypes_sint16 20000.0 RB_PT_PCT_SWC_DST_CompuMethods_DST_Ident -10000. 10000. FORMAT "%10.5"
 /begin ANNOTATION ANNOTATION_LABEL "Description (coming from AUTOSAR DESC field)"
  /begin ANNOTATION_TEXT "Engine speed above peak rpm in demand to use as limit of decel downshifts\r\n" /end ANNOTATION_TEXT
 /end ANNOTATION
 MATRIX_DIM 17 1 1 /end CHARACTERISTIC
/begin CHARACTERISTIC DST_EFLASHB.DST_DG.DST_ShiftPointsAndComp.DST_ShiftCompensation.DST_DECELUPPERLIMITLOWERCLAMP "" VALUE 0x8060651A DefaultValueRecordLayout_AUTOSAR_Platform_BaseTypes_uint16 20000.0 RB_PT_PCT_SWC_DST_CompuMethods_DST_Ident 0.0 20000. FORMAT "%10.5"
 /begin ANNOTATION ANNOTATION_LABEL "Description (coming from AUTOSAR DESC field)"
  /begin ANNOTATION_TEXT "lowest value possible for Decel upper limit - prevents decel being completely inactive when driven at low rpm\r\n" /end ANNOTATION_TEXT
 /end ANNOTATION
/end CHARACTERISTIC
/begin CHARACTERISTIC DST_EFLASHB.DST_DG.DST_ShiftPointsAndComp.DST_ShiftCompensation.DST_DECELUPPERLIMITSTRATEGY "" VAL_BLK 0x8060647E DefaultValueRecordLayout_AUTOSAR_Platform_BaseTypes_uint8 4.0 RB_PT_PCT_SWC_DST_CompuMethods_ident 0.0 4. FORMAT "%10.5"
 /begin ANNOTATION ANNOTATION_LABEL "Description (coming from AUTOSAR DESC field)"
  /begin ANNOTATION_TEXT "0 = No upper limit, 1 = Rpm when on throttle, 2 = Rpm when downshift requested, 3=When downshift requested but increase ramp\r\n" /end ANNOTATION_TEXT
 /end ANNOTATION
 MATRIX_DIM 17 1 1 /end CHARACTERISTIC
/begin CHARACTERISTIC DST_EFLASHB.DST_DG.DST_ShiftPointsAndComp.DST_ShiftCompensation.DST_DOWNSHIFTABOVEIDLESHIFTMODE "" VAL_BLK 0x8060645C DefaultValueRecordLayout_AUTOSAR_Platform_BaseTypes_uint16 20000.0 RB_PT_PCT_SWC_DST_CompuMethods_ident 0.0 20000. FORMAT "%10.5"
 /begin ANNOTATION ANNOTATION_LABEL "Description (coming from AUTOSAR DESC field)" /begin ANNOTATION_TEXT "Rpm above idle speed to request downshift\r\n" /end ANNOTATION_TEXT /end ANNOTATION
 MATRIX_DIM 17 1 1 /end CHARACTERISTIC
/begin CHARACTERISTIC DST_EFLASHB.DST_DG.DST_ShiftPointsAndComp.DST_ShiftCompensation.DST_DOWNSHIFTATIDLEMINDECELCOMP "" VALUE 0x8060652B DefaultValueRecordLayout_AUTOSAR_Platform_BaseTypes_boolean 255.0 AUTOSAR_Platform_CompuMethods_boolean 0.0 255. FORMAT "%10.5"
 /begin ANNOTATION ANNOTATION_LABEL "Description (coming from AUTOSAR DESC field)"
  /begin ANNOTATION_TEXT "If true, rather than using idle speed + offset, it will use the minimum of the current zero line and idle speed + offset\r\n" /end ANNOTATION_TEXT
 /end ANNOTATION
/end CHARACTERISTIC
/begin CHARACTERISTIC DST_EFLASHB.DST_DG.DST_ShiftPointsAndComp.DST_ShiftCompensation.DST_FAILEDGEARHYST "" VALUE 0x8060651C DefaultValueRecordLayout_AUTOSAR_Platform_BaseTypes_sint16 20000.0 RB_PT_PCT_SWC_DST_CompuMethods_ident 0.0 20000. FORMAT "%10.5"
 /begin ANNOTATION ANNOTATION_LABEL "Description (coming from AUTOSAR DESC field)"
  /begin ANNOTATION_TEXT "Minimum hysteresis between maximum rpm and minimum rpm for a failed gear\r\n" /end ANNOTATION_TEXT
 /end ANNOTATION
/end CHARACTERISTIC
/begin CHARACTERISTIC DST_EFLASHB.DST_DG.DST_ShiftPointsAndComp.DST_ShiftCompensation.DST_GRADMAXMAXRPMACTIVE "" VALUE 0x8060651E DefaultValueRecordLayout_AUTOSAR_Platform_BaseTypes_uint16 20000.0 RB_PT_PCT_SWC_DST_CompuMethods_DST_Ident 0.0 20000. FORMAT "%10.5"
 /begin ANNOTATION ANNOTATION_LABEL "Description (coming from AUTOSAR DESC field)"
  /begin ANNOTATION_TEXT "Maximum value the gradient compensaion can increase to\r\n" /end ANNOTATION_TEXT
 /end ANNOTATION
/end CHARACTERISTIC
/begin CHARACTERISTIC DST_EFLASHB.DST_DG.DST_ShiftPointsAndComp.DST_ShiftCompensation.DST_GRADMINMAXRPMACTIVE "" VALUE 0x80606520 DefaultValueRecordLayout_AUTOSAR_Platform_BaseTypes_uint16 20000.0 RB_PT_PCT_SWC_DST_CompuMethods_DST_Ident 0.0 20000. FORMAT "%10.5"
 /begin ANNOTATION ANNOTATION_LABEL "Description (coming from AUTOSAR DESC field)"
  /begin ANNOTATION_TEXT "Maximum value the gradient compensaion can increase to\r\n" /end ANNOTATION_TEXT
 /end ANNOTATION
/end CHARACTERISTIC
/begin CHARACTERISTIC DST_EFLASHB.DST_DG.DST_ShiftPointsAndComp.DST_ShiftCompensation.DST_IDLECOMPMAXRPMMINGEAR "" VALUE 0x8060652C DefaultValueRecordLayout_AUTOSAR_Platform_BaseTypes_uint8 255.0 RB_PT_PCT_SWC_DST_CompuMethods_ident 0.0 255. FORMAT "%10.5"
 /begin ANNOTATION ANNOTATION_LABEL "Description (coming from AUTOSAR DESC field)" /begin ANNOTATION_TEXT "Lowest gear to apply idle downshift\r\n" /end ANNOTATION_TEXT /end ANNOTATION
/end CHARACTERISTIC
/begin CHARACTERISTIC DST_EFLASHB.DST_DG.DST_ShiftPointsAndComp.DST_ShiftCompensation.DST_IDLECOMPMINRPMMINGEAR "" VALUE 0x8060652D DefaultValueRecordLayout_AUTOSAR_Platform_BaseTypes_uint8 255.0 RB_PT_PCT_SWC_DST_CompuMethods_ident 0.0 255. FORMAT "%10.5"
 /begin ANNOTATION ANNOTATION_LABEL "Description (coming from AUTOSAR DESC field)" /begin ANNOTATION_TEXT "Lowest gear to apply idle downshift\r\n" /end ANNOTATION_TEXT /end ANNOTATION
/end CHARACTERISTIC
/begin CHARACTERISTIC DST_EFLASHB.DST_DG.DST_ShiftPointsAndComp.DST_ShiftCompensation.DST_INHIBITDOWNABOVEIDLE "" VALUE 0x80606522 DefaultValueRecordLayout_AUTOSAR_Platform_BaseTypes_uint16 20000.0 RB_PT_PCT_SWC_DST_CompuMethods_ident 0.0 20000. FORMAT "%10.5"
 /begin ANNOTATION ANNOTATION_LABEL "Description (coming from AUTOSAR DESC field)" /begin ANNOTATION_TEXT "Used to calculate the lower downshift limit\r\n" /end ANNOTATION_TEXT /end ANNOTATION
/end CHARACTERISTIC
/begin CHARACTERISTIC DST_EFLASHB.DST_DG.DST_ShiftPointsAndComp.DST_ShiftCompensation.DST_LEVERPULLBACKDOWNHYST "" VALUE 0x80606524 DefaultValueRecordLayout_AUTOSAR_Platform_BaseTypes_uint16 20000.0 RB_PT_PCT_SWC_DST_CompuMethods_ident 0.0 20000. FORMAT "%10.5"
 /begin ANNOTATION ANNOTATION_LABEL "Description (coming from AUTOSAR DESC field)"
  /begin ANNOTATION_TEXT "Hysteresis used to limit the lowest gear available if the driver pulls back the PRNDl\r\n" /end ANNOTATION_TEXT
 /end ANNOTATION
/end CHARACTERISTIC
/begin CHARACTERISTIC DST_EFLASHB.DST_DG.DST_ShiftPointsAndComp.DST_ShiftCompensation.DST_PULLAWAY2NDMAXGRAD "" VALUE 0x80606526 DefaultValueRecordLayout_AUTOSAR_Platform_BaseTypes_sint16 65.4 RB_PT_PCT_SWC_DST_CompuMethods_ratio_0p001 -32.7 32.7 FORMAT "%10.5"
 /begin ANNOTATION ANNOTATION_LABEL "Description (coming from AUTOSAR DESC field)"
  /begin ANNOTATION_TEXT "Positive (up-hill) gradient above which second gear pullaway is disabled\r\n" /end ANNOTATION_TEXT
 /end ANNOTATION
/end CHARACTERISTIC
/begin CHARACTERISTIC DST_EFLASHB.DST_DG.DST_ShiftPointsAndComp.DST_ShiftCompensation.DST_PULLAWAY2NDMAXTHROTTLE "" VAL_BLK 0x8060648F DefaultValueRecordLayout_AUTOSAR_Platform_BaseTypes_uint8 102.0 RB_PT_PCT_SWC_DST_CompuMethods_ratio_0p4 0.0 102. FORMAT "%10.5"
 /begin ANNOTATION ANNOTATION_LABEL "Description (coming from AUTOSAR DESC field)"
  /begin ANNOTATION_TEXT "At this throttle or above, pullaway in second gear will be disabled\r\n" /end ANNOTATION_TEXT
 /end ANNOTATION
 MATRIX_DIM 17 1 1 /end CHARACTERISTIC
/begin CHARACTERISTIC DST_EFLASHB.DST_DG.DST_ShiftPointsAndComp.DST_ShiftCompensation.DST_PULLAWAY2NDTIMEB4ENABLED "" VALUE 0x80606528 DefaultValueRecordLayout_AUTOSAR_Platform_BaseTypes_uint16 655.35 RB_PT_PCT_SWC_DST_CompuMethods_DST_Time 0.0 655.35 FORMAT "%10.5"
 /begin ANNOTATION ANNOTATION_LABEL "Description (coming from AUTOSAR DESC field)" /begin ANNOTATION_TEXT "Time in seconds before pullaway in second is enabled\r\n" /end ANNOTATION_TEXT /end ANNOTATION
/end CHARACTERISTIC
/begin CHARACTERISTIC DST_EFLASHB.DST_DG.DST_ShiftPointsAndComp.DST_ShiftMaps.DST_ALWAYSUPSHIFTINLAUNCHMODE "" VALUE 0x8060653C DefaultValueRecordLayout_AUTOSAR_Platform_BaseTypes_boolean 255.0 AUTOSAR_Platform_CompuMethods_boolean 0.0 255. FORMAT "%10.5"
 /begin ANNOTATION ANNOTATION_LABEL "Description (coming from AUTOSAR DESC field)"
  /begin ANNOTATION_TEXT "If true, the transmission will aways upshift when launch mode is active\r\n" /end ANNOTATION_TEXT
 /end ANNOTATION
/end CHARACTERISTIC
/begin CHARACTERISTIC DST_EFLASHB.DST_DG.DST_ShiftPointsAndComp.DST_ShiftMaps.DST_ALWAYSUPSHIFTWITHKDPRESSED "" VALUE 0x8060653D DefaultValueRecordLayout_AUTOSAR_Platform_BaseTypes_boolean 255.0 AUTOSAR_Platform_CompuMethods_boolean 0.0 255. FORMAT "%10.5"
 /begin ANNOTATION ANNOTATION_LABEL "Description (coming from AUTOSAR DESC field)"
  /begin ANNOTATION_TEXT "If this is true, always auto upshift when the KD pedal is pressed, even if bounce off rev limit is true\r\n" /end ANNOTATION_TEXT
 /end ANNOTATION
/end CHARACTERISTIC
/begin CHARACTERISTIC DST_EFLASHB.DST_DG.DST_ShiftPointsAndComp.DST_ShiftMaps.DST_BELOWRPMLIMITCOUNTDOWNBOUNCETIME "" VALUE 0x8060652E DefaultValueRecordLayout_AUTOSAR_Platform_BaseTypes_uint16 20000.0 RB_PT_PCT_SWC_DST_CompuMethods_ident 0.0 20000. FORMAT "%10.5"
 /begin ANNOTATION ANNOTATION_LABEL "Description (coming from AUTOSAR DESC field)"
  /begin ANNOTATION_TEXT "Engine speed below the rev limit above which the bounce timer will count down\r\n" /end ANNOTATION_TEXT
 /end ANNOTATION
/end CHARACTERISTIC
/begin CHARACTERISTIC DST_EFLASHB.DST_DG.DST_ShiftPointsAndComp.DST_ShiftMaps.DST_BELOWRPMLIMITRESETBOUNCETIME "" VALUE 0x80606530 DefaultValueRecordLayout_AUTOSAR_Platform_BaseTypes_uint16 20000.0 RB_PT_PCT_SWC_DST_CompuMethods_ident 0.0 20000. FORMAT "%10.5"
 /begin ANNOTATION ANNOTATION_LABEL "Description (coming from AUTOSAR DESC field)"
  /begin ANNOTATION_TEXT "Engine speed below the Rev limit to reset the rev limit bounce time\r\n" /end ANNOTATION_TEXT
 /end ANNOTATION
/end CHARACTERISTIC
/begin CHARACTERISTIC DST_EFLASHB.DST_DG.DST_ShiftPointsAndComp.DST_ShiftMaps.DST_DSTTHROTTLE4KD "" VALUE 0x80606532 DefaultValueRecordLayout_AUTOSAR_Platform_BaseTypes_uint16 110.0 RB_PT_PCT_SWC_DST_CompuMethods_ratio_0p1 0.0 110. FORMAT "%10.5"
 /begin ANNOTATION ANNOTATION_LABEL "Description (coming from AUTOSAR DESC field)" /begin ANNOTATION_TEXT "DST throttle pedal to trigger KD\r\n" /end ANNOTATION_TEXT /end ANNOTATION
/end CHARACTERISTIC
/begin CHARACTERISTIC DST_EFLASHB.DST_DG.DST_ShiftPointsAndComp.DST_ShiftMaps.DST_IOPTHROTTLE4KD "" VALUE 0x8060653E DefaultValueRecordLayout_AUTOSAR_Platform_BaseTypes_uint8 102.0 RB_PT_PCT_SWC_DST_CompuMethods_ratio_0p4 0.0 102. FORMAT "%10.5"
 /begin ANNOTATION ANNOTATION_LABEL "Description (coming from AUTOSAR DESC field)" /begin ANNOTATION_TEXT "IOP throttle pedal angle to trigger KD\r\n" /end ANNOTATION_TEXT /end ANNOTATION
/end CHARACTERISTIC
/begin CHARACTERISTIC DST_EFLASHB.DST_DG.DST_ShiftPointsAndComp.DST_ShiftMaps.DST_OVERRIDEMAXRPMPULLAWAY "" VALUE 0x80606534 DefaultValueRecordLayout_AUTOSAR_Platform_BaseTypes_sint16 20000.0 RB_PT_PCT_SWC_DST_CompuMethods_DST_Ident 0.0 20000. FORMAT "%10.5"
 /begin ANNOTATION ANNOTATION_LABEL "Description (coming from AUTOSAR DESC field)" /begin ANNOTATION_TEXT "Value to set max rpm when overwriting min rpm 2nd\r\n" /end ANNOTATION_TEXT /end ANNOTATION
/end CHARACTERISTIC
/begin CHARACTERISTIC DST_EFLASHB.DST_DG.DST_ShiftPointsAndComp.DST_ShiftMaps.DST_PULLAWAYHOLDTIME "" VALUE 0x80606536 DefaultValueRecordLayout_AUTOSAR_Platform_BaseTypes_uint16 655.35 RB_PT_PCT_SWC_DST_CompuMethods_DST_Time 0.0 655.35 FORMAT "%10.5"
 /begin ANNOTATION ANNOTATION_LABEL "Description (coming from AUTOSAR DESC field)"
  /begin ANNOTATION_TEXT "Time to hold pullaway shift map / gear after DWC says no longer in pullaway\r\n" /end ANNOTATION_TEXT
 /end ANNOTATION
/end CHARACTERISTIC
/begin CHARACTERISTIC DST_EFLASHB.DST_DG.DST_ShiftPointsAndComp.DST_ShiftMaps.DST_TESTTHROTTLEMAXCHECK "" VALUE 0x80606538 DefaultValueRecordLayout_AUTOSAR_Platform_BaseTypes_uint16 110.0 RB_PT_PCT_SWC_DST_CompuMethods_ratio_0p1 0.0 110. FORMAT "%10.5"
 /begin ANNOTATION ANNOTATION_LABEL "Description (coming from AUTOSAR DESC field)" /begin ANNOTATION_TEXT "Maximum throttle to test for the next downshift\r\n" /end ANNOTATION_TEXT /end ANNOTATION
/end CHARACTERISTIC
/begin CHARACTERISTIC DST_EFLASHB.DST_DG.DST_ShiftPointsAndComp.DST_ShiftMaps.DST_TESTTHROTTLESTEP "" VALUE 0x8060653A DefaultValueRecordLayout_AUTOSAR_Platform_BaseTypes_uint16 110.0 RB_PT_PCT_SWC_DST_CompuMethods_ratio_0p1 0.0 110. FORMAT "%10.5"
 /begin ANNOTATION ANNOTATION_LABEL "Description (coming from AUTOSAR DESC field)"
  /begin ANNOTATION_TEXT "Step between each program loop to increase test throttle to see when next downshift will be requested\r\n" /end ANNOTATION_TEXT
 /end ANNOTATION
/end CHARACTERISTIC
/begin CHARACTERISTIC DST_EFLASHB.DST_DG.DST_ShiftTimeComp_Demand.DST_MAXRPM2DOWNSHIFT "" VAL_BLK 0x80606562 DefaultValueRecordLayout_AUTOSAR_Platform_BaseTypes_uint16 5000.0 RB_PT_PCT_SWC_DST_CompuMethods_ident 0.0 5000. FORMAT "%10.5"
 /begin ANNOTATION ANNOTATION_LABEL "Description (coming from AUTOSAR DESC field)" /begin ANNOTATION_TEXT "Maximum rpm to shift for the current gear\r\n" /end ANNOTATION_TEXT /end ANNOTATION
 MATRIX_DIM 11 1 1 /end CHARACTERISTIC
/begin CHARACTERISTIC DST_EFLASHB.DST_DG.DST_ShiftTimeComp_Demand.DST_MINABOVEIDLEDOTORQUEPHASE "" VALUE 0x80606578 DefaultValueRecordLayout_AUTOSAR_Platform_BaseTypes_uint16 20000.0 RB_PT_PCT_SWC_DST_CompuMethods_ident 0.0 20000. FORMAT "%10.5"
 /begin ANNOTATION ANNOTATION_LABEL "Description (coming from AUTOSAR DESC field)"
  /begin ANNOTATION_TEXT "Minimum rpm above idle speed in target gear when a torque phase will be completed\r\n" /end ANNOTATION_TEXT
 /end ANNOTATION
/end CHARACTERISTIC
/begin CHARACTERISTIC DST_EFLASHB.DST_DG.DST_ShiftTimeComp_Demand.DST_OSHAFTSPDAPPLYT2SACC "" VALUE 0x8060657A DefaultValueRecordLayout_AUTOSAR_Platform_BaseTypes_sint16 2000.0 RB_PT_PCT_SWC_DST_CompuMethods_ratio_0p1 -1000. 1000. FORMAT "%10.5"
 /begin ANNOTATION ANNOTATION_LABEL "Description (coming from AUTOSAR DESC field)"
  /begin ANNOTATION_TEXT "Minimum output shaft acceleration before time to shift is applied to max rpm\r\n" /end ANNOTATION_TEXT
 /end ANNOTATION
/end CHARACTERISTIC
/begin CHARACTERISTIC DST_EFLASHB.DST_DG.DST_ShiftTimeComp_Demand.DST_OSHAFTSPDAPPLYT2SDEC "" VALUE 0x8060657C DefaultValueRecordLayout_AUTOSAR_Platform_BaseTypes_sint16 2000.0 RB_PT_PCT_SWC_DST_CompuMethods_ratio_0p1 -1000. 1000. FORMAT "%10.5"
 /begin ANNOTATION ANNOTATION_LABEL "Description (coming from AUTOSAR DESC field)"
  /begin ANNOTATION_TEXT "Minimum output shaft acceleration before time to shift is applied to max rpm\r\n" /end ANNOTATION_TEXT
 /end ANNOTATION
/end CHARACTERISTIC
/begin CHARACTERISTIC DST_EFLASHB.DST_DG.DST_ShiftTimeComp_Demand.DST_SHIFTMODEENABLEAGGDOWNS "" VAL_BLK 0x80606540 DefaultValueRecordLayout_AUTOSAR_Platform_BaseTypes_boolean 255.0 AUTOSAR_Platform_CompuMethods_boolean 0.0 255. FORMAT "%10.5"
 /begin ANNOTATION ANNOTATION_LABEL "Description (coming from AUTOSAR DESC field)" /begin ANNOTATION_TEXT "Enable very agressive downshifts to the rev limit\r\n" /end ANNOTATION_TEXT /end ANNOTATION
 MATRIX_DIM 17 1 1 /end CHARACTERISTIC
/begin CHARACTERISTIC DST_EFLASHB.DST_DG.DST_ShiftTimeComp_Demand.DST_SHIFTTIMEFACT2USE "" VAL_BLK 0x80606551 DefaultValueRecordLayout_AUTOSAR_Platform_BaseTypes_uint8 2.0 RB_PT_PCT_SWC_DST_CompuMethods_ident 0.0 2. FORMAT "%10.5"
 /begin ANNOTATION ANNOTATION_LABEL "Description (coming from AUTOSAR DESC field)"
  /begin ANNOTATION_TEXT "0 = No shift time, 1 = Reduced, 2 = Full shift time at higher rpm\r\n" /end ANNOTATION_TEXT
 /end ANNOTATION
 MATRIX_DIM 17 1 1 /end CHARACTERISTIC
/begin CHARACTERISTIC DST_EFLASHB.DST_DG.DST_ShiftTimeComp_Demand.DST_SHIFTTIMEFACTVSRPM "" MAP 0x80606586 RB_PT_PCT_SWC_DST_RecordLayouts_RL_Map_uint8_12_uint16_4_uint8_3 1.0 RB_PT_PCT_SWC_DST_CompuMethods_ratio_0p01 0.0 1. FORMAT "%10.5"
 /begin ANNOTATION ANNOTATION_LABEL "Description (coming from AUTOSAR DESC field)"
  /begin ANNOTATION_TEXT "Allows reduced impact of shift time at low rpm to maintain shift map hysteresis\r\n" /end ANNOTATION_TEXT
 /end ANNOTATION
 /begin AXIS_DESCR STD_AXIS NO_INPUT_QUANTITY RB_PT_PCT_SWC_DST_CompuMethods_DST_Ident 4 0.0 20000. FORMAT "%10.5" DEPOSIT ABSOLUTE /end AXIS_DESCR
 /begin AXIS_DESCR STD_AXIS NO_INPUT_QUANTITY RB_PT_PCT_SWC_DST_CompuMethods_ident 3 0.0 2. FORMAT "%10.5" DEPOSIT ABSOLUTE /end AXIS_DESCR
/end CHARACTERISTIC
/begin CHARACTERISTIC DST_EFLASHB.DST_DG.DST_ShiftTimeComp_Demand.DST_THROTTLEINCRPMACTIVE "" VALUE 0x8060657E DefaultValueRecordLayout_AUTOSAR_Platform_BaseTypes_sint16 20000.0 RB_PT_PCT_SWC_DST_CompuMethods_DST_Ident 0.0 20000. FORMAT "%10.5"
 /begin ANNOTATION ANNOTATION_LABEL "Description (coming from AUTOSAR DESC field)"
  /begin ANNOTATION_TEXT "Rpm below rev limit to monitor changes in pedal angle\r\n" /end ANNOTATION_TEXT
 /end ANNOTATION
/end CHARACTERISTIC
/begin CHARACTERISTIC DST_EFLASHB.DST_DG.DST_ShiftTimeComp_Demand.DST_THROTTLEINCSHIFTRPM "" VALUE 0x80606580 DefaultValueRecordLayout_AUTOSAR_Platform_BaseTypes_uint16 5000.0 RB_PT_PCT_SWC_DST_CompuMethods_ident 0.0 5000. FORMAT "%10.5"
 /begin ANNOTATION ANNOTATION_LABEL "Description (coming from AUTOSAR DESC field)"
  /begin ANNOTATION_TEXT "If throttle applied quickly at high rpm, this is rpm to force immediate up-shift\r\n" /end ANNOTATION_TEXT
 /end ANNOTATION
/end CHARACTERISTIC
/begin CHARACTERISTIC DST_EFLASHB.DST_DG.DST_ShiftTimeComp_Demand.DST_THROTTLEINCTRIGTHRESH "" VALUE 0x80606584 DefaultValueRecordLayout_AUTOSAR_Platform_BaseTypes_uint8 102.0 RB_PT_PCT_SWC_DST_CompuMethods_ratio_0p4 0.0 102. FORMAT "%10.5"
 /begin ANNOTATION ANNOTATION_LABEL "Description (coming from AUTOSAR DESC field)" /begin ANNOTATION_TEXT "Increase in throttle to trigger min time to shift\r\n" /end ANNOTATION_TEXT /end ANNOTATION
/end CHARACTERISTIC
/begin CHARACTERISTIC DST_EFLASHB.DST_DG.DST_ShiftTimeComp_Demand.DST_TIME2REVUPENGINE "" VALUE 0x80606582 DefaultValueRecordLayout_AUTOSAR_Platform_BaseTypes_uint16 1.0 RB_PT_PCT_SWC_DST_CompuMethods_ratio_0p001 0.0 1. FORMAT "%10.5"
 /begin ANNOTATION ANNOTATION_LABEL "Description (coming from AUTOSAR DESC field)"
  /begin ANNOTATION_TEXT "Estimate of how long it takes to rev up the engine during an aggressive ASG downshift\r\n" /end ANNOTATION_TEXT
 /end ANNOTATION
/end CHARACTERISTIC
/begin CHARACTERISTIC DST_EFLASHB.DST_DriverInterface.DST_AUTODNCANCELTEMPMANPEDAL "" VALUE 0x806065AE DefaultValueRecordLayout_AUTOSAR_Platform_BaseTypes_uint8 102.0 RB_PT_PCT_SWC_DST_CompuMethods_ratio_0p4 0.0 102. FORMAT "%10.5"
 /begin ANNOTATION ANNOTATION_LABEL "Description (coming from AUTOSAR DESC field)"
  /begin ANNOTATION_TEXT "If true, any auto down-shift can instantly cancel temporary manual mode\r\n" /end ANNOTATION_TEXT
 /end ANNOTATION
/end CHARACTERISTIC
/begin CHARACTERISTIC DST_EFLASHB.DST_DriverInterface.DST_BOBDOWNSHIFT "" VALUE 0x806065AF DefaultValueRecordLayout_AUTOSAR_Platform_BaseTypes_boolean 255.0 AUTOSAR_Platform_CompuMethods_boolean 0.0 255. FORMAT "%10.5"
 /begin ANNOTATION ANNOTATION_LABEL "Description (coming from AUTOSAR DESC field)"
  /begin ANNOTATION_TEXT "Software option to force the downshift to be set true\r\n" /end ANNOTATION_TEXT
 /end ANNOTATION
/end CHARACTERISTIC
/begin CHARACTERISTIC DST_EFLASHB.DST_DriverInterface.DST_BOBUPSHIFT "" VALUE 0x806065B0 DefaultValueRecordLayout_AUTOSAR_Platform_BaseTypes_boolean 255.0 AUTOSAR_Platform_CompuMethods_boolean 0.0 255. FORMAT "%10.5"
 /begin ANNOTATION ANNOTATION_LABEL "Description (coming from AUTOSAR DESC field)" /begin ANNOTATION_TEXT "Software option to force upshift signal to be true\r\n" /end ANNOTATION_TEXT /end ANNOTATION
/end CHARACTERISTIC
/begin CHARACTERISTIC DST_EFLASHB.DST_DriverInterface.DST_CANCELTEMPMAN_AUTODN "" VALUE 0x806065B1 DefaultValueRecordLayout_AUTOSAR_Platform_BaseTypes_boolean 255.0 AUTOSAR_Platform_CompuMethods_boolean 0.0 255. FORMAT "%10.5"
 /begin ANNOTATION ANNOTATION_LABEL "Description (coming from AUTOSAR DESC field)"
  /begin ANNOTATION_TEXT "Allow Cancel temporary manual mode as soon as an auto up-shift occurs\r\n" /end ANNOTATION_TEXT
 /end ANNOTATION
/end CHARACTERISTIC
/begin CHARACTERISTIC DST_EFLASHB.DST_DriverInterface.DST_CANCELTEMPMAN_AUTOUP "" VALUE 0x806065B2 DefaultValueRecordLayout_AUTOSAR_Platform_BaseTypes_boolean 255.0 AUTOSAR_Platform_CompuMethods_boolean 0.0 255. FORMAT "%10.5"
 /begin ANNOTATION ANNOTATION_LABEL "Description (coming from AUTOSAR DESC field)"
  /begin ANNOTATION_TEXT "Allow Cancel temporary manual mode as soon as an auto up-shift occurs\r\n" /end ANNOTATION_TEXT
 /end ANNOTATION
/end CHARACTERISTIC
/begin CHARACTERISTIC DST_EFLASHB.DST_DriverInterface.DST_DNSELECTNEUTRALBRAKETIME "" VALUE 0x806065A4 DefaultValueRecordLayout_AUTOSAR_Platform_BaseTypes_uint16 655.35 RB_PT_PCT_SWC_DST_CompuMethods_DST_Time 0.0 655.35 FORMAT "%10.5"
 /begin ANNOTATION ANNOTATION_LABEL "Description (coming from AUTOSAR DESC field)"
  /begin ANNOTATION_TEXT "Time since the foot brake to select neutral with the down paddle\r\n" /end ANNOTATION_TEXT
 /end ANNOTATION
/end CHARACTERISTIC
/begin CHARACTERISTIC DST_EFLASHB.DST_DriverInterface.DST_DNSELECTNEUTRALPADDLEHOLDTIME "" VALUE 0x806065A6 DefaultValueRecordLayout_AUTOSAR_Platform_BaseTypes_uint16 655.35 RB_PT_PCT_SWC_DST_CompuMethods_DST_Time 0.0 655.35 FORMAT "%10.5"
 /begin ANNOTATION ANNOTATION_LABEL "Description (coming from AUTOSAR DESC field)"
  /begin ANNOTATION_TEXT "Time the downshift paddle needs to be held when stationary to select neutral\r\n" /end ANNOTATION_TEXT
 /end ANNOTATION
/end CHARACTERISTIC
/begin CHARACTERISTIC DST_EFLASHB.DST_DriverInterface.DST_DNSELECTNEUTRALREFSPDTHRESH "" VALUE 0x806065A8 DefaultValueRecordLayout_AUTOSAR_Platform_BaseTypes_uint16 500.0 RB_PT_PCT_SWC_DST_CompuMethods_kph_0p1 0.0 500. FORMAT "%10.5"
 /begin ANNOTATION ANNOTATION_LABEL "Description (coming from AUTOSAR DESC field)"
  /begin ANNOTATION_TEXT "Vehicle speed below which Neutral will be selected if the down paddle is held\r\n" /end ANNOTATION_TEXT
 /end ANNOTATION
/end CHARACTERISTIC
/begin CHARACTERISTIC DST_EFLASHB.DST_DriverInterface.DST_DOWNPADDLE2REVERSEENABLE "" VALUE 0x806065B3 DefaultValueRecordLayout_AUTOSAR_Platform_BaseTypes_boolean 255.0 AUTOSAR_Platform_CompuMethods_boolean 0.0 255. FORMAT "%10.5"
 /begin ANNOTATION ANNOTATION_LABEL "Description (coming from AUTOSAR DESC field)"
  /begin ANNOTATION_TEXT "If true, the down-paddle can be used to select Reverse from Neutral when stationary\r\n" /end ANNOTATION_TEXT
 /end ANNOTATION
/end CHARACTERISTIC
/begin CHARACTERISTIC DST_EFLASHB.DST_DriverInterface.DST_ENABLEDOWNPADDLE2NEUTRAL "" VALUE 0x806065B4 DefaultValueRecordLayout_AUTOSAR_Platform_BaseTypes_boolean 255.0 AUTOSAR_Platform_CompuMethods_boolean 0.0 255. FORMAT "%10.5"
 /begin ANNOTATION ANNOTATION_LABEL "Description (coming from AUTOSAR DESC field)"
  /begin ANNOTATION_TEXT "If true, the down paddle can be held to select neutral\r\n" /end ANNOTATION_TEXT
 /end ANNOTATION
/end CHARACTERISTIC
/begin CHARACTERISTIC DST_EFLASHB.DST_DriverInterface.DST_OVERIDEINI "" VALUE 0x806065B5 DefaultValueRecordLayout_AUTOSAR_Platform_BaseTypes_boolean 255.0 AUTOSAR_Platform_CompuMethods_boolean 0.0 255. FORMAT "%10.5"
 /begin ANNOTATION ANNOTATION_LABEL "Description (coming from AUTOSAR DESC field)"
  /begin ANNOTATION_TEXT "If true, OK flags from other modules do not need to be set beflore allowing gear selection\r\n" /end ANNOTATION_TEXT
 /end ANNOTATION
/end CHARACTERISTIC
/begin CHARACTERISTIC DST_EFLASHB.DST_DriverInterface.DST_PADDLEHELDDNCANCELMAN "" VALUE 0x806065AA DefaultValueRecordLayout_AUTOSAR_Platform_BaseTypes_uint16 655.35 RB_PT_PCT_SWC_DST_CompuMethods_DST_Time 0.0 655.35 FORMAT "%10.5"
 /begin ANNOTATION ANNOTATION_LABEL "Description (coming from AUTOSAR DESC field)"
  /begin ANNOTATION_TEXT "WHen the down paddle is held longer than this time manual mode is disabled\r\n" /end ANNOTATION_TEXT
 /end ANNOTATION
/end CHARACTERISTIC
/begin CHARACTERISTIC DST_EFLASHB.DST_DriverInterface.DST_PADDLEHELDUPCANCELMAN "" VALUE 0x806065AC DefaultValueRecordLayout_AUTOSAR_Platform_BaseTypes_uint16 655.35 RB_PT_PCT_SWC_DST_CompuMethods_DST_Time 0.0 655.35 FORMAT "%10.5"
 /begin ANNOTATION ANNOTATION_LABEL "Description (coming from AUTOSAR DESC field)"
  /begin ANNOTATION_TEXT "Time the up paddle must be held before Manual mode is disabled\r\n" /end ANNOTATION_TEXT
 /end ANNOTATION
/end CHARACTERISTIC
/begin CHARACTERISTIC DST_EFLASHB.DST_DriverInterface.DST_POWERUPINMANUAL "" VALUE 0x806065B6 DefaultValueRecordLayout_AUTOSAR_Platform_BaseTypes_boolean 255.0 AUTOSAR_Platform_CompuMethods_boolean 0.0 255. FORMAT "%10.5"
 /begin ANNOTATION ANNOTATION_LABEL "Description (coming from AUTOSAR DESC field)" /begin ANNOTATION_TEXT "If true, the car will pwoer up in manual mode\r\n" /end ANNOTATION_TEXT /end ANNOTATION
/end CHARACTERISTIC
/begin CHARACTERISTIC DST_EFLASHB.DST_ENGCNTLWARMUP "" VALUE 0x80605F8F DefaultValueRecordLayout_AUTOSAR_Platform_BaseTypes_boolean 255.0 AUTOSAR_Platform_CompuMethods_boolean 0.0 255. FORMAT "%10.5"
 /begin ANNOTATION ANNOTATION_LABEL "Description (coming from AUTOSAR DESC field)"
  /begin ANNOTATION_TEXT "If true, the logical flag from the engine will control the warm-up maps\r\n" /end ANNOTATION_TEXT
 /end ANNOTATION
/end CHARACTERISTIC
/begin CHARACTERISTIC DST_EFLASHB.DST_In_DriverDemand.DST_BOBCRUISEPEDAL "" VALUE 0x8060669A DefaultValueRecordLayout_AUTOSAR_Platform_BaseTypes_boolean 255.0 AUTOSAR_Platform_CompuMethods_boolean 0.0 255. FORMAT "%10.5"
 /begin ANNOTATION ANNOTATION_LABEL "Description (coming from AUTOSAR DESC field)"
  /begin ANNOTATION_TEXT "If set true, sets the cruise accelerate function to 1 to manipulate the throttle pedal\r\n" /end ANNOTATION_TEXT
 /end ANNOTATION
/end CHARACTERISTIC
/begin CHARACTERISTIC DST_EFLASHB.DST_In_DriverDemand.DST_CRUISEALWAYSLIMITLOWER "" VALUE 0x8060669B DefaultValueRecordLayout_AUTOSAR_Platform_BaseTypes_boolean 255.0 AUTOSAR_Platform_CompuMethods_boolean 0.0 255. FORMAT "%10.5"
 /begin ANNOTATION ANNOTATION_LABEL "Description (coming from AUTOSAR DESC field)"
  /begin ANNOTATION_TEXT "If true, the cruise pedal will always be used as the minimum driver demand\r\n" /end ANNOTATION_TEXT
 /end ANNOTATION
/end CHARACTERISTIC
/begin CHARACTERISTIC DST_EFLASHB.DST_In_DriverDemand.DST_CRUISEPEDALACCEL "" CURVE 0x806066A8 RB_PT_PCT_SWC_DST_RecordLayouts_RL_Curve_uint8_5_uint16_5 100.0 RB_PT_PCT_SWC_DST_CompuMethods_ratio_0p4 0.0 100. FORMAT "%10.5"
 /begin ANNOTATION ANNOTATION_LABEL "Description (coming from AUTOSAR DESC field)"
  /begin ANNOTATION_TEXT "Pedal angle to use for cruise acceleration as function of vehicle speed\r\n" /end ANNOTATION_TEXT
 /end ANNOTATION
 /begin AXIS_DESCR STD_AXIS NO_INPUT_QUANTITY RB_PT_PCT_SWC_DST_CompuMethods_kph_0p1 5 0.0 500. FORMAT "%10.5" DEPOSIT ABSOLUTE /end AXIS_DESCR
/end CHARACTERISTIC
/begin CHARACTERISTIC DST_EFLASHB.DST_In_DriverDemand.DST_CRUISEPEDALDECAY "" VALUE 0x8060669C DefaultValueRecordLayout_AUTOSAR_Platform_BaseTypes_uint8 100.0 RB_PT_PCT_SWC_DST_CompuMethods_ratio_0p4 0.0 100. FORMAT "%10.5"
 /begin ANNOTATION ANNOTATION_LABEL "Description (coming from AUTOSAR DESC field)" /begin ANNOTATION_TEXT "Decay of cruise pedal\r\n" /end ANNOTATION_TEXT /end ANNOTATION
/end CHARACTERISTIC
/begin CHARACTERISTIC DST_EFLASHB.DST_In_DriverDemand.DST_CRUISERESUMECANCEL "" VALUE 0x80606684 DefaultValueRecordLayout_AUTOSAR_Platform_BaseTypes_uint16 20.0 RB_PT_PCT_SWC_DST_CompuMethods_kph_0p1 0.0 20. FORMAT "%10.5"
 /begin ANNOTATION ANNOTATION_LABEL "Description (coming from AUTOSAR DESC field)"
  /begin ANNOTATION_TEXT "Vehicle speed below set speed that resume is set false\r\n" /end ANNOTATION_TEXT
 /end ANNOTATION
/end CHARACTERISTIC
/begin CHARACTERISTIC DST_EFLASHB.DST_In_DriverDemand.DST_CRUISERESUMESET "" VALUE 0x80606686 DefaultValueRecordLayout_AUTOSAR_Platform_BaseTypes_uint16 20.0 RB_PT_PCT_SWC_DST_CompuMethods_kph_0p1 0.0 20. FORMAT "%10.5"
 /begin ANNOTATION ANNOTATION_LABEL "Description (coming from AUTOSAR DESC field)" /begin ANNOTATION_TEXT "Vehicle speed below set point when resume is true\r\n" /end ANNOTATION_TEXT /end ANNOTATION
/end CHARACTERISTIC
/begin CHARACTERISTIC DST_EFLASHB.DST_In_DriverDemand.DST_ENABLEIMMEIDATEUPDOWNSHIFTABORT "" VALUE 0x8060669D DefaultValueRecordLayout_AUTOSAR_Platform_BaseTypes_boolean 255.0 AUTOSAR_Platform_CompuMethods_boolean 0.0 255. FORMAT "%10.5"
 /begin ANNOTATION ANNOTATION_LABEL "Description (coming from AUTOSAR DESC field)"
  /begin ANNOTATION_TEXT "If true and a downshift is requested but the throttle lifts before the downshift has completed, this will immeidately cancel fast off timer\r\n" /end ANNOTATION_TEXT
 /end ANNOTATION
/end CHARACTERISTIC
/begin CHARACTERISTIC DST_EFLASHB.DST_In_DriverDemand.DST_ENABLEPEDALPEAKHOLDPEDALERROR "" VALUE 0x8060669E DefaultValueRecordLayout_AUTOSAR_Platform_BaseTypes_boolean 255.0 AUTOSAR_Platform_CompuMethods_boolean 0.0 255. FORMAT "%10.5"
 /begin ANNOTATION ANNOTATION_LABEL "Description (coming from AUTOSAR DESC field)"
  /begin ANNOTATION_TEXT "Enable the peak hold time to be updated based on the error between the peak held pedal and the input pedal\r\n" /end ANNOTATION_TEXT
 /end ANNOTATION
/end CHARACTERISTIC
/begin CHARACTERISTIC DST_EFLASHB.DST_In_DriverDemand.DST_ENABLEPEDALPEAKHOLDROC "" VALUE 0x8060669F DefaultValueRecordLayout_AUTOSAR_Platform_BaseTypes_boolean 255.0 AUTOSAR_Platform_CompuMethods_boolean 0.0 255. FORMAT "%10.5"
 /begin ANNOTATION ANNOTATION_LABEL "Description (coming from AUTOSAR DESC field)"
  /begin ANNOTATION_TEXT "Enable pedal peak hold time being extended based on rate of change of pedal\r\n" /end ANNOTATION_TEXT
 /end ANNOTATION
/end CHARACTERISTIC
/begin CHARACTERISTIC DST_EFLASHB.DST_In_DriverDemand.DST_FASTOFF_ENGINESPD2CANCEL "" VALUE 0x8060668A DefaultValueRecordLayout_AUTOSAR_Platform_BaseTypes_uint16 20000.0 RB_PT_PCT_SWC_DST_CompuMethods_ident 0.0 20000. FORMAT "%10.5"
 /begin ANNOTATION ANNOTATION_LABEL "Description (coming from AUTOSAR DESC field)" /begin ANNOTATION_TEXT "Engine speed below which fast off will be cancelled\r\n" /end ANNOTATION_TEXT /end ANNOTATION
/end CHARACTERISTIC
/begin CHARACTERISTIC DST_EFLASHB.DST_In_DriverDemand.DST_FASTOFFCANCEL_MODECHNG "" VALUE 0x806066A0 DefaultValueRecordLayout_AUTOSAR_Platform_BaseTypes_boolean 255.0 AUTOSAR_Platform_CompuMethods_boolean 0.0 255. FORMAT "%10.5"
 /begin ANNOTATION ANNOTATION_LABEL "Description (coming from AUTOSAR DESC field)"
  /begin ANNOTATION_TEXT "If true, fast-off will be cancelled as soon as the mode is changed\r\n" /end ANNOTATION_TEXT
 /end ANNOTATION
/end CHARACTERISTIC
/begin CHARACTERISTIC DST_EFLASHB.DST_In_DriverDemand.DST_FASTOFFCANCEL_NRM "" VALUE 0x806066A1 DefaultValueRecordLayout_AUTOSAR_Platform_BaseTypes_boolean 255.0 AUTOSAR_Platform_CompuMethods_boolean 0.0 255. FORMAT "%10.5"
 /begin ANNOTATION ANNOTATION_LABEL "Description (coming from AUTOSAR DESC field)"
  /begin ANNOTATION_TEXT "If true, fast off will be cancelled in Neutral, Reverse and Manual\r\n" /end ANNOTATION_TEXT
 /end ANNOTATION
/end CHARACTERISTIC
/begin CHARACTERISTIC DST_EFLASHB.DST_In_DriverDemand.DST_FASTOFFDISABLE "" VAL_BLK 0x80606640 DefaultValueRecordLayout_AUTOSAR_Platform_BaseTypes_boolean 255.0 AUTOSAR_Platform_CompuMethods_boolean 0.0 255. FORMAT "%10.5"
 /begin ANNOTATION ANNOTATION_LABEL "Description (coming from AUTOSAR DESC field)"
  /begin ANNOTATION_TEXT "If true, throttle peak hold and fast off functions will be disabled\r\n" /end ANNOTATION_TEXT
 /end ANNOTATION
 MATRIX_DIM 17 1 1 /end CHARACTERISTIC
/begin CHARACTERISTIC DST_EFLASHB.DST_In_DriverDemand.DST_FASTOFFLOWESTGEAR "" VALUE 0x806066A2 DefaultValueRecordLayout_AUTOSAR_Platform_BaseTypes_uint8 11.0 RB_PT_PCT_SWC_DST_CompuMethods_ident 0.0 11. FORMAT "%10.5"
 /begin ANNOTATION ANNOTATION_LABEL "Description (coming from AUTOSAR DESC field)" /begin ANNOTATION_TEXT "This is the lowest gear fastoff can be active\r\n" /end ANNOTATION_TEXT /end ANNOTATION
/end CHARACTERISTIC
/begin CHARACTERISTIC DST_EFLASHB.DST_In_DriverDemand.DST_FASTOFFLOWESTKMH "" VALUE 0x80606688 DefaultValueRecordLayout_AUTOSAR_Platform_BaseTypes_uint16 500.0 RB_PT_PCT_SWC_DST_CompuMethods_kph_0p1 0.0 500. FORMAT "%10.5"
 /begin ANNOTATION ANNOTATION_LABEL "Description (coming from AUTOSAR DESC field)" /begin ANNOTATION_TEXT "Vehicle speed below which fast-off is not active\r\n" /end ANNOTATION_TEXT /end ANNOTATION
/end CHARACTERISTIC
/begin CHARACTERISTIC DST_EFLASHB.DST_In_DriverDemand.DST_KDSOFTWARECANCEL "" VALUE 0x806066A3 DefaultValueRecordLayout_AUTOSAR_Platform_BaseTypes_uint8 102.0 RB_PT_PCT_SWC_DST_CompuMethods_ratio_0p4 0.0 102. FORMAT "%10.5"
 /begin ANNOTATION ANNOTATION_LABEL "Description (coming from AUTOSAR DESC field)"
  /begin ANNOTATION_TEXT "Throttle pedal below which the software Kickdown will be cancelled\r\n" /end ANNOTATION_TEXT
 /end ANNOTATION
/end CHARACTERISTIC
/begin CHARACTERISTIC DST_EFLASHB.DST_In_DriverDemand.DST_KDSOFTWAREENABLE "" VALUE 0x806066A4 DefaultValueRecordLayout_AUTOSAR_Platform_BaseTypes_boolean 255.0 AUTOSAR_Platform_CompuMethods_boolean 0.0 255. FORMAT "%10.5"
 /begin ANNOTATION ANNOTATION_LABEL "Description (coming from AUTOSAR DESC field)"
  /begin ANNOTATION_TEXT "If true, a software kickdown can be set if the pedal is increasing rapidly to above a threshold.  Advise this is false if the car has a kick-down switch fitted\r\n" /end ANNOTATION_TEXT
 /end ANNOTATION
/end CHARACTERISTIC
/begin CHARACTERISTIC DST_EFLASHB.DST_In_DriverDemand.DST_KDSOFTWAREKMHABOVE2ENABLE "" VALUE 0x8060668C DefaultValueRecordLayout_AUTOSAR_Platform_BaseTypes_uint16 500.0 RB_PT_PCT_SWC_DST_CompuMethods_kph_0p1 0.0 500. FORMAT "%10.5"
 /begin ANNOTATION ANNOTATION_LABEL "Description (coming from AUTOSAR DESC field)"
  /begin ANNOTATION_TEXT "Software kickdown can be enabled if the vehicle speed is above this threshold\r\n" /end ANNOTATION_TEXT
 /end ANNOTATION
/end CHARACTERISTIC
/begin CHARACTERISTIC DST_EFLASHB.DST_In_DriverDemand.DST_KDSOFTWAREKMHBELOW2ENABLE "" VALUE 0x8060668E DefaultValueRecordLayout_AUTOSAR_Platform_BaseTypes_uint16 500.0 RB_PT_PCT_SWC_DST_CompuMethods_kph_0p1 0.0 500. FORMAT "%10.5"
 /begin ANNOTATION ANNOTATION_LABEL "Description (coming from AUTOSAR DESC field)"
  /begin ANNOTATION_TEXT "Software kickdown can be enabled if the vehicle speed is below this threshold\r\n" /end ANNOTATION_TEXT
 /end ANNOTATION
/end CHARACTERISTIC
/begin CHARACTERISTIC DST_EFLASHB.DST_In_DriverDemand.DST_KDSOFTWAREROC2SET "" CURVE 0x806066BA RB_PT_PCT_SWC_DST_RecordLayouts_RL_Curve_sint16_5_uint16_5 2000.0 RB_PT_PCT_SWC_DST_CompuMethods_ident -1000. 1000. FORMAT "%10.5"
 /begin ANNOTATION ANNOTATION_LABEL "Description (coming from AUTOSAR DESC field)"
  /begin ANNOTATION_TEXT "Rate of change of throttle pedal (based on average pedal angle) to trigger the software kickdown\r\n" /end ANNOTATION_TEXT
 /end ANNOTATION
 /begin AXIS_DESCR STD_AXIS NO_INPUT_QUANTITY RB_PT_PCT_SWC_DST_CompuMethods_ratio_0p01 5 0.0 102. FORMAT "%10.5" DEPOSIT ABSOLUTE /end AXIS_DESCR
/end CHARACTERISTIC
/begin CHARACTERISTIC DST_EFLASHB.DST_In_DriverDemand.DST_KDSOFTWARESET "" VALUE 0x806066A5 DefaultValueRecordLayout_AUTOSAR_Platform_BaseTypes_uint8 102.0 RB_PT_PCT_SWC_DST_CompuMethods_ratio_0p4 0.0 102. FORMAT "%10.5"
 /begin ANNOTATION ANNOTATION_LABEL "Description (coming from AUTOSAR DESC field)"
  /begin ANNOTATION_TEXT "Throttle pedal above which the software Kickdown can be set\r\n" /end ANNOTATION_TEXT
 /end ANNOTATION
/end CHARACTERISTIC
/begin CHARACTERISTIC DST_EFLASHB.DST_In_DriverDemand.DST_PEDALCHANGEGAIN "" VALUE 0x80606690 DefaultValueRecordLayout_AUTOSAR_Platform_BaseTypes_sint16 1.0 RB_PT_PCT_SWC_DST_CompuMethods_ratio_0p001 0.0 1. FORMAT "%10.5"
 /begin ANNOTATION ANNOTATION_LABEL "Description (coming from AUTOSAR DESC field)" /begin ANNOTATION_TEXT "Change to PedalChangeFiltd per program loop\r\n" /end ANNOTATION_TEXT /end ANNOTATION
/end CHARACTERISTIC
/begin CHARACTERISTIC DST_EFLASHB.DST_In_DriverDemand.DST_PEDALHOLDTIMEdPEDALSHIFTMODE "" MAP 0x80606788 RB_PT_PCT_SWC_DST_RecordLayouts_RL_Map_uint16_68_sint16_4_sint8_17 327.67 RB_PT_PCT_SWC_DST_CompuMethods_DST_Time 0.0 327.67 FORMAT "%10.5"
 /begin ANNOTATION ANNOTATION_LABEL "Description (coming from AUTOSAR DESC field)"
  /begin ANNOTATION_TEXT "If the pedal angle reduces rapidly, this can increase the peak hold time based on rate of change of pedal and shift mode\r\n" /end ANNOTATION_TEXT
 /end ANNOTATION
 /begin AXIS_DESCR STD_AXIS NO_INPUT_QUANTITY RB_PT_PCT_SWC_DST_CompuMethods_ident 4 -1000. 1000. FORMAT "%10.5" DEPOSIT ABSOLUTE /end AXIS_DESCR
 /begin AXIS_DESCR STD_AXIS NO_INPUT_QUANTITY RB_PT_PCT_SWC_DST_CompuMethods_ident 17 0.0 16. FORMAT "%10.5" DEPOSIT ABSOLUTE /end AXIS_DESCR
/end CHARACTERISTIC
/begin CHARACTERISTIC DST_EFLASHB.DST_In_DriverDemand.DST_PEDALHOLDTIMEPEDAL "" CURVE 0x806066D0 RB_PT_PCT_SWC_DST_RecordLayouts_RL_Curve_uint16_4_uint16_4 327.67 RB_PT_PCT_SWC_DST_CompuMethods_DST_Time 0.0 327.67 FORMAT "%10.5"
 /begin ANNOTATION ANNOTATION_LABEL "Description (coming from AUTOSAR DESC field)"
  /begin ANNOTATION_TEXT "The time to set the pedal hold time based on pedal angle\r\n" /end ANNOTATION_TEXT
 /end ANNOTATION
 /begin AXIS_DESCR STD_AXIS NO_INPUT_QUANTITY RB_PT_PCT_SWC_DST_CompuMethods_ratio_0p1 4 0.0 110. FORMAT "%10.5" DEPOSIT ABSOLUTE /end AXIS_DESCR
/end CHARACTERISTIC
/begin CHARACTERISTIC DST_EFLASHB.DST_In_DriverDemand.DST_PEDALHOLDTIMEPEDALERROR "" MAP 0x806066E2 RB_PT_PCT_SWC_DST_RecordLayouts_RL_Map_uint16_68_sint16_4_sint8_17 327.67 RB_PT_PCT_SWC_DST_CompuMethods_DST_Time 0.0 327.67 FORMAT "%10.5"
 /begin ANNOTATION ANNOTATION_LABEL "Description (coming from AUTOSAR DESC field)"
  /begin ANNOTATION_TEXT "If the pedal angle reduces rapidly, this can increase the peak hold time based on rate of change of pedal and shift mode\r\n" /end ANNOTATION_TEXT
 /end ANNOTATION
 /begin AXIS_DESCR STD_AXIS NO_INPUT_QUANTITY RB_PT_PCT_SWC_DST_CompuMethods_ratio_0p1 4 -110. 110. FORMAT "%10.5" DEPOSIT ABSOLUTE /end AXIS_DESCR
 /begin AXIS_DESCR STD_AXIS NO_INPUT_QUANTITY RB_PT_PCT_SWC_DST_CompuMethods_ident 17 0.0 16. FORMAT "%10.5" DEPOSIT ABSOLUTE /end AXIS_DESCR
/end CHARACTERISTIC
/begin CHARACTERISTIC DST_EFLASHB.DST_In_DriverDemand.DST_PEDALHOLDTIMESHIFTMODE "" VAL_BLK 0x806065B8 DefaultValueRecordLayout_AUTOSAR_Platform_BaseTypes_uint16 327.67 RB_PT_PCT_SWC_DST_CompuMethods_DST_Time 0.0 327.67 FORMAT "%10.5"
 /begin ANNOTATION ANNOTATION_LABEL "Description (coming from AUTOSAR DESC field)"
  /begin ANNOTATION_TEXT "When the pedal is decreasing, this is the hold time before the output value will ramp down\r\n" /end ANNOTATION_TEXT
 /end ANNOTATION
 MATRIX_DIM 17 1 1 /end CHARACTERISTIC
/begin CHARACTERISTIC DST_EFLASHB.DST_In_DriverDemand.DST_PEDALINITALVALUELOGIC "" VAL_BLK 0x80606651 DefaultValueRecordLayout_AUTOSAR_Platform_BaseTypes_uint8 3.0 RB_PT_PCT_SWC_DST_CompuMethods_ident 0.0 3. FORMAT "%10.5"
 /begin ANNOTATION ANNOTATION_LABEL "Description (coming from AUTOSAR DESC field)"
  /begin ANNOTATION_TEXT "0 - Dont pre-load timer, 1 = Timer f(shift mode), 2 = Timer f(Pedal input), 3 = Max 1 & 2\r\n" /end ANNOTATION_TEXT
 /end ANNOTATION
 MATRIX_DIM 17 1 1 /end CHARACTERISTIC
/begin CHARACTERISTIC DST_EFLASHB.DST_In_DriverDemand.DST_PEDALRESETTIMERATZEROPEDAL "" VAL_BLK 0x80606662 DefaultValueRecordLayout_AUTOSAR_Platform_BaseTypes_boolean 255.0 AUTOSAR_Platform_CompuMethods_boolean 0.0 255. FORMAT "%10.5"
 /begin ANNOTATION ANNOTATION_LABEL "Description (coming from AUTOSAR DESC field)"
  /begin ANNOTATION_TEXT "If true a new pedal value will be written when the pedal reaches zero\r\n" /end ANNOTATION_TEXT
 /end ANNOTATION
 MATRIX_DIM 17 1 1 /end CHARACTERISTIC
/begin CHARACTERISTIC DST_EFLASHB.DST_In_DriverDemand.DST_PEDALROC2DISABLEPEAKHOLDCOUNTDOWN "" VAL_BLK 0x806065DA DefaultValueRecordLayout_AUTOSAR_Platform_BaseTypes_sint16 2000.0 RB_PT_PCT_SWC_DST_CompuMethods_ident -1000. 1000. FORMAT "%10.5"
 /begin ANNOTATION ANNOTATION_LABEL "Description (coming from AUTOSAR DESC field)"
  /begin ANNOTATION_TEXT "If the filtered rate of change of pedal is above this value, the peak hold time remain will count down\r\n" /end ANNOTATION_TEXT
 /end ANNOTATION
 MATRIX_DIM 17 1 1 /end CHARACTERISTIC
/begin CHARACTERISTIC DST_EFLASHB.DST_In_DriverDemand.DST_PEDALSLOWCHANGEGAIN "" VALUE 0x80606692 DefaultValueRecordLayout_AUTOSAR_Platform_BaseTypes_sint16 1.0 RB_PT_PCT_SWC_DST_CompuMethods_ratio_0p001 0.0 1. FORMAT "%10.5"
 /begin ANNOTATION ANNOTATION_LABEL "Description (coming from AUTOSAR DESC field)" /begin ANNOTATION_TEXT "Change to PedalChangeFiltd per program loop\r\n" /end ANNOTATION_TEXT /end ANNOTATION
/end CHARACTERISTIC
/begin CHARACTERISTIC DST_EFLASHB.DST_In_DriverDemand.DST_PEDALZEROTHROTTLEHOLDTIME "" VAL_BLK 0x806065FC DefaultValueRecordLayout_AUTOSAR_Platform_BaseTypes_uint16 327.67 RB_PT_PCT_SWC_DST_CompuMethods_DST_Time 0.0 327.67 FORMAT "%10.5"
 /begin ANNOTATION ANNOTATION_LABEL "Description (coming from AUTOSAR DESC field)"
  /begin ANNOTATION_TEXT "Time after the pedal is zero to hold the output pedal\r\n" /end ANNOTATION_TEXT
 /end ANNOTATION
 MATRIX_DIM 17 1 1 /end CHARACTERISTIC
/begin CHARACTERISTIC DST_EFLASHB.DST_In_DriverDemand.DST_ROCUPDATEHOLDTIME "" VALUE 0x80606694 DefaultValueRecordLayout_AUTOSAR_Platform_BaseTypes_sint16 2000.0 RB_PT_PCT_SWC_DST_CompuMethods_ident -1000. 1000. FORMAT "%10.5"
 /begin ANNOTATION ANNOTATION_LABEL "Description (coming from AUTOSAR DESC field)"
  /begin ANNOTATION_TEXT "Rate of change of pedal threshold below which the peak hold time will be updated\r\n" /end ANNOTATION_TEXT
 /end ANNOTATION
/end CHARACTERISTIC
/begin CHARACTERISTIC DST_EFLASHB.DST_In_DriverDemand.DST_SWKDENABLE "" VAL_BLK 0x80606673 DefaultValueRecordLayout_AUTOSAR_Platform_BaseTypes_boolean 255.0 AUTOSAR_Platform_CompuMethods_boolean 0.0 255. FORMAT "%10.5"
 /begin ANNOTATION ANNOTATION_LABEL "Description (coming from AUTOSAR DESC field)" /begin ANNOTATION_TEXT "array to enable software kickdown\r\n" /end ANNOTATION_TEXT /end ANNOTATION
 MATRIX_DIM 17 1 1 /end CHARACTERISTIC
/begin CHARACTERISTIC DST_EFLASHB.DST_In_DriverDemand.DST_THROTTLEANGLESETKD "" VALUE 0x806066A6 DefaultValueRecordLayout_AUTOSAR_Platform_BaseTypes_uint8 102.0 RB_PT_PCT_SWC_DST_CompuMethods_ratio_0p4 0.0 102. FORMAT "%10.5"
 /begin ANNOTATION ANNOTATION_LABEL "Description (coming from AUTOSAR DESC field)"
  /begin ANNOTATION_TEXT "FOr projects without a Kickdown switch, this can be used to set KD at high pedal angles.  Also for use on projects with KD detent but progressive throttle pedal\r\n" /end ANNOTATION_TEXT
 /end ANNOTATION
/end CHARACTERISTIC
/begin CHARACTERISTIC DST_EFLASHB.DST_In_DriverDemand.DST_THROTTLEHOLDFASTOFF "" VALUE 0x80606696 DefaultValueRecordLayout_AUTOSAR_Platform_BaseTypes_uint16 110.0 RB_PT_PCT_SWC_DST_CompuMethods_ratio_0p1 0.0 110. FORMAT "%10.5"
 /begin ANNOTATION ANNOTATION_LABEL "Description (coming from AUTOSAR DESC field)"
  /begin ANNOTATION_TEXT "Pedal angle above which fast off timer will be decayed (if DST_ALWAYSCOUNTDOWNFASTOFF is true, this parameter becomes irrelevant)\r\n" /end ANNOTATION_TEXT
 /end ANNOTATION
/end CHARACTERISTIC
/begin CHARACTERISTIC DST_EFLASHB.DST_In_DriverDemand.DST_THROTTLEIN2HELDERROR4FASTOFF "" VAL_BLK 0x8060661E DefaultValueRecordLayout_AUTOSAR_Platform_BaseTypes_uint16 110.0 RB_PT_PCT_SWC_DST_CompuMethods_ratio_0p1 0.0 110. FORMAT "%10.5"
 /begin ANNOTATION ANNOTATION_LABEL "Description (coming from AUTOSAR DESC field)"
  /begin ANNOTATION_TEXT "Difference between the input pedal and output pedal to trigger fast off\r\n" /end ANNOTATION_TEXT
 /end ANNOTATION
 MATRIX_DIM 17 1 1 /end CHARACTERISTIC
/begin CHARACTERISTIC DST_EFLASHB.DST_In_DriverDemand.DST_THROTTLEIN2HELDERRORCANCELFASTOFF "" VALUE 0x80606698 DefaultValueRecordLayout_AUTOSAR_Platform_BaseTypes_uint16 110.0 RB_PT_PCT_SWC_DST_CompuMethods_ratio_0p1 0.0 110. FORMAT "%10.5"
 /begin ANNOTATION ANNOTATION_LABEL "Description (coming from AUTOSAR DESC field)"
  /begin ANNOTATION_TEXT "Difference between pedal output and pedal input to cancel fast off\r\n" /end ANNOTATION_TEXT
 /end ANNOTATION
/end CHARACTERISTIC
/begin CHARACTERISTIC DST_EFLASHB.DST_In_DriverDemand.DST_THROTTLELINEAISATION2D "" MAP 0x8060682E RB_PT_PCT_SWC_DST_RecordLayouts_RL_Map_uint16_77_uint16_7_uint8_11 110.0 RB_PT_PCT_SWC_DST_CompuMethods_ratio_0p1 0.0 110. FORMAT "%10.5"
 /begin ANNOTATION ANNOTATION_LABEL "Description (coming from AUTOSAR DESC field)"
  /begin ANNOTATION_TEXT "Change pedal in vs pedal out characteristics based on shift mode\r\n" /end ANNOTATION_TEXT
 /end ANNOTATION
 /begin AXIS_DESCR STD_AXIS NO_INPUT_QUANTITY RB_PT_PCT_SWC_DST_CompuMethods_ratio_0p1 7 0.0 110. FORMAT "%10.5" DEPOSIT ABSOLUTE /end AXIS_DESCR
 /begin AXIS_DESCR STD_AXIS NO_INPUT_QUANTITY RB_PT_PCT_SWC_DST_CompuMethods_ident 11 1. 11. FORMAT "%10.5" DEPOSIT ABSOLUTE /end AXIS_DESCR
/end CHARACTERISTIC
/begin CHARACTERISTIC DST_EFLASHB.DST_In_FootBrk.DST_ABOVETHISFORBRAKEON "" VALUE 0x806068EA DefaultValueRecordLayout_AUTOSAR_Platform_BaseTypes_uint8 4.0 RB_PT_PCT_SWC_DST_CompuMethods_ident 0.0 4. FORMAT "%10.5"
 /begin ANNOTATION ANNOTATION_LABEL "Description (coming from AUTOSAR DESC field)"
  /begin ANNOTATION_TEXT "Number of foot brake pressed signals that must be exceeded to ensure the footbrake is pressed\r\n" /end ANNOTATION_TEXT
 /end ANNOTATION
/end CHARACTERISTIC
/begin CHARACTERISTIC DST_EFLASHB.DST_In_FootBrk.DST_BRAKEPRESSURE4BRAKEOFF "" VALUE 0x806068E6 DefaultValueRecordLayout_AUTOSAR_Platform_BaseTypes_uint16 409.5 RB_PT_PCT_SWC_DST_CompuMethods_ratio_0p1 0.0 409.5 FORMAT "%10.5"
 /begin ANNOTATION ANNOTATION_LABEL "Description (coming from AUTOSAR DESC field)"
  /begin ANNOTATION_TEXT "Brake pressure above which the pedal is assumed to be pressed\r\n" /end ANNOTATION_TEXT
 /end ANNOTATION
/end CHARACTERISTIC
/begin CHARACTERISTIC DST_EFLASHB.DST_In_FootBrk.DST_BRAKEPRESSURE4BRAKEON "" VALUE 0x806068E8 DefaultValueRecordLayout_AUTOSAR_Platform_BaseTypes_uint16 409.5 RB_PT_PCT_SWC_DST_CompuMethods_ratio_0p1 0.0 409.5 FORMAT "%10.5"
 /begin ANNOTATION ANNOTATION_LABEL "Description (coming from AUTOSAR DESC field)"
  /begin ANNOTATION_TEXT "Brake pressure above which the pedal is assumed to be pressed\r\n" /end ANNOTATION_TEXT
 /end ANNOTATION
/end CHARACTERISTIC
/begin CHARACTERISTIC DST_EFLASHB.DST_In_FootBrk.DST_MAXDECELNOBRAKES "" CURVE 0x806068EC RB_PT_PCT_SWC_DST_RecordLayouts_RL_Curve_sint16_5_uint16_5 4.0 RB_PT_PCT_SWC_DST_CompuMethods_ratio_0p01 -2. 2. FORMAT "%10.5"
 /begin ANNOTATION ANNOTATION_LABEL "Description (coming from AUTOSAR DESC field)"
  /begin ANNOTATION_TEXT "Maximum vehicle deceleration expected without using the brakes, to make brake yes/no more sensitive when travelling at speed\r\n" /end ANNOTATION_TEXT
 /end ANNOTATION
 /begin AXIS_DESCR STD_AXIS NO_INPUT_QUANTITY RB_PT_PCT_SWC_DST_CompuMethods_kph_0p1 5 0.0 500. FORMAT "%10.5" DEPOSIT ABSOLUTE /end AXIS_DESCR
/end CHARACTERISTIC
/begin CHARACTERISTIC DST_EFLASHB.DST_In_OpShftGrad.DST_BOBLONGACCIMPLAUS "" VALUE 0x80606902 DefaultValueRecordLayout_AUTOSAR_Platform_BaseTypes_uint16 65535.0 RB_PT_PCT_SWC_DST_CompuMethods_ident 0.0 65535. FORMAT "%10.5"
 /begin ANNOTATION ANNOTATION_LABEL "Description (coming from AUTOSAR DESC field)" /begin ANNOTATION_TEXT "Forces DST long acc to be implausible\r\n" /end ANNOTATION_TEXT /end ANNOTATION
/end CHARACTERISTIC
/begin CHARACTERISTIC DST_EFLASHB.DST_In_OpShftGrad.DST_CONVG2PCNTGRAD "" CURVE 0x8060693C RB_PT_PCT_SWC_DST_RecordLayouts_RL_Curve_sint16_5_sint16_5 65.4 RB_PT_PCT_SWC_DST_CompuMethods_ratio_0p001 -32.7 32.7 FORMAT "%10.5"
 /begin ANNOTATION ANNOTATION_LABEL "Description (coming from AUTOSAR DESC field)"
  /begin ANNOTATION_TEXT "Conversion from gradient expressed as g to Percentage\r\n" /end ANNOTATION_TEXT
 /end ANNOTATION
 /begin AXIS_DESCR STD_AXIS NO_INPUT_QUANTITY RB_PT_PCT_SWC_DST_CompuMethods_ratio_0p0001 5 -2. 2. FORMAT "%10.5" DEPOSIT ABSOLUTE /end AXIS_DESCR
/end CHARACTERISTIC
/begin CHARACTERISTIC DST_EFLASHB.DST_In_OpShftGrad.DST_ENABLEREVERSINGFLAG "" VALUE 0x80606930 DefaultValueRecordLayout_AUTOSAR_Platform_BaseTypes_boolean 255.0 AUTOSAR_Platform_CompuMethods_boolean 0.0 255. FORMAT "%10.5"
 /begin ANNOTATION ANNOTATION_LABEL "Description (coming from AUTOSAR DESC field)" /begin ANNOTATION_TEXT "If true, the reversing flag can be set\r\n" /end ANNOTATION_TEXT /end ANNOTATION
/end CHARACTERISTIC
/begin CHARACTERISTIC DST_EFLASHB.DST_In_OpShftGrad.DST_FILTGAINdOp "" VALUE 0x80606931 DefaultValueRecordLayout_AUTOSAR_Platform_BaseTypes_uint8 1.0 RB_PT_PCT_SWC_DST_CompuMethods_ratio_0p01 0.0 1. FORMAT "%10.5"
 /begin ANNOTATION ANNOTATION_LABEL "Description (coming from AUTOSAR DESC field)" /begin ANNOTATION_TEXT "Filter gain to calculated dOutputSpeed\r\n" /end ANNOTATION_TEXT /end ANNOTATION
/end CHARACTERISTIC
/begin CHARACTERISTIC DST_EFLASHB.DST_In_OpShftGrad.DST_GRADOFFSETWHEELACCEL "" CURVE 0x80606952 RB_PT_PCT_SWC_DST_RecordLayouts_RL_Curve_sint16_5_sint16_5 65.4 RB_PT_PCT_SWC_DST_CompuMethods_ratio_0p001 -32.7 32.7 FORMAT "%10.5"
 /begin ANNOTATION ANNOTATION_LABEL "Description (coming from AUTOSAR DESC field)"
  /begin ANNOTATION_TEXT "Gradient offset based on wheel acceleration - takes account of pitch of car\r\n" /end ANNOTATION_TEXT
 /end ANNOTATION
 /begin AXIS_DESCR STD_AXIS NO_INPUT_QUANTITY RB_PT_PCT_SWC_DST_CompuMethods_ratio_0p0001 5 -2. 2. FORMAT "%10.5" DEPOSIT ABSOLUTE /end AXIS_DESCR
/end CHARACTERISTIC
/begin CHARACTERISTIC DST_EFLASHB.DST_In_OpShftGrad.DST_GRADOPRPMREVWHEELACC "" VALUE 0x80606904 DefaultValueRecordLayout_AUTOSAR_Platform_BaseTypes_sint16 40000.0 RB_PT_PCT_SWC_DST_CompuMethods_ident -20000. 20000. FORMAT "%10.5"
 /begin ANNOTATION ANNOTATION_LABEL "Description (coming from AUTOSAR DESC field)"
  /begin ANNOTATION_TEXT "output shaft speed to reverse the wheel acceleration signal\r\n" /end ANNOTATION_TEXT
 /end ANNOTATION
/end CHARACTERISTIC
/begin CHARACTERISTIC DST_EFLASHB.DST_In_OpShftGrad.DST_GRADREFSPD2ENABLE "" VALUE 0x80606906 DefaultValueRecordLayout_AUTOSAR_Platform_BaseTypes_uint16 500.0 RB_PT_PCT_SWC_DST_CompuMethods_kph_0p1 0.0 500. FORMAT "%10.5"
 /begin ANNOTATION ANNOTATION_LABEL "Description (coming from AUTOSAR DESC field)"
  /begin ANNOTATION_TEXT "Reference speed must equal or exceed this value before gradient caliculation is enabled\r\n" /end ANNOTATION_TEXT
 /end ANNOTATION
/end CHARACTERISTIC
/begin CHARACTERISTIC DST_EFLASHB.DST_In_OpShftGrad.DST_GRADUPDATELATACCTHRESH "" VALUE 0x80606932 DefaultValueRecordLayout_AUTOSAR_Platform_BaseTypes_uint8 1.27 RB_PT_PCT_SWC_DST_CompuMethods_ratio_0p01 0.0 1.27 FORMAT "%10.5"
 /begin ANNOTATION ANNOTATION_LABEL "Description (coming from AUTOSAR DESC field)"
  /begin ANNOTATION_TEXT "Lateral acceleration threshold below which the gradient will be updated\r\n" /end ANNOTATION_TEXT
 /end ANNOTATION
/end CHARACTERISTIC
/begin CHARACTERISTIC DST_EFLASHB.DST_In_OpShftGrad.DST_GSENSORAVERAGECOUNT "" VALUE 0x80606933 DefaultValueRecordLayout_AUTOSAR_Platform_BaseTypes_uint8 48.0 RB_PT_PCT_SWC_DST_CompuMethods_ident 2. 50. FORMAT "%10.5"
 /begin ANNOTATION ANNOTATION_LABEL "Description (coming from AUTOSAR DESC field)" /begin ANNOTATION_TEXT "Number of samples to average the wheel acceleration\r\n" /end ANNOTATION_TEXT /end ANNOTATION
/end CHARACTERISTIC
/begin CHARACTERISTIC DST_EFLASHB.DST_In_OpShftGrad.DST_GSENSORFILTGAINFAST "" VALUE 0x80606908 DefaultValueRecordLayout_AUTOSAR_Platform_BaseTypes_uint16 1.0 RB_PT_PCT_SWC_DST_CompuMethods_ratio_0p001 0.0 1. FORMAT "%10.5"
 /begin ANNOTATION ANNOTATION_LABEL "Description (coming from AUTOSAR DESC field)" /begin ANNOTATION_TEXT "Filter gain for long acc sensor\r\n" /end ANNOTATION_TEXT /end ANNOTATION
/end CHARACTERISTIC
/begin CHARACTERISTIC DST_EFLASHB.DST_In_OpShftGrad.DST_GSENSORFILTGAINSLOW "" VALUE 0x8060690A DefaultValueRecordLayout_AUTOSAR_Platform_BaseTypes_uint16 1.0 RB_PT_PCT_SWC_DST_CompuMethods_ratio_0p001 0.0 1. FORMAT "%10.5"
 /begin ANNOTATION ANNOTATION_LABEL "Description (coming from AUTOSAR DESC field)" /begin ANNOTATION_TEXT "Filter gain for long acc sensor\r\n" /end ANNOTATION_TEXT /end ANNOTATION
/end CHARACTERISTIC
/begin CHARACTERISTIC DST_EFLASHB.DST_In_OpShftGrad.DST_GSENSORHIGH2ENABLEGRAD "" VALUE 0x8060690C DefaultValueRecordLayout_AUTOSAR_Platform_BaseTypes_sint16 4.0 RB_PT_PCT_SWC_DST_CompuMethods_ratio_0p0001 -2. 2. FORMAT "%10.5"
 /begin ANNOTATION ANNOTATION_LABEL "Description (coming from AUTOSAR DESC field)"
  /begin ANNOTATION_TEXT "Sensor negative reading to enable gradient calculation\r\n" /end ANNOTATION_TEXT
 /end ANNOTATION
/end CHARACTERISTIC
/begin CHARACTERISTIC DST_EFLASHB.DST_In_OpShftGrad.DST_GSENSORLOW2ENABLEGRAD "" VALUE 0x8060690E DefaultValueRecordLayout_AUTOSAR_Platform_BaseTypes_sint16 4.0 RB_PT_PCT_SWC_DST_CompuMethods_ratio_0p0001 -2. 2. FORMAT "%10.5"
 /begin ANNOTATION ANNOTATION_LABEL "Description (coming from AUTOSAR DESC field)"
  /begin ANNOTATION_TEXT "Sensor negative reading to enable gradient calculation\r\n" /end ANNOTATION_TEXT
 /end ANNOTATION
/end CHARACTERISTIC
/begin CHARACTERISTIC DST_EFLASHB.DST_In_OpShftGrad.DST_GSENSORREFRAMP "" VALUE 0x80606910 DefaultValueRecordLayout_AUTOSAR_Platform_BaseTypes_sint16 0.2 RB_PT_PCT_SWC_DST_CompuMethods_ratio_0p0001 0.0 0.2 FORMAT "%10.5"
 /begin ANNOTATION ANNOTATION_LABEL "Description (coming from AUTOSAR DESC field)" /begin ANNOTATION_TEXT "Rate of ramp of g sensor ramp\r\n" /end ANNOTATION_TEXT /end ANNOTATION
/end CHARACTERISTIC
/begin CHARACTERISTIC DST_EFLASHB.DST_In_OpShftGrad.DST_GSENSORWHEELNOISEINTGAIN "" VALUE 0x80606934 DefaultValueRecordLayout_AUTOSAR_Platform_BaseTypes_uint8 25.5 RB_PT_PCT_SWC_DST_CompuMethods_ratio_0p1 0.0 25.5 FORMAT "%10.5"
 /begin ANNOTATION ANNOTATION_LABEL "Description (coming from AUTOSAR DESC field)"
  /begin ANNOTATION_TEXT "Multiply noise prior to integration to highlight noise\r\n" /end ANNOTATION_TEXT
 /end ANNOTATION
/end CHARACTERISTIC
/begin CHARACTERISTIC DST_EFLASHB.DST_In_OpShftGrad.DST_GWHEELNOISEINTGAIN "" VALUE 0x80606935 DefaultValueRecordLayout_AUTOSAR_Platform_BaseTypes_uint8 25.5 RB_PT_PCT_SWC_DST_CompuMethods_ratio_0p1 0.0 25.5 FORMAT "%10.5"
 /begin ANNOTATION ANNOTATION_LABEL "Description (coming from AUTOSAR DESC field)"
  /begin ANNOTATION_TEXT "Multiply noise prior to integration to highlight noise\r\n" /end ANNOTATION_TEXT
 /end ANNOTATION
/end CHARACTERISTIC
/begin CHARACTERISTIC DST_EFLASHB.DST_In_OpShftGrad.DST_GWHEELSAVERAGECOUNT "" VALUE 0x80606936 DefaultValueRecordLayout_AUTOSAR_Platform_BaseTypes_uint8 48.0 RB_PT_PCT_SWC_DST_CompuMethods_ident 2. 50. FORMAT "%10.5"
 /begin ANNOTATION ANNOTATION_LABEL "Description (coming from AUTOSAR DESC field)" /begin ANNOTATION_TEXT "Number of samples to average the wheel acceleration\r\n" /end ANNOTATION_TEXT /end ANNOTATION
/end CHARACTERISTIC
/begin CHARACTERISTIC DST_EFLASHB.DST_In_OpShftGrad.DST_GWHEELSFILTGAINFAST "" VALUE 0x80606912 DefaultValueRecordLayout_AUTOSAR_Platform_BaseTypes_uint16 1.0 RB_PT_PCT_SWC_DST_CompuMethods_ratio_0p001 0.0 1. FORMAT "%10.5"
 /begin ANNOTATION ANNOTATION_LABEL "Description (coming from AUTOSAR DESC field)" /begin ANNOTATION_TEXT "Filter gain to calculated dOutputSpeed\r\n" /end ANNOTATION_TEXT /end ANNOTATION
/end CHARACTERISTIC
/begin CHARACTERISTIC DST_EFLASHB.DST_In_OpShftGrad.DST_GWHEELSFILTGAINSLOW "" VALUE 0x80606914 DefaultValueRecordLayout_AUTOSAR_Platform_BaseTypes_uint16 1.0 RB_PT_PCT_SWC_DST_CompuMethods_ratio_0p001 0.0 1. FORMAT "%10.5"
 /begin ANNOTATION ANNOTATION_LABEL "Description (coming from AUTOSAR DESC field)" /begin ANNOTATION_TEXT "Filter gain to calculated dOutputSpeed\r\n" /end ANNOTATION_TEXT /end ANNOTATION
/end CHARACTERISTIC
/begin CHARACTERISTIC DST_EFLASHB.DST_In_OpShftGrad.DST_GWHEELSREFRAMP "" VALUE 0x80606916 DefaultValueRecordLayout_AUTOSAR_Platform_BaseTypes_sint16 0.2 RB_PT_PCT_SWC_DST_CompuMethods_ratio_0p0001 0.0 0.2 FORMAT "%10.5"
 /begin ANNOTATION ANNOTATION_LABEL "Description (coming from AUTOSAR DESC field)"
  /begin ANNOTATION_TEXT "Rate of change of linear reference g wheels acceleration signal\r\n" /end ANNOTATION_TEXT
 /end ANNOTATION
/end CHARACTERISTIC
/begin CHARACTERISTIC DST_EFLASHB.DST_In_OpShftGrad.DST_HIGHLATACC "" VALUE 0x80606937 DefaultValueRecordLayout_AUTOSAR_Platform_BaseTypes_sint8 2.54 RB_PT_PCT_SWC_DST_CompuMethods_ratio_0p01 -1.27 1.27 FORMAT "%10.5"
 /begin ANNOTATION ANNOTATION_LABEL "Description (coming from AUTOSAR DESC field)"
  /begin ANNOTATION_TEXT "Continuous Lateral acceleration level that will result in the output value being set to zero\r\n" /end ANNOTATION_TEXT
 /end ANNOTATION
/end CHARACTERISTIC
/begin CHARACTERISTIC DST_EFLASHB.DST_In_OpShftGrad.DST_LATACCFILTER "" VALUE 0x80606938 DefaultValueRecordLayout_AUTOSAR_Platform_BaseTypes_uint8 1.0 RB_PT_PCT_SWC_DST_CompuMethods_ratio_0p01 0.0 1. FORMAT "%10.5"
 /begin ANNOTATION ANNOTATION_LABEL "Description (coming from AUTOSAR DESC field)" /begin ANNOTATION_TEXT "First order filter constant\r\n" /end ANNOTATION_TEXT /end ANNOTATION
/end CHARACTERISTIC
/begin CHARACTERISTIC DST_EFLASHB.DST_In_OpShftGrad.DST_LATACCKMHPLAUSEN "" VALUE 0x80606918 DefaultValueRecordLayout_AUTOSAR_Platform_BaseTypes_uint16 500.0 RB_PT_PCT_SWC_DST_CompuMethods_kph_0p1 0.0 500. FORMAT "%10.5"
 /begin ANNOTATION ANNOTATION_LABEL "Description (coming from AUTOSAR DESC field)"
  /begin ANNOTATION_TEXT "Vehicle speed above which Lateral acceleration plausibility tests are performed\r\n" /end ANNOTATION_TEXT
 /end ANNOTATION
/end CHARACTERISTIC
/begin CHARACTERISTIC DST_EFLASHB.DST_In_OpShftGrad.DST_LATACCPEAKDECAY "" VALUE 0x8060691A DefaultValueRecordLayout_AUTOSAR_Platform_BaseTypes_uint16 0.01 RB_PT_PCT_SWC_DST_CompuMethods_ratio_0p0001 0.0 0.01 FORMAT "%10.5"
 /begin ANNOTATION ANNOTATION_LABEL "Description (coming from AUTOSAR DESC field)" /begin ANNOTATION_TEXT "Decay of Peak held lateral acceleration\r\n" /end ANNOTATION_TEXT /end ANNOTATION
/end CHARACTERISTIC
/begin CHARACTERISTIC DST_EFLASHB.DST_In_OpShftGrad.DST_LATACCPEAKHOLDTIME "" VALUE 0x8060691C DefaultValueRecordLayout_AUTOSAR_Platform_BaseTypes_uint16 655.35 RB_PT_PCT_SWC_DST_CompuMethods_DST_Time 0.0 655.35 FORMAT "%10.5"
 /begin ANNOTATION ANNOTATION_LABEL "Description (coming from AUTOSAR DESC field)"
  /begin ANNOTATION_TEXT "Time to hold the peak held lateral acceleration timer high\r\n" /end ANNOTATION_TEXT
 /end ANNOTATION
/end CHARACTERISTIC
/begin CHARACTERISTIC DST_EFLASHB.DST_In_OpShftGrad.DST_LONGACCPLAUSGRADUPDATE "" VALUE 0x8060691E DefaultValueRecordLayout_AUTOSAR_Platform_BaseTypes_uint16 100.0 RB_PT_PCT_SWC_DST_CompuMethods_DST_Time 0.0 100. FORMAT "%10.5"
 /begin ANNOTATION ANNOTATION_LABEL "Description (coming from AUTOSAR DESC field)" /begin ANNOTATION_TEXT "Time above which Long Acc sensor is deemed to be OK\r\n" /end ANNOTATION_TEXT /end ANNOTATION
/end CHARACTERISTIC
/begin CHARACTERISTIC DST_EFLASHB.DST_In_OpShftGrad.DST_PLAUSTIME_RANGE "" VALUE 0x80606920 DefaultValueRecordLayout_AUTOSAR_Platform_BaseTypes_uint16 655.35 RB_PT_PCT_SWC_DST_CompuMethods_DST_Time 0.0 655.35 FORMAT "%10.5"
 /begin ANNOTATION ANNOTATION_LABEL "Description (coming from AUTOSAR DESC field)" /begin ANNOTATION_TEXT "Time above which Long Acc sensor is deemed to be OK\r\n" /end ANNOTATION_TEXT /end ANNOTATION
/end CHARACTERISTIC
/begin CHARACTERISTIC DST_EFLASHB.DST_In_OpShftGrad.DST_PLAUSTIME_STUCK "" VALUE 0x80606922 DefaultValueRecordLayout_AUTOSAR_Platform_BaseTypes_uint16 655.35 RB_PT_PCT_SWC_DST_CompuMethods_DST_Time 0.0 655.35 FORMAT "%10.5"
 /begin ANNOTATION ANNOTATION_LABEL "Description (coming from AUTOSAR DESC field)" /begin ANNOTATION_TEXT "Time above which Long Acc sensor is deemed to be OK\r\n" /end ANNOTATION_TEXT /end ANNOTATION
/end CHARACTERISTIC
/begin CHARACTERISTIC DST_EFLASHB.DST_In_OpShftGrad.DST_SET_GRADOUTPUT2ZERO "" VALUE 0x80606939 DefaultValueRecordLayout_AUTOSAR_Platform_BaseTypes_boolean 255.0 AUTOSAR_Platform_CompuMethods_boolean 0.0 255. FORMAT "%10.5"
 /begin ANNOTATION ANNOTATION_LABEL "Description (coming from AUTOSAR DESC field)" /begin ANNOTATION_TEXT "If true, the gradient output will be set to 0\r\n" /end ANNOTATION_TEXT /end ANNOTATION
/end CHARACTERISTIC
/begin CHARACTERISTIC DST_EFLASHB.DST_In_OpShftGrad.DST_SETREVERSINGFALSE "" VALUE 0x80606924 DefaultValueRecordLayout_AUTOSAR_Platform_BaseTypes_sint16 40000.0 RB_PT_PCT_SWC_DST_CompuMethods_ident -20000. 20000. FORMAT "%10.5"
 /begin ANNOTATION ANNOTATION_LABEL "Description (coming from AUTOSAR DESC field)"
  /begin ANNOTATION_TEXT "Output shaft speed above which reversing is set to false\r\n" /end ANNOTATION_TEXT
 /end ANNOTATION
/end CHARACTERISTIC
/begin CHARACTERISTIC DST_EFLASHB.DST_In_OpShftGrad.DST_SETREVERSINGFALSE_R "" VALUE 0x80606926 DefaultValueRecordLayout_AUTOSAR_Platform_BaseTypes_sint16 40000.0 RB_PT_PCT_SWC_DST_CompuMethods_ident -20000. 20000. FORMAT "%10.5"
 /begin ANNOTATION ANNOTATION_LABEL "Description (coming from AUTOSAR DESC field)"
  /begin ANNOTATION_TEXT "Output shaft speed above which reversing is set to false when in Reverse\r\n" /end ANNOTATION_TEXT
 /end ANNOTATION
/end CHARACTERISTIC
/begin CHARACTERISTIC DST_EFLASHB.DST_In_OpShftGrad.DST_SETREVERSINGTRUE "" VALUE 0x80606928 DefaultValueRecordLayout_AUTOSAR_Platform_BaseTypes_sint16 40000.0 RB_PT_PCT_SWC_DST_CompuMethods_ident -20000. 20000. FORMAT "%10.5"
 /begin ANNOTATION ANNOTATION_LABEL "Description (coming from AUTOSAR DESC field)"
  /begin ANNOTATION_TEXT "Output shaft speed below which reversing is set to true\r\n" /end ANNOTATION_TEXT
 /end ANNOTATION
/end CHARACTERISTIC
/begin CHARACTERISTIC DST_EFLASHB.DST_In_OpShftGrad.DST_SETREVERSINGTRUE_R "" VALUE 0x8060692A DefaultValueRecordLayout_AUTOSAR_Platform_BaseTypes_sint16 40000.0 RB_PT_PCT_SWC_DST_CompuMethods_ident -20000. 20000. FORMAT "%10.5"
 /begin ANNOTATION ANNOTATION_LABEL "Description (coming from AUTOSAR DESC field)"
  /begin ANNOTATION_TEXT "Output shaft speed below which reversing is set to true when in Reverse\r\n" /end ANNOTATION_TEXT
 /end ANNOTATION
/end CHARACTERISTIC
/begin CHARACTERISTIC DST_EFLASHB.DST_In_OpShftGrad.DST_TIME2FAILLATACC "" VALUE 0x8060692C DefaultValueRecordLayout_AUTOSAR_Platform_BaseTypes_uint16 655.35 RB_PT_PCT_SWC_DST_CompuMethods_DST_Time 0.0 655.35 FORMAT "%10.5"
 /begin ANNOTATION ANNOTATION_LABEL "Description (coming from AUTOSAR DESC field)"
  /begin ANNOTATION_TEXT "When lat acc above threshold, after this time the lateral acceleration will be set to zero\r\n" /end ANNOTATION_TEXT
 /end ANNOTATION
/end CHARACTERISTIC
/begin CHARACTERISTIC DST_EFLASHB.DST_In_OpShftGrad.DST_TIME2SETLATACCFAILSTATIC "" VALUE 0x8060692E DefaultValueRecordLayout_AUTOSAR_Platform_BaseTypes_uint16 655.35 RB_PT_PCT_SWC_DST_CompuMethods_DST_Time 0.0 655.35 FORMAT "%10.5"
 /begin ANNOTATION ANNOTATION_LABEL "Description (coming from AUTOSAR DESC field)"
  /begin ANNOTATION_TEXT "When timer is below this value, the lateral acceleration will be set OK\r\n" /end ANNOTATION_TEXT
 /end ANNOTATION
/end CHARACTERISTIC
/begin CHARACTERISTIC DST_EFLASHB.DST_In_OpShftGrad.DST_USEDWCOUTPUTSPEED "" VALUE 0x8060693A DefaultValueRecordLayout_AUTOSAR_Platform_BaseTypes_boolean 255.0 AUTOSAR_Platform_CompuMethods_boolean 0.0 255. FORMAT "%10.5"
 /begin ANNOTATION ANNOTATION_LABEL "Description (coming from AUTOSAR DESC field)"
  /begin ANNOTATION_TEXT "If true, DWC output speed will be used to generate DST_dOutputSpeed, rather than IOP_OutputSpeed\r\n" /end ANNOTATION_TEXT
 /end ANNOTATION
/end CHARACTERISTIC
/begin CHARACTERISTIC DST_EFLASHB.DST_Ini.DST_1ABOVEMAX2INHIBITUPSHIFTS "" VALUE 0x8060697E DefaultValueRecordLayout_AUTOSAR_Platform_BaseTypes_uint16 20000.0 RB_PT_PCT_SWC_DST_CompuMethods_ident 0.0 20000. FORMAT "%10.5"
 /begin ANNOTATION ANNOTATION_LABEL "Description (coming from AUTOSAR DESC field)"
  /begin ANNOTATION_TEXT "If this is set to 0 (default), the vehicles will upshift at the redline).  If greater then will hit rev limit\r\n" /end ANNOTATION_TEXT
 /end ANNOTATION
/end CHARACTERISTIC
/begin CHARACTERISTIC DST_EFLASHB.DST_Ini.DST_1MINRPMKDTARGET "" VAL_BLK 0x80606968 DefaultValueRecordLayout_AUTOSAR_Platform_BaseTypes_uint16 20000.0 RB_PT_PCT_SWC_DST_CompuMethods_ident 0.0 20000. FORMAT "%10.5"
 /begin ANNOTATION ANNOTATION_LABEL "Description (coming from AUTOSAR DESC field)"
  /begin ANNOTATION_TEXT "Maximum engine speed that can be acheived in the relevant gear after a kickdown is requested.\r\n" /end ANNOTATION_TEXT
 /end ANNOTATION
 MATRIX_DIM 11 1 1 /end CHARACTERISTIC
/begin CHARACTERISTIC DST_EFLASHB.DST_Ini.DST_1RPMLIMITTRANSMISSION "" CURVE 0x80606986 RB_PT_PCT_SWC_DST_RecordLayouts_RL_Curve_uint16_7_sint16_7 20000.0 RB_PT_PCT_SWC_DST_CompuMethods_ident 0.0 20000. FORMAT "%10.5"
 /begin ANNOTATION ANNOTATION_LABEL "Description (coming from AUTOSAR DESC field)" /begin ANNOTATION_TEXT "Engine rev limit based on transmission temperature\r\n" /end ANNOTATION_TEXT /end ANNOTATION
 /begin AXIS_DESCR STD_AXIS NO_INPUT_QUANTITY RB_PT_PCT_SWC_DST_CompuMethods_ident 7 -50. 200. FORMAT "%10.5" DEPOSIT ABSOLUTE /end AXIS_DESCR
/end CHARACTERISTIC
/begin CHARACTERISTIC DST_EFLASHB.DST_Ini.DST_1UPSHIFTBELOWLIMIT "" CURVE 0x806069A4 RB_PT_PCT_SWC_DST_RecordLayouts_RL_Curve_sint16_7_uint16_7 20000.0 RB_PT_PCT_SWC_DST_CompuMethods_ident 0.0 20000. FORMAT "%10.5"
 /begin ANNOTATION ANNOTATION_LABEL "Description (coming from AUTOSAR DESC field)"
  /begin ANNOTATION_TEXT "Based on the maximum requested engine speed, this table gives the ability to vary the max rpm requested\r\n" /end ANNOTATION_TEXT
 /end ANNOTATION
 /begin AXIS_DESCR STD_AXIS NO_INPUT_QUANTITY RB_PT_PCT_SWC_DST_CompuMethods_ident 7 0.0 20000. FORMAT "%10.5" DEPOSIT ABSOLUTE /end AXIS_DESCR
/end CHARACTERISTIC
/begin CHARACTERISTIC DST_EFLASHB.DST_Ini.DST_OP2KMHADAPTSTEP "" VALUE 0x80606980 DefaultValueRecordLayout_AUTOSAR_Platform_BaseTypes_uint16 0.2 RB_PT_PCT_SWC_DST_CompuMethods_ratio_0p0001 0.0 0.2 FORMAT "%10.5"
 /begin ANNOTATION ANNOTATION_LABEL "Description (coming from AUTOSAR DESC field)" /begin ANNOTATION_TEXT "Step size each time DST_Op2Kmh changes\r\n" /end ANNOTATION_TEXT /end ANNOTATION
/end CHARACTERISTIC
/begin CHARACTERISTIC DST_EFLASHB.DST_Ini.DST_OP2KMHFILTGAIN "" VALUE 0x80606984 DefaultValueRecordLayout_AUTOSAR_Platform_BaseTypes_uint8 1.0 RB_PT_PCT_SWC_DST_CompuMethods_ratio_0p005 0.0 1. FORMAT "%10.5"
 /begin ANNOTATION ANNOTATION_LABEL "Description (coming from AUTOSAR DESC field)" /begin ANNOTATION_TEXT "Gain for filtering the calculated Op to Kmh value\r\n" /end ANNOTATION_TEXT /end ANNOTATION
/end CHARACTERISTIC
/begin CHARACTERISTIC DST_EFLASHB.DST_Ini.DST_OP2KMHTIMEBETWEENADAPTS "" VALUE 0x80606982 DefaultValueRecordLayout_AUTOSAR_Platform_BaseTypes_uint16 655.35 RB_PT_PCT_SWC_DST_CompuMethods_DST_Time 0.0 655.35 FORMAT "%10.5"
 /begin ANNOTATION ANNOTATION_LABEL "Description (coming from AUTOSAR DESC field)" /begin ANNOTATION_TEXT "Time between each adaption of Op2Kmh\r\n" /end ANNOTATION_TEXT /end ANNOTATION
/end CHARACTERISTIC
/begin CHARACTERISTIC DST_EFLASHB.DST_ModeSelectGeneric.DST_BOBShiftLockLamp "" VALUE 0x80606D30 DefaultValueRecordLayout_AUTOSAR_Platform_BaseTypes_boolean 255.0 AUTOSAR_Platform_CompuMethods_boolean 0.0 255. FORMAT "%10.5"
 /begin ANNOTATION ANNOTATION_LABEL "Description (coming from AUTOSAR DESC field)" /begin ANNOTATION_TEXT "State of the shift lock lamp output when in BOB mode\r\n" /end ANNOTATION_TEXT /end ANNOTATION
/end CHARACTERISTIC
/begin CHARACTERISTIC DST_EFLASHB.DST_ModeSelectGeneric.DST_BOBShiftLockLampEn "" VALUE 0x80606CC4 DefaultValueRecordLayout_AUTOSAR_Platform_BaseTypes_uint32 99999.0 RB_PT_PCT_SWC_DST_CompuMethods_ident 0.0 99999. FORMAT "%10.5"
 /begin ANNOTATION ANNOTATION_LABEL "Description (coming from AUTOSAR DESC field)" /begin ANNOTATION_TEXT "90210 to allow manual control of shift lock solenoid\r\n" /end ANNOTATION_TEXT /end ANNOTATION
/end CHARACTERISTIC
/begin CHARACTERISTIC DST_EFLASHB.DST_ModeSelectGeneric.DST_COOLANTOVERHEATRESET "" VALUE 0x80606CC8 DefaultValueRecordLayout_AUTOSAR_Platform_BaseTypes_sint16 255.0 RB_PT_PCT_SWC_DST_CompuMethods_ident -60. 195. FORMAT "%10.5"
 /begin ANNOTATION ANNOTATION_LABEL "Description (coming from AUTOSAR DESC field)"
  /begin ANNOTATION_TEXT "Engine coolant temperature threshold below which the engine no longer requires an overheat map to be used\r\n" /end ANNOTATION_TEXT
 /end ANNOTATION
/end CHARACTERISTIC
/begin CHARACTERISTIC DST_EFLASHB.DST_ModeSelectGeneric.DST_COOLANTOVERHEATSET "" VALUE 0x80606CCA DefaultValueRecordLayout_AUTOSAR_Platform_BaseTypes_sint16 255.0 RB_PT_PCT_SWC_DST_CompuMethods_ident -60. 195. FORMAT "%10.5"
 /begin ANNOTATION ANNOTATION_LABEL "Description (coming from AUTOSAR DESC field)"
  /begin ANNOTATION_TEXT "Engine coolant temperature above which an overheat shift map is required\r\n" /end ANNOTATION_TEXT
 /end ANNOTATION
/end CHARACTERISTIC
/begin CHARACTERISTIC DST_EFLASHB.DST_ModeSelectGeneric.DST_DIRECTFWD2REVWOBRAKE "" VALUE 0x80606D31 DefaultValueRecordLayout_AUTOSAR_Platform_BaseTypes_boolean 255.0 AUTOSAR_Platform_CompuMethods_boolean 0.0 255. FORMAT "%10.5"
 /begin ANNOTATION ANNOTATION_LABEL "Description (coming from AUTOSAR DESC field)"
  /begin ANNOTATION_TEXT "If false, the brake must be applied to transition directly from D to R and R to D\r\n" /end ANNOTATION_TEXT
 /end ANNOTATION
/end CHARACTERISTIC
/begin CHARACTERISTIC DST_EFLASHB.DST_ModeSelectGeneric.DST_DIRECTREV2FWDWOBRAKE "" VALUE 0x80606D32 DefaultValueRecordLayout_AUTOSAR_Platform_BaseTypes_boolean 255.0 AUTOSAR_Platform_CompuMethods_boolean 0.0 255. FORMAT "%10.5"
 /begin ANNOTATION ANNOTATION_LABEL "Description (coming from AUTOSAR DESC field)"
  /begin ANNOTATION_TEXT "If false, the brake must be applied to transition directly from D to R and R to D\r\n" /end ANNOTATION_TEXT
 /end ANNOTATION
/end CHARACTERISTIC
/begin CHARACTERISTIC DST_EFLASHB.DST_ModeSelectGeneric.DST_DOOROPEN2NEUTRALSPEED "" VALUE 0x80606CCC DefaultValueRecordLayout_AUTOSAR_Platform_BaseTypes_uint16 500.0 RB_PT_PCT_SWC_DST_CompuMethods_kph_0p1 0.0 500. FORMAT "%10.5"
 /begin ANNOTATION ANNOTATION_LABEL "Description (coming from AUTOSAR DESC field)"
  /begin ANNOTATION_TEXT "vehicle speed below which neutral can be selected when the door is open\r\n" /end ANNOTATION_TEXT
 /end ANNOTATION
/end CHARACTERISTIC
/begin CHARACTERISTIC DST_EFLASHB.DST_ModeSelectGeneric.DST_DOOROPEN2NEUTRALTHROTTLE "" VALUE 0x80606D33 DefaultValueRecordLayout_AUTOSAR_Platform_BaseTypes_uint8 102.0 RB_PT_PCT_SWC_DST_CompuMethods_ratio_0p4 0.0 102. FORMAT "%10.5"
 /begin ANNOTATION ANNOTATION_LABEL "Description (coming from AUTOSAR DESC field)"
  /begin ANNOTATION_TEXT "Throttle angle below which driver not in car will count down\r\n" /end ANNOTATION_TEXT
 /end ANNOTATION
/end CHARACTERISTIC
/begin CHARACTERISTIC DST_EFLASHB.DST_ModeSelectGeneric.DST_DOOROPEN2NEUTRALTIME "" VALUE 0x80606CCE DefaultValueRecordLayout_AUTOSAR_Platform_BaseTypes_uint16 655.35 RB_PT_PCT_SWC_DST_CompuMethods_DST_Time 0.0 655.35 FORMAT "%10.5"
 /begin ANNOTATION ANNOTATION_LABEL "Description (coming from AUTOSAR DESC field)"
  /begin ANNOTATION_TEXT "Time the door must be open, no brake, no throttle, in gear at low speed before neutral is selected\r\n" /end ANNOTATION_TEXT
 /end ANNOTATION
/end CHARACTERISTIC
/begin CHARACTERISTIC DST_EFLASHB.DST_ModeSelectGeneric.DST_DOOROPENALLOWPADDLEENGAGE "" VALUE 0x80606D34 DefaultValueRecordLayout_AUTOSAR_Platform_BaseTypes_boolean 255.0 AUTOSAR_Platform_CompuMethods_boolean 0.0 255. FORMAT "%10.5"
 /begin ANNOTATION ANNOTATION_LABEL "Description (coming from AUTOSAR DESC field)"
  /begin ANNOTATION_TEXT "If true, a gear can be engaged using the shift paddle, even if the door is open\r\n" /end ANNOTATION_TEXT
 /end ANNOTATION
/end CHARACTERISTIC
/begin CHARACTERISTIC DST_EFLASHB.DST_ModeSelectGeneric.DST_ENABLED2R "" VALUE 0x80606D35 DefaultValueRecordLayout_AUTOSAR_Platform_BaseTypes_boolean 255.0 AUTOSAR_Platform_CompuMethods_boolean 0.0 255. FORMAT "%10.5"
 /begin ANNOTATION ANNOTATION_LABEL "Description (coming from AUTOSAR DESC field)"
  /begin ANNOTATION_TEXT "If set true, this will allow selection from Reverse directly to Drive and Visa Versa\r\n" /end ANNOTATION_TEXT
 /end ANNOTATION
/end CHARACTERISTIC
/begin CHARACTERISTIC DST_EFLASHB.DST_ModeSelectGeneric.DST_ENABLER2D "" VALUE 0x80606D36 DefaultValueRecordLayout_AUTOSAR_Platform_BaseTypes_boolean 255.0 AUTOSAR_Platform_CompuMethods_boolean 0.0 255. FORMAT "%10.5"
 /begin ANNOTATION ANNOTATION_LABEL "Description (coming from AUTOSAR DESC field)"
  /begin ANNOTATION_TEXT "If set true, this will allow selection from Reverse directly to Drive and Visa Versa\r\n" /end ANNOTATION_TEXT
 /end ANNOTATION
/end CHARACTERISTIC
/begin CHARACTERISTIC DST_EFLASHB.DST_ModeSelectGeneric.DST_ENGINERUNNINGTHRESH "" VALUE 0x80606CD0 DefaultValueRecordLayout_AUTOSAR_Platform_BaseTypes_uint16 20000.0 RB_PT_PCT_SWC_DST_CompuMethods_ident 0.0 20000. FORMAT "%10.5"
 /begin ANNOTATION ANNOTATION_LABEL "Description (coming from AUTOSAR DESC field)" /begin ANNOTATION_TEXT "Speed above which engine is running\r\n" /end ANNOTATION_TEXT /end ANNOTATION
/end CHARACTERISTIC
/begin CHARACTERISTIC DST_EFLASHB.DST_ModeSelectGeneric.DST_ENGINERUNTIMEB4GEARALLOWED "" VALUE 0x80606CD2 DefaultValueRecordLayout_AUTOSAR_Platform_BaseTypes_uint16 655.35 RB_PT_PCT_SWC_DST_CompuMethods_DST_Time 0.0 655.35 FORMAT "%10.5"
 /begin ANNOTATION ANNOTATION_LABEL "Description (coming from AUTOSAR DESC field)"
  /begin ANNOTATION_TEXT "Time the engine should be running before a gear is allowed\r\n" /end ANNOTATION_TEXT
 /end ANNOTATION
/end CHARACTERISTIC
/begin CHARACTERISTIC DST_EFLASHB.DST_ModeSelectGeneric.DST_ENGINESPEED2NEUTRAL "" VALUE 0x80606CD4 DefaultValueRecordLayout_AUTOSAR_Platform_BaseTypes_uint16 20000.0 RB_PT_PCT_SWC_DST_CompuMethods_ident 0.0 20000. FORMAT "%10.5"
 /begin ANNOTATION ANNOTATION_LABEL "Description (coming from AUTOSAR DESC field)" /begin ANNOTATION_TEXT "Engine speed below which Neutral will be selected\r\n" /end ANNOTATION_TEXT /end ANNOTATION
/end CHARACTERISTIC
/begin CHARACTERISTIC DST_EFLASHB.DST_ModeSelectGeneric.DST_ENGINESPEEDSTOPPED "" VALUE 0x80606CD6 DefaultValueRecordLayout_AUTOSAR_Platform_BaseTypes_uint16 20000.0 RB_PT_PCT_SWC_DST_CompuMethods_ident 0.0 20000. FORMAT "%10.5"
 /begin ANNOTATION ANNOTATION_LABEL "Description (coming from AUTOSAR DESC field)"
  /begin ANNOTATION_TEXT "Engine speed below which DST_Eco_ExitCount and DST_Eco_TimeB4Active are both set to 0\r\n" /end ANNOTATION_TEXT
 /end ANNOTATION
/end CHARACTERISTIC
/begin CHARACTERISTIC DST_EFLASHB.DST_ModeSelectGeneric.DST_ENGINESTOPPEDTHRESH "" VALUE 0x80606CD8 DefaultValueRecordLayout_AUTOSAR_Platform_BaseTypes_uint16 20000.0 RB_PT_PCT_SWC_DST_CompuMethods_ident 0.0 20000. FORMAT "%10.5"
 /begin ANNOTATION ANNOTATION_LABEL "Description (coming from AUTOSAR DESC field)"
  /begin ANNOTATION_TEXT "Engine speed below which considered stopped (reset running timer)\r\n" /end ANNOTATION_TEXT
 /end ANNOTATION
/end CHARACTERISTIC
/begin CHARACTERISTIC DST_EFLASHB.DST_ModeSelectGeneric.DST_EXTENABLEDRICVEOVERRIDE "" VALUE 0x80606D37 DefaultValueRecordLayout_AUTOSAR_Platform_BaseTypes_boolean 255.0 AUTOSAR_Platform_CompuMethods_boolean 0.0 255. FORMAT "%10.5"
 /begin ANNOTATION ANNOTATION_LABEL "Description (coming from AUTOSAR DESC field)"
  /begin ANNOTATION_TEXT "If true, the external bit to enable drive is overridden\r\n" /end ANNOTATION_TEXT
 /end ANNOTATION
/end CHARACTERISTIC
/begin CHARACTERISTIC DST_EFLASHB.DST_ModeSelectGeneric.DST_FWD2RPMTHRESH "" VALUE 0x80606CDA DefaultValueRecordLayout_AUTOSAR_Platform_BaseTypes_uint16 20000.0 RB_PT_PCT_SWC_DST_CompuMethods_ident 0.0 20000. FORMAT "%10.5"
 /begin ANNOTATION ANNOTATION_LABEL "Description (coming from AUTOSAR DESC field)"
  /begin ANNOTATION_TEXT "Engine speed must be above thisto go direct Fwd to Rev\r\n" /end ANNOTATION_TEXT
 /end ANNOTATION
/end CHARACTERISTIC
/begin CHARACTERISTIC DST_EFLASHB.DST_ModeSelectGeneric.DST_INVERTSHIFTLOCKSOLINPARK "" VALUE 0x80606D38 DefaultValueRecordLayout_AUTOSAR_Platform_BaseTypes_boolean 255.0 AUTOSAR_Platform_CompuMethods_boolean 0.0 255. FORMAT "%10.5"
 /begin ANNOTATION ANNOTATION_LABEL "Description (coming from AUTOSAR DESC field)"
  /begin ANNOTATION_TEXT "If true and the shift lever is in Park position, the logic to control the solenoid is reversed\r\n" /end ANNOTATION_TEXT
 /end ANNOTATION
/end CHARACTERISTIC
/begin CHARACTERISTIC DST_EFLASHB.DST_ModeSelectGeneric.DST_KMH4SHIFTLOKSOLINGEAR_Cancel "" VALUE 0x80606CDC DefaultValueRecordLayout_AUTOSAR_Platform_BaseTypes_sint16 600.0 RB_PT_PCT_SWC_DST_CompuMethods_DST_RefSpd_0p1 -100. 500. FORMAT "%10.5"
 /begin ANNOTATION ANNOTATION_LABEL "Description (coming from AUTOSAR DESC field)"
  /begin ANNOTATION_TEXT "Vehicle speed below which when the brake is pressed the shift lock sol will trigger in drive.  NB. Relies on cal of DST_SHIFTLOKSOLSTRAT\r\n" /end ANNOTATION_TEXT
 /end ANNOTATION
/end CHARACTERISTIC
/begin CHARACTERISTIC DST_EFLASHB.DST_ModeSelectGeneric.DST_KMH4SHIFTLOKSOLINGEAR_Set "" VALUE 0x80606CDE DefaultValueRecordLayout_AUTOSAR_Platform_BaseTypes_sint16 600.0 RB_PT_PCT_SWC_DST_CompuMethods_DST_RefSpd_0p1 -100. 500. FORMAT "%10.5"
 /begin ANNOTATION ANNOTATION_LABEL "Description (coming from AUTOSAR DESC field)"
  /begin ANNOTATION_TEXT "Vehicle speed below which when the brake is pressed the shift lock sol will trigger in drive.  NB. Relies on cal of DST_SHIFTLOKSOLSTRAT\r\n" /end ANNOTATION_TEXT
 /end ANNOTATION
/end CHARACTERISTIC
/begin CHARACTERISTIC DST_EFLASHB.DST_ModeSelectGeneric.DST_KMHALLOWDRD "" VALUE 0x80606CE0 DefaultValueRecordLayout_AUTOSAR_Platform_BaseTypes_uint16 500.0 RB_PT_PCT_SWC_DST_CompuMethods_ratio_0p01 0.0 500. FORMAT "%10.5"
 /begin ANNOTATION ANNOTATION_LABEL "Description (coming from AUTOSAR DESC field)" /begin ANNOTATION_TEXT "Vehicle speed below which an R to D is allowed\r\n" /end ANNOTATION_TEXT /end ANNOTATION
/end CHARACTERISTIC
/begin CHARACTERISTIC DST_EFLASHB.DST_ModeSelectGeneric.DST_KMHSHIFTLOCKSOLNEUTRAL_Set "" VALUE 0x80606CE2 DefaultValueRecordLayout_AUTOSAR_Platform_BaseTypes_sint16 600.0 RB_PT_PCT_SWC_DST_CompuMethods_DST_RefSpd_0p1 -100. 500. FORMAT "%10.5"
 /begin ANNOTATION ANNOTATION_LABEL "Description (coming from AUTOSAR DESC field)"
  /begin ANNOTATION_TEXT "Vehicle speed in neutral below which the shift lock solenoid can be active\r\n" /end ANNOTATION_TEXT
 /end ANNOTATION
/end CHARACTERISTIC
/begin CHARACTERISTIC DST_EFLASHB.DST_ModeSelectGeneric.DST_LATERALACCMAINTAINTEMPMAN "" VALUE 0x80606D39 DefaultValueRecordLayout_AUTOSAR_Platform_BaseTypes_uint8 1.27 RB_PT_PCT_SWC_DST_CompuMethods_ratio_0p01 0.0 1.27 FORMAT "%10.5"
 /begin ANNOTATION ANNOTATION_LABEL "Description (coming from AUTOSAR DESC field)"
  /begin ANNOTATION_TEXT "Lateral acceleration above which the temporary manual shift timer should be maintained/reset\r\n" /end ANNOTATION_TEXT
 /end ANNOTATION
/end CHARACTERISTIC
/begin CHARACTERISTIC DST_EFLASHB.DST_ModeSelectGeneric.DST_MAINTAINTEMPMAN_KMH "" VALUE 0x80606D3A DefaultValueRecordLayout_AUTOSAR_Platform_BaseTypes_boolean 255.0 AUTOSAR_Platform_CompuMethods_boolean 0.0 255. FORMAT "%10.5"
 /begin ANNOTATION ANNOTATION_LABEL "Description (coming from AUTOSAR DESC field)"
  /begin ANNOTATION_TEXT "Flag to maintain temp man mode depending on condition\r\n" /end ANNOTATION_TEXT
 /end ANNOTATION
/end CHARACTERISTIC
/begin CHARACTERISTIC DST_EFLASHB.DST_ModeSelectGeneric.DST_MAPAUTO_EURO1 "" VAL_BLK 0x80606A2A DefaultValueRecordLayout_AUTOSAR_Platform_BaseTypes_uint8 16.0 RB_PT_PCT_SWC_DST_CompuMethods_ident 0.0 16. FORMAT "%10.5"
 /begin ANNOTATION ANNOTATION_LABEL "Description (coming from AUTOSAR DESC field)"
  /begin ANNOTATION_TEXT "Maps the current aggression and mode to the shift map for Manual\r\n" /end ANNOTATION_TEXT
 /end ANNOTATION
 MATRIX_DIM 10 9 1 /end CHARACTERISTIC
/begin CHARACTERISTIC DST_EFLASHB.DST_ModeSelectGeneric.DST_MAPAUTO_EURO2 "" VAL_BLK 0x80606A84 DefaultValueRecordLayout_AUTOSAR_Platform_BaseTypes_uint8 16.0 RB_PT_PCT_SWC_DST_CompuMethods_ident 0.0 16. FORMAT "%10.5"
 /begin ANNOTATION ANNOTATION_LABEL "Description (coming from AUTOSAR DESC field)"
  /begin ANNOTATION_TEXT "Maps the current aggression and mode to the shift map for Manual\r\n" /end ANNOTATION_TEXT
 /end ANNOTATION
 MATRIX_DIM 10 9 1 /end CHARACTERISTIC
/begin CHARACTERISTIC DST_EFLASHB.DST_ModeSelectGeneric.DST_MAPAUTO_SPARE1 "" VAL_BLK 0x80606ADE DefaultValueRecordLayout_AUTOSAR_Platform_BaseTypes_uint8 16.0 RB_PT_PCT_SWC_DST_CompuMethods_ident 0.0 16. FORMAT "%10.5"
 /begin ANNOTATION ANNOTATION_LABEL "Description (coming from AUTOSAR DESC field)"
  /begin ANNOTATION_TEXT "Maps the current aggression and mode to the shift map for Manual\r\n" /end ANNOTATION_TEXT
 /end ANNOTATION
 MATRIX_DIM 10 9 1 /end CHARACTERISTIC
/begin CHARACTERISTIC DST_EFLASHB.DST_ModeSelectGeneric.DST_MAPAUTO_SPARE2 "" VAL_BLK 0x80606B38 DefaultValueRecordLayout_AUTOSAR_Platform_BaseTypes_uint8 16.0 RB_PT_PCT_SWC_DST_CompuMethods_ident 0.0 16. FORMAT "%10.5"
 /begin ANNOTATION ANNOTATION_LABEL "Description (coming from AUTOSAR DESC field)"
  /begin ANNOTATION_TEXT "Maps the current aggression and mode to the shift map for Manual\r\n" /end ANNOTATION_TEXT
 /end ANNOTATION
 MATRIX_DIM 10 9 1 /end CHARACTERISTIC
/begin CHARACTERISTIC DST_EFLASHB.DST_ModeSelectGeneric.DST_MAPAUTO_USA1 "" VAL_BLK 0x80606B92 DefaultValueRecordLayout_AUTOSAR_Platform_BaseTypes_uint8 16.0 RB_PT_PCT_SWC_DST_CompuMethods_ident 0.0 16. FORMAT "%10.5"
 /begin ANNOTATION ANNOTATION_LABEL "Description (coming from AUTOSAR DESC field)"
  /begin ANNOTATION_TEXT "Maps the current aggression and mode to the shift map for Manual\r\n" /end ANNOTATION_TEXT
 /end ANNOTATION
 MATRIX_DIM 10 9 1 /end CHARACTERISTIC
/begin CHARACTERISTIC DST_EFLASHB.DST_ModeSelectGeneric.DST_MAPAUTO_USA2 "" VAL_BLK 0x80606BEC DefaultValueRecordLayout_AUTOSAR_Platform_BaseTypes_uint8 16.0 RB_PT_PCT_SWC_DST_CompuMethods_ident 0.0 16. FORMAT "%10.5"
 /begin ANNOTATION ANNOTATION_LABEL "Description (coming from AUTOSAR DESC field)"
  /begin ANNOTATION_TEXT "Maps the current aggression and mode to the shift map for Manual\r\n" /end ANNOTATION_TEXT
 /end ANNOTATION
 MATRIX_DIM 10 9 1 /end CHARACTERISTIC
/begin CHARACTERISTIC DST_EFLASHB.DST_ModeSelectGeneric.DST_MAPMODESMANUAL "" VAL_BLK 0x80606C46 DefaultValueRecordLayout_AUTOSAR_Platform_BaseTypes_uint8 16.0 RB_PT_PCT_SWC_DST_CompuMethods_ident 0.0 16. FORMAT "%10.5"
 /begin ANNOTATION ANNOTATION_LABEL "Description (coming from AUTOSAR DESC field)"
  /begin ANNOTATION_TEXT "Maps the current aggression and mode to the shift map for Manual\r\n" /end ANNOTATION_TEXT
 /end ANNOTATION
 MATRIX_DIM 10 9 1 /end CHARACTERISTIC
/begin CHARACTERISTIC DST_EFLASHB.DST_ModeSelectGeneric.DST_MAXENGINESPEEDENGAGE "" VALUE 0x80606CE4 DefaultValueRecordLayout_AUTOSAR_Platform_BaseTypes_uint16 20000.0 RB_PT_PCT_SWC_DST_CompuMethods_ident 0.0 20000. FORMAT "%10.5"
 /begin ANNOTATION ANNOTATION_LABEL "Description (coming from AUTOSAR DESC field)"
  /begin ANNOTATION_TEXT "Maximum allowable engine speed to engage Driver or Reverse if the vehicle is stationary\r\n" /end ANNOTATION_TEXT
 /end ANNOTATION
/end CHARACTERISTIC
/begin CHARACTERISTIC DST_EFLASHB.DST_ModeSelectGeneric.DST_MAXTHROTTLE2ENGAGE "" VALUE 0x80606D3B DefaultValueRecordLayout_AUTOSAR_Platform_BaseTypes_uint8 102.0 RB_PT_PCT_SWC_DST_CompuMethods_ratio_0p4 0.0 102. FORMAT "%10.5"
 /begin ANNOTATION ANNOTATION_LABEL "Description (coming from AUTOSAR DESC field)" /begin ANNOTATION_TEXT "Maximum throttle angle to allow engagement of a gear\r\n" /end ANNOTATION_TEXT /end ANNOTATION
/end CHARACTERISTIC
/begin CHARACTERISTIC DST_EFLASHB.DST_ModeSelectGeneric.DST_MINENGSPDSHIFTLOCKLAMP "" VALUE 0x80606CE6 DefaultValueRecordLayout_AUTOSAR_Platform_BaseTypes_uint16 20000.0 RB_PT_PCT_SWC_DST_CompuMethods_ident 0.0 20000. FORMAT "%10.5"
 /begin ANNOTATION ANNOTATION_LABEL "Description (coming from AUTOSAR DESC field)"
  /begin ANNOTATION_TEXT "Engine speed must be equal to or above this for the shift lock lamp to be illuminated\r\n" /end ANNOTATION_TEXT
 /end ANNOTATION
/end CHARACTERISTIC
/begin CHARACTERISTIC DST_EFLASHB.DST_ModeSelectGeneric.DST_MINSPDPADDLEENGAGEIFDOOROPEN "" VALUE 0x80606CE8 DefaultValueRecordLayout_AUTOSAR_Platform_BaseTypes_uint16 500.0 RB_PT_PCT_SWC_DST_CompuMethods_kph_0p1 0.0 500. FORMAT "%10.5"
 /begin ANNOTATION ANNOTATION_LABEL "Description (coming from AUTOSAR DESC field)"
  /begin ANNOTATION_TEXT "Vehicle speed below which paddles will not allow gear selection if the door is open\r\n" /end ANNOTATION_TEXT
 /end ANNOTATION
/end CHARACTERISTIC
/begin CHARACTERISTIC DST_EFLASHB.DST_ModeSelectGeneric.DST_NEUTRALIFPRESSDINR2FAST "" VALUE 0x80606D3C DefaultValueRecordLayout_AUTOSAR_Platform_BaseTypes_boolean 255.0 AUTOSAR_Platform_CompuMethods_boolean 0.0 255. FORMAT "%10.5"
 /begin ANNOTATION ANNOTATION_LABEL "Description (coming from AUTOSAR DESC field)"
  /begin ANNOTATION_TEXT "If true, when in Reverse and travelling too fast to engage a forward gear, Neutral will be select.  If False, a warning will be output for displaying to the driver\r\n" /end ANNOTATION_TEXT
 /end ANNOTATION
/end CHARACTERISTIC
/begin CHARACTERISTIC DST_EFLASHB.DST_ModeSelectGeneric.DST_NEUTRALIFPRESSRIND2FAST "" VALUE 0x80606D3D DefaultValueRecordLayout_AUTOSAR_Platform_BaseTypes_boolean 255.0 AUTOSAR_Platform_CompuMethods_boolean 0.0 255. FORMAT "%10.5"
 /begin ANNOTATION ANNOTATION_LABEL "Description (coming from AUTOSAR DESC field)"
  /begin ANNOTATION_TEXT "If true, when in Drive and travelling too fast to engage a Reverse, Neutral will be select.  If False, a warning will be output for displaying to the driver\r\n" /end ANNOTATION_TEXT
 /end ANNOTATION
/end CHARACTERISTIC
/begin CHARACTERISTIC DST_EFLASHB.DST_ModeSelectGeneric.DST_OVERRIDEMAPSELECTION "" VALUE 0x80606D3E DefaultValueRecordLayout_AUTOSAR_Platform_BaseTypes_uint8 16.0 RB_PT_PCT_SWC_DST_CompuMethods_ident 0.0 16. FORMAT "%10.5"
 /begin ANNOTATION ANNOTATION_LABEL "Description (coming from AUTOSAR DESC field)"
  /begin ANNOTATION_TEXT "Force map 0: Dont Override, 1:Overheat 2:  Winter  4:Economy  5:Normal  6:Sport1  7:Sport2   9:Track1  10: Track2  11:Manual Overheat  14: Manual Normal\r\n" /end ANNOTATION_TEXT
 /end ANNOTATION
/end CHARACTERISTIC
/begin CHARACTERISTIC DST_EFLASHB.DST_ModeSelectGeneric.DST_PARSETCHECK "" VALUE 0x80606CEA DefaultValueRecordLayout_AUTOSAR_Platform_BaseTypes_uint16 65535.0 RB_PT_PCT_SWC_DST_CompuMethods_ident 0.0 65535. FORMAT "%10.5"
 /begin ANNOTATION ANNOTATION_LABEL "Description (coming from AUTOSAR DESC field)"
  /begin ANNOTATION_TEXT "Data check.  If this value is not 21930 then gears cannot be selected.  Also inserted to enable some requirement checking tests.\r\n" /end ANNOTATION_TEXT
 /end ANNOTATION
/end CHARACTERISTIC
/begin CHARACTERISTIC DST_EFLASHB.DST_ModeSelectGeneric.DST_R2D2RMAXENGNIESPEED "" VALUE 0x80606CEC DefaultValueRecordLayout_AUTOSAR_Platform_BaseTypes_uint16 20000.0 RB_PT_PCT_SWC_DST_CompuMethods_ident 0.0 20000. FORMAT "%10.5"
 /begin ANNOTATION ANNOTATION_LABEL "Description (coming from AUTOSAR DESC field)" /begin ANNOTATION_TEXT "Maximum engine speed for R to D to R transitions\r\n" /end ANNOTATION_TEXT /end ANNOTATION
/end CHARACTERISTIC
/begin CHARACTERISTIC DST_EFLASHB.DST_ModeSelectGeneric.DST_R2D2RMAXINPUTSPEED "" VALUE 0x80606CEE DefaultValueRecordLayout_AUTOSAR_Platform_BaseTypes_uint16 20000.0 RB_PT_PCT_SWC_DST_CompuMethods_ident 0.0 20000. FORMAT "%10.5"
 /begin ANNOTATION ANNOTATION_LABEL "Description (coming from AUTOSAR DESC field)" /begin ANNOTATION_TEXT "Maximum input speed direct D to R to D\r\n" /end ANNOTATION_TEXT /end ANNOTATION
/end CHARACTERISTIC
/begin CHARACTERISTIC DST_EFLASHB.DST_ModeSelectGeneric.DST_R2D2RMAXTHROTTLE "" VALUE 0x80606D3F DefaultValueRecordLayout_AUTOSAR_Platform_BaseTypes_uint8 102.0 RB_PT_PCT_SWC_DST_CompuMethods_ratio_0p4 0.0 102. FORMAT "%10.5"
 /begin ANNOTATION ANNOTATION_LABEL "Description (coming from AUTOSAR DESC field)"
  /begin ANNOTATION_TEXT "Maximum throttle angle for direct D to R to D transitions\r\n" /end ANNOTATION_TEXT
 /end ANNOTATION
/end CHARACTERISTIC
/begin CHARACTERISTIC DST_EFLASHB.DST_ModeSelectGeneric.DST_R2D2RMAXWHEELSPEED "" VALUE 0x80606CF0 DefaultValueRecordLayout_AUTOSAR_Platform_BaseTypes_uint16 500.0 RB_PT_PCT_SWC_DST_CompuMethods_kph_0p1 0.0 500. FORMAT "%10.5"
 /begin ANNOTATION ANNOTATION_LABEL "Description (coming from AUTOSAR DESC field)"
  /begin ANNOTATION_TEXT "Maximum wheel speed to perform direct D to R and R to D transitions\r\n" /end ANNOTATION_TEXT
 /end ANNOTATION
/end CHARACTERISTIC
/begin CHARACTERISTIC DST_EFLASHB.DST_ModeSelectGeneric.DST_RoadDetect.DST_CITYENABLEECO "" VALUE 0x80606DAE DefaultValueRecordLayout_AUTOSAR_Platform_BaseTypes_boolean 255.0 AUTOSAR_Platform_CompuMethods_boolean 0.0 255. FORMAT "%10.5"
 /begin ANNOTATION ANNOTATION_LABEL "Description (coming from AUTOSAR DESC field)" /begin ANNOTATION_TEXT "If true, when in Eco, city mode will be disabled\r\n" /end ANNOTATION_TEXT /end ANNOTATION
/end CHARACTERISTIC
/begin CHARACTERISTIC DST_EFLASHB.DST_ModeSelectGeneric.DST_RoadDetect.DST_CITYGRADIENT2EXIT "" VALUE 0x80606D96 DefaultValueRecordLayout_AUTOSAR_Platform_BaseTypes_sint16 65.4 RB_PT_PCT_SWC_DST_CompuMethods_ratio_0p001 -32.7 32.7 FORMAT "%10.5"
 /begin ANNOTATION ANNOTATION_LABEL "Description (coming from AUTOSAR DESC field)"
  /begin ANNOTATION_TEXT "Maximum positive or negative gradient that will leave city\r\n" /end ANNOTATION_TEXT
 /end ANNOTATION
/end CHARACTERISTIC
/begin CHARACTERISTIC DST_EFLASHB.DST_ModeSelectGeneric.DST_RoadDetect.DST_CITYLATACC2EXIT "" VALUE 0x80606DAF DefaultValueRecordLayout_AUTOSAR_Platform_BaseTypes_uint8 1.27 RB_PT_PCT_SWC_DST_CompuMethods_ratio_0p01 0.0 1.27 FORMAT "%10.5"
 /begin ANNOTATION ANNOTATION_LABEL "Description (coming from AUTOSAR DESC field)" /begin ANNOTATION_TEXT "Abs Lateral acceleration above which City will exit\r\n" /end ANNOTATION_TEXT /end ANNOTATION
/end CHARACTERISTIC
/begin CHARACTERISTIC DST_EFLASHB.DST_ModeSelectGeneric.DST_RoadDetect.DST_CITYLONGACC2EXIT "" VALUE 0x80606D98 DefaultValueRecordLayout_AUTOSAR_Platform_BaseTypes_sint16 4.0 RB_PT_PCT_SWC_DST_CompuMethods_ratio_0p0001 -2. 2. FORMAT "%10.5"
 /begin ANNOTATION ANNOTATION_LABEL "Description (coming from AUTOSAR DESC field)" /begin ANNOTATION_TEXT "Maximum long acc before city will exit\r\n" /end ANNOTATION_TEXT /end ANNOTATION
/end CHARACTERISTIC
/begin CHARACTERISTIC DST_EFLASHB.DST_ModeSelectGeneric.DST_RoadDetect.DST_CITYREFSPEED2COUNTDOWN "" VALUE 0x80606D9A DefaultValueRecordLayout_AUTOSAR_Platform_BaseTypes_uint16 500.0 RB_PT_PCT_SWC_DST_CompuMethods_kph_0p1 0.0 500. FORMAT "%10.5"
 /begin ANNOTATION ANNOTATION_LABEL "Description (coming from AUTOSAR DESC field)"
  /begin ANNOTATION_TEXT "Vehicle speed above which the time to city counter will count down\r\n" /end ANNOTATION_TEXT
 /end ANNOTATION
/end CHARACTERISTIC
/begin CHARACTERISTIC DST_EFLASHB.DST_ModeSelectGeneric.DST_RoadDetect.DST_CITYREFSPEED2EXIT "" VALUE 0x80606D9C DefaultValueRecordLayout_AUTOSAR_Platform_BaseTypes_uint16 500.0 RB_PT_PCT_SWC_DST_CompuMethods_kph_0p1 0.0 500. FORMAT "%10.5"
 /begin ANNOTATION ANNOTATION_LABEL "Description (coming from AUTOSAR DESC field)" /begin ANNOTATION_TEXT "Reference speed above which city will be cancelled\r\n" /end ANNOTATION_TEXT /end ANNOTATION
/end CHARACTERISTIC
/begin CHARACTERISTIC DST_EFLASHB.DST_ModeSelectGeneric.DST_RoadDetect.DST_CITYSHIFTMODESSETTIMERHIGH "" VAL_BLK 0x80606D68 DefaultValueRecordLayout_AUTOSAR_Platform_BaseTypes_boolean 255.0 AUTOSAR_Platform_CompuMethods_boolean 0.0 255. FORMAT "%10.5"
 /begin ANNOTATION ANNOTATION_LABEL "Description (coming from AUTOSAR DESC field)"
  /begin ANNOTATION_TEXT "Can be used to reset the timer to a high value based on the current shift mode\r\n" /end ANNOTATION_TEXT
 /end ANNOTATION
 MATRIX_DIM 17 1 1 /end CHARACTERISTIC
/begin CHARACTERISTIC DST_EFLASHB.DST_ModeSelectGeneric.DST_RoadDetect.DST_CITYSTEERINGANGLE2EXIT "" VALUE 0x80606D9E DefaultValueRecordLayout_AUTOSAR_Platform_BaseTypes_uint16 2048.0 RB_PT_PCT_SWC_DST_CompuMethods_ratio_0p5 0.0 2048. FORMAT "%10.5"
 /begin ANNOTATION ANNOTATION_LABEL "Description (coming from AUTOSAR DESC field)" /begin ANNOTATION_TEXT "Maximum steering angle before city is cancelled\r\n" /end ANNOTATION_TEXT /end ANNOTATION
/end CHARACTERISTIC
/begin CHARACTERISTIC DST_EFLASHB.DST_ModeSelectGeneric.DST_RoadDetect.DST_CITYTHROTTLE2COUNTDOWN "" VALUE 0x80606DB0 DefaultValueRecordLayout_AUTOSAR_Platform_BaseTypes_uint8 102.0 RB_PT_PCT_SWC_DST_CompuMethods_ratio_0p4 0.0 102. FORMAT "%10.5"
 /begin ANNOTATION ANNOTATION_LABEL "Description (coming from AUTOSAR DESC field)"
  /begin ANNOTATION_TEXT "Throttle angle => that will cause the DST_CityTimeB4Active to count down\r\n" /end ANNOTATION_TEXT
 /end ANNOTATION
/end CHARACTERISTIC
/begin CHARACTERISTIC DST_EFLASHB.DST_ModeSelectGeneric.DST_RoadDetect.DST_CITYTHROTTLE2EXIT "" VAL_BLK 0x80606D8A DefaultValueRecordLayout_AUTOSAR_Platform_BaseTypes_uint8 102.0 RB_PT_PCT_SWC_DST_CompuMethods_ratio_0p4 0.0 102. FORMAT "%10.5"
 /begin ANNOTATION ANNOTATION_LABEL "Description (coming from AUTOSAR DESC field)" /begin ANNOTATION_TEXT "Throttle to exit based on current demand gear\r\n" /end ANNOTATION_TEXT /end ANNOTATION
 MATRIX_DIM 12 1 1 /end CHARACTERISTIC
/begin CHARACTERISTIC DST_EFLASHB.DST_ModeSelectGeneric.DST_RoadDetect.DST_MWAYENABLEECO "" VALUE 0x80606DB1 DefaultValueRecordLayout_AUTOSAR_Platform_BaseTypes_boolean 255.0 AUTOSAR_Platform_CompuMethods_boolean 0.0 255. FORMAT "%10.5"
 /begin ANNOTATION ANNOTATION_LABEL "Description (coming from AUTOSAR DESC field)" /begin ANNOTATION_TEXT "If true, when in Eco, motorway mode will be disabled\r\n" /end ANNOTATION_TEXT /end ANNOTATION
/end CHARACTERISTIC
/begin CHARACTERISTIC DST_EFLASHB.DST_ModeSelectGeneric.DST_RoadDetect.DST_MWAYEXITTIME "" VAL_BLK 0x80606D46 DefaultValueRecordLayout_AUTOSAR_Platform_BaseTypes_uint16 655.35 RB_PT_PCT_SWC_DST_CompuMethods_DST_Time 0.0 655.35 FORMAT "%10.5"
 /begin ANNOTATION ANNOTATION_LABEL "Description (coming from AUTOSAR DESC field)" /begin ANNOTATION_TEXT "Shift mode based time to leave Motorway\r\n" /end ANNOTATION_TEXT /end ANNOTATION
 MATRIX_DIM 17 1 1 /end CHARACTERISTIC
/begin CHARACTERISTIC DST_EFLASHB.DST_ModeSelectGeneric.DST_RoadDetect.DST_MWAYGRADIENT2EXIT "" VALUE 0x80606DA0 DefaultValueRecordLayout_AUTOSAR_Platform_BaseTypes_sint16 65.4 RB_PT_PCT_SWC_DST_CompuMethods_ratio_0p001 -32.7 32.7 FORMAT "%10.5"
 /begin ANNOTATION ANNOTATION_LABEL "Description (coming from AUTOSAR DESC field)" /begin ANNOTATION_TEXT "Gradient above which motorway will exit\r\n" /end ANNOTATION_TEXT /end ANNOTATION
/end CHARACTERISTIC
/begin CHARACTERISTIC DST_EFLASHB.DST_ModeSelectGeneric.DST_RoadDetect.DST_MWAYLATACC2EXIT "" VALUE 0x80606DB2 DefaultValueRecordLayout_AUTOSAR_Platform_BaseTypes_uint8 1.27 RB_PT_PCT_SWC_DST_CompuMethods_ratio_0p01 0.0 1.27 FORMAT "%10.5"
 /begin ANNOTATION ANNOTATION_LABEL "Description (coming from AUTOSAR DESC field)"
  /begin ANNOTATION_TEXT "Lateral acceleration above which motorway detection will be cancelled\r\n" /end ANNOTATION_TEXT
 /end ANNOTATION
/end CHARACTERISTIC
/begin CHARACTERISTIC DST_EFLASHB.DST_ModeSelectGeneric.DST_RoadDetect.DST_MWAYLONGACC2EXIT "" VALUE 0x80606DA2 DefaultValueRecordLayout_AUTOSAR_Platform_BaseTypes_sint16 4.0 RB_PT_PCT_SWC_DST_CompuMethods_ratio_0p0001 -2. 2. FORMAT "%10.5"
 /begin ANNOTATION ANNOTATION_LABEL "Description (coming from AUTOSAR DESC field)"
  /begin ANNOTATION_TEXT "Long acc above which (or below negative) that motorway will exit\r\n" /end ANNOTATION_TEXT
 /end ANNOTATION
/end CHARACTERISTIC
/begin CHARACTERISTIC DST_EFLASHB.DST_ModeSelectGeneric.DST_RoadDetect.DST_MWAYREFSPD2COUNTDOWN "" VALUE 0x80606DA4 DefaultValueRecordLayout_AUTOSAR_Platform_BaseTypes_uint16 500.0 RB_PT_PCT_SWC_DST_CompuMethods_kph_0p1 0.0 500. FORMAT "%10.5"
 /begin ANNOTATION ANNOTATION_LABEL "Description (coming from AUTOSAR DESC field)" /begin ANNOTATION_TEXT "Vehicle speed before the timer counts down\r\n" /end ANNOTATION_TEXT /end ANNOTATION
/end CHARACTERISTIC
/begin CHARACTERISTIC DST_EFLASHB.DST_ModeSelectGeneric.DST_RoadDetect.DST_MWAYREFSPDMAX "" VALUE 0x80606DA6 DefaultValueRecordLayout_AUTOSAR_Platform_BaseTypes_uint16 500.0 RB_PT_PCT_SWC_DST_CompuMethods_kph_0p1 0.0 500. FORMAT "%10.5"
 /begin ANNOTATION ANNOTATION_LABEL "Description (coming from AUTOSAR DESC field)" /begin ANNOTATION_TEXT "Maximum reference speed to activate motorway\r\n" /end ANNOTATION_TEXT /end ANNOTATION
/end CHARACTERISTIC
/begin CHARACTERISTIC DST_EFLASHB.DST_ModeSelectGeneric.DST_RoadDetect.DST_MWAYREFSPDMIN "" VALUE 0x80606DA8 DefaultValueRecordLayout_AUTOSAR_Platform_BaseTypes_uint16 500.0 RB_PT_PCT_SWC_DST_CompuMethods_kph_0p1 0.0 500. FORMAT "%10.5"
 /begin ANNOTATION ANNOTATION_LABEL "Description (coming from AUTOSAR DESC field)" /begin ANNOTATION_TEXT "Minimum reference speed to activate motorway\r\n" /end ANNOTATION_TEXT /end ANNOTATION
/end CHARACTERISTIC
/begin CHARACTERISTIC DST_EFLASHB.DST_ModeSelectGeneric.DST_RoadDetect.DST_MWAYSHIFTMODESSETTIMERHIGH "" VAL_BLK 0x80606D79 DefaultValueRecordLayout_AUTOSAR_Platform_BaseTypes_boolean 255.0 AUTOSAR_Platform_CompuMethods_boolean 0.0 255. FORMAT "%10.5"
 /begin ANNOTATION ANNOTATION_LABEL "Description (coming from AUTOSAR DESC field)"
  /begin ANNOTATION_TEXT "Can be used to reset the timer to a high value based on the current shift mode\r\n" /end ANNOTATION_TEXT
 /end ANNOTATION
 MATRIX_DIM 17 1 1 /end CHARACTERISTIC
/begin CHARACTERISTIC DST_EFLASHB.DST_ModeSelectGeneric.DST_RoadDetect.DST_MWAYSTEERINGANGLE2EXIT "" VALUE 0x80606DAA DefaultValueRecordLayout_AUTOSAR_Platform_BaseTypes_uint16 2048.0 RB_PT_PCT_SWC_DST_CompuMethods_ratio_0p5 0.0 2048. FORMAT "%10.5"
 /begin ANNOTATION ANNOTATION_LABEL "Description (coming from AUTOSAR DESC field)" /begin ANNOTATION_TEXT "Steering angle above which motorway will exit\r\n" /end ANNOTATION_TEXT /end ANNOTATION
/end CHARACTERISTIC
/begin CHARACTERISTIC DST_EFLASHB.DST_ModeSelectGeneric.DST_RoadDetect.DST_MWAYTHROTTLE2COUNTDOWN "" VALUE 0x80606DB3 DefaultValueRecordLayout_AUTOSAR_Platform_BaseTypes_uint8 102.0 RB_PT_PCT_SWC_DST_CompuMethods_ratio_0p4 0.0 102. FORMAT "%10.5"
 /begin ANNOTATION ANNOTATION_LABEL "Description (coming from AUTOSAR DESC field)"
  /begin ANNOTATION_TEXT "Throttle angle => that will cause the DST_MwayTimeB4Active to count down\r\n" /end ANNOTATION_TEXT
 /end ANNOTATION
/end CHARACTERISTIC
/begin CHARACTERISTIC DST_EFLASHB.DST_ModeSelectGeneric.DST_RoadDetect.DST_MWAYTHROTTLE2EXIT "" VALUE 0x80606DB4 DefaultValueRecordLayout_AUTOSAR_Platform_BaseTypes_uint8 102.0 RB_PT_PCT_SWC_DST_CompuMethods_ratio_0p4 0.0 102. FORMAT "%10.5"
 /begin ANNOTATION ANNOTATION_LABEL "Description (coming from AUTOSAR DESC field)" /begin ANNOTATION_TEXT "Throttle pedal value above which motorway will exit\r\n" /end ANNOTATION_TEXT /end ANNOTATION
/end CHARACTERISTIC
/begin CHARACTERISTIC DST_EFLASHB.DST_ModeSelectGeneric.DST_RoadDetect.DST_STOPGOCOUNTACTIVATE "" VALUE 0x80606DB5 DefaultValueRecordLayout_AUTOSAR_Platform_BaseTypes_uint8 254.0 RB_PT_PCT_SWC_DST_CompuMethods_ident 1. 255. FORMAT "%10.5"
 /begin ANNOTATION ANNOTATION_LABEL "Description (coming from AUTOSAR DESC field)"
  /begin ANNOTATION_TEXT "Number of stop and gos before the strategy is triggered\r\n" /end ANNOTATION_TEXT
 /end ANNOTATION
/end CHARACTERISTIC
/begin CHARACTERISTIC DST_EFLASHB.DST_ModeSelectGeneric.DST_RoadDetect.DST_STOPGOINCREASELOW "" VALUE 0x80606DAC DefaultValueRecordLayout_AUTOSAR_Platform_BaseTypes_uint16 650.0 RB_PT_PCT_SWC_DST_CompuMethods_DST_RefSpd_0p01Signed -150. 500. FORMAT "%10.5"
 /begin ANNOTATION ANNOTATION_LABEL "Description (coming from AUTOSAR DESC field)"
  /begin ANNOTATION_TEXT "Vehicle speed below which stop go counter will be increased\r\n" /end ANNOTATION_TEXT
 /end ANNOTATION
/end CHARACTERISTIC
/begin CHARACTERISTIC DST_EFLASHB.DST_ModeSelectGeneric.DST_ROADDETECTENABLED "" VALUE 0x80606D40 DefaultValueRecordLayout_AUTOSAR_Platform_BaseTypes_boolean 255.0 AUTOSAR_Platform_CompuMethods_boolean 0.0 255. FORMAT "%10.5"
 /begin ANNOTATION ANNOTATION_LABEL "Description (coming from AUTOSAR DESC field)"
  /begin ANNOTATION_TEXT "If true, the type of road will be calculated and used to update the road type\r\n" /end ANNOTATION_TEXT
 /end ANNOTATION
/end CHARACTERISTIC
/begin CHARACTERISTIC DST_EFLASHB.DST_ModeSelectGeneric.DST_SHIFTLOCKLAMPPOLARITY "" VALUE 0x80606D41 DefaultValueRecordLayout_AUTOSAR_Platform_BaseTypes_boolean 255.0 AUTOSAR_Platform_CompuMethods_boolean 0.0 255. FORMAT "%10.5"
 /begin ANNOTATION ANNOTATION_LABEL "Description (coming from AUTOSAR DESC field)"
  /begin ANNOTATION_TEXT "Set true to reverse the output logic of the shift lock solenoid\r\n" /end ANNOTATION_TEXT
 /end ANNOTATION
/end CHARACTERISTIC
/begin CHARACTERISTIC DST_EFLASHB.DST_ModeSelectGeneric.DST_SPORTINDEC_THROTTLEINCRATE "" VALUE 0x80606CF2 DefaultValueRecordLayout_AUTOSAR_Platform_BaseTypes_sint16 100.0 RB_PT_PCT_SWC_DST_CompuMethods_ratio_0p005 0.0 100. FORMAT "%10.5"
 /begin ANNOTATION ANNOTATION_LABEL "Description (coming from AUTOSAR DESC field)" /begin ANNOTATION_TEXT "Decay rate of peak held throttle\r\n" /end ANNOTATION_TEXT /end ANNOTATION
/end CHARACTERISTIC
/begin CHARACTERISTIC DST_EFLASHB.DST_ModeSelectGeneric.DST_SPORTINDEX_BRAKEDECAY "" VALUE 0x80606CF4 DefaultValueRecordLayout_AUTOSAR_Platform_BaseTypes_sint16 2.0 RB_PT_PCT_SWC_DST_CompuMethods_ratio_0p0001 0.0 2. FORMAT "%10.5"
 /begin ANNOTATION ANNOTATION_LABEL "Description (coming from AUTOSAR DESC field)" /begin ANNOTATION_TEXT "Decay rate of peak held throttle\r\n" /end ANNOTATION_TEXT /end ANNOTATION
/end CHARACTERISTIC
/begin CHARACTERISTIC DST_EFLASHB.DST_ModeSelectGeneric.DST_SPORTINDEX_BRAKEHOLDTIME "" VALUE 0x80606CF6 DefaultValueRecordLayout_AUTOSAR_Platform_BaseTypes_uint16 655.35 RB_PT_PCT_SWC_DST_CompuMethods_DST_Time 0.0 655.35 FORMAT "%10.5"
 /begin ANNOTATION ANNOTATION_LABEL "Description (coming from AUTOSAR DESC field)" /begin ANNOTATION_TEXT "Time the throttle will be held high\r\n" /end ANNOTATION_TEXT /end ANNOTATION
/end CHARACTERISTIC
/begin CHARACTERISTIC DST_EFLASHB.DST_ModeSelectGeneric.DST_SPORTINDEX_BRAKING "" CURVE 0x80606DB6 RB_PT_PCT_SWC_DST_RecordLayouts_RL_Curve_uint8_6_uint16_6 100.0 RB_PT_PCT_SWC_DST_CompuMethods_percent_0p5 0.0 100. FORMAT "%10.5"
 /begin ANNOTATION ANNOTATION_LABEL "Description (coming from AUTOSAR DESC field)" /begin ANNOTATION_TEXT "Impact on sport index from braking effort\r\n" /end ANNOTATION_TEXT /end ANNOTATION
 /begin AXIS_DESCR STD_AXIS NO_INPUT_QUANTITY RB_PT_PCT_SWC_DST_CompuMethods_ratio_0p0001 6 0.0 2. FORMAT "%10.5" DEPOSIT ABSOLUTE /end AXIS_DESCR
/end CHARACTERISTIC
/begin CHARACTERISTIC DST_EFLASHB.DST_ModeSelectGeneric.DST_SPORTINDEX_GRADNEG "" CURVE 0x80606DCA RB_PT_PCT_SWC_DST_RecordLayouts_RL_Curve_uint8_6_sint16_6 100.0 RB_PT_PCT_SWC_DST_CompuMethods_percent_0p5 0.0 100. FORMAT "%10.5"
 /begin ANNOTATION ANNOTATION_LABEL "Description (coming from AUTOSAR DESC field)" /begin ANNOTATION_TEXT "Impact on sport index from negative gradient\r\n" /end ANNOTATION_TEXT /end ANNOTATION
 /begin AXIS_DESCR STD_AXIS NO_INPUT_QUANTITY RB_PT_PCT_SWC_DST_CompuMethods_ratio_0p001 6 -32.7 32.7 FORMAT "%10.5" DEPOSIT ABSOLUTE /end AXIS_DESCR
/end CHARACTERISTIC
/begin CHARACTERISTIC DST_EFLASHB.DST_ModeSelectGeneric.DST_SPORTINDEX_GRADPOS "" CURVE 0x80606DDE RB_PT_PCT_SWC_DST_RecordLayouts_RL_Curve_uint8_6_sint16_6 100.0 RB_PT_PCT_SWC_DST_CompuMethods_percent_0p5 0.0 100. FORMAT "%10.5"
 /begin ANNOTATION ANNOTATION_LABEL "Description (coming from AUTOSAR DESC field)" /begin ANNOTATION_TEXT "Impact on sport index from positive gradient\r\n" /end ANNOTATION_TEXT /end ANNOTATION
 /begin AXIS_DESCR STD_AXIS NO_INPUT_QUANTITY RB_PT_PCT_SWC_DST_CompuMethods_ratio_0p001 6 -32.7 32.7 FORMAT "%10.5" DEPOSIT ABSOLUTE /end AXIS_DESCR
/end CHARACTERISTIC
/begin CHARACTERISTIC DST_EFLASHB.DST_ModeSelectGeneric.DST_SPORTINDEX_HOLDTIMELATERAL "" VALUE 0x80606CF8 DefaultValueRecordLayout_AUTOSAR_Platform_BaseTypes_uint16 655.35 RB_PT_PCT_SWC_DST_CompuMethods_DST_Time 0.0 655.35 FORMAT "%10.5"
 /begin ANNOTATION ANNOTATION_LABEL "Description (coming from AUTOSAR DESC field)" /begin ANNOTATION_TEXT "Time the throttle will be held high\r\n" /end ANNOTATION_TEXT /end ANNOTATION
/end CHARACTERISTIC
/begin CHARACTERISTIC DST_EFLASHB.DST_ModeSelectGeneric.DST_SPORTINDEX_HOLDTIMETHROTTLE "" VALUE 0x80606CFA DefaultValueRecordLayout_AUTOSAR_Platform_BaseTypes_uint16 655.35 RB_PT_PCT_SWC_DST_CompuMethods_DST_Time 0.0 655.35 FORMAT "%10.5"
 /begin ANNOTATION ANNOTATION_LABEL "Description (coming from AUTOSAR DESC field)" /begin ANNOTATION_TEXT "Time the throttle will be held high\r\n" /end ANNOTATION_TEXT /end ANNOTATION
/end CHARACTERISTIC
/begin CHARACTERISTIC DST_EFLASHB.DST_ModeSelectGeneric.DST_SPORTINDEX_KMHHOLDTIME "" VALUE 0x80606CFC DefaultValueRecordLayout_AUTOSAR_Platform_BaseTypes_uint16 655.35 RB_PT_PCT_SWC_DST_CompuMethods_DST_Time 0.0 655.35 FORMAT "%10.5"
 /begin ANNOTATION ANNOTATION_LABEL "Description (coming from AUTOSAR DESC field)" /begin ANNOTATION_TEXT "Time the throttle will be held high\r\n" /end ANNOTATION_TEXT /end ANNOTATION
/end CHARACTERISTIC
/begin CHARACTERISTIC DST_EFLASHB.DST_ModeSelectGeneric.DST_SPORTINDEX_LATACC "" CURVE 0x80606DF2 RB_PT_PCT_SWC_DST_RecordLayouts_RL_Curve_uint8_6_uint16_6 100.0 RB_PT_PCT_SWC_DST_CompuMethods_percent_0p5 0.0 100. FORMAT "%10.5"
 /begin ANNOTATION ANNOTATION_LABEL "Description (coming from AUTOSAR DESC field)" /begin ANNOTATION_TEXT "Impact on sport index due to lateral acceleration\r\n" /end ANNOTATION_TEXT /end ANNOTATION
 /begin AXIS_DESCR STD_AXIS NO_INPUT_QUANTITY RB_PT_PCT_SWC_DST_CompuMethods_ratio_0p0001 6 0.0 1.27 FORMAT "%10.5" DEPOSIT ABSOLUTE /end AXIS_DESCR
/end CHARACTERISTIC
/begin CHARACTERISTIC DST_EFLASHB.DST_ModeSelectGeneric.DST_SPORTINDEX_LATERALDECAY "" VALUE 0x80606CFE DefaultValueRecordLayout_AUTOSAR_Platform_BaseTypes_uint16 1.27 RB_PT_PCT_SWC_DST_CompuMethods_ratio_0p0001 0.0 1.27 FORMAT "%10.5"
 /begin ANNOTATION ANNOTATION_LABEL "Description (coming from AUTOSAR DESC field)" /begin ANNOTATION_TEXT "Decay rate of peak held throttle\r\n" /end ANNOTATION_TEXT /end ANNOTATION
/end CHARACTERISTIC
/begin CHARACTERISTIC DST_EFLASHB.DST_ModeSelectGeneric.DST_SPORTINDEX_THROTTLEDECAY "" VALUE 0x80606D00 DefaultValueRecordLayout_AUTOSAR_Platform_BaseTypes_sint16 100.0 RB_PT_PCT_SWC_DST_CompuMethods_ratio_0p005 0.0 100. FORMAT "%10.5"
 /begin ANNOTATION ANNOTATION_LABEL "Description (coming from AUTOSAR DESC field)" /begin ANNOTATION_TEXT "Decay rate of peak held throttle\r\n" /end ANNOTATION_TEXT /end ANNOTATION
/end CHARACTERISTIC
/begin CHARACTERISTIC DST_EFLASHB.DST_ModeSelectGeneric.DST_SPORTINDEX_THROTTLEHOLDTIME "" VALUE 0x80606D02 DefaultValueRecordLayout_AUTOSAR_Platform_BaseTypes_uint16 655.35 RB_PT_PCT_SWC_DST_CompuMethods_DST_Time 0.0 655.35 FORMAT "%10.5"
 /begin ANNOTATION ANNOTATION_LABEL "Description (coming from AUTOSAR DESC field)" /begin ANNOTATION_TEXT "Time the throttle will be held high\r\n" /end ANNOTATION_TEXT /end ANNOTATION
/end CHARACTERISTIC
/begin CHARACTERISTIC DST_EFLASHB.DST_ModeSelectGeneric.DST_TEMPMAN_ACCELNEG "" VALUE 0x80606D0E DefaultValueRecordLayout_AUTOSAR_Platform_BaseTypes_sint16 4.0 RB_PT_PCT_SWC_DST_CompuMethods_ratio_0p01 -2. 2. FORMAT "%10.5"
 /begin ANNOTATION ANNOTATION_LABEL "Description (coming from AUTOSAR DESC field)"
  /begin ANNOTATION_TEXT "Longitudinal acceleration to maintain temporary manual\r\n" /end ANNOTATION_TEXT
 /end ANNOTATION
/end CHARACTERISTIC
/begin CHARACTERISTIC DST_EFLASHB.DST_ModeSelectGeneric.DST_TEMPMAN_ACCELPOS "" VALUE 0x80606D10 DefaultValueRecordLayout_AUTOSAR_Platform_BaseTypes_sint16 4.0 RB_PT_PCT_SWC_DST_CompuMethods_ratio_0p01 -2. 2. FORMAT "%10.5"
 /begin ANNOTATION ANNOTATION_LABEL "Description (coming from AUTOSAR DESC field)"
  /begin ANNOTATION_TEXT "Longitudinal acceleration to maintain temporary manual\r\n" /end ANNOTATION_TEXT
 /end ANNOTATION
/end CHARACTERISTIC
/begin CHARACTERISTIC DST_EFLASHB.DST_ModeSelectGeneric.DST_TEMPMAN_KMH2ENABLE "" VALUE 0x80606D12 DefaultValueRecordLayout_AUTOSAR_Platform_BaseTypes_uint16 500.0 RB_PT_PCT_SWC_DST_CompuMethods_kph_0p1 0.0 500. FORMAT "%10.5"
 /begin ANNOTATION ANNOTATION_LABEL "Description (coming from AUTOSAR DESC field)"
  /begin ANNOTATION_TEXT "Vehicle speed equal to and above temporary manual time can be extended by using the shift paddles\r\n" /end ANNOTATION_TEXT
 /end ANNOTATION
/end CHARACTERISTIC
/begin CHARACTERISTIC DST_EFLASHB.DST_ModeSelectGeneric.DST_TEMPMAN_THROTTLE "" VALUE 0x80606D44 DefaultValueRecordLayout_AUTOSAR_Platform_BaseTypes_uint8 102.0 RB_PT_PCT_SWC_DST_CompuMethods_ratio_0p4 0.0 102. FORMAT "%10.5"
 /begin ANNOTATION ANNOTATION_LABEL "Description (coming from AUTOSAR DESC field)" /begin ANNOTATION_TEXT "Throttle pedal to remain in temporary manual mode\r\n" /end ANNOTATION_TEXT /end ANNOTATION
/end CHARACTERISTIC
/begin CHARACTERISTIC DST_EFLASHB.DST_ModeSelectGeneric.DST_TEMPMAN_THROTTLEDOWNMARGIN "" VALUE 0x80606D14 DefaultValueRecordLayout_AUTOSAR_Platform_BaseTypes_uint16 110.0 RB_PT_PCT_SWC_DST_CompuMethods_ratio_0p1 0.0 110. FORMAT "%10.5"
 /begin ANNOTATION ANNOTATION_LABEL "Description (coming from AUTOSAR DESC field)"
  /begin ANNOTATION_TEXT "Subtract from throttle angle that will cause downshift - safety margin\r\n" /end ANNOTATION_TEXT
 /end ANNOTATION
/end CHARACTERISTIC
/begin CHARACTERISTIC DST_EFLASHB.DST_ModeSelectGeneric.DST_TEMPMANCANCELPTRAINMODECHNG "" VALUE 0x80606D42 DefaultValueRecordLayout_AUTOSAR_Platform_BaseTypes_boolean 255.0 AUTOSAR_Platform_CompuMethods_boolean 0.0 255. FORMAT "%10.5"
 /begin ANNOTATION ANNOTATION_LABEL "Description (coming from AUTOSAR DESC field)"
  /begin ANNOTATION_TEXT "If true, temporary manual will be cancelled if the powertrain mode is changed\r\n" /end ANNOTATION_TEXT
 /end ANNOTATION
/end CHARACTERISTIC
/begin CHARACTERISTIC DST_EFLASHB.DST_ModeSelectGeneric.DST_TEMPMANTAKEMAXTIMESTOPPED "" VALUE 0x80606D43 DefaultValueRecordLayout_AUTOSAR_Platform_BaseTypes_boolean 255.0 AUTOSAR_Platform_CompuMethods_boolean 0.0 255. FORMAT "%10.5"
 /begin ANNOTATION ANNOTATION_LABEL "Description (coming from AUTOSAR DESC field)"
  /begin ANNOTATION_TEXT "If true, when this condition is true to change the temp manual time remaining, it will take the max of current value and parameter.  If false, it will overwrite with parameter\r\n" /end ANNOTATION_TEXT
 /end ANNOTATION
/end CHARACTERISTIC
/begin CHARACTERISTIC DST_EFLASHB.DST_ModeSelectGeneric.DST_TEMPMANTIME_POSTDNSHIFT "" VALUE 0x80606D08 DefaultValueRecordLayout_AUTOSAR_Platform_BaseTypes_uint16 655.35 RB_PT_PCT_SWC_DST_CompuMethods_DST_Time 0.0 655.35 FORMAT "%10.5"
 /begin ANNOTATION ANNOTATION_LABEL "Description (coming from AUTOSAR DESC field)"
  /begin ANNOTATION_TEXT "Normal time in Temporary Manual after single manual shift\r\n" /end ANNOTATION_TEXT
 /end ANNOTATION
/end CHARACTERISTIC
/begin CHARACTERISTIC DST_EFLASHB.DST_ModeSelectGeneric.DST_TEMPMANTIME_POSTUPSHIFT "" VALUE 0x80606D0A DefaultValueRecordLayout_AUTOSAR_Platform_BaseTypes_uint16 655.35 RB_PT_PCT_SWC_DST_CompuMethods_DST_Time 0.0 655.35 FORMAT "%10.5"
 /begin ANNOTATION ANNOTATION_LABEL "Description (coming from AUTOSAR DESC field)"
  /begin ANNOTATION_TEXT "Normal time in Temporary Manual after single manual shift\r\n" /end ANNOTATION_TEXT
 /end ANNOTATION
/end CHARACTERISTIC
/begin CHARACTERISTIC DST_EFLASHB.DST_ModeSelectGeneric.DST_TEMPMANTIME_POSTWHENSTOPPED "" VALUE 0x80606D0C DefaultValueRecordLayout_AUTOSAR_Platform_BaseTypes_uint16 655.35 RB_PT_PCT_SWC_DST_CompuMethods_DST_Time 0.0 655.35 FORMAT "%10.5"
 /begin ANNOTATION ANNOTATION_LABEL "Description (coming from AUTOSAR DESC field)"
  /begin ANNOTATION_TEXT "Normal time in Temporary Manual after single manual shift\r\n" /end ANNOTATION_TEXT
 /end ANNOTATION
/end CHARACTERISTIC
/begin CHARACTERISTIC DST_EFLASHB.DST_ModeSelectGeneric.DST_TEMPMANTIMEMIN_LONGACC "" VALUE 0x80606D04 DefaultValueRecordLayout_AUTOSAR_Platform_BaseTypes_uint16 655.35 RB_PT_PCT_SWC_DST_CompuMethods_DST_Time 0.0 655.35 FORMAT "%10.5"
 /begin ANNOTATION ANNOTATION_LABEL "Description (coming from AUTOSAR DESC field)"
  /begin ANNOTATION_TEXT "Minimum value of temporary manual time remain if accelerating, decelerating or high throttle\r\n" /end ANNOTATION_TEXT
 /end ANNOTATION
/end CHARACTERISTIC
/begin CHARACTERISTIC DST_EFLASHB.DST_ModeSelectGeneric.DST_TEMPMANTIMEMIN_MAPDOWNSHIFT "" VALUE 0x80606D06 DefaultValueRecordLayout_AUTOSAR_Platform_BaseTypes_uint16 655.35 RB_PT_PCT_SWC_DST_CompuMethods_DST_Time 0.0 655.35 FORMAT "%10.5"
 /begin ANNOTATION ANNOTATION_LABEL "Description (coming from AUTOSAR DESC field)"
  /begin ANNOTATION_TEXT "Time to hold temp manual time to if the shift map would request a downshift\r\n" /end ANNOTATION_TEXT
 /end ANNOTATION
/end CHARACTERISTIC
/begin CHARACTERISTIC DST_EFLASHB.DST_ModeSelectGeneric.DST_TEMPMANTIMEMIN_POSTBRAKE "" VAL_BLK 0x806069C4 DefaultValueRecordLayout_AUTOSAR_Platform_BaseTypes_uint16 655.35 RB_PT_PCT_SWC_DST_CompuMethods_DST_Time 0.0 655.35 FORMAT "%10.5"
 /begin ANNOTATION ANNOTATION_LABEL "Description (coming from AUTOSAR DESC field)"
  /begin ANNOTATION_TEXT "Min time after the brake pedal is released to maintain temporary manual\r\n" /end ANNOTATION_TEXT
 /end ANNOTATION
 MATRIX_DIM 17 1 1 /end CHARACTERISTIC
/begin CHARACTERISTIC DST_EFLASHB.DST_ModeSelectGeneric.DST_TEMPMANTIMEMIN_POSTLATACC "" VAL_BLK 0x806069E6 DefaultValueRecordLayout_AUTOSAR_Platform_BaseTypes_uint16 655.35 RB_PT_PCT_SWC_DST_CompuMethods_DST_Time 0.0 655.35 FORMAT "%10.5"
 /begin ANNOTATION ANNOTATION_LABEL "Description (coming from AUTOSAR DESC field)"
  /begin ANNOTATION_TEXT "Min time after a corner for temporary manual mode to be maintained\r\n" /end ANNOTATION_TEXT
 /end ANNOTATION
 MATRIX_DIM 17 1 1 /end CHARACTERISTIC
/begin CHARACTERISTIC DST_EFLASHB.DST_ModeSelectGeneric.DST_TEMPMANTIMEMIN_POSTZEROTHROTTLE "" VAL_BLK 0x80606A08 DefaultValueRecordLayout_AUTOSAR_Platform_BaseTypes_uint16 655.35 RB_PT_PCT_SWC_DST_CompuMethods_DST_Time 0.0 655.35 FORMAT "%10.5"
 /begin ANNOTATION ANNOTATION_LABEL "Description (coming from AUTOSAR DESC field)"
  /begin ANNOTATION_TEXT "Min time after zero throttle that temp manual should be maintained\r\n" /end ANNOTATION_TEXT
 /end ANNOTATION
 MATRIX_DIM 17 1 1 /end CHARACTERISTIC
/begin CHARACTERISTIC DST_EFLASHB.DST_ModeSelectGeneric.DST_TIME_INNBRAKEHOLD "" VALUE 0x80606D20 DefaultValueRecordLayout_AUTOSAR_Platform_BaseTypes_uint16 655.35 RB_PT_PCT_SWC_DST_CompuMethods_DST_Time 0.0 655.35 FORMAT "%10.5"
 /begin ANNOTATION ANNOTATION_LABEL "Description (coming from AUTOSAR DESC field)"
  /begin ANNOTATION_TEXT "Time to hold the shift lock solenoid active when initially selecting Neutral\r\n" /end ANNOTATION_TEXT
 /end ANNOTATION
/end CHARACTERISTIC
/begin CHARACTERISTIC DST_EFLASHB.DST_ModeSelectGeneric.DST_TIMEB4SHIFTLOCKFWDMODE "" VALUE 0x80606D16 DefaultValueRecordLayout_AUTOSAR_Platform_BaseTypes_uint16 655.35 RB_PT_PCT_SWC_DST_CompuMethods_DST_Time 0.0 655.35 FORMAT "%10.5"
 /begin ANNOTATION ANNOTATION_LABEL "Description (coming from AUTOSAR DESC field)" /begin ANNOTATION_TEXT "Time in Neutral before the shift lock becomes active\r\n" /end ANNOTATION_TEXT /end ANNOTATION
/end CHARACTERISTIC
/begin CHARACTERISTIC DST_EFLASHB.DST_ModeSelectGeneric.DST_TIMEB4SHIFTLOCKREVMODE "" VALUE 0x80606D18 DefaultValueRecordLayout_AUTOSAR_Platform_BaseTypes_uint16 655.35 RB_PT_PCT_SWC_DST_CompuMethods_DST_Time 0.0 655.35 FORMAT "%10.5"
 /begin ANNOTATION ANNOTATION_LABEL "Description (coming from AUTOSAR DESC field)" /begin ANNOTATION_TEXT "TIme until shift lock is active when in reverse\r\n" /end ANNOTATION_TEXT /end ANNOTATION
/end CHARACTERISTIC
/begin CHARACTERISTIC DST_EFLASHB.DST_ModeSelectGeneric.DST_TIMEENGINESTOPPEDRESET "" VALUE 0x80606D1A DefaultValueRecordLayout_AUTOSAR_Platform_BaseTypes_uint16 655.35 RB_PT_PCT_SWC_DST_CompuMethods_DST_Time 0.0 655.35 FORMAT "%10.5"
 /begin ANNOTATION ANNOTATION_LABEL "Description (coming from AUTOSAR DESC field)"
  /begin ANNOTATION_TEXT "Time KL15 must be low for Eco to instantly be re-enabled\r\n" /end ANNOTATION_TEXT
 /end ANNOTATION
/end CHARACTERISTIC
/begin CHARACTERISTIC DST_EFLASHB.DST_ModeSelectGeneric.DST_TIMEENGRUNB44ROADDETECTENABLE "" VALUE 0x80606D1C DefaultValueRecordLayout_AUTOSAR_Platform_BaseTypes_uint16 655.35 RB_PT_PCT_SWC_DST_CompuMethods_DST_Time 0.0 655.35 FORMAT "%10.5"
 /begin ANNOTATION ANNOTATION_LABEL "Description (coming from AUTOSAR DESC field)"
  /begin ANNOTATION_TEXT "Time engine must have been running before the road detect timers are allowed to increase\r\n" /end ANNOTATION_TEXT
 /end ANNOTATION
/end CHARACTERISTIC
/begin CHARACTERISTIC DST_EFLASHB.DST_ModeSelectGeneric.DST_TIMEKL15LOW2RESET "" VALUE 0x80606D1E DefaultValueRecordLayout_AUTOSAR_Platform_BaseTypes_uint16 655.35 RB_PT_PCT_SWC_DST_CompuMethods_DST_Time 0.0 655.35 FORMAT "%10.5"
 /begin ANNOTATION ANNOTATION_LABEL "Description (coming from AUTOSAR DESC field)"
  /begin ANNOTATION_TEXT "Time KL15 must be low for Eco to instantly be re-enabled\r\n" /end ANNOTATION_TEXT
 /end ANNOTATION
/end CHARACTERISTIC
/begin CHARACTERISTIC DST_EFLASHB.DST_ModeSelectGeneric.DST_TRANSTEMPOVERHEATRESET "" VALUE 0x80606D22 DefaultValueRecordLayout_AUTOSAR_Platform_BaseTypes_sint16 250.0 RB_PT_PCT_SWC_DST_CompuMethods_ident -50. 200. FORMAT "%10.5"
 /begin ANNOTATION ANNOTATION_LABEL "Description (coming from AUTOSAR DESC field)"
  /begin ANNOTATION_TEXT "Transmission bulk oil temperature to cancel the transmission overheat strategy\r\n" /end ANNOTATION_TEXT
 /end ANNOTATION
/end CHARACTERISTIC
/begin CHARACTERISTIC DST_EFLASHB.DST_ModeSelectGeneric.DST_TRANSTEMPOVERHEATSET "" VALUE 0x80606D24 DefaultValueRecordLayout_AUTOSAR_Platform_BaseTypes_sint16 250.0 RB_PT_PCT_SWC_DST_CompuMethods_ident -50. 200. FORMAT "%10.5"
 /begin ANNOTATION ANNOTATION_LABEL "Description (coming from AUTOSAR DESC field)"
  /begin ANNOTATION_TEXT "Transmission bulk oil temperature to trigger the transmission overheat strategy\r\n" /end ANNOTATION_TEXT
 /end ANNOTATION
/end CHARACTERISTIC
/begin CHARACTERISTIC DST_EFLASHB.DST_ModeSelectGeneric.DST_VEHICLESPEED4DOWNPADDLEENGAGE "" VALUE 0x80606D26 DefaultValueRecordLayout_AUTOSAR_Platform_BaseTypes_uint16 500.0 RB_PT_PCT_SWC_DST_CompuMethods_kph_0p1 0.0 500. FORMAT "%10.5"
 /begin ANNOTATION ANNOTATION_LABEL "Description (coming from AUTOSAR DESC field)"
  /begin ANNOTATION_TEXT "Vehicle speed above which the downshift paddle will engage a forward gear from Neutral\r\n" /end ANNOTATION_TEXT
 /end ANNOTATION
/end CHARACTERISTIC
/begin CHARACTERISTIC DST_EFLASHB.DST_ModeSelectGeneric.DST_VEHICLESPEED4UPPADDLEENGAGE "" VALUE 0x80606D28 DefaultValueRecordLayout_AUTOSAR_Platform_BaseTypes_uint16 500.0 RB_PT_PCT_SWC_DST_CompuMethods_kph_0p1 0.0 500. FORMAT "%10.5"
 /begin ANNOTATION ANNOTATION_LABEL "Description (coming from AUTOSAR DESC field)"
  /begin ANNOTATION_TEXT "Vehicle speed must be equal to or above this value to allow up-paddle to engage Drive\r\n" /end ANNOTATION_TEXT
 /end ANNOTATION
/end CHARACTERISTIC
/begin CHARACTERISTIC DST_EFLASHB.DST_ModeSelectGeneric.DST_VEHICLESPEEDMAINTAINTEMPMAN "" VALUE 0x80606D2A DefaultValueRecordLayout_AUTOSAR_Platform_BaseTypes_uint16 500.0 RB_PT_PCT_SWC_DST_CompuMethods_kph_0p1 0.0 500. FORMAT "%10.5"
 /begin ANNOTATION ANNOTATION_LABEL "Description (coming from AUTOSAR DESC field)"
  /begin ANNOTATION_TEXT "Vehicle speed below which the Temp Manual timer will be reset\r\n" /end ANNOTATION_TEXT
 /end ANNOTATION
/end CHARACTERISTIC
/begin CHARACTERISTIC DST_EFLASHB.DST_ModeSelectGeneric.DST_WARMUPBASEDONOIL "" VALUE 0x80606D45 DefaultValueRecordLayout_AUTOSAR_Platform_BaseTypes_boolean 255.0 AUTOSAR_Platform_CompuMethods_boolean 0.0 255. FORMAT "%10.5"
 /begin ANNOTATION ANNOTATION_LABEL "Description (coming from AUTOSAR DESC field)"
  /begin ANNOTATION_TEXT "If true, the warmup temperature thresholds will be compare to engine oil, not coolant temperature\r\n" /end ANNOTATION_TEXT
 /end ANNOTATION
/end CHARACTERISTIC
/begin CHARACTERISTIC DST_EFLASHB.DST_ModeSelectGeneric.DST_WARMUPENGINE_CANCEL "" VAL_BLK 0x80606CA0 DefaultValueRecordLayout_AUTOSAR_Platform_BaseTypes_sint16 255.0 RB_PT_PCT_SWC_DST_CompuMethods_ident -60. 195. FORMAT "%10.5"
 /begin ANNOTATION ANNOTATION_LABEL "Description (coming from AUTOSAR DESC field)"
  /begin ANNOTATION_TEXT "Engine tempertuare above which  the warmup will be cancelled\r\n" /end ANNOTATION_TEXT
 /end ANNOTATION
 MATRIX_DIM 6 1 1 /end CHARACTERISTIC
/begin CHARACTERISTIC DST_EFLASHB.DST_ModeSelectGeneric.DST_WARMUPENGINE_MAXTIME "" VAL_BLK 0x80606CAC DefaultValueRecordLayout_AUTOSAR_Platform_BaseTypes_uint16 655.35 RB_PT_PCT_SWC_DST_CompuMethods_DST_Time 0.0 655.35 FORMAT "%10.5"
 /begin ANNOTATION ANNOTATION_LABEL "Description (coming from AUTOSAR DESC field)" /begin ANNOTATION_TEXT "Maximum time the warmup strategy can be active\r\n" /end ANNOTATION_TEXT /end ANNOTATION
 MATRIX_DIM 6 1 1 /end CHARACTERISTIC
/begin CHARACTERISTIC DST_EFLASHB.DST_ModeSelectGeneric.DST_WARMUPENGINE_TRIGGER "" VAL_BLK 0x80606CB8 DefaultValueRecordLayout_AUTOSAR_Platform_BaseTypes_sint16 255.0 RB_PT_PCT_SWC_DST_CompuMethods_ident -60. 195. FORMAT "%10.5"
 /begin ANNOTATION ANNOTATION_LABEL "Description (coming from AUTOSAR DESC field)"
  /begin ANNOTATION_TEXT "Engine temperature below which a warm-up will be requested\r\n" /end ANNOTATION_TEXT
 /end ANNOTATION
 MATRIX_DIM 6 1 1 /end CHARACTERISTIC
/begin CHARACTERISTIC DST_EFLASHB.DST_ModeSelectGeneric.DST_WARMUPTRANSCANCEL "" VALUE 0x80606D2C DefaultValueRecordLayout_AUTOSAR_Platform_BaseTypes_sint16 250.0 RB_PT_PCT_SWC_DST_CompuMethods_ident -50. 200. FORMAT "%10.5"
 /begin ANNOTATION ANNOTATION_LABEL "Description (coming from AUTOSAR DESC field)"
  /begin ANNOTATION_TEXT "Temperature above which the transmission will not request warmup mode\r\n" /end ANNOTATION_TEXT
 /end ANNOTATION
/end CHARACTERISTIC
/begin CHARACTERISTIC DST_EFLASHB.DST_ModeSelectGeneric.DST_WARMUPTRANSTRIGGER "" VALUE 0x80606D2E DefaultValueRecordLayout_AUTOSAR_Platform_BaseTypes_sint16 250.0 RB_PT_PCT_SWC_DST_CompuMethods_ident -50. 200. FORMAT "%10.5"
 /begin ANNOTATION ANNOTATION_LABEL "Description (coming from AUTOSAR DESC field)"
  /begin ANNOTATION_TEXT "Temperature below which transmission will request warmup mode\r\n" /end ANNOTATION_TEXT
 /end ANNOTATION
/end CHARACTERISTIC
/begin CHARACTERISTIC DST_EFLASHB.DST_PSG.DST_DISABLEPRESELECTFWDGEARS "" VAL_BLK 0x80606E6E DefaultValueRecordLayout_AUTOSAR_Platform_BaseTypes_boolean 255.0 AUTOSAR_Platform_CompuMethods_boolean 0.0 255. FORMAT "%10.5"
 /begin ANNOTATION ANNOTATION_LABEL "Description (coming from AUTOSAR DESC field)"
  /begin ANNOTATION_TEXT "If set true for the appropriate shift mode, preselect gear will be disabled (set to 0)\r\n" /end ANNOTATION_TEXT
 /end ANNOTATION
 MATRIX_DIM 17 1 1 /end CHARACTERISTIC
/begin CHARACTERISTIC DST_EFLASHB.DST_PSG.DST_DISABLEPRESELECTWITHFAILEDGEAR "" VALUE 0x80606F06 DefaultValueRecordLayout_AUTOSAR_Platform_BaseTypes_boolean 255.0 AUTOSAR_Platform_CompuMethods_boolean 0.0 255. FORMAT "%10.5"
 /begin ANNOTATION ANNOTATION_LABEL "Description (coming from AUTOSAR DESC field)"
  /begin ANNOTATION_TEXT "If true, no gears will be preselected if a single gear has failed\r\n" /end ANNOTATION_TEXT
 /end ANNOTATION
/end CHARACTERISTIC
/begin CHARACTERISTIC DST_EFLASHB.DST_PSG.DST_DONTPREDOWNROLLOUTCLUNK "" VALUE 0x80606F07 DefaultValueRecordLayout_AUTOSAR_Platform_BaseTypes_boolean 255.0 AUTOSAR_Platform_CompuMethods_boolean 0.0 255. FORMAT "%10.5"
 /begin ANNOTATION ANNOTATION_LABEL "Description (coming from AUTOSAR DESC field)"
  /begin ANNOTATION_TEXT "Flag, if true, disable preselecting 1st when 2nd is engaged to prevent rollout clunk as 1st gear engages\r\n" /end ANNOTATION_TEXT
 /end ANNOTATION
/end CHARACTERISTIC
/begin CHARACTERISTIC DST_EFLASHB.DST_PSG.DST_MINRPMB4THROTTLECANCELSHUTTLE "" VALUE 0x80606ED4 DefaultValueRecordLayout_AUTOSAR_Platform_BaseTypes_uint16 20000.0 RB_PT_PCT_SWC_DST_CompuMethods_ident 0.0 20000. FORMAT "%10.5"
 /begin ANNOTATION ANNOTATION_LABEL "Description (coming from AUTOSAR DESC field)"
  /begin ANNOTATION_TEXT "Minimum engine speed before the throttle pedal will cancel shutting (prevents throttle press when engine off cancelling shuttling)\r\n" /end ANNOTATION_TEXT
 /end ANNOTATION
/end CHARACTERISTIC
/begin CHARACTERISTIC DST_EFLASHB.DST_PSG.DST_PRE4REVERSE "" VALUE 0x80606F08 DefaultValueRecordLayout_AUTOSAR_Platform_BaseTypes_uint8 11.0 RB_PT_PCT_SWC_DST_CompuMethods_ident 0.0 11. FORMAT "%10.5"
 /begin ANNOTATION ANNOTATION_LABEL "Description (coming from AUTOSAR DESC field)"
  /begin ANNOTATION_TEXT "Gear to be preselected when reverse is the demand gear\r\n" /end ANNOTATION_TEXT
 /end ANNOTATION
/end CHARACTERISTIC
/begin CHARACTERISTIC DST_EFLASHB.DST_PSG.DST_PREDN_ABOUT2UPSHIFTCANCELTIME "" VALUE 0x80606EE2 DefaultValueRecordLayout_AUTOSAR_Platform_BaseTypes_uint16 655.35 RB_PT_PCT_SWC_DST_CompuMethods_DST_Time 0.0 655.35 FORMAT "%10.5"
 /begin ANNOTATION ANNOTATION_LABEL "Description (coming from AUTOSAR DESC field)" /begin ANNOTATION_TEXT "Time since preup set conditions true\r\n" /end ANNOTATION_TEXT /end ANNOTATION
/end CHARACTERISTIC
/begin CHARACTERISTIC DST_EFLASHB.DST_PSG.DST_PREDN_ONTHROTTLEMAXTIME "" VALUE 0x80606EE4 DefaultValueRecordLayout_AUTOSAR_Platform_BaseTypes_uint16 655.35 RB_PT_PCT_SWC_DST_CompuMethods_DST_Time 0.0 655.35 FORMAT "%10.5"
 /begin ANNOTATION ANNOTATION_LABEL "Description (coming from AUTOSAR DESC field)"
  /begin ANNOTATION_TEXT "Maximum time on throttle before DST_PreDn_OffTHrottle is cancelled\r\n" /end ANNOTATION_TEXT
 /end ANNOTATION
/end CHARACTERISTIC
/begin CHARACTERISTIC DST_EFLASHB.DST_PSG.DST_PREDNABOUT2SHIFT "" VALUE 0x80606F09 DefaultValueRecordLayout_AUTOSAR_Platform_BaseTypes_uint8 255.0 RB_PT_PCT_SWC_DST_CompuMethods_ident 0.0 255. FORMAT "%10.5"
 /begin ANNOTATION ANNOTATION_LABEL "Description (coming from AUTOSAR DESC field)"
  /begin ANNOTATION_TEXT "Preselect priority for preselect down request due to time to shift\r\n" /end ANNOTATION_TEXT
 /end ANNOTATION
/end CHARACTERISTIC
/begin CHARACTERISTIC DST_EFLASHB.DST_PSG.DST_PREDNABOVEIDLESET "" VAL_BLK 0x80606E08 DefaultValueRecordLayout_AUTOSAR_Platform_BaseTypes_uint16 20000.0 RB_PT_PCT_SWC_DST_CompuMethods_ident 0.0 20000. FORMAT "%10.5"
 /begin ANNOTATION ANNOTATION_LABEL "Description (coming from AUTOSAR DESC field)"
  /begin ANNOTATION_TEXT "Rpm above idle speed to set the low revs preselect logic\r\n" /end ANNOTATION_TEXT
 /end ANNOTATION
 MATRIX_DIM 17 1 1 /end CHARACTERISTIC
/begin CHARACTERISTIC DST_EFLASHB.DST_PSG.DST_PREDNABOVELIMITENABLE "" VALUE 0x80606ED6 DefaultValueRecordLayout_AUTOSAR_Platform_BaseTypes_sint16 20000.0 RB_PT_PCT_SWC_DST_CompuMethods_DST_Ident 0.0 20000. FORMAT "%10.5"
 /begin ANNOTATION ANNOTATION_LABEL "Description (coming from AUTOSAR DESC field)"
  /begin ANNOTATION_TEXT "Engine speed above the Engine speed limit to enable preselect\r\n" /end ANNOTATION_TEXT
 /end ANNOTATION
/end CHARACTERISTIC
/begin CHARACTERISTIC DST_EFLASHB.DST_PSG.DST_PREDNABOVELIMITUPPERLIMIT "" VALUE 0x80606ED8 DefaultValueRecordLayout_AUTOSAR_Platform_BaseTypes_sint16 20000.0 RB_PT_PCT_SWC_DST_CompuMethods_DST_Ident 0.0 20000. FORMAT "%10.5"
 /begin ANNOTATION ANNOTATION_LABEL "Description (coming from AUTOSAR DESC field)"
  /begin ANNOTATION_TEXT "Engine speed above the Engine speed limit to enable preselect\r\n" /end ANNOTATION_TEXT
 /end ANNOTATION
/end CHARACTERISTIC
/begin CHARACTERISTIC DST_EFLASHB.DST_PSG.DST_PREDNDECEL "" VALUE 0x80606F0A DefaultValueRecordLayout_AUTOSAR_Platform_BaseTypes_uint8 255.0 RB_PT_PCT_SWC_DST_CompuMethods_ident 0.0 255. FORMAT "%10.5"
 /begin ANNOTATION ANNOTATION_LABEL "Description (coming from AUTOSAR DESC field)"
  /begin ANNOTATION_TEXT "Preselect priority for preselect down request due deceleration being active\r\n" /end ANNOTATION_TEXT
 /end ANNOTATION
/end CHARACTERISTIC
/begin CHARACTERISTIC DST_EFLASHB.DST_PSG.DST_PREDNHALFPULLDNPAD "" VALUE 0x80606F0B DefaultValueRecordLayout_AUTOSAR_Platform_BaseTypes_uint8 255.0 RB_PT_PCT_SWC_DST_CompuMethods_ident 0.0 255. FORMAT "%10.5"
 /begin ANNOTATION ANNOTATION_LABEL "Description (coming from AUTOSAR DESC field)"
  /begin ANNOTATION_TEXT "Preselect down priority if the two stage down-shift paddle is half pulled\r\n" /end ANNOTATION_TEXT
 /end ANNOTATION
/end CHARACTERISTIC
/begin CHARACTERISTIC DST_EFLASHB.DST_PSG.DST_PREDNJUSTDOWNSHIFTED "" VAL_BLK 0x80606E7F DefaultValueRecordLayout_AUTOSAR_Platform_BaseTypes_uint8 255.0 RB_PT_PCT_SWC_DST_CompuMethods_ident 0.0 255. FORMAT "%10.5"
 /begin ANNOTATION ANNOTATION_LABEL "Description (coming from AUTOSAR DESC field)"
  /begin ANNOTATION_TEXT "Allows the next lower preselect gear to be enabled based on the driving mode if the transmission has just downshifted\r\n" /end ANNOTATION_TEXT
 /end ANNOTATION
 MATRIX_DIM 17 1 1 /end CHARACTERISTIC
/begin CHARACTERISTIC DST_EFLASHB.DST_PSG.DST_PREDNLOWREVS "" VALUE 0x80606F0C DefaultValueRecordLayout_AUTOSAR_Platform_BaseTypes_uint8 255.0 RB_PT_PCT_SWC_DST_CompuMethods_ident 0.0 255. FORMAT "%10.5"
 /begin ANNOTATION ANNOTATION_LABEL "Description (coming from AUTOSAR DESC field)"
  /begin ANNOTATION_TEXT "Preselect priority for preselect down request due to low input shaft speed\r\n" /end ANNOTATION_TEXT
 /end ANNOTATION
/end CHARACTERISTIC
/begin CHARACTERISTIC DST_EFLASHB.DST_PSG.DST_PREDNLOWRPMHYST "" VALUE 0x80606EDA DefaultValueRecordLayout_AUTOSAR_Platform_BaseTypes_sint16 20000.0 RB_PT_PCT_SWC_DST_CompuMethods_DST_Ident 0.0 20000. FORMAT "%10.5"
 /begin ANNOTATION ANNOTATION_LABEL "Description (coming from AUTOSAR DESC field)"
  /begin ANNOTATION_TEXT "Input speed above which a downshift is not possible and an upshift is immenant (probably)\r\n" /end ANNOTATION_TEXT
 /end ANNOTATION
/end CHARACTERISTIC
/begin CHARACTERISTIC DST_EFLASHB.DST_PSG.DST_PREDNMAXRPMBELOWPRELIMIT "" VALUE 0x80606EDC DefaultValueRecordLayout_AUTOSAR_Platform_BaseTypes_sint16 20000.0 RB_PT_PCT_SWC_DST_CompuMethods_DST_Ident 0.0 20000. FORMAT "%10.5"
 /begin ANNOTATION ANNOTATION_LABEL "Description (coming from AUTOSAR DESC field)"
  /begin ANNOTATION_TEXT "Rpm below DST_PreDownRpmLimit to allow preselection of the next lowest gear\r\n" /end ANNOTATION_TEXT
 /end ANNOTATION
/end CHARACTERISTIC
/begin CHARACTERISTIC DST_EFLASHB.DST_PSG.DST_PREDNOFFTHROTTLE "" VAL_BLK 0x80606E90 DefaultValueRecordLayout_AUTOSAR_Platform_BaseTypes_uint8 255.0 RB_PT_PCT_SWC_DST_CompuMethods_ident 0.0 255. FORMAT "%10.5"
 /begin ANNOTATION ANNOTATION_LABEL "Description (coming from AUTOSAR DESC field)"
  /begin ANNOTATION_TEXT "Priority for preselect down when off throttle, based on shiftmode\r\n" /end ANNOTATION_TEXT
 /end ANNOTATION
 MATRIX_DIM 17 1 1 /end CHARACTERISTIC
/begin CHARACTERISTIC DST_EFLASHB.DST_PSG.DST_PREDNOFFTHROTTLECANCEL "" VALUE 0x80606F0D DefaultValueRecordLayout_AUTOSAR_Platform_BaseTypes_uint8 102.0 RB_PT_PCT_SWC_DST_CompuMethods_ratio_0p4 0.0 102. FORMAT "%10.5"
 /begin ANNOTATION ANNOTATION_LABEL "Description (coming from AUTOSAR DESC field)"
  /begin ANNOTATION_TEXT "Above this throttle angle, DST_PreDn_OffTHrottle will be set to 0\r\n" /end ANNOTATION_TEXT
 /end ANNOTATION
/end CHARACTERISTIC
/begin CHARACTERISTIC DST_EFLASHB.DST_PSG.DST_PREDNOFFTHROTTLECANCELDEBOUNCE "" VALUE 0x80606F0E DefaultValueRecordLayout_AUTOSAR_Platform_BaseTypes_uint8 102.0 RB_PT_PCT_SWC_DST_CompuMethods_ratio_0p4 0.0 102. FORMAT "%10.5"
 /begin ANNOTATION ANNOTATION_LABEL "Description (coming from AUTOSAR DESC field)"
  /begin ANNOTATION_TEXT "Throttle pedal above which on throttle timer will increase\r\n" /end ANNOTATION_TEXT
 /end ANNOTATION
/end CHARACTERISTIC
/begin CHARACTERISTIC DST_EFLASHB.DST_PSG.DST_PREDNOFFTHROTTLECANCELUPSHIFT "" VALUE 0x80606F0F DefaultValueRecordLayout_AUTOSAR_Platform_BaseTypes_uint8 102.0 RB_PT_PCT_SWC_DST_CompuMethods_ratio_0p4 0.0 102. FORMAT "%10.5"
 /begin ANNOTATION ANNOTATION_LABEL "Description (coming from AUTOSAR DESC field)"
  /begin ANNOTATION_TEXT "Throttle pedal equal to and above this will set PreDn_OffThrottle to zero if IOP_UphiftPreFill is true\r\n" /end ANNOTATION_TEXT
 /end ANNOTATION
/end CHARACTERISTIC
/begin CHARACTERISTIC DST_EFLASHB.DST_PSG.DST_PREDNOFFTHROTTLESET "" VALUE 0x80606F10 DefaultValueRecordLayout_AUTOSAR_Platform_BaseTypes_uint8 102.0 RB_PT_PCT_SWC_DST_CompuMethods_ratio_0p4 0.0 102. FORMAT "%10.5"
 /begin ANNOTATION ANNOTATION_LABEL "Description (coming from AUTOSAR DESC field)"
  /begin ANNOTATION_TEXT "Below this threshold is considered off throttle, 0% = Disable function\r\n" /end ANNOTATION_TEXT
 /end ANNOTATION
/end CHARACTERISTIC
/begin CHARACTERISTIC DST_EFLASHB.DST_PSG.DST_PREDNPRECOGHIGHTHROTTLESET "" VALUE 0x80606F11 DefaultValueRecordLayout_AUTOSAR_Platform_BaseTypes_uint8 102.0 RB_PT_PCT_SWC_DST_CompuMethods_ratio_0p4 0.0 102. FORMAT "%10.5"
 /begin ANNOTATION ANNOTATION_LABEL "Description (coming from AUTOSAR DESC field)"
  /begin ANNOTATION_TEXT "Percentage above which pre-cof is cancelled as soon as the paddle is released\r\n" /end ANNOTATION_TEXT
 /end ANNOTATION
/end CHARACTERISTIC
/begin CHARACTERISTIC DST_EFLASHB.DST_PSG.DST_PREDNPRECOGLOWTHROTTLESET "" VALUE 0x80606F12 DefaultValueRecordLayout_AUTOSAR_Platform_BaseTypes_uint8 102.0 RB_PT_PCT_SWC_DST_CompuMethods_ratio_0p4 0.0 102. FORMAT "%10.5"
 /begin ANNOTATION ANNOTATION_LABEL "Description (coming from AUTOSAR DESC field)" /begin ANNOTATION_TEXT "Throttle pedal threshold when precog downshift set\r\n" /end ANNOTATION_TEXT /end ANNOTATION
/end CHARACTERISTIC
/begin CHARACTERISTIC DST_EFLASHB.DST_PSG.DST_PREDNPRECOGTHROTTLECANCEL "" VALUE 0x80606F13 DefaultValueRecordLayout_AUTOSAR_Platform_BaseTypes_uint8 102.0 RB_PT_PCT_SWC_DST_CompuMethods_ratio_0p4 0.0 102. FORMAT "%10.5"
 /begin ANNOTATION ANNOTATION_LABEL "Description (coming from AUTOSAR DESC field)"
  /begin ANNOTATION_TEXT "At or below this threshold, the precog down function is cancelled\r\n" /end ANNOTATION_TEXT
 /end ANNOTATION
/end CHARACTERISTIC
/begin CHARACTERISTIC DST_EFLASHB.DST_PSG.DST_PREDNPWROFFRPMCANCEL "" VALUE 0x80606EDE DefaultValueRecordLayout_AUTOSAR_Platform_BaseTypes_sint16 20000.0 RB_PT_PCT_SWC_DST_CompuMethods_DST_Ident 0.0 20000. FORMAT "%10.5"
 /begin ANNOTATION ANNOTATION_LABEL "Description (coming from AUTOSAR DESC field)"
  /begin ANNOTATION_TEXT "Engine speed in the current gear to allow the preselection of the lower gear\r\n" /end ANNOTATION_TEXT
 /end ANNOTATION
/end CHARACTERISTIC
/begin CHARACTERISTIC DST_EFLASHB.DST_PSG.DST_PREDNPWROFFRPMSET "" VALUE 0x80606EE0 DefaultValueRecordLayout_AUTOSAR_Platform_BaseTypes_sint16 20000.0 RB_PT_PCT_SWC_DST_CompuMethods_DST_Ident 0.0 20000. FORMAT "%10.5"
 /begin ANNOTATION ANNOTATION_LABEL "Description (coming from AUTOSAR DESC field)"
  /begin ANNOTATION_TEXT "Engine speed in the current gear to allow the preselection of the lower gear\r\n" /end ANNOTATION_TEXT
 /end ANNOTATION
/end CHARACTERISTIC
/begin CHARACTERISTIC DST_EFLASHB.DST_PSG.DST_PREDNPWROFFTHROTTLEPCANCEL "" VALUE 0x80606F14 DefaultValueRecordLayout_AUTOSAR_Platform_BaseTypes_uint8 102.0 RB_PT_PCT_SWC_DST_CompuMethods_ratio_0p4 0.0 102. FORMAT "%10.5"
 /begin ANNOTATION ANNOTATION_LABEL "Description (coming from AUTOSAR DESC field)"
  /begin ANNOTATION_TEXT "THrottle angle below which the power off down preselect is set\r\n" /end ANNOTATION_TEXT
 /end ANNOTATION
/end CHARACTERISTIC
/end MODULE
/end PROJECT
