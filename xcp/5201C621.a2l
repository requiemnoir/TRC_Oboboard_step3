/*-- Generated by A2L Merger 4.8.2 --*/
/* Created by DAMOS++ V5.8.24 Win10 */
ASAP2_VERSION 1 60
/begin PROJECT LB74x_TCU "5201C621"
/begin HEADER "" VERSION "5201C621" PROJECT_NO LB74x_TCU /end HEADER
/begin MODULE DIM ""
/begin MOD_PAR "5201C621" VERSION "5201C621" ADDR_EPK 0x80600278 EPK "37/1/TDG19p80/0/OX005540//5201C621///" CUSTOMER_NO "0" USER "" PHONE_NO "" ECU "TDG19p80" CPU_TYPE "IFX"
 /begin MEMORY_SEGMENT Pst80000000 "" RESERVED FLASH INTERN 0x80000000 0x20 -1 -1 -1 -1 -1 /end MEMORY_SEGMENT
 /begin MEMORY_SEGMENT Pst80000020 "" RESERVED FLASH INTERN 0x80000020 0xFFE0 -1 -1 -1 -1 -1 /end MEMORY_SEGMENT
 /begin MEMORY_SEGMENT Pst80010000 "" RESERVED FLASH INTERN 0x80010000 0x8000 -1 -1 -1 -1 -1 /end MEMORY_SEGMENT
 /begin MEMORY_SEGMENT Pst8001C000 "" RESERVED FLASH INTERN 0x8001C000 0x24000 -1 -1 -1 -1 -1 /end MEMORY_SEGMENT
 /begin MEMORY_SEGMENT Pst80058000 "" RESERVED FLASH INTERN 0x80058000 0x8000 -1 -1 -1 -1 -1 /end MEMORY_SEGMENT
 /begin MEMORY_SEGMENT Pst80080000 "" CODE FLASH INTERN 0x80080000 0x21FAE0 -1 -1 -1 -1 -1
  /begin IF_DATA ETK_XETK
   /begin ETK_XETK_ACCESS SERIAL_INTERFACE /end ETK_XETK_ACCESS
  /end IF_DATA
  /begin IF_DATA XCPplus 0x0102
   /begin SEGMENT 0 0x01 0x00 0x00 0x00 /begin CHECKSUM XCP_CRC_32 MAX_BLOCK_SIZE 0xFFFFFFFF /end CHECKSUM
    /begin PAGE 0x00 ECU_ACCESS_WITH_XCP_ONLY XCP_READ_ACCESS_WITH_ECU_ONLY XCP_WRITE_ACCESS_NOT_ALLOWED /end PAGE
   /end SEGMENT
  /end IF_DATA
 /end MEMORY_SEGMENT
 /begin MEMORY_SEGMENT Pst8029FAE0 "" RESERVED FLASH INTERN 0x8029FAE0 0x520 -1 -1 -1 -1 -1 /end MEMORY_SEGMENT
 /begin MEMORY_SEGMENT Pst80404000 "" CODE FLASH INTERN 0x80404000 0xBAE0 -1 -1 -1 -1 -1
  /begin IF_DATA ETK_XETK
   /begin ETK_XETK_ACCESS SERIAL_INTERFACE /end ETK_XETK_ACCESS
  /end IF_DATA
  /begin IF_DATA XCPplus 0x0102
   /begin SEGMENT 1 0x01 0x00 0x00 0x00 /begin CHECKSUM XCP_CRC_32 MAX_BLOCK_SIZE 0xFFFFFFFF /end CHECKSUM
    /begin PAGE 0x00 ECU_ACCESS_WITH_XCP_ONLY XCP_READ_ACCESS_WITH_ECU_ONLY XCP_WRITE_ACCESS_NOT_ALLOWED /end PAGE
   /end SEGMENT
  /end IF_DATA
 /end MEMORY_SEGMENT
 /begin MEMORY_SEGMENT Pst8040FAE0 "" RESERVED FLASH INTERN 0x8040FAE0 0x520 -1 -1 -1 -1 -1 /end MEMORY_SEGMENT
 /begin MEMORY_SEGMENT Pst8063FAE0 "" RESERVED FLASH INTERN 0x8063FAE0 0x520 -1 -1 -1 -1 -1
  /begin IF_DATA ETK_XETK WRITE_AT_DATA_UPDATE USE_FILE ETK_XETK_REF 1 2 3 4 /end IF_DATA
 /end MEMORY_SEGMENT
 /begin MEMORY_SEGMENT Pst80018000 "" RESERVED FLASH INTERN 0x80018000 0x100 -1 -1 -1 -1 -1 /end MEMORY_SEGMENT
 /begin MEMORY_SEGMENT Pst80018100 "" RESERVED FLASH INTERN 0x80018100 0x3F00 -1 -1 -1 -1 -1 /end MEMORY_SEGMENT
 /begin MEMORY_SEGMENT Pst80060000 "" RESERVED FLASH INTERN 0x80060000 0x100 -1 -1 -1 -1 -1 /end MEMORY_SEGMENT
 /begin MEMORY_SEGMENT Pst80060100 "" RESERVED FLASH INTERN 0x80060100 0x1FF00 -1 -1 -1 -1 -1 /end MEMORY_SEGMENT
 /begin MEMORY_SEGMENT Dst80600000 "" DATA FLASH INTERN 0x80600000 0x3FAE0 -1 -1 -1 -1 -1
  /begin IF_DATA ETK_XETK
   /begin ETK_XETK_ACCESS SERIAL_INTERFACE /end ETK_XETK_ACCESS
  /end IF_DATA
  /begin IF_DATA XCPplus 0x0102
   /begin SEGMENT 2 0x02 0x00 0x00 0x00 /begin CHECKSUM XCP_CRC_32 MAX_BLOCK_SIZE 0xFFFFFFFF /end CHECKSUM
    /begin PAGE 0x00 ECU_ACCESS_DONT_CARE XCP_READ_ACCESS_DONT_CARE XCP_WRITE_ACCESS_NOT_ALLOWED /end PAGE
    /begin PAGE 0x01 ECU_ACCESS_DONT_CARE XCP_READ_ACCESS_DONT_CARE XCP_WRITE_ACCESS_WITH_ECU_ONLY /end PAGE
   /end SEGMENT
  /end IF_DATA
 /end MEMORY_SEGMENT
 /begin MEMORY_SEGMENT RamAFE70000 "" VARIABLES RAM INTERN 0xAFE70000 0x8000 -1 -1 -1 -1 -1
  /begin IF_DATA ETK_XETK
   /begin ETK_XETK_ACCESS SERIAL_INTERFACE /end ETK_XETK_ACCESS
  /end IF_DATA
  /begin IF_DATA XCPplus 0x0102
   /begin SEGMENT 3 0x00 0x00 0x00 0x00 /end SEGMENT
  /end IF_DATA
 /end MEMORY_SEGMENT
 /begin MEMORY_SEGMENT RamB0000000 "" VARIABLES RAM INTERN 0xB0000000 0x8000 -1 -1 -1 -1 -1
  /begin IF_DATA ETK_XETK
   /begin ETK_XETK_ACCESS SERIAL_INTERFACE /end ETK_XETK_ACCESS
  /end IF_DATA
  /begin IF_DATA XCPplus 0x0102
   /begin SEGMENT 4 0x00 0x00 0x00 0x00 /end SEGMENT
  /end IF_DATA
 /end MEMORY_SEGMENT
 /begin MEMORY_SEGMENT Ram70100000 "" VARIABLES RAM INTERN 0x70100000 0x8000 -1 -1 -1 -1 -1
  /begin IF_DATA ETK_XETK
   /begin ETK_XETK_ACCESS SERIAL_INTERFACE /end ETK_XETK_ACCESS
  /end IF_DATA
  /begin IF_DATA XCPplus 0x0102
   /begin SEGMENT 5 0x00 0x00 0x00 0x00 /end SEGMENT
  /end IF_DATA
 /end MEMORY_SEGMENT
 /begin MEMORY_SEGMENT Ram60100000 "" VARIABLES RAM INTERN 0x60100000 0x8000 -1 -1 -1 -1 -1
  /begin IF_DATA ETK_XETK
   /begin ETK_XETK_ACCESS SERIAL_INTERFACE /end ETK_XETK_ACCESS
  /end IF_DATA
  /begin IF_DATA XCPplus 0x0102
   /begin SEGMENT 6 0x00 0x00 0x00 0x00 /end SEGMENT
  /end IF_DATA
 /end MEMORY_SEGMENT
 /begin MEMORY_SEGMENT Ram50100000 "" VARIABLES RAM INTERN 0x50100000 0x8000 -1 -1 -1 -1 -1
  /begin IF_DATA ETK_XETK
   /begin ETK_XETK_ACCESS SERIAL_INTERFACE /end ETK_XETK_ACCESS
  /end IF_DATA
  /begin IF_DATA XCPplus 0x0102
   /begin SEGMENT 7 0x00 0x00 0x00 0x00 /end SEGMENT
  /end IF_DATA
 /end MEMORY_SEGMENT
 /begin MEMORY_SEGMENT Ram70000000 "" VARIABLES RAM INTERN 0x70000000 0x1E000 -1 -1 -1 -1 -1
  /begin IF_DATA ETK_XETK
   /begin ETK_XETK_ACCESS SERIAL_INTERFACE /end ETK_XETK_ACCESS
  /end IF_DATA
  /begin IF_DATA XCPplus 0x0102
   /begin SEGMENT 8 0x00 0x00 0x00 0x00 /end SEGMENT
  /end IF_DATA
 /end MEMORY_SEGMENT
 /begin MEMORY_SEGMENT Ram60000000 "" VARIABLES RAM INTERN 0x60000000 0x3C000 -1 -1 -1 -1 -1
  /begin IF_DATA ETK_XETK
   /begin ETK_XETK_ACCESS SERIAL_INTERFACE /end ETK_XETK_ACCESS
  /end IF_DATA
  /begin IF_DATA XCPplus 0x0102
   /begin SEGMENT 9 0x00 0x00 0x00 0x00 /end SEGMENT
  /end IF_DATA
 /end MEMORY_SEGMENT
 /begin MEMORY_SEGMENT Ram50000000 "" VARIABLES RAM INTERN 0x50000000 0x3C000 -1 -1 -1 -1 -1
  /begin IF_DATA ETK_XETK
   /begin ETK_XETK_ACCESS SERIAL_INTERFACE /end ETK_XETK_ACCESS
  /end IF_DATA
  /begin IF_DATA XCPplus 0x0102
   /begin SEGMENT 10 0x00 0x00 0x00 0x00 /end SEGMENT
  /end IF_DATA
 /end MEMORY_SEGMENT
 /begin MEMORY_SEGMENT RamBF1F77B8 "" VARIABLES RAM INTERN 0xBF1F77B8 0x8848 -1 -1 -1 -1 -1
  /begin IF_DATA ETK_XETK
   /begin ETK_XETK_ACCESS SERIAL_INTERFACE /end ETK_XETK_ACCESS
  /end IF_DATA
  /begin IF_DATA XCPplus 0x0102
   /begin SEGMENT 11 0x00 0x00 0x00 0x00 /end SEGMENT
  /end IF_DATA
 /end MEMORY_SEGMENT
 /begin MEMORY_SEGMENT RamBF1F0000 "" CALIBRATION_VARIABLES RAM INTERN 0xBF1F0000 0x77B8 -1 -1 -1 -1 -1
  /begin IF_DATA ETK_XETK
   /begin ETK_XETK_ACCESS SERIAL_INTERFACE /end ETK_XETK_ACCESS
  /end IF_DATA
  /begin IF_DATA XCPplus 0x0102
   /begin SEGMENT 12 0x00 0x00 0x00 0x00 /end SEGMENT
  /end IF_DATA
 /end MEMORY_SEGMENT
 /begin MEMORY_SEGMENT RamF0000014 "" VARIABLES RAM INTERN 0xF0000014 0x4 -1 -1 -1 -1 -1
  /begin IF_DATA ETK_XETK
   /begin ETK_XETK_ACCESS SERIAL_INTERFACE /end ETK_XETK_ACCESS
  /end IF_DATA
  /begin IF_DATA XCPplus 0x0102
   /begin SEGMENT 4026531860 0x00 0x00 0x00 0x00 /end SEGMENT
  /end IF_DATA
 /end MEMORY_SEGMENT
 /begin CALIBRATION_METHOD /* name calibration methode */ "DataSetId" /* version calibration metode */ 256 /begin CALIBRATION_HANDLE /* adr data set id characteristic */ 0xB0006274 /end CALIBRATION_HANDLE /end CALIBRATION_METHOD
 /begin CALIBRATION_METHOD /* Method name */ "FixedSizeMoveableEmuRAM" /* Method version */ 1 /begin CALIBRATION_HANDLE 0 0xBF000000 0x10000 /end CALIBRATION_HANDLE /begin CALIBRATION_HANDLE 1 0xBF010000 0x10000 /end CALIBRATION_HANDLE /begin CALIBRATION_HANDLE 2 0xBF020000 0x10000 /end CALIBRATION_HANDLE /begin CALIBRATION_HANDLE 3 0xBF030000 0x10000 /end CALIBRATION_HANDLE /begin CALIBRATION_HANDLE 4 0xBF040000 0x10000 /end CALIBRATION_HANDLE /begin CALIBRATION_HANDLE 5 0xBF050000 0x10000 /end CALIBRATION_HANDLE /begin CALIBRATION_HANDLE 6 0xBF060000 0x10000 /end CALIBRATION_HANDLE /begin CALIBRATION_HANDLE 7 0xBF070000 0x10000 /end CALIBRATION_HANDLE /begin CALIBRATION_HANDLE 8 0xBF080000 0x10000 /end CALIBRATION_HANDLE /begin CALIBRATION_HANDLE 9 0xBF090000 0x10000 /end CALIBRATION_HANDLE /begin CALIBRATION_HANDLE 10 0xBF0A0000 0x10000 /end CALIBRATION_HANDLE /begin CALIBRATION_HANDLE 11 0xBF0B0000 0x10000 /end CALIBRATION_HANDLE /begin CALIBRATION_HANDLE 12 0xBF0C0000 0x10000 /end CALIBRATION_HANDLE /begin CALIBRATION_HANDLE 13 0xBF0D0000 0x10000 /end CALIBRATION_HANDLE /begin CALIBRATION_HANDLE 14 0xBF0E0000 0x10000 /end CALIBRATION_HANDLE /begin CALIBRATION_HANDLE 15 0xBF0F0000 0x10000 /end CALIBRATION_HANDLE /begin CALIBRATION_HANDLE 16 0xBF100000 0x10000 /end CALIBRATION_HANDLE /begin CALIBRATION_HANDLE 17 0xBF110000 0x10000 /end CALIBRATION_HANDLE /begin CALIBRATION_HANDLE 18 0xBF120000 0x10000 /end CALIBRATION_HANDLE /begin CALIBRATION_HANDLE 19 0xBF130000 0x10000 /end CALIBRATION_HANDLE /begin CALIBRATION_HANDLE 20 0xBF140000 0x10000 /end CALIBRATION_HANDLE /begin CALIBRATION_HANDLE 21 0xBF150000 0x10000 /end CALIBRATION_HANDLE /begin CALIBRATION_HANDLE 22 0xBF160000 0x10000 /end CALIBRATION_HANDLE /begin CALIBRATION_HANDLE 23 0xBF170000 0x10000 /end CALIBRATION_HANDLE /begin CALIBRATION_HANDLE 24 0xBF180000 0x10000 /end CALIBRATION_HANDLE /begin CALIBRATION_HANDLE 25 0xBF190000 0x10000 /end CALIBRATION_HANDLE /begin CALIBRATION_HANDLE 26 0xBF1A0000 0x10000 /end CALIBRATION_HANDLE /begin CALIBRATION_HANDLE 27 0xBF1B0000 0x10000 /end CALIBRATION_HANDLE /begin CALIBRATION_HANDLE 28 0xBF1C0000 0x10000 /end CALIBRATION_HANDLE /begin CALIBRATION_HANDLE 29 0xBF1D0000 0x10000 /end CALIBRATION_HANDLE /begin CALIBRATION_HANDLE 30 0xBF1E0000 0x10000 /end CALIBRATION_HANDLE /end CALIBRATION_METHOD
 SYSTEM_CONSTANT "ACCPED_VEL_INTPOL" "1"
 SYSTEM_CONSTANT "ACCPED_VN_INTPOL" "0"
 SYSTEM_CONSTANT "ACTYP_MECHELEC" "4"
 SYSTEM_CONSTANT "ADDHTR_CONST" "360"
 SYSTEM_CONSTANT "ADDLEONV_SC" "0"
 SYSTEM_CONSTANT "AIRCTL_NUMBUFDDTEGRLPPOS" "26"
 SYSTEM_CONSTANT "AIRMASS_2_RES_REV" "10"
 SYSTEM_CONSTANT "AIRMSPRTIMEQ0P0003_RES" "0.0003"
 SYSTEM_CONSTANT "AIRMSQ0P1_RES" "0.1"
 SYSTEM_CONSTANT "AIRMSQ0P1_RES_REV" "10"
 SYSTEM_CONSTANT "AIRPOUT_TYPAVL_SC" "0"
 SYSTEM_CONSTANT "AIRSYS_AREAEFFONE" "1"
 SYSTEM_CONSTANT "AIRSYS_AREAEFFONE_SY" "1"
 SYSTEM_CONSTANT "AIRSYS_MINDEADTIME_SY" "1"
 SYSTEM_CONSTANT "AIRSYS_TEMPTHRPST" "300"
 SYSTEM_CONSTANT "AIRSYS_TEMPTHRPST_SY" "300"
 SYSTEM_CONSTANT "AIRTIN_TYPAVL_SC" "0"
 SYSTEM_CONSTANT "ALTCRNT_LIM_RES" "0.25"
 SYSTEM_CONSTANT "ALTCRNT_OUT_RES" "0.125"
 SYSTEM_CONSTANT "ALTLD_RES" "3.125"
 SYSTEM_CONSTANT "ALTVLTG_OFS" "10.6"
 SYSTEM_CONSTANT "ALTVLTG_RES_SY" "0.1"
 SYSTEM_CONSTANT "ALT_CHPTEMP_OFS" "-32"
 SYSTEM_CONSTANT "ALT_CHPTEMP_RES" "8"
 SYSTEM_CONSTANT "AMPC_RES_REV" "10"
 SYSTEM_CONSTANT "AMPT_NOXLDUNLD_RES" "0.0001"
 SYSTEM_CONSTANT "AMPT_NOXLDUNLD_RES_REV" "10000"
 SYSTEM_CONSTANT "AMPT_NOXRGN_MIN" "0"
 SYSTEM_CONSTANT "AMPT_NOXRGN_RES" "0.0005"
 SYSTEM_CONSTANT "AMPT_NOXRGN_RES_REV" "2000"
 SYSTEM_CONSTANT "AMPT_NOX_RES" "1e-005"
 SYSTEM_CONSTANT "AMPT_NOX_RES_REV" "100000"
 SYSTEM_CONSTANT "AMPT_RES_2" "3.2e-005"
 SYSTEM_CONSTANT "AMPT_RES_2_REV" "31250"
 SYSTEM_CONSTANT "AMPT_SOX1_MIN" "0"
 SYSTEM_CONSTANT "AMPT_SOX1_RES" "0.003"
 SYSTEM_CONSTANT "ARBLD_SC" "1"
 SYSTEM_CONSTANT "ARCOM_SY" "0"
 SYSTEM_CONSTANT "ARVERS_SC" "2"
 SYSTEM_CONSTANT "ASMOD_FACRSTOICH" "14.5"
 SYSTEM_CONSTANT "ASMOD_HTFLW_RES" "2"
 SYSTEM_CONSTANT "ASMOD_NUMEOMCOEMI_SY" "3"
 SYSTEM_CONSTANT "ASMOD_PHC" "3"
 SYSTEM_CONSTANT "ASMOD_QLMBD" "100"
 SYSTEM_CONSTANT "ASMOD_RGN" "4"
 SYSTEM_CONSTANT "ASMOD_RM" "2"
 SYSTEM_CONSTANT "ATS_BRK_APP_SC" "0"
 SYSTEM_CONSTANT "BASEMAP_INTRPNFAC_FIVE" "5"
 SYSTEM_CONSTANT "BASEMAP_INTRPNFAC_SIX" "6"
 SYSTEM_CONSTANT "BASSVRAPPL_EXTSTIIFENA_SC" "0"
 SYSTEM_CONSTANT "BMW_PRODUCTLINE_SY" "0"
 SYSTEM_CONSTANT "BRKBSTP_TYPAVL_SC" "0"
 SYSTEM_CONSTANT "BSWDEVLERRDETNACTVN_SC" "1"
 SYSTEM_CONSTANT "BYPASS_SY" "1"
 SYSTEM_CONSTANT "CACDSPLP_TYPAVL_SC" "0"
 SYSTEM_CONSTANT "CACDSTLP_TYPAVL_SC" "0"
 SYSTEM_CONSTANT "CALCNROLLGDIAGPLAUS_SC" "0"
 SYSTEM_CONSTANT "CALORIFIC_VALUE" "42.5"
 SYSTEM_CONSTANT "CALORY_RES_REV" "1"
 SYSTEM_CONSTANT "CALWUP_SY" "1"
 SYSTEM_CONSTANT "CAMLIFT_RES_REV" "256"
 SYSTEM_CONSTANT "CAMPAR_A_RES_REV" "1024"
 SYSTEM_CONSTANT "CAMSFT_ACTRINTKB2_SC" "0"
 SYSTEM_CONSTANT "CAMSFT_ACTROUTLB2_SC" "0"
 SYSTEM_CONSTANT "CAMSFT_ADPNCLB_SC" "0"
 SYSTEM_CONSTANT "CAMSFT_LOCKDIAGINTK_SC" "0"
 SYSTEM_CONSTANT "CAMSFT_LOCKDIAGOUTL_SC" "0"
 SYSTEM_CONSTANT "CAMSFT_VARIINTK_SC" "2"
 SYSTEM_CONSTANT "CAMSFT_VARIOUTL_SC" "2"
 SYSTEM_CONSTANT "CAMSLP_RES_REV" "1024"
 SYSTEM_CONSTANT "CANIPCORETYPE_SC" "1"
 SYSTEM_CONSTANT "CANNM_SC" "0"
 SYSTEM_CONSTANT "CANSM_SC" "1"
 SYSTEM_CONSTANT "CANTP_SC" "1"
 SYSTEM_CONSTANT "CANTSYN_SC" "0"
 SYSTEM_CONSTANT "CAN_MDS_SC" "0"
 SYSTEM_CONSTANT "CARBMDLYR19UPD2016_SC" "0"
 SYSTEM_CONSTANT "CASI1_EXTSSP_SY" "0"
 SYSTEM_CONSTANT "CASI1_SSP_SY" "0"
 SYSTEM_CONSTANT "CASI2_SSP_SY" "0"
 SYSTEM_CONSTANT "CASMAX" "1"
 SYSTEM_CONSTANT "CASO1_SSP_SY" "0"
 SYSTEM_CONSTANT "CASO2_SSP_SY" "0"
 SYSTEM_CONSTANT "CASTYP_SY" "6"
 SYSTEM_CONSTANT "CAS_ADAP_SY" "1"
 SYSTEM_CONSTANT "CAS_ANGLE_SY" "1"
 SYSTEM_CONSTANT "CAS_BACKUPVAR_SY" "0"
 SYSTEM_CONSTANT "CAS_BACKUP_SY" "1"
 SYSTEM_CONSTANT "CAS_CY30CONF_SY" "0"
 SYSTEM_CONSTANT "CAS_DELAY_SC" "0"
 SYSTEM_CONSTANT "CAS_DIAG_SY" "0"
 SYSTEM_CONSTANT "CAS_I1_SY" "1"
 SYSTEM_CONSTANT "CAS_I2_SY" "0"
 SYSTEM_CONSTANT "CAS_MAX" "2"
 SYSTEM_CONSTANT "CAS_MOUNTCHK_SY" "0"
 SYSTEM_CONSTANT "CAS_O1_SY" "0"
 SYSTEM_CONSTANT "CAS_O2_SY" "0"
 SYSTEM_CONSTANT "CAS_OUT_SY" "0"
 SYSTEM_CONSTANT "CCACHPDST_TYPAVL_SY" "0"
 SYSTEM_CONSTANT "CCACLPDST_TYPAVL_SY" "0"
 SYSTEM_CONSTANT "CDGEN_ENV_SC" "2"
 SYSTEM_CONSTANT "CELPRJ_SIMPLEMDLENA_SC" "1"
 SYSTEM_CONSTANT "CENGDST_TYPAVL_SY" "0"
 SYSTEM_CONSTANT "CENGUST2_TYPAVL_SC" "0"
 SYSTEM_CONSTANT "CENGUST_TYPAVL_SY" "0"
 SYSTEM_CONSTANT "CHDT_TYPAVL_SC" "0"
 SYSTEM_CONSTANT "CHRCTL_EIAECD_SY" "0"
 SYSTEM_CONSTANT "CJ721_SC" "0"
 SYSTEM_CONSTANT "CJ722_SC" "0"
 SYSTEM_CONSTANT "CJ930_SY" "0"
 SYSTEM_CONSTANT "CJ950_SY" "2"
 SYSTEM_CONSTANT "CJ960_SC" "0"
 SYSTEM_CONSTANT "CJ970_SC" "0"
 SYSTEM_CONSTANT "CMBTYP_DS" "0"
 SYSTEM_CONSTANT "CMBTYP_GS" "1"
 SYSTEM_CONSTANT "CMBTYP_SY" "1"
 SYSTEM_CONSTANT "CMPRHP2DST_TYPAVL_SC" "0"
 SYSTEM_CONSTANT "CNG_SY" "0"
 SYSTEM_CONSTANT "CNVTCOEFFCATAIR_RES_REV" "50"
 SYSTEM_CONSTANT "COEOM_INJCRVMI1NUMMAP_SY" "0"
 SYSTEM_CONSTANT "COEOM_INJCRVMI1NUMSWTDES_SY" "1"
 SYSTEM_CONSTANT "COEOM_INJCRVMI1NUMSWTMAX_SY" "0"
 SYSTEM_CONSTANT "COEOM_INJCRVMI1NUMSWTSET_SY" "0"
 SYSTEM_CONSTANT "COEOM_INJCRVPII1NUMMAP_SY" "0"
 SYSTEM_CONSTANT "COEOM_INJCRVPII1NUMSWTDES_SY" "1"
 SYSTEM_CONSTANT "COEOM_INJCRVPII1NUMSWTMAX_SY" "0"
 SYSTEM_CONSTANT "COEOM_INJCRVPII1NUMSWTSET_SY" "0"
 SYSTEM_CONSTANT "COEOM_INJCRVPII2NUMMAP_SY" "0"
 SYSTEM_CONSTANT "COEOM_INJCRVPII2NUMSWTDES_SY" "1"
 SYSTEM_CONSTANT "COEOM_INJCRVPII2NUMSWTMAX_SY" "0"
 SYSTEM_CONSTANT "COEOM_INJCRVPII2NUMSWTSET_SY" "0"
 SYSTEM_CONSTANT "COEOM_INJCRVPOI1NUMMAP_SY" "0"
 SYSTEM_CONSTANT "COEOM_INJCRVPOI1NUMSWTDES_SY" "1"
 SYSTEM_CONSTANT "COEOM_INJCRVPOI1NUMSWTMAX_SY" "0"
 SYSTEM_CONSTANT "COEOM_INJCRVPOI1NUMSWTSET_SY" "0"
 SYSTEM_CONSTANT "COEOM_INJCRVPOI2NUMMAP_SY" "0"
 SYSTEM_CONSTANT "COEOM_INJCRVPOI2NUMSWTDES_SY" "1"
 SYSTEM_CONSTANT "COEOM_INJCRVPOI2NUMSWTMAX_SY" "0"
 SYSTEM_CONSTANT "COEOM_INJCRVPOI2NUMSWTSET_SY" "0"
 SYSTEM_CONSTANT "COEOM_INJCRVPOI3NUMMAP_SY" "0"
 SYSTEM_CONSTANT "COEOM_INJCRVPOI3NUMSWTDES_SY" "1"
 SYSTEM_CONSTANT "COEOM_INJCRVPOI3NUMSWTMAX_SY" "0"
 SYSTEM_CONSTANT "COEOM_INJCRVPOI3NUMSWTSET_SY" "0"
 SYSTEM_CONSTANT "COEOM_TYP_SY" "1"
 SYSTEM_CONSTANT "COMCIL_COMTYPE_SY" "4"
 SYSTEM_CONSTANT "COMDIA_EOLENA_SC" "0"
 SYSTEM_CONSTANT "COMDIA_RTEENA_SC" "1"
 SYSTEM_CONSTANT "COMM_SC" "1"
 SYSTEM_CONSTANT "COMPACCPED_ON" "1"
 SYSTEM_CONSTANT "COMPACCPED_SY" "0"
 SYSTEM_CONSTANT "COMSCL_COOR_ACSCEDA_BP" "2"
 SYSTEM_CONSTANT "COMSCL_COOR_ACSSBVA_BP" "4"
 SYSTEM_CONSTANT "COMSCL_COOR_ACSSEDA_BP" "1"
 SYSTEM_CONSTANT "COMSCL_COOR_BASESAMPLETIMS_FRA" "5"
 SYSTEM_CONSTANT "COMSCL_COOR_CYCLE_INIT" "255"
 SYSTEM_CONSTANT "COMSCL_COOR_ERRRPRTTI_SEC" "6"
 SYSTEM_CONSTANT "COMSCL_COOR_FALLBACK" "254"
 SYSTEM_CONSTANT "COMSCL_COOR_JOB1" "1"
 SYSTEM_CONSTANT "COMSCL_COOR_JOB2" "2"
 SYSTEM_CONSTANT "COMSCL_COOR_JOB3" "3"
 SYSTEM_CONSTANT "COMSCL_COOR_MACROTICK_ERROR" "3003"
 SYSTEM_CONSTANT "COMSCL_COOR_MACROTICK_INIT" "65535"
 SYSTEM_CONSTANT "COMSCL_COOR_NRCYCLES" "64"
 SYSTEM_CONSTANT "COMSCL_COOR_SYNCLOSS" "255"
 SYSTEM_CONSTANT "COMSCL_COOR_SYNCTIMEOUT_MS" "6"
 SYSTEM_CONSTANT "COMVERS_SC" "0"
 SYSTEM_CONSTANT "COM_SC" "1"
 SYSTEM_CONSTANT "CONDRDSFLDP_TYPAVL_SC" "0"
 SYSTEM_CONSTANT "CONDRDSFLDT_TYPAVL_SC" "0"
 SYSTEM_CONSTANT "CONDRUSCOOLTT_TYPAVL_SC" "0"
 SYSTEM_CONSTANT "CONDRUSFLDT_TYPAVL_SC" "0"
 SYSTEM_CONSTANT "CONV_MGS2KGS" "1000000"
 SYSTEM_CONSTANT "COOLTPIN_TYPAVL_SC" "0"
 SYSTEM_CONSTANT "COOLTPOUT_TYPAVL_SC" "0"
 SYSTEM_CONSTANT "COOLTTIN_TYPAVL_SC" "0"
 SYSTEM_CONSTANT "COOLTTOUT_TYPAVL_SY" "0"
 SYSTEM_CONSTANT "COOLTTRADROUT_TYPAVL_SC" "0"
 SYSTEM_CONSTANT "CPUDEVICE_SC" "4"
 SYSTEM_CONSTANT "CPUVENDOR_SC" "1"
 SYSTEM_CONSTANT "CRCSP_TYPAVL_SC" "0"
 SYSTEM_CONSTANT "CRKCSPABSLT_TYPAVL_SY" "0"
 SYSTEM_CONSTANT "CRSEDGEFALL_SC" "1"
 SYSTEM_CONSTANT "CRSSENSTYP_SY" "1"
 SYSTEM_CONSTANT "CRSTST_DATTX_SY" "0"
 SYSTEM_CONSTANT "CRSTYP_SY" "0"
 SYSTEM_CONSTANT "CRS_ALTPIN_SY" "0"
 SYSTEM_CONSTANT "CRS_ANGLECOR_SY" "0"
 SYSTEM_CONSTANT "CRS_BACKUP_CASTYP_SY" "1"
 SYSTEM_CONSTANT "CRS_BACKUP_DYN_SY" "0"
 SYSTEM_CONSTANT "CRS_BACKUP_SY" "2"
 SYSTEM_CONSTANT "CRS_CY30CONF_SY" "0"
 SYSTEM_CONSTANT "CRS_DIAG_DETAIL_SY" "0"
 SYSTEM_CONSTANT "CRS_DIAG_SYNCINJLOST_SY" "0"
 SYSTEM_CONSTANT "CRS_EXTSSP_SY" "0"
 SYSTEM_CONSTANT "CRS_MIAP_SY" "0"
 SYSTEM_CONSTANT "CRS_SSP_SY" "0"
 SYSTEM_CONSTANT "CRS_TAA_SY" "0"
 SYSTEM_CONSTANT "CRS_TOOTHAVRG_SY" "0"
 SYSTEM_CONSTANT "CRYPTOLIB_SC" "0"
 SYSTEM_CONSTANT "CTEGRCLRUS_TYPAVL_SY" "0"
 SYSTEM_CONSTANT "CTEVCHRGRDS_TYPAVL_SY" "0"
 SYSTEM_CONSTANT "CTEVEMDS_TYPAVL_SY" "0"
 SYSTEM_CONSTANT "CTEVINVRUS_TYPAVL_SY" "0"
 SYSTEM_CONSTANT "CTEVLEDS_TYPAVL_SY" "0"
 SYSTEM_CONSTANT "CURR_RES" "1"
 SYSTEM_CONSTANT "CVN_USE_DATA" "1"
 SYSTEM_CONSTANT "CVN_USE_EEP" "0"
 SYSTEM_CONSTANT "CVN_USE_ENVRAM" "1"
 SYSTEM_CONSTANT "CVN_USE_MEM" "1"
 SYSTEM_CONSTANT "CVOCFG_SC" "0"
 SYSTEM_CONSTANT "CVT_SY" "0"
 SYSTEM_CONSTANT "CY150_SC" "0"
 SYSTEM_CONSTANT "CY326_SC" "0"
 SYSTEM_CONSTANT "CY327_SY" "1"
 SYSTEM_CONSTANT "CY329_SC" "0"
 SYSTEM_CONSTANT "CYL_MAX" "4"
 SYSTEM_CONSTANT "DCS_OVRDS_ENGPRT" "1"
 SYSTEM_CONSTANT "DDRC_DTRFRZINFHEALDEB_SY" "1"
 SYSTEM_CONSTANT "DDRC_DTRUPDSUP" "1"
 SYSTEM_CONSTANT "DDRC_DTRUPDSUP_SY" "1"
 SYSTEM_CONSTANT "DDRC_NUM_DFC_EVTROW" "137"
 SYSTEM_CONSTANT "DDRC_NUM_DFC_EVTROW_SML" "0"
 SYSTEM_CONSTANT "DDRC_NUM_DFC_EVTUD" "0"
 SYSTEM_CONSTANT "DDRC_NUM_DFC_EVTUD_SML" "0"
 SYSTEM_CONSTANT "DDRC_NUM_DFC_TIROW" "1"
 SYSTEM_CONSTANT "DDRC_NUM_DFC_TIROW_SML" "264"
 SYSTEM_CONSTANT "DDRC_NUM_DFC_TIUD" "0"
 SYSTEM_CONSTANT "DDRC_NUM_DFC_TIUD_SML" "398"
 SYSTEM_CONSTANT "DDVOL_RES" "10"
 SYSTEM_CONSTANT "DEDIA_DBG_SC" "1"
 SYSTEM_CONSTANT "DEDIA_VRNTCONF_SY" "0"
 SYSTEM_CONSTANT "DEFDSTRTTMNGFORDIGSENS_SY" "0"
 SYSTEM_CONSTANT "DELIB_DBG_SC" "0"
 SYSTEM_CONSTANT "DELIB_DYNSDLDEACTV_SC" "0"
 SYSTEM_CONSTANT "DELIB_ELECACTRTYPAVL_SC" "1"
 SYSTEM_CONSTANT "DELIB_ENGDATENG_TYPAVL_SC" "0"
 SYSTEM_CONSTANT "DELIB_FACPRECTLDWNTEMPCORRSIZECUR_SC" "2"
 SYSTEM_CONSTANT "DELIB_FACPRECTLUPTEMPCORRSIZECUR_SC" "2"
 SYSTEM_CONSTANT "DELIB_FACTQLOSSCMPSIZECUR_SC" "2"
 SYSTEM_CONSTANT "DELIB_HVDDC_TYPAVL_SC" "0"
 SYSTEM_CONSTANT "DELIB_MDLEXHSNSRAVL_SC" "0"
 SYSTEM_CONSTANT "DELIB_PMINLRNSIZECUR_SC" "2"
 SYSTEM_CONSTANT "DELIB_RACTRLIM2SIZECUR_SC" "2"
 SYSTEM_CONSTANT "DELIB_RACTRLIMSIZECUR_SC" "2"
 SYSTEM_CONSTANT "DELIB_RDIAVALMINSIZECUR_SC" "2"
 SYSTEM_CONSTANT "DELIB_RPRECTLDWNMAINMAPSIZEX_SC" "2"
 SYSTEM_CONSTANT "DELIB_RPRECTLDWNMAINMAPSIZEY_SC" "2"
 SYSTEM_CONSTANT "DELIB_RPRECTLDWNMAPSIZEX_SC" "2"
 SYSTEM_CONSTANT "DELIB_RPRECTLDWNMAPSIZEY_SC" "2"
 SYSTEM_CONSTANT "DELIB_RPRECTLUPMAINMAPSIZEX_SC" "2"
 SYSTEM_CONSTANT "DELIB_RPRECTLUPMAINMAPSIZEY_SC" "2"
 SYSTEM_CONSTANT "DELIB_RPRECTLUPMAPSIZEX_SC" "2"
 SYSTEM_CONSTANT "DELIB_RPRECTLUPMAPSIZEY_SC" "2"
 SYSTEM_CONSTANT "DELIB_RPSMAXMAPSIZEX_SC" "2"
 SYSTEM_CONSTANT "DELIB_RPSMAXMAPSIZEY_SC" "2"
 SYSTEM_CONSTANT "DELIB_RPSMAXSIZECUR_SC" "2"
 SYSTEM_CONSTANT "DELIB_RQONE00111183_SC" "0"
 SYSTEM_CONSTANT "DELIB_RQONE00151721_SC" "0"
 SYSTEM_CONSTANT "DELIB_RQONE00163869_SC" "0"
 SYSTEM_CONSTANT "DELIB_RQONE00167551_SC" "0"
 SYSTEM_CONSTANT "DELIB_RQONE00167754_SC" "0"
 SYSTEM_CONSTANT "DELIB_RQONE00174472_SC" "1"
 SYSTEM_CONSTANT "DELIB_RQONE00180988_SC" "0"
 SYSTEM_CONSTANT "DELIB_RQONE00186872_SC" "0"
 SYSTEM_CONSTANT "DELIB_RQONE00195544_SC" "0"
 SYSTEM_CONSTANT "DELIB_RQONE00211693_SC" "0"
 SYSTEM_CONSTANT "DELIB_RQONE00213783_SC" "0"
 SYSTEM_CONSTANT "DELIB_RQONE00216998_SC" "0"
 SYSTEM_CONSTANT "DELIB_RQONE00239728_SC" "0"
 SYSTEM_CONSTANT "DELIB_RQONE00241588_SC" "0"
 SYSTEM_CONSTANT "DELIB_RQONE00257275_SC" "0"
 SYSTEM_CONSTANT "DELIB_RQONE00267870_SC" "0"
 SYSTEM_CONSTANT "DELIB_RQONE00281379_SC" "0"
 SYSTEM_CONSTANT "DELIB_RQONE00374908_SC" "0"
 SYSTEM_CONSTANT "DELIB_RQONE00389934_SC" "0"
 SYSTEM_CONSTANT "DELIB_RQONE00422998_SC" "0"
 SYSTEM_CONSTANT "DELIB_RQONE00425596_SC" "0"
 SYSTEM_CONSTANT "DELIB_RQONE00428019_SC" "0"
 SYSTEM_CONSTANT "DELIB_RQONE00431800_SC" "0"
 SYSTEM_CONSTANT "DELIB_RQONE00446098_SC" "0"
 SYSTEM_CONSTANT "DELIB_RQONE00458807_SC" "0"
 SYSTEM_CONSTANT "DELIB_RQONE00469470_SC" "0"
 SYSTEM_CONSTANT "DELIB_SENTCALULINSIZECUR_SC" "2"
 SYSTEM_CONSTANT "DELIB_SENTLAHCALULINSIZECUR_SC" "2"
 SYSTEM_CONSTANT "DELIB_STDACTRTYPAVL_SC" "1"
 SYSTEM_CONSTANT "DELIB_STDSENSTYPAVL_SC" "1"
 SYSTEM_CONSTANT "DELIB_STEPACTRTYPAVL_SC" "1"
 SYSTEM_CONSTANT "DELIB_TIDIAGDISSIZECUR_SC" "2"
 SYSTEM_CONSTANT "DELIB_UTOFFSADJCLSDSIZECRV_SC" "2"
 SYSTEM_CONSTANT "DELIB_UTOFFSADJOPENDSIZECRV_SC" "2"
 SYSTEM_CONSTANT "DEM_ENABLECONDITION_CONFIG" "0"
 SYSTEM_CONSTANT "DEM_FAULTINTERFACE_CONFIG" "0"
 SYSTEM_CONSTANT "DEM_GENERAL_INTERFACE_SUPPORT" "0"
 SYSTEM_CONSTANT "DENSFINE_RES_REV" "500"
 SYSTEM_CONSTANT "DEVLIB_4WINDIACMPNENA_SY" "0"
 SYSTEM_CONSTANT "DEVLIB_ACTRPRTAIRHTRCHK_SY" "0"
 SYSTEM_CONSTANT "DEVLIB_ACTRPRTCMPNENA_SY" "0"
 SYSTEM_CONSTANT "DEVLIB_ACTRPRTGLWCTLCHK_SY" "0"
 SYSTEM_CONSTANT "DEVLIB_DBG_SY" "1"
 SYSTEM_CONSTANT "DEVLIB_DIACTLLINECMPNENA_SY" "0"
 SYSTEM_CONSTANT "DEVLIB_HBRGADVHWSEL_SY" "0"
 SYSTEM_CONSTANT "DEVLIB_HBRGENA_SY" "0"
 SYSTEM_CONSTANT "DEVLIB_PHYSRNGCHK_SY" "1"
 SYSTEM_CONSTANT "DEVLIB_PSOFFOPNLD_SY" "0"
 SYSTEM_CONSTANT "DEVLIB_PSSTATEMOCSOPINI_SY" "0"
 SYSTEM_CONSTANT "DEVLIB_PWRSTGSTATEMOCSOPCHK_SY" "0"
 SYSTEM_CONSTANT "DFC_CALPRMSTATDISBLMSK_SC" "1"
 SYSTEM_CONSTANT "DFC_CTLDISBLLAYOUT_SY" "1"
 SYSTEM_CONSTANT "DFC_CTLMSKBYTES_SY" "2"
 SYSTEM_CONSTANT "DFC_CTLMSK_RESCANCMSK" "1"
 SYSTEM_CONSTANT "DFC_CTLMSK_RESINIMSK" "1"
 SYSTEM_CONSTANT "DFC_DISBLMSKBYTES_SY" "2"
 SYSTEM_CONSTANT "DFC_SETSTATDITHOAPI_SC" "1"
 SYSTEM_CONSTANT "DFES_ACTVENHMTSIMCONDPID9F_SC" "0"
 SYSTEM_CONSTANT "DFES_ACTVSIMRCDNPID03_SC" "0"
 SYSTEM_CONSTANT "DFES_ADDLMILMOD_SC" "0"
 SYSTEM_CONSTANT "DFES_AGINGCTR_VAR1" "1"
 SYSTEM_CONSTANT "DFES_BLKENTRY_SY" "0"
 SYSTEM_CONSTANT "DFES_COMMILDEB_SY" "0"
 SYSTEM_CONSTANT "DFES_DTC_TSTFAIL_SY" "0"
 SYSTEM_CONSTANT "DFES_EOBDCV_SY" "0"
 SYSTEM_CONSTANT "DFES_EOLCLR_SY" "1"
 SYSTEM_CONSTANT "DFES_EXTDFLT_SY" "0"
 SYSTEM_CONSTANT "DFES_IMDTNVSTORG_SC" "0"
 SYSTEM_CONSTANT "DFES_IRV_SY" "0"
 SYSTEM_CONSTANT "DFES_MONITORING_LEN_SY" "2"
 SYSTEM_CONSTANT "DFES_NUMENTRIES_SY" "30"
 SYSTEM_CONSTANT "DFES_NUM_COMMON_ENV_DID" "0"
 SYSTEM_CONSTANT "DFES_NUM_COMMON_ENV_SIGNALS" "0"
 SYSTEM_CONSTANT "DFES_NUM_ENTRY_U8_BITBASE" "4"
 SYSTEM_CONSTANT "DFES_NUM_ENV_BLK" "2"
 SYSTEM_CONSTANT "DFES_NUM_ENV_BYT" "60"
 SYSTEM_CONSTANT "DFES_NUM_ENV_DID" "30"
 SYSTEM_CONSTANT "DFES_NUM_ENV_SIGNALS" "0"
 SYSTEM_CONSTANT "DFES_NUM_EXFRZFR_BYT" "0"
 SYSTEM_CONSTANT "DFES_NUM_FRFR_DID" "15"
 SYSTEM_CONSTANT "DFES_NUM_FRZFR_BYT" "33"
 SYSTEM_CONSTANT "DFES_PDTC_SY" "1"
 SYSTEM_CONSTANT "DFES_PRVTSTRDLT_SY" "0"
 SYSTEM_CONSTANT "DFES_SIMCOND_READONLY" "0"
 SYSTEM_CONSTANT "DFES_SIMCOND_SY" "0"
 SYSTEM_CONSTANT "DFES_VIS_BUF_SY" "1"
 SYSTEM_CONSTANT "DIAACTR_ELECCTRLLINEDIAGCPTENA_SC" "0"
 SYSTEM_CONSTANT "DIAACTR_ELECHBRDGDIAGENA_SC" "1"
 SYSTEM_CONSTANT "DIAACTR_ELECPSDIAGCMPNENA_SC" "1"
 SYSTEM_CONSTANT "DIAACTR_ELECPSDIAGERRINFO_SC" "0"
 SYSTEM_CONSTANT "DIABAS_ATSLRGIDSUPRT_SC" "0"
 SYSTEM_CONSTANT "DIABAS_ATSSUSP_SC" "1"
 SYSTEM_CONSTANT "DIABAS_ATS_SC" "1"
 SYSTEM_CONSTANT "DIABAS_AVS_SY" "1"
 SYSTEM_CONSTANT "DIABAS_BSWVERS_SC" "22"
 SYSTEM_CONSTANT "DIABAS_CALIDCVNCTRL_SC" "1"
 SYSTEM_CONSTANT "DIABAS_CALIDCVNLENSEQ_SC" "0"
 SYSTEM_CONSTANT "DIABAS_CUSVAR_SC" "0"
 SYSTEM_CONSTANT "DIABAS_ETCINTSTATE_SC" "0"
 SYSTEM_CONSTANT "DIABAS_IFFLOATSIG_SC" "1"
 SYSTEM_CONSTANT "DIABAS_NODIAP_SY" "1"
 SYSTEM_CONSTANT "DIABAS_PNDRPRTMOD2_SC" "0"
 SYSTEM_CONSTANT "DIABAS_PRMIDAUTVIEW_SC" "1"
 SYSTEM_CONSTANT "DIABAS_SCRCTL_RCNT_RESET_SY" "0"
 SYSTEM_CONSTANT "DIABAS_SRV8_SC" "0"
 SYSTEM_CONSTANT "DIAGCOM_CALCAN_SC" "0"
 SYSTEM_CONSTANT "DIAGCOM_CANFD_SC" "1"
 SYSTEM_CONSTANT "DIAGCOM_ECUTYP_SC" "1"
 SYSTEM_CONSTANT "DIAGCOM_NETVRNT_SC" "0"
 SYSTEM_CONSTANT "DIAG_GWPAHSELN_SC" "0"
 SYSTEM_CONSTANT "DIAG_PACKAGING_SY" "0"
 SYSTEM_CONSTANT "DIAG_SVRPTCOL_SY" "1"
 SYSTEM_CONSTANT "DINH_DEF25DEB0DI_SC" "0"
 SYSTEM_CONSTANT "DINH_FID_VIEW_SC" "1"
 SYSTEM_CONSTANT "DINH_MONINHBCNT_SC" "4"
 SYSTEM_CONSTANT "DINH_NEWTRIPWITHFCMCLR_SC" "0"
 SYSTEM_CONSTANT "DIPO_SY" "0"
 SYSTEM_CONSTANT "DISTAB_SY" "1"
 SYSTEM_CONSTANT "DIUMPR_500MD_SY" "0"
 SYSTEM_CONSTANT "DIUMPR_COLDSTARTDEN_SC" "0"
 SYSTEM_CONSTANT "DIUMPR_CTGEN_READONLY" "0"
 SYSTEM_CONSTANT "DIUMPR_CTGEN_TIFUENGOPMIN_RW" "1"
 SYSTEM_CONSTANT "DIUMPR_DATAFROMCAN_SC" "1"
 SYSTEM_CONSTANT "DIUMPR_DENOMCDN_SC" "1"
 SYSTEM_CONSTANT "DIUMPR_DSTTRVLDSNCERST_SC" "0"
 SYSTEM_CONSTANT "DIUMPR_EVAPDENOMTIPRPSYSOFF_SC" "0"
 SYSTEM_CONSTANT "DIUMPR_EVAPDEN_SY" "0"
 SYSTEM_CONSTANT "DIUMPR_EVAP_RW" "0"
 SYSTEM_CONSTANT "DIUMPR_FUENGOPERTI_SC" "0"
 SYSTEM_CONSTANT "DIUMPR_IGNCYCTMR_SC" "0"
 SYSTEM_CONSTANT "DIUMPR_NUMDENOMIDXGRP_SY" "0"
 SYSTEM_CONSTANT "DIUMPR_NUMMSGGRPS" "0"
 SYSTEM_CONSTANT "DIUMPR_NUMRATCFG" "0"
 SYSTEM_CONSTANT "DIUMPR_NUMRATCLB" "1"
 SYSTEM_CONSTANT "DIUMPR_NUMRATLFTI" "0"
 SYSTEM_CONSTANT "DIUMPR_NUMSIGCLB" "0"
 SYSTEM_CONSTANT "DIUMPR_NUM_GROUPS_SY" "15"
 SYSTEM_CONSTANT "DM_SOX2_RES_FL" "0.004"
 SYSTEM_CONSTANT "DOIP_SC" "0"
 SYSTEM_CONSTANT "DPDIFFTMP_RES" "100"
 SYSTEM_CONSTANT "DPDIFF_RES" "0.1"
 SYSTEM_CONSTANT "DPRC_100" "100"
 SYSTEM_CONSTANT "DPRC_M_100" "-100"
 SYSTEM_CONSTANT "DRCTSTRT_SY" "0"
 SYSTEM_CONSTANT "DRESFLW_RES" "0.001"
 SYSTEM_CONSTANT "DRESFLW_RES_REV" "1000"
 SYSTEM_CONSTANT "DRVPRGSWT_NUMMODE" "0"
 SYSTEM_CONSTANT "DRVPRGSWT_NUMSPRT" "0"
 SYSTEM_CONSTANT "DRVPRGSWT_NUMWNTR" "0"
 SYSTEM_CONSTANT "DSCHED_COEOMEXT_SC" "0"
 SYSTEM_CONSTANT "DSCHED_COEOM_SY" "0"
 SYSTEM_CONSTANT "DSCHED_DFCSPEC_SY" "0"
 SYSTEM_CONSTANT "DSCHED_FIDMAXPRIOLST_SY" "0"
 SYSTEM_CONSTANT "DSCHED_FTI_SY" "0"
 SYSTEM_CONSTANT "DSCHED_PRIOACTVJMP_SY" "0"
 SYSTEM_CONSTANT "DSCHED_PRIODFCSTLDF_SY" "0"
 SYSTEM_CONSTANT "DSCHED_PRIODFCSTTST_SY" "0"
 SYSTEM_CONSTANT "DSCHED_PRIOPHYSURGENCY_SY" "0"
 SYSTEM_CONSTANT "DSCHED_PRIORMPCALC_SY" "0"
 SYSTEM_CONSTANT "DSCHED_RATECALC_SY" "0"
 SYSTEM_CONSTANT "DSCHED_WTT_LOWLIM" "0"
 SYSTEM_CONSTANT "DSCHED_WTT_SY" "0"
 SYSTEM_CONSTANT "DSCHED_WTT_UPLIM" "9"
 SYSTEM_CONSTANT "DSHBTESTSUPRT_SC" "0"
 SYSTEM_CONSTANT "DSM2AUTOSAR_ARRELS_SC" "0"
 SYSTEM_CONSTANT "DSM2AUTOSAR_ASWPF_SC" "0"
 SYSTEM_CONSTANT "DSM2AUTOSAR_DCMIF_SC" "0"
 SYSTEM_CONSTANT "DSM2AUTOSAR_DEMBSWERRORBUFFERSIZE" "30"
 SYSTEM_CONSTANT "DSM2AUTOSAR_DEV_ERROR_DETECT" "1"
 SYSTEM_CONSTANT "DSM2AUTOSAR_NRDEMCLIENT" "2"
 SYSTEM_CONSTANT "DSM2AUTOSAR_NRDEMCLIENTFULLSUPPORT" "2"
 SYSTEM_CONSTANT "DSM2AUTOSAR_NRDEMCLIENTNOFULLSUPPORT" "0"
 SYSTEM_CONSTANT "DSM2AUTOSAR_NRDEMCLIENTRTESUPPORT" "0"
 SYSTEM_CONSTANT "DSM2AUTOSAR_SC" "1"
 SYSTEM_CONSTANT "DSM2AUTOSAR_SECFCM_SC" "0"
 SYSTEM_CONSTANT "DSM2SG_ASCETINF_SC" "0"
 SYSTEM_CONSTANT "DSM2SG_DFC_MAX_SY" "0"
 SYSTEM_CONSTANT "DSM2SG_DFC_SY" "0"
 SYSTEM_CONSTANT "DSM2SG_DSQ_MAX_SY" "0"
 SYSTEM_CONSTANT "DSM2SG_DSQ_SY" "0"
 SYSTEM_CONSTANT "DSM2SG_EXCH_SC" "0"
 SYSTEM_CONSTANT "DSM2SG_FID_MAX_SY" "0"
 SYSTEM_CONSTANT "DSM2SG_FID_SY" "0"
 SYSTEM_CONSTANT "DSMAPL_CMNDIAG_SY" "0"
 SYSTEM_CONSTANT "DSMAPL_DIUMPRTLE4251_SY" "0"
 SYSTEM_CONSTANT "DSMAPL_DTRREAD_SC" "0"
 SYSTEM_CONSTANT "DSMAPPLFADEOUT_NWDF_SC" "0"
 SYSTEM_CONSTANT "DSMAUX_READONLY" "0"
 SYSTEM_CONSTANT "DSMAUX_ROEBUFLEN" "0"
 SYSTEM_CONSTANT "DSMAUX_ROEBUFUSEENVRAM" "0"
 SYSTEM_CONSTANT "DSMAUX_TCSORT_SY" "0"
 SYSTEM_CONSTANT "DSMBAS_CENSUPPDIUMPR_SC" "1"
 SYSTEM_CONSTANT "DSMBAS_CENSUPPDTR_SC" "1"
 SYSTEM_CONSTANT "DSMBAS_DARCORDARYLEN_SC" "0"
 SYSTEM_CONSTANT "DSMBAS_DARCORDENA_SC" "0"
 SYSTEM_CONSTANT "DSMBAS_ENACFMDFLTCNTR_SC" "0"
 SYSTEM_CONSTANT "DSMBAS_ENADTRBASDONOBDMID_SC" "1"
 SYSTEM_CONSTANT "DSMBAS_ENAFRQCNTRNOTRSTSRVPND_SC" "0"
 SYSTEM_CONSTANT "DSMBAS_ENAOPTMZDRDNFORCMPHCPT_SC" "0"
 SYSTEM_CONSTANT "DSMBAS_ENASATELLITEHNDLG_SC" "0"
 SYSTEM_CONSTANT "DSMBAS_ENASIMRCDN_SC" "1"
 SYSTEM_CONSTANT "DSMBAS_ENVTLBLKUPD_SC" "1"
 SYSTEM_CONSTANT "DSMBAS_IRRVFLTINHB_SC" "0"
 SYSTEM_CONSTANT "DSMBAS_KEYONCYCFLCTRIG_SC" "0"
 SYSTEM_CONSTANT "DSMBAS_KEYONCYCTRANDURGDRV_SC" "0"
 SYSTEM_CONSTANT "DSMBAS_NEWDCYCWITHFCMCLR_SC" "0"
 SYSTEM_CONSTANT "DSMBAS_NODFP_SC" "0"
 SYSTEM_CONSTANT "DSMBAS_NODIAGCSDL_SC" "0"
 SYSTEM_CONSTANT "DSMBAS_NODTR_SC" "0"
 SYSTEM_CONSTANT "DSMBAS_OBDUDSCMBNCUSTDATA_SC" "1"
 SYSTEM_CONSTANT "DSMBAS_OSAPPSETUP_SC" "3"
 SYSTEM_CONSTANT "DSMBAS_PNDRPRTMOD2_SC" "0"
 SYSTEM_CONSTANT "DSMBAS_PREFAILDINTDEB_SC" "1"
 SYSTEM_CONSTANT "DSMBAS_REINIMETHSELN_SC" "1"
 SYSTEM_CONSTANT "DSMBAS_SELNADDLDEMINDCR_SC" "0"
 SYSTEM_CONSTANT "DSMBAS_SELNCTRLDIAGCCYC_SC" "0"
 SYSTEM_CONSTANT "DSMBAS_SELNPID93BHVR_SC" "0"
 SYSTEM_CONSTANT "DSMBAS_SELPID41BHVR_SC" "0"
 SYSTEM_CONSTANT "DSMBAS_SVSILLMNASWREQ_SC" "0"
 SYSTEM_CONSTANT "DSMBAS_TESTFAILDSNCELSTCLR_SC" "0"
 SYSTEM_CONSTANT "DSMBDEP_SY" "0"
 SYSTEM_CONSTANT "DSMCONF_DEBMULDCY_SC" "0"
 SYSTEM_CONSTANT "DSMCONF_DFCCTTSTD" "0"
 SYSTEM_CONSTANT "DSMCONF_DTCOCLASSIC" "1"
 SYSTEM_CONSTANT "DSMCONF_DTCTABLE_DTCM" "0"
 SYSTEM_CONSTANT "DSMCONF_DTCTABLE_DTCX" "1"
 SYSTEM_CONSTANT "DSMCONF_NUMDTRSIZECAN_SC" "34"
 SYSTEM_CONSTANT "DSMCONF_NUMDTRSIZEKLINE_SC" "1"
 SYSTEM_CONSTANT "DSMCONF_NUMFRFRBYTES_SC" "42"
 SYSTEM_CONSTANT "DSMCONF_NUMFRFRSIGNALS_SC" "42"
 SYSTEM_CONSTANT "DSMCONF_NUMSPAREFID_SC" "5"
 SYSTEM_CONSTANT "DSMCONF_NUM_CLASSES" "20"
 SYSTEM_CONSTANT "DSMCONF_SUPGLBCTLMSK" "0"
 SYSTEM_CONSTANT "DSMCONF_SUPGLBDBLV" "1"
 SYSTEM_CONSTANT "DSMCONF_SUPGLBDISBLMSK" "0"
 SYSTEM_CONSTANT "DSMCONF_SUPGLBDTCFUNCUNIT" "0"
 SYSTEM_CONSTANT "DSMCONF_SUPGLBDTCGROUP" "0"
 SYSTEM_CONSTANT "DSMCONF_SUPGLBDTCSEVERITY" "0"
 SYSTEM_CONSTANT "DSMCONF_SUPGLBENVREF" "0"
 SYSTEM_CONSTANT "DSMCONF_SUPGLBFAULTTYP" "0"
 SYSTEM_CONSTANT "DSMCONF_SUPGLBFLTCLS" "0"
 SYSTEM_CONSTANT "DSMCONF_SUPGLBOBDFAULTTYP" "0"
 SYSTEM_CONSTANT "DSMCONF_SUP_DFC_STUNCFMDTHISKEYONCYC" "0"
 SYSTEM_CONSTANT "DSMCONF_SUP_TNPSCPU" "0"
 SYSTEM_CONSTANT "DSMCONF_SUP_TNPSDTCC" "0"
 SYSTEM_CONSTANT "DSMDFC_BAS16BITARYSIZE" "60"
 SYSTEM_CONSTANT "DSMDUR_MIL_GLB_SY" "1"
 SYSTEM_CONSTANT "DSMDUR_NUM_DFES_CNT" "0"
 SYSTEM_CONSTANT "DSMDUR_NUM_GLB_CNT" "1"
 SYSTEM_CONSTANT "DSMDUR_SUPPID4D_SC" "1"
 SYSTEM_CONSTANT "DSMDUR_SUPPID4E_SC" "1"
 SYSTEM_CONSTANT "DSMENV_NUMBYTALCENTRY_SY" "8"
 SYSTEM_CONSTANT "DSMENV_NUMBYTFRZFRM_SY" "14"
 SYSTEM_CONSTANT "DSMENV_NUMSIGALCENTRY_SY" "8"
 SYSTEM_CONSTANT "DSMENV_NUMSIGFRZFRM_SY" "7"
 SYSTEM_CONSTANT "DSMRDY_ENA_FLSYSFORCELABEL_SC" "0"
 SYSTEM_CONSTANT "DSMRDY_ENGSPEC_SY" "1"
 SYSTEM_CONSTANT "DSMRDY_ENVCOND_SUP" "1"
 SYSTEM_CONSTANT "DSMRDY_FIDINH_SUP" "1"
 SYSTEM_CONSTANT "DSMRDY_FLSYSNONCONT" "0"
 SYSTEM_CONSTANT "DSMRDY_INHP41_SY" "1"
 SYSTEM_CONSTANT "DSMRDY_READONLY" "0"
 SYSTEM_CONSTANT "DSMRDY_READONLYGRP" "0"
 SYSTEM_CONSTANT "DSMRDY_SIZE_LST_Cat" "15"
 SYSTEM_CONSTANT "DSMRDY_SIZE_LST_ComprCmpnt" "400"
 SYSTEM_CONSTANT "DSMRDY_SIZE_LST_CSER" "15"
 SYSTEM_CONSTANT "DSMRDY_SIZE_LST_DOR" "15"
 SYSTEM_CONSTANT "DSMRDY_SIZE_LST_ECS" "15"
 SYSTEM_CONSTANT "DSMRDY_SIZE_LST_EGR" "1"
 SYSTEM_CONSTANT "DSMRDY_SIZE_LST_EGR_EXCL" "15"
 SYSTEM_CONSTANT "DSMRDY_SIZE_LST_EvpSys" "15"
 SYSTEM_CONSTANT "DSMRDY_SIZE_LST_FlSys" "15"
 SYSTEM_CONSTANT "DSMRDY_SIZE_LST_GPF" "15"
 SYSTEM_CONSTANT "DSMRDY_SIZE_LST_HtCat" "15"
 SYSTEM_CONSTANT "DSMRDY_SIZE_LST_Misf" "15"
 SYSTEM_CONSTANT "DSMRDY_SIZE_LST_NOxAdsorb" "1"
 SYSTEM_CONSTANT "DSMRDY_SIZE_LST_NOxCatNOx" "1"
 SYSTEM_CONSTANT "DSMRDY_SIZE_LST_O2Sens" "15"
 SYSTEM_CONSTANT "DSMRDY_SIZE_LST_O2SensHt" "15"
 SYSTEM_CONSTANT "DSMRDY_SIZE_LST_Other" "15"
 SYSTEM_CONSTANT "DSMRDY_SIZE_LST_PCV" "15"
 SYSTEM_CONSTANT "DSMRDY_SIZE_LST_SecAirSys" "15"
 SYSTEM_CONSTANT "DSMRDY_SIZE_LST_VVT" "15"
 SYSTEM_CONSTANT "DSMRDY_STDCONFIG" "1"
 SYSTEM_CONSTANT "DSMRDY_SUPPID41_SY" "1"
 SYSTEM_CONSTANT "DSMRDY_VERS_SC" "2"
 SYSTEM_CONSTANT "DSM_CONF_SUP_DFC_STCLCTLDF" "0"
 SYSTEM_CONSTANT "DSM_CONF_SUP_DSMRDY_CT" "0"
 SYSTEM_CONSTANT "DSM_CONF_SUP_DSMRDY_XWHY" "1"
 SYSTEM_CONSTANT "DSM_DISBLGRPSIZE_SY" "0"
 SYSTEM_CONSTANT "DSM_DOBD_SC" "0"
 SYSTEM_CONSTANT "DSM_DPFSRVSUPRT_SC" "0"
 SYSTEM_CONSTANT "DSM_DSM2SG_SY" "0"
 SYSTEM_CONSTANT "DSM_DSMADENA_SC" "1"
 SYSTEM_CONSTANT "DSM_DTRINTCOMPUVLDN_SC" "0"
 SYSTEM_CONSTANT "DSM_ENVSIZE_SY" "49"
 SYSTEM_CONSTANT "DSM_FAILCNT_SY" "1"
 SYSTEM_CONSTANT "DSM_FAULTSEQ_SY" "1"
 SYSTEM_CONSTANT "DSM_FRZFRSIZE_SY" "28"
 SYSTEM_CONSTANT "DSM_GETSTSTRTEND_LEGACY_SC" "0"
 SYSTEM_CONSTANT "DSM_GETSTSTRTEND_SC" "1"
 SYSTEM_CONSTANT "DSM_HDOBD_SY" "0"
 SYSTEM_CONSTANT "DSM_INHRLS_SY" "0"
 SYSTEM_CONSTANT "DSM_MDOBD_SY" "0"
 SYSTEM_CONSTANT "DSM_MPU_ENABLED" "0"
 SYSTEM_CONSTANT "DSM_NUMDFC" "958"
 SYSTEM_CONSTANT "DSM_NUMFID" "20"
 SYSTEM_CONSTANT "DSM_NUM_MPU_PARTITIONS" "0"
 SYSTEM_CONSTANT "DSM_OBSVR_SY" "0"
 SYSTEM_CONSTANT "DSM_PDTCTSTRA_SY" "0"
 SYSTEM_CONSTANT "DSM_TESTMODDIAGCODLAMP_SC" "0"
 SYSTEM_CONSTANT "DSM_WUCDET_SY" "4"
 SYSTEM_CONSTANT "DSM_XDI_ENA_SC" "0"
 SYSTEM_CONSTANT "DTR_LEGIFC_SY" "0"
 SYSTEM_CONSTANT "DTR_NUM_ELEMENTS" "1"
 SYSTEM_CONSTANT "DTTEMP_300" "300"
 SYSTEM_CONSTANT "DTTEMP_M_300" "-300"
 SYSTEM_CONSTANT "DTY_CYC_ZERO" "0"
 SYSTEM_CONSTANT "DT_KELV_RES" "0.1"
 SYSTEM_CONSTANT "DVOL_RES" "0.1"
 SYSTEM_CONSTANT "D_FLCONS_RES" "0.01"
 SYSTEM_CONSTANT "ECBVLV_TYPAVL_SY" "0"
 SYSTEM_CONSTANT "ECUNUM_SY" "1"
 SYSTEM_CONSTANT "ECUOFF_TMR_SY" "0"
 SYSTEM_CONSTANT "ECUTYP_SC" "7"
 SYSTEM_CONSTANT "ECU_GENR_SY" "6"
 SYSTEM_CONSTANT "ECU_TYPE_SY" "7"
 SYSTEM_CONSTANT "EEPROM_RESET_CALIB" "3"
 SYSTEM_CONSTANT "EEPROM_RESET_INACTIVE" "2"
 SYSTEM_CONSTANT "EGREVAPRUSFLDP_TYPAVL_SC" "0"
 SYSTEM_CONSTANT "EGRVLVINSDT_TYPAVL_SC" "0"
 SYSTEM_CONSTANT "EGRVLV_TYPAVL_SY" "0"
 SYSTEM_CONSTANT "EGTCOND_ACTV_BP" "0"
 SYSTEM_CONSTANT "EGTSWT_FACT" "16384000"
 SYSTEM_CONSTANT "EGTSWT_FACT_S16" "16384"
 SYSTEM_CONSTANT "EGTSWT_NRM_EXP" "14"
 SYSTEM_CONSTANT "EGTSWT_RES" "6.103515625e-008"
 SYSTEM_CONSTANT "EGTSWT_RES_S16" "6.103515625e-005"
 SYSTEM_CONSTANT "ENADATASETID_CALPAR_SC" "0"
 SYSTEM_CONSTANT "ENERGY_J_HI_RES" "1"
 SYSTEM_CONSTANT "ENERGY_Q0P0001_RES" "0.0001"
 SYSTEM_CONSTANT "ENERGY_Q0P0001_RES_REV" "10000"
 SYSTEM_CONSTANT "ENERGY_Q0P001_RES" "0.001"
 SYSTEM_CONSTANT "ENERGY_Q0P001_RES_REV" "1000"
 SYSTEM_CONSTANT "ENERGY_RES" "1"
 SYSTEM_CONSTANT "ENGCMPTMTT_TYPAVL_SY" "0"
 SYSTEM_CONSTANT "ENGMIDT_TYPAVL_SC" "0"
 SYSTEM_CONSTANT "ENGOILT_TYPAVL_SC" "0"
 SYSTEM_CONSTANT "ENGRESTRT_SY" "0"
 SYSTEM_CONSTANT "ENGSPD_SWTENA_SY" "0"
 SYSTEM_CONSTANT "ENRGPERMASS_RES" "0.1"
 SYSTEM_CONSTANT "ENVP_TYPAVL_SY" "1"
 SYSTEM_CONSTANT "ENVRAM_RESET_ACTIVE" "1"
 SYSTEM_CONSTANT "ENVT_TYPAVL_SY" "1"
 SYSTEM_CONSTANT "EPMBCA_FACSEGTIMEACC_CURX_SC" "4"
 SYSTEM_CONSTANT "EPMBCR_DTINCSTRT_CURX_SC" "2"
 SYSTEM_CONSTANT "EPMBCR_FACWEIGHTPAS_DSTX_SC" "2"
 SYSTEM_CONSTANT "EPMBCR_FACWEIGHT_DSTX_SC" "2"
 SYSTEM_CONSTANT "EPMBCR_NENG_DSTX_SC" "2"
 SYSTEM_CONSTANT "EPMCAS_DIAGSRC2_SC" "0"
 SYSTEM_CONSTANT "EPMCAS_FACPLAUS_DSTX_SC" "3"
 SYSTEM_CONSTANT "EPMCAS_NUMSEGLEN_SC" "10"
 SYSTEM_CONSTANT "EPMCAS_NUMSEG_SC" "10"
 SYSTEM_CONSTANT "EPMCAS_OFFSDIAGDTRENA_SC" "0"
 SYSTEM_CONSTANT "EPMCAS_PHINCOR_CURX_SC" "6"
 SYSTEM_CONSTANT "EPMCAS_PHITEMPADAPCORSIZEDSTX_SC" "5"
 SYSTEM_CONSTANT "EPMCAS_PHITEMPCOR05_DSTX_SC" "3"
 SYSTEM_CONSTANT "EPMCAS_PRODCORRNVAL_SC" "0"
 SYSTEM_CONSTANT "EPMCAS_REFADPNTSTR_SC" "0"
 SYSTEM_CONSTANT "EPMCAS_SELNDIAGFAILRADPN_SC" "0"
 SYSTEM_CONSTANT "EPMCRS_DGIPLSCORRNACTVD_SC" "0"
 SYSTEM_CONSTANT "EPMCRS_DIAGDETAILEXTD_SC" "0"
 SYSTEM_CONSTANT "EPMCRS_DIAGSRC_SC" "0"
 SYSTEM_CONSTANT "EPMCRS_DIAGSYNCLOST_SC" "0"
 SYSTEM_CONSTANT "EPMCRS_ENASIGLVLDIAG_SC" "0"
 SYSTEM_CONSTANT "EPMCRS_MAXAXISPNTSTIPLSCRV_SC" "0"
 SYSTEM_CONSTANT "EPMCRS_NRENGSPDSEGPLAUS_SC" "4"
 SYSTEM_CONSTANT "EPMCRS_NUMINCOUT_SC" "15"
 SYSTEM_CONSTANT "EPMCRS_PLSWIDTHAPPLACTVD_SC" "0"
 SYSTEM_CONSTANT "EPMCRS_RESLTOTREV_SC" "0"
 SYSTEM_CONSTANT "EPMCRS_REVSTRTCONT_SC" "1"
 SYSTEM_CONSTANT "EPMCRS_TIINCOUTPVBL_SC" "1"
 SYSTEM_CONSTANT "EPMCRS_TIINCOUT_SC" "0"
 SYSTEM_CONSTANT "EPMERR_NRERRINFOARY_SC" "3"
 SYSTEM_CONSTANT "EPMHCAS_MAXTRYPREBUF" "50"
 SYSTEM_CONSTANT "EPMHCAS_NUMBUFSIZE" "32"
 SYSTEM_CONSTANT "EPMHCAS_NUMCASMAX4BUFFER" "1"
 SYSTEM_CONSTANT "EPMHCAS_OFFSET_BP" "16"
 SYSTEM_CONSTANT "EPMHCRS_CRSSENSADD" "1"
 SYSTEM_CONSTANT "EPMHCRS_FALLING_EDGE" "0"
 SYSTEM_CONSTANT "EPMHCRS_NUMGAP" "1"
 SYSTEM_CONSTANT "EPMHCRS_NUMGAPMAX" "1"
 SYSTEM_CONSTANT "EPMHCRS_NUMINC" "60"
 SYSTEM_CONSTANT "EPMHCRS_NUMINCGAP" "3"
 SYSTEM_CONSTANT "EPMHCRS_RISING_EDGE" "1"
 SYSTEM_CONSTANT "EPMHCRS_SIGBUF_MAX" "132"
 SYSTEM_CONSTANT "EPMHWE_RTM_SY" "0"
 SYSTEM_CONSTANT "EPMHWE_SWTCPU_SY" "1"
 SYSTEM_CONSTANT "EPMRRS_IGNLOCKRELSIMDT_SC" "0"
 SYSTEM_CONSTANT "EPMRRS_SY" "2"
 SYSTEM_CONSTANT "EPMRRS_TITEMP_CURX_SC" "3"
 SYSTEM_CONSTANT "EPMRVSROTYMETH_SY" "1"
 SYSTEM_CONSTANT "EPMSPD_ENAPSDIAG_SC" "0"
 SYSTEM_CONSTANT "EPMSPD_SIGGENN_SC" "0"
 SYSTEM_CONSTANT "EPMSYN_INJRLS_SC" "0"
 SYSTEM_CONSTANT "EPMSYN_PHIINCCOR_CURX_SC" "4"
 SYSTEM_CONSTANT "EPMTDC_PRODCORRNVAL_SC" "0"
 SYSTEM_CONSTANT "EPM_ATS_SY" "0"
 SYSTEM_CONSTANT "EPM_CAMSFTSNSRDEACTVN_SC" "0"
 SYSTEM_CONSTANT "EPM_CUSTADP_SC" "0"
 SYSTEM_CONSTANT "EPM_DGIDIRCORRN_SC" "1"
 SYSTEM_CONSTANT "EPM_DGIDIRFRCD_SC" "1"
 SYSTEM_CONSTANT "EPM_DGIDYNCHG_SC" "1"
 SYSTEM_CONSTANT "EPM_DGIPLSRNG_SC" "1"
 SYSTEM_CONSTANT "EPM_DIAGSPC_SY" "0"
 SYSTEM_CONSTANT "EPM_GTCRED_SY" "0"
 SYSTEM_CONSTANT "EPM_HIRESLSEGLENCAL_SC" "0"
 SYSTEM_CONSTANT "EPM_IAPACTV_SC" "0"
 SYSTEM_CONSTANT "EPM_INDCAMSFTCFG_SC" "0"
 SYSTEM_CONSTANT "EPM_KEEPDGISYNC_SC" "1"
 SYSTEM_CONSTANT "EPM_MEASURE_SY" "2"
 SYSTEM_CONSTANT "EPM_NRAGEVE_SC" "0"
 SYSTEM_CONSTANT "EPM_OPTMRT_SC" "0"
 SYSTEM_CONSTANT "EPM_RVSROTPRED_SC" "0"
 SYSTEM_CONSTANT "EPM_SPD_CALC_SY" "0"
 SYSTEM_CONSTANT "EPM_STRTSELECT_SC" "0"
 SYSTEM_CONSTANT "EPM_STRTWOCAMSFTSIGDETN_SC" "0"
 SYSTEM_CONSTANT "EPM_SYNCSLV_SY" "0"
 SYSTEM_CONSTANT "EPM_TDCDSTCLB_SC" "0"
 SYSTEM_CONSTANT "EPM_TIMING_SY" "0"
 SYSTEM_CONSTANT "ERCLNTVLVT_TYPAVL_SC" "0"
 SYSTEM_CONSTANT "ERCLNTVLV_ACTRTEMPMODELAVL_SY" "1"
 SYSTEM_CONSTANT "ERCLNTVLV_ADCSENSCAL_SY" "0"
 SYSTEM_CONSTANT "ERCLNTVLV_ASWTYPTWINFLWELEC_SY" "1"
 SYSTEM_CONSTANT "ERCLNTVLV_AVRGFLTSIZ_SY" "0"
 SYSTEM_CONSTANT "ERCLNTVLV_CJ230CAL_SY" "0"
 SYSTEM_CONSTANT "ERCLNTVLV_CJ945CAL_SY" "0"
 SYSTEM_CONSTANT "ERCLNTVLV_CLNVRFY_SY" "0"
 SYSTEM_CONSTANT "ERCLNTVLV_DESVALOSCI_SY" "0"
 SYSTEM_CONSTANT "ERCLNTVLV_DIAGGRDKEYCAL_SY" "0"
 SYSTEM_CONSTANT "ERCLNTVLV_DIGCAL_SY" "0"
 SYSTEM_CONSTANT "ERCLNTVLV_ETCACTROFSLRN_SY" "0"
 SYSTEM_CONSTANT "ERCLNTVLV_ETCACTRTST_SY" "0"
 SYSTEM_CONSTANT "ERCLNTVLV_FMIN_SY" "0"
 SYSTEM_CONSTANT "ERCLNTVLV_GOVDVTMONCAL_SY" "1"
 SYSTEM_CONSTANT "ERCLNTVLV_HYSTCOMP_SY" "0"
 SYSTEM_CONSTANT "ERCLNTVLV_MULHYSAVL_SY" "0"
 SYSTEM_CONSTANT "ERCLNTVLV_PDSBCCOMP_SY" "0"
 SYSTEM_CONSTANT "ERCLNTVLV_PLSTCMP_SC" "0"
 SYSTEM_CONSTANT "ERCLNTVLV_POSGOVCAL_SY" "1"
 SYSTEM_CONSTANT "ERCLNTVLV_POSGOVPAR1CAL_SY" "1"
 SYSTEM_CONSTANT "ERCLNTVLV_POSGOVPAR2CAL_SY" "0"
 SYSTEM_CONSTANT "ERCLNTVLV_POSGOVPARACUR_SY" "1"
 SYSTEM_CONSTANT "ERCLNTVLV_PWMIN_SY" "0"
 SYSTEM_CONSTANT "ERCLNTVLV_RLSFUNC_SY" "1"
 SYSTEM_CONSTANT "ERCLNTVLV_SENTCAL_SY" "1"
 SYSTEM_CONSTANT "ERCLNTVLV_STEXTDEM_SY" "0"
 SYSTEM_CONSTANT "ERCLNTVLV_TYPAVLACTRLIB_SY" "1"
 SYSTEM_CONSTANT "ERCLNTVLV_TYPAVL_SY" "0"
 SYSTEM_CONSTANT "ERCLNTVLV_TYPTWINFLW_SY" "0"
 SYSTEM_CONSTANT "ERRLMP_ATSINTVMOD_SY" "0"
 SYSTEM_CONSTANT "ERRLMP_CUST_SY" "0"
 SYSTEM_CONSTANT "ERRLMP_PSPRS_SY" "0"
 SYSTEM_CONSTANT "ERRLMP_UNIFY_SC" "0"
 SYSTEM_CONSTANT "ERRLMP_VLDTSTDSQ_SC" "0"
 SYSTEM_CONSTANT "ESC_ACTVTSYNCHAINCFG_SC" "2"
 SYSTEM_CONSTANT "ESC_ACTVTSYNTSKCHAIN_SC" "0"
 SYSTEM_CONSTANT "ESC_NRAGEVEWCYC_SC" "0"
 SYSTEM_CONSTANT "ESC_NRTSKAGEVE_SC" "2"
 SYSTEM_CONSTANT "ESC_SAMPLETICALCN_SC" "0"
 SYSTEM_CONSTANT "ESC_SELNCAMSFTTSKACTVN_SC" "0"
 SYSTEM_CONSTANT "ESC_SELNMETHSYNSDL_SC" "0"
 SYSTEM_CONSTANT "ESC_SELNNOTSTDTISYNCNTSK_SC" "0"
 SYSTEM_CONSTANT "ESC_SWTSYNRTMEASMT_SC" "0"
 SYSTEM_CONSTANT "ESC_SYNCTASK_SC" "0"
 SYSTEM_CONSTANT "ETA_THM_ENG_ONE" "1"
 SYSTEM_CONSTANT "ETCLB_NUM_RAILP_CLB_PNT" "2"
 SYSTEM_CONSTANT "ETCTL_ACTV_BP" "0"
 SYSTEM_CONSTANT "ETC_Act_SY" "1"
 SYSTEM_CONSTANT "ETHTSYN_SC" "0"
 SYSTEM_CONSTANT "ETH_SC" "0"
 SYSTEM_CONSTANT "ETKS_SY" "1"
 SYSTEM_CONSTANT "ETS_INJPOI1" "4"
 SYSTEM_CONSTANT "ETS_LEAN_SY" "0"
 SYSTEM_CONSTANT "ETS_NSC_SY" "0"
 SYSTEM_CONSTANT "ETS_NUMINPMSK_SY" "0"
 SYSTEM_CONSTANT "ETS_PFLT1_SY" "0"
 SYSTEM_CONSTANT "ETS_PFLT2_1" "31"
 SYSTEM_CONSTANT "ETS_PFLT2_SY" "0"
 SYSTEM_CONSTANT "ETS_PHC_SY" "0"
 SYSTEM_CONSTANT "ETS_SOX_SY" "0"
 SYSTEM_CONSTANT "EVAPRDSMIXFLDP_TYPAVL_SC" "0"
 SYSTEM_CONSTANT "EVAPRDSMIXFLDT_TYPAVL_SC" "0"
 SYSTEM_CONSTANT "EXHEVAPRDSFLDT_TYPAVL_SC" "0"
 SYSTEM_CONSTANT "EXHEVAPRDSGAST_TYPAVL_SC" "0"
 SYSTEM_CONSTANT "EXHEVAPRUSFLDP_TYPAVL_SC" "0"
 SYSTEM_CONSTANT "EXHEVAPRUSFLDT_TYPAVL_SC" "0"
 SYSTEM_CONSTANT "EXHEVAPRUSGAST_TYPAVL_SC" "0"
 SYSTEM_CONSTANT "EXHPPFLT_TYPAVL_SY" "0"
 SYSTEM_CONSTANT "FACT16_EXP" "16"
 SYSTEM_CONSTANT "FACT16_RES_REV" "65536"
 SYSTEM_CONSTANT "FACT1_ZERO" "0"
 SYSTEM_CONSTANT "FACT26_EXP" "26"
 SYSTEM_CONSTANT "FACT26_RES_REV" "67108864"
 SYSTEM_CONSTANT "FACT6_RES_REV" "500"
 SYSTEM_CONSTANT "FACT9_RES_REV" "5000"
 SYSTEM_CONSTANT "FACTLOW1_RES_REV" "25"
 SYSTEM_CONSTANT "FACT_NSCAGETOT_RES" "3"
 SYSTEM_CONSTANT "FACT_NSCAGE_RES" "0.001"
 SYSTEM_CONSTANT "FACT_NSCEFF_RES" "0.0001"
 SYSTEM_CONSTANT "FACT_NSCEFF_RES_REV" "10000"
 SYSTEM_CONSTANT "FACT_NSC_MAX" "1"
 SYSTEM_CONSTANT "FACT_NSC_MIN" "0"
 SYSTEM_CONSTANT "FACT_NSC_RES" "0.001"
 SYSTEM_CONSTANT "FACT_NSC_RES_REV" "1000"
 SYSTEM_CONSTANT "FACT_OIL_VOLSNGLDIFF" "32000"
 SYSTEM_CONSTANT "FACT_Q0P001_RES" "0.001"
 SYSTEM_CONSTANT "FACT_Q0P001_RES_REV" "1000"
 SYSTEM_CONSTANT "FACT_VOLNSC_RES" "1e-006"
 SYSTEM_CONSTANT "FAC_AG_CRS_HI_RESO" "128"
 SYSTEM_CONSTANT "FAC_MASSINJ_TO_QNTINJ" "10000"
 SYSTEM_CONSTANT "FAC_QNTADJ_TO_QNTINJ_0" "1000"
 SYSTEM_CONSTANT "FAC_QNTADJ_TO_QNTINJ_1" "1500"
 SYSTEM_CONSTANT "FAC_QNTADJ_TO_QNTINJ_2" "2500"
 SYSTEM_CONSTANT "FAC_QNTADJ_TO_QNTINJ_3" "5000"
 SYSTEM_CONSTANT "FAC_QNTADJ_TO_QNTINJ_RES" "100"
 SYSTEM_CONSTANT "FAC_T_INC_PER_DUR_HI_RESO" "256"
 SYSTEM_CONSTANT "FANCTL_HOTLMP" "0"
 SYSTEM_CONSTANT "FANCTL_HOTLMPWRN" "1"
 SYSTEM_CONSTANT "FDE_SC" "0"
 SYSTEM_CONSTANT "FLCONS1_RES" "0.01"
 SYSTEM_CONSTANT "FLCONS2_RES" "1"
 SYSTEM_CONSTANT "FLCONS2_RES_HIGH_REV" "20"
 SYSTEM_CONSTANT "FLCONS2_RES_REV" "1"
 SYSTEM_CONSTANT "FLCONS3_MIN" "0"
 SYSTEM_CONSTANT "FLCONS_SDET_MIN" "0.01"
 SYSTEM_CONSTANT "FLEXPSCTRLRNR_SC" "0"
 SYSTEM_CONSTANT "FLFLTDSP_TYPAVL_SC" "0"
 SYSTEM_CONSTANT "FLMNG_R_STOICH_CONF" "14.5"
 SYSTEM_CONSTANT "FLOATIFRESLSELN_SC" "0"
 SYSTEM_CONSTANT "FLOWFCTCRITAIR" "0.48417899"
 SYSTEM_CONSTANT "FLVOL_RES" "0.05"
 SYSTEM_CONSTANT "FLXR_SY" "0"
 SYSTEM_CONSTANT "FRARTP_SC" "0"
 SYSTEM_CONSTANT "FRIPCORETYPE_SC" "0"
 SYSTEM_CONSTANT "FRM_END2END_STATE_INITIALIZED" "1"
 SYSTEM_CONSTANT "FRM_END2END_STATE_NORMAL" "2"
 SYSTEM_CONSTANT "FRM_END2END_STATE_SAFESTATE" "3"
 SYSTEM_CONSTANT "FRM_END2END_STATE_SAFESTATEPERM" "4"
 SYSTEM_CONSTANT "FRNM_SC" "0"
 SYSTEM_CONSTANT "FRTP_SC" "0"
 SYSTEM_CONSTANT "FRTSYN_SC" "0"
 SYSTEM_CONSTANT "FSPDSFLDP_TYPAVL_SC" "0"
 SYSTEM_CONSTANT "FUELP_TYPAVL_SY" "0"
 SYSTEM_CONSTANT "FUELT_TYPAVL_SY" "0"
 SYSTEM_CONSTANT "GBXOILP_TYPAVL_SY" "0"
 SYSTEM_CONSTANT "GBXOILT_TYPAVL_SY" "0"
 SYSTEM_CONSTANT "GDI_SY" "0"
 SYSTEM_CONSTANT "GEAR0" "0"
 SYSTEM_CONSTANT "GEAR1" "1"
 SYSTEM_CONSTANT "GEAR2" "2"
 SYSTEM_CONSTANT "GEAR3" "3"
 SYSTEM_CONSTANT "GEAR4" "4"
 SYSTEM_CONSTANT "GEAR5" "5"
 SYSTEM_CONSTANT "GEAR6" "6"
 SYSTEM_CONSTANT "GEAR7" "7"
 SYSTEM_CONSTANT "GLWCTL_TIME_MS_RES" "10"
 SYSTEM_CONSTANT "GSSYS_TYPAIRSYS_SY" "1"
 SYSTEM_CONSTANT "GSSYS_TYPEEXHFLW_SY" "1"
 SYSTEM_CONSTANT "GSSYS_TYPEXHTFLD_SY" "1"
 SYSTEM_CONSTANT "GSSYS_TYPPCR_SY" "1"
 SYSTEM_CONSTANT "HCMPT_Q0P0000004_ZERO" "0"
 SYSTEM_CONSTANT "HEAT_CAPACITY_RES_REV" "10"
 SYSTEM_CONSTANT "HEGN_CVN_SENS1_SY" "0"
 SYSTEM_CONSTANT "HEGN_CVN_SENS2_SY" "0"
 SYSTEM_CONSTANT "HEM_SY" "0"
 SYSTEM_CONSTANT "HESRV_CSTNCCHKECU1" "1"
 SYSTEM_CONSTANT "HESRV_CSTNCCHKECU2" "2"
 SYSTEM_CONSTANT "HESRV_ENASCNDFLW_SY" "0"
 SYSTEM_CONSTANT "HESRV_HCU" "3"
 SYSTEM_CONSTANT "HESRV_HETYP_SY" "255"
 SYSTEM_CONSTANT "HESRV_MSIDEXCLSN_SC" "1"
 SYSTEM_CONSTANT "HESRV_MSIDPLAUSCHECK_SC" "0"
 SYSTEM_CONSTANT "HESRV_NOTUSED" "0"
 SYSTEM_CONSTANT "HESRV_SEGPROCENA_SC" "0"
 SYSTEM_CONSTANT "HESRV_SWCSTNCARYSIZE_SC" "0"
 SYSTEM_CONSTANT "HESRV_SWCSTNCCHK_SC" "0"
 SYSTEM_CONSTANT "HESRV_VCU" "2"
 SYSTEM_CONSTANT "HEVCHGR_SY" "0"
 SYSTEM_CONSTANT "HEVGEN_SY" "0"
 SYSTEM_CONSTANT "HEVPLINAVL_SC" "0"
 SYSTEM_CONSTANT "HEVTYP_SY" "0"
 SYSTEM_CONSTANT "HPDIFF_TYPAVL_SC" "0"
 SYSTEM_CONSTANT "HPIN_TYPAVL_SC" "0"
 SYSTEM_CONSTANT "HPOUTPRR_TYPAVL_SY" "0"
 SYSTEM_CONSTANT "HTANKP_TYPAVL_SY" "0"
 SYSTEM_CONSTANT "HTANKT_TYPAVL_SY" "0"
 SYSTEM_CONSTANT "HTIN_TYPAVL_SC" "0"
 SYSTEM_CONSTANT "HTOUT_TYPAVL_SC" "0"
 SYSTEM_CONSTANT "HVACHEATPMPP_TYPAVL_SC" "0"
 SYSTEM_CONSTANT "HVACHEATPMPT_TYPAVL_SC" "0"
 SYSTEM_CONSTANT "HVACSPT_TYPAVL_SC" "0"
 SYSTEM_CONSTANT "HVDDCTYPAVL_SC" "0"
 SYSTEM_CONSTANT "HWDPD_SC" "0"
 SYSTEM_CONSTANT "HYBTOPO_NO" "0"
 SYSTEM_CONSTANT "HYBTOPO_P0" "1"
 SYSTEM_CONSTANT "HYBTOPO_P0_P4" "6"
 SYSTEM_CONSTANT "HYBTOPO_P1" "2"
 SYSTEM_CONSTANT "HYBTOPO_P2" "3"
 SYSTEM_CONSTANT "HYBTOPO_P3" "4"
 SYSTEM_CONSTANT "HYBTOPO_P4" "5"
 SYSTEM_CONSTANT "HYDSTORGHIPT_TYPAVL_SC" "0"
 SYSTEM_CONSTANT "HYDSTORGLOPT_TYPAVL_SC" "0"
 SYSTEM_CONSTANT "HYDSYSHIPTSEC_TYPAVL_SC" "0"
 SYSTEM_CONSTANT "HYDSYSLOPT_TYPAVL_SC" "0"
 SYSTEM_CONSTANT "I15031APPL_NOXSENSNUM_VAG_SY" "0"
 SYSTEM_CONSTANT "I15031APPL_NUMSIZETEXHFLD_SY" "0"
 SYSTEM_CONSTANT "I15031EXTD_DEACTVTAESINFO_SC" "1"
 SYSTEM_CONSTANT "I15031EXTD_INACTVTGEFN_SC" "1"
 SYSTEM_CONSTANT "I15031EXTD_UPDBYTEA" "1"
 SYSTEM_CONSTANT "I15031SRV9NOXBIN_SC" "0"
 SYSTEM_CONSTANT "I15031SRV9VT_SC" "1"
 SYSTEM_CONSTANT "I15031SRV9VT_STORGRSTBHVR_SC" "1"
 SYSTEM_CONSTANT "I15031_CUSVAR_SY" "0"
 SYSTEM_CONSTANT "I15031_CVNALG_SC" "1"
 SYSTEM_CONSTANT "I15031_CVN_CRC_DIABAS" "1"
 SYSTEM_CONSTANT "I15031_CVN_CRC_SECULIBS" "2"
 SYSTEM_CONSTANT "I15031_CVN_SHA_BCL" "3"
 SYSTEM_CONSTANT "I15031_CVN_SHA_BCL_AUTO" "5"
 SYSTEM_CONSTANT "I15031_CVN_SHA_HSM" "4"
 SYSTEM_CONSTANT "I15031_CVN_SHA_HSM_AUTO" "6"
 SYSTEM_CONSTANT "I15031_CVN_TIMER" "60000"
 SYSTEM_CONSTANT "I15031_ELEMSTRTSIZE_F5RNG_SC" "257"
 SYSTEM_CONSTANT "I15031_ELEMSTRTSIZE_SC" "257"
 SYSTEM_CONSTANT "I15031_EXTCVNSTORGBHVR_SC" "1"
 SYSTEM_CONSTANT "I15031_ITID_RANGE_ARRAY_SIZE" "8"
 SYSTEM_CONSTANT "I15031_OBD_CNTL_SC" "0"
 SYSTEM_CONSTANT "I15031_PID6B_SC" "0"
 SYSTEM_CONSTANT "I15031_PID6F_SC" "0"
 SYSTEM_CONSTANT "I15031_PID94_SC" "0"
 SYSTEM_CONSTANT "I15031_PID_RANGE_ARRAY_SIZE" "8"
 SYSTEM_CONSTANT "I15031_SRV8_SY" "0"
 SYSTEM_CONSTANT "I15031_SRV9AES_SC" "0"
 SYSTEM_CONSTANT "I15031_SRV9GHG_SC" "0"
 SYSTEM_CONSTANT "I15031_SRV9_VT_CAL_SUPP" "0"
 SYSTEM_CONSTANT "I15031_SRV9_VT_LENRPRTFMT_SC" "1"
 SYSTEM_CONSTANT "I15031_ST_SUPP_PID_F5RNG_SC" "42"
 SYSTEM_CONSTANT "I15031_ST_SUPP_PID_SC" "38"
 SYSTEM_CONSTANT "I15031_VARCOD_SY" "0"
 SYSTEM_CONSTANT "I15031_VISYSIZE_F5RNG_SC" "256"
 SYSTEM_CONSTANT "I15031_VISYSIZE_SC" "256"
 SYSTEM_CONSTANT "I27145_CANID_SC" "0"
 SYSTEM_CONSTANT "I27145_SC" "0"
 SYSTEM_CONSTANT "IDEAL_GAS_VOL" "22.4"
 SYSTEM_CONSTANT "IDLSHTDWN_SY" "0"
 SYSTEM_CONSTANT "IGNARCDURMONI_SY" "0"
 SYSTEM_CONSTANT "IGNARC_NUMTIM_SY" "1"
 SYSTEM_CONSTANT "IGNCLMPVLTGDURMON_SC" "0"
 SYSTEM_CONSTANT "IGNCLPS_BENCHERR_SC" "2"
 SYSTEM_CONSTANT "IGNCLPS_STADIAENBL_SY" "1"
 SYSTEM_CONSTANT "IGNCL_CLCRNTMON_SY" "0"
 SYSTEM_CONSTANT "IGNCL_INTCALCNXTCHL_SC" "1"
 SYSTEM_CONSTANT "IGNCL_QAG_SY" "2"
 SYSTEM_CONSTANT "IGNINCIR_SY" "0"
 SYSTEM_CONSTANT "INIT_ZERO" "0"
 SYSTEM_CONSTANT "INJCRV_ANGLE" "0"
 SYSTEM_CONSTANT "INJCRV_INJMASSPIIFACT_SY" "1"
 SYSTEM_CONSTANT "INJCRV_TIME" "1"
 SYSTEM_CONSTANT "INJDRVGEN_SY" "1"
 SYSTEM_CONSTANT "INJGDI_NUMPRESCIR_SY" "1"
 SYSTEM_CONSTANT "INJMSQ0P1_RES" "0.1"
 SYSTEM_CONSTANT "INJMSQ0P2_RES" "0.2"
 SYSTEM_CONSTANT "INJSYS_BENCHCVO_SC" "0"
 SYSTEM_CONSTANT "INJSYS_INJRLSSETPOINT_SY" "0"
 SYSTEM_CONSTANT "INJSYS_INJTMNGVRNT_SC" "0"
 SYSTEM_CONSTANT "INJSYS_POI1SETPOINT_SY" "0"
 SYSTEM_CONSTANT "INJSYS_POI2SETPOINT_SY" "0"
 SYSTEM_CONSTANT "INJSYS_POI3SETPOINT_SY" "0"
 SYSTEM_CONSTANT "INJTIME_US_ZERO" "0"
 SYSTEM_CONSTANT "INJTMNGDIAGPRS_SC" "0"
 SYSTEM_CONSTANT "INJVLVPS_DIASMALLTI_SY" "0"
 SYSTEM_CONSTANT "INJVLV_ADDRLY_SY" "0"
 SYSTEM_CONSTANT "INJVLV_ATS_SY" "0"
 SYSTEM_CONSTANT "INJVLV_CRNTPRFLMOD_SY" "0"
 SYSTEM_CONSTANT "INJVLV_DURVLVOFFMNST_SY" "1000"
 SYSTEM_CONSTANT "INJVLV_DURVLVOFFMN_SY" "200"
 SYSTEM_CONSTANT "INJVLV_ENDC_SY" "0"
 SYSTEM_CONSTANT "INJVLV_FSTRCVAFTFCO_SY" "0"
 SYSTEM_CONSTANT "INJVLV_NUMDCDC_SY" "0"
 SYSTEM_CONSTANT "INJVLV_ONOFF_ATS_SC" "0"
 SYSTEM_CONSTANT "INJVLV_PSIC_SC" "5"
 SYSTEM_CONSTANT "INJVLV_PSNR_SC" "1"
 SYSTEM_CONSTANT "INJVLV_STOREFLTONVEHSTOP_SC" "0"
 SYSTEM_CONSTANT "INJ_MASS100_MAX" "100"
 SYSTEM_CONSTANT "INJ_MASSCYC_MAX" "327.67"
 SYSTEM_CONSTANT "INJ_MASSCYC_MIN" "0"
 SYSTEM_CONSTANT "INJ_MASSCYC_RES" "0.01"
 SYSTEM_CONSTANT "INJ_MASSCYC_RES_INV" "100"
 SYSTEM_CONSTANT "INJ_MASSCYC_RES_REV" "100"
 SYSTEM_CONSTANT "INJ_MASSCYC_ZERO" "0"
 SYSTEM_CONSTANT "INJ_MASSINJ_RES" "0.01"
 SYSTEM_CONSTANT "INJ_MASSMIN_MAX" "10"
 SYSTEM_CONSTANT "INJ_MASSPII1_MAX" "10"
 SYSTEM_CONSTANT "INJ_MASSPII2_MAX" "10"
 SYSTEM_CONSTANT "INJ_MASSPII3_MAX" "10"
 SYSTEM_CONSTANT "INJ_MASSPOI0_MAX" "10"
 SYSTEM_CONSTANT "INJ_MASSPOI1_MAX" "10"
 SYSTEM_CONSTANT "INJ_MASSPOI2_MAX" "10"
 SYSTEM_CONSTANT "INJ_MASSPOI3_MAX" "10"
 SYSTEM_CONSTANT "INJ_MASS_MAX" "327.67"
 SYSTEM_CONSTANT "INJ_MASS_MIN" "0"
 SYSTEM_CONSTANT "INJ_MASS_ONE" "1"
 SYSTEM_CONSTANT "INJ_MASS_RES" "0.01"
 SYSTEM_CONSTANT "INJ_MASS_RES_INV" "100"
 SYSTEM_CONSTANT "INJ_MASS_ZERO" "0"
 SYSTEM_CONSTANT "INJ_QNTINJ_MAX" "100"
 SYSTEM_CONSTANT "INJ_QNTINJ_MIN" "0"
 SYSTEM_CONSTANT "INJ_QNTINJ_RES" "0.01"
 SYSTEM_CONSTANT "INJ_QNTINJ_ZERO" "0"
 SYSTEM_CONSTANT "INJ_QNT_RES" "0.1"
 SYSTEM_CONSTANT "INTKAIRT_SNSR1POS_SC" "0"
 SYSTEM_CONSTANT "INTKAIRT_SNSR2POS_SC" "0"
 SYSTEM_CONSTANT "INTKAIRT_SNSR3POS_SC" "0"
 SYSTEM_CONSTANT "INTKAIRT_TYPAVL_SC" "0"
 SYSTEM_CONSTANT "IOEXTDEV_CJ260_SC" "0"
 SYSTEM_CONSTANT "IOEXTDEV_PORTEXP_SC" "0"
 SYSTEM_CONSTANT "IPDUM_SC" "1"
 SYSTEM_CONSTANT "IUMPR_SY" "1"
 SYSTEM_CONSTANT "IUMPR_VERS_SY" "3"
 SYSTEM_CONSTANT "I_COIL_MAX" "5000"
 SYSTEM_CONSTANT "I_COIL_MIN" "0"
 SYSTEM_CONSTANT "J1939NM_SC" "0"
 SYSTEM_CONSTANT "J1939RM_SC" "0"
 SYSTEM_CONSTANT "J1939TP_SC" "0"
 SYSTEM_CONSTANT "KAPPADRYAIR" "1.4"
 SYSTEM_CONSTANT "KAPPA_DRYAIR" "1.4"
 SYSTEM_CONSTANT "KD_PRAIL2Q_1_MAX" "0.5"
 SYSTEM_CONSTANT "KD_PRAIL2Q_1_NRM" "4"
 SYSTEM_CONSTANT "KD_PRC_RES" "0.000125"
 SYSTEM_CONSTANT "KGH_TO_KGS" "3600"
 SYSTEM_CONSTANT "KI_PRAIL2Q_1_MAX" "2"
 SYSTEM_CONSTANT "KI_PRAIL2Q_1_NRM" "1"
 SYSTEM_CONSTANT "KLINE_SY" "0"
 SYSTEM_CONSTANT "KP_LMBDREC2INJMASS_1_MAX" "250"
 SYSTEM_CONSTANT "KP_LMBDREC2INJMASS_1_NRM" "2"
 SYSTEM_CONSTANT "KP_LMBDREC2INJMASS_1_RES_REV" "4"
 SYSTEM_CONSTANT "KP_PRAIL2Q_1_MAX" "0.2"
 SYSTEM_CONSTANT "KP_PRAIL2Q_1_NRM" "2"
 SYSTEM_CONSTANT "L9779_SC" "0"
 SYSTEM_CONSTANT "L9959_SC" "0"
 SYSTEM_CONSTANT "L9966_SC" "3"
 SYSTEM_CONSTANT "LAMBDAREC_RESVAL" "0.001"
 SYSTEM_CONSTANT "LAMBDA_INJMASS_RES" "1450"
 SYSTEM_CONSTANT "LAMBDA_MIN" "0"
 SYSTEM_CONSTANT "LAMBDA_ONE" "1"
 SYSTEM_CONSTANT "LAMBDA_REC_ZERO" "0"
 SYSTEM_CONSTANT "LAMBDA_TEN" "10"
 SYSTEM_CONSTANT "LAMBDA_ZERO" "0"
 SYSTEM_CONSTANT "LAMCTLDESVAL_NUM" "2"
 SYSTEM_CONSTANT "LAMCTLGOV_NUM" "2"
 SYSTEM_CONSTANT "LAMCTLMON_DVT_MAX" "10"
 SYSTEM_CONSTANT "LAMCTLMON_NUM_RM" "2"
 SYSTEM_CONSTANT "LAMCTLMON_TIME_MAX" "20"
 SYSTEM_CONSTANT "LAMCTLPRECTL_NUM" "2"
 SYSTEM_CONSTANT "LAMCTL_ACTVMONFDBKCTL_BP" "1"
 SYSTEM_CONSTANT "LAMCTL_DFL" "0"
 SYSTEM_CONSTANT "LAMCTL_SWTACTV_BP" "0"
 SYSTEM_CONSTANT "LENGTH_MM_RES" "1"
 SYSTEM_CONSTANT "LENGTH_M_PER_KM" "1000"
 SYSTEM_CONSTANT "LINNM_SC" "0"
 SYSTEM_CONSTANT "LIN_SY" "1"
 SYSTEM_CONSTANT "LLIM_ACTIVE" "3"
 SYSTEM_CONSTANT "LLIM_OFF" "1"
 SYSTEM_CONSTANT "LLIM_STANDBY" "2"
 SYSTEM_CONSTANT "LSM_SY" "0"
 SYSTEM_CONSTANT "LSU_CT_SENSORS" "1"
 SYSTEM_CONSTANT "LSU_CT_SENSORS_MAX" "4"
 SYSTEM_CONSTANT "LSU_CT_SENSORS_SY" "1"
 SYSTEM_CONSTANT "LSU_CT_SENSORS_TWFLW_SYS" "1"
 SYSTEM_CONSTANT "MASS_CONV_G2MG" "1000"
 SYSTEM_CONSTANT "MASS_CONV_KG2G" "1000"
 SYSTEM_CONSTANT "MASS_MOL_EG" "28.5"
 SYSTEM_CONSTANT "MASS_Q1_RES_REV" "1"
 SYSTEM_CONSTANT "MAX_NUM_ADDINJ_SY" "1"
 SYSTEM_CONSTANT "MAX_NUM_MAININJ_SY" "2"
 SYSTEM_CONSTANT "MDG1CPUDEVICE_SC" "4"
 SYSTEM_CONSTANT "MDG1CPUSTEP_SC" "120"
 SYSTEM_CONSTANT "MDG1CPUVENDOR_SC" "1"
 SYSTEM_CONSTANT "MDG1MSGCNCPT_SC" "0"
 SYSTEM_CONSTANT "MEM_CENDIAGACTVD_SC" "1"
 SYSTEM_CONSTANT "MEM_DIAGACTVDEXTD_SC" "0"
 SYSTEM_CONSTANT "MFVLV_NRCAMSFTCTRLHDP_SC" "0"
 SYSTEM_CONSTANT "MFVLV_NVHTYP_SC" "3"
 SYSTEM_CONSTANT "MFVLV_PQNTSVAL_SC" "0"
 SYSTEM_CONSTANT "MFVLV_TIDLYPULLINCFG_SC" "0"
 SYSTEM_CONSTANT "MFVLV_TSTRIFMOD_SY" "0"
 SYSTEM_CONSTANT "MFVLV_VARCTL_SC" "0"
 SYSTEM_CONSTANT "MILDHEV_SC" "0"
 SYSTEM_CONSTANT "MILLMP_2HZBLINK_SC" "1"
 SYSTEM_CONSTANT "MILLMP_ENGSTRTWITH2SECCDN_SC" "1"
 SYSTEM_CONSTANT "MILLMP_PWRSTG_SY" "0"
 SYSTEM_CONSTANT "MILLMP_SUPRT_ATS_SY" "0"
 SYSTEM_CONSTANT "MISFDET_TYP_SC" "0"
 SYSTEM_CONSTANT "MOCCPU_IT_SY" "5"
 SYSTEM_CONSTANT "MOCFC_NRCYCBLK_SC" "8"
 SYSTEM_CONSTANT "MOCFC_POSTBLDCHKS_SC" "0"
 SYSTEM_CONSTANT "MOCFC_SCCERRREACTN_SC" "0"
 SYSTEM_CONSTANT "MOCMM_COMSOPTESTENA_SC" "0"
 SYSTEM_CONSTANT "MOCMM_HWLAYOUT_SC" "1"
 SYSTEM_CONSTANT "MOLMASS_RES" "0.01"
 SYSTEM_CONSTANT "MOMENT_INERTIA_RES" "100"
 SYSTEM_CONSTANT "MO_CMNDSLGSLSW_SC" "1"
 SYSTEM_CONSTANT "MO_ROM_SY" "0"
 SYSTEM_CONSTANT "MRLY_STACTDSQENA_SC" "0"
 SYSTEM_CONSTANT "MSAGEN_SY" "0"
 SYSTEM_CONSTANT "MSI_SC" "0"
 SYSTEM_CONSTANT "MSI_SY" "0"
 SYSTEM_CONSTANT "MSI_TMPR_SY" "0"
 SYSTEM_CONSTANT "MSPERVOL_RES" "0.001"
 SYSTEM_CONSTANT "MSPERVOL_RES_REV" "1000"
 SYSTEM_CONSTANT "MSVSUBKOMP_SC" "2"
 SYSTEM_CONSTANT "MS_O2_RES" "0.001"
 SYSTEM_CONSTANT "MS_O2_RES_REV" "1000"
 SYSTEM_CONSTANT "MS_SOXLDTOT_RES" "0.5"
 SYSTEM_CONSTANT "MS_SOXLDTOT_RES_FL" "0.5"
 SYSTEM_CONSTANT "MS_SOXLDTOT_RES_REV" "2"
 SYSTEM_CONSTANT "MS_SOXNOX_RES" "1e-005"
 SYSTEM_CONSTANT "MS_SOXNOX_RES_REV" "100000"
 SYSTEM_CONSTANT "MS_SOX_RES" "0.000305"
 SYSTEM_CONSTANT "M_NOXLD_LORES_RES" "0.004"
 SYSTEM_CONSTANT "M_NOXLD_LORES_RES_REV" "250"
 SYSTEM_CONSTANT "M_SOOT_RES1" "0.004"
 SYSTEM_CONSTANT "M_SOOT_RES1_REV" "250"
 SYSTEM_CONSTANT "NOCAT2DS_CALID_SY" "0"
 SYSTEM_CONSTANT "NOMCATDS_CALID_SY" "0"
 SYSTEM_CONSTANT "NOREINI_SC" "1"
 SYSTEM_CONSTANT "NORM_AIRMASS_INJCRV_FACT1" "1280"
 SYSTEM_CONSTANT "NORM_DVOL_X_DT" "360000"
 SYSTEM_CONSTANT "NORM_HCMPTQ0P00000042HCMPT" "4"
 SYSTEM_CONSTANT "NORM_HCMPTQ0P82HCMPT" "8"
 SYSTEM_CONSTANT "NORM_MNOXLOAD2LR" "400"
 SYSTEM_CONSTANT "NORM_Q_BY_RHO" "1000"
 SYSTEM_CONSTANT "NORM_SEC_US" "1000000"
 SYSTEM_CONSTANT "NORM_TIME2LR" "100"
 SYSTEM_CONSTANT "NOXFLWEG_RES" "0.025"
 SYSTEM_CONSTANT "NOXFLW_RES" "0.001"
 SYSTEM_CONSTANT "NOXMASSFLW_RES" "0.001"
 SYSTEM_CONSTANT "NOXMASSFLW_RES_REV" "1000"
 SYSTEM_CONSTANT "NOX_FLD" "10"
 SYSTEM_CONSTANT "NOX_RES" "1"
 SYSTEM_CONSTANT "NRM_DVOL_X_DT" "360000"
 SYSTEM_CONSTANT "NRM_DVOL_X_DT_HIGH" "18000"
 SYSTEM_CONSTANT "NRM_EXPO_AG_CRS_HI_RESO" "7"
 SYSTEM_CONSTANT "NRM_EXPO_T_INC_PER_DUR_HI_RESO" "8"
 SYSTEM_CONSTANT "NRM_EXP_RES_TRIGO_FUNC" "12"
 SYSTEM_CONSTANT "NRM_Q_BY_RHO" "1000"
 SYSTEM_CONSTANT "NRM_VOL_L_TO_UL" "20"
 SYSTEM_CONSTANT "NSCDS_CT_SENSORS" "1"
 SYSTEM_CONSTANT "NSCLD_MTOTSTRTRGN_MIN" "0.001"
 SYSTEM_CONSTANT "NSCLD_RDCAGTMIN" "-1e-005"
 SYSTEM_CONSTANT "NSCMON_TIAFTLM_MAX" "65.536"
 SYSTEM_CONSTANT "NSCMON_UBINLAM_MAX" "2000"
 SYSTEM_CONSTANT "NSCRGN_TIME_100_RES" "0.01"
 SYSTEM_CONSTANT "NSC_ACTV_BP" "1"
 SYSTEM_CONSTANT "NSC_AMPTNOXLDUNLD_MAX" "0"
 SYSTEM_CONSTANT "NSC_AMPTNOXLDUNLD_MIN" "-10"
 SYSTEM_CONSTANT "NSC_AMPTNOXRGN_MAX" "0"
 SYSTEM_CONSTANT "NSC_AMPTNOX_MIN" "0"
 SYSTEM_CONSTANT "NSC_CT_SENSORS" "0"
 SYSTEM_CONSTANT "NSC_CT_SENSORS_SY" "0"
 SYSTEM_CONSTANT "NSC_CT_SENSORS_TWFLW_SYS" "0"
 SYSTEM_CONSTANT "NSC_MSO2_MIN" "0"
 SYSTEM_CONSTANT "NSC_MSPERVOL_MIN" "0"
 SYSTEM_CONSTANT "NSC_MSSOXNOX_MAX" "0.1"
 SYSTEM_CONSTANT "NSC_MSSOXNOX_MIN" "0"
 SYSTEM_CONSTANT "NSC_NOXMASSFLW_MIN" "0"
 SYSTEM_CONSTANT "NSC_NOX_ZERO" "0"
 SYSTEM_CONSTANT "NSC_SWTACTV_BP" "0"
 SYSTEM_CONSTANT "NSC_TIMEMAX_SY" "327.5"
 SYSTEM_CONSTANT "NUMCASMAX" "1"
 SYSTEM_CONSTANT "NUMCYLACT_SY" "4"
 SYSTEM_CONSTANT "NUMCYLCAL_SY" "1"
 SYSTEM_CONSTANT "NUMCYLMAX_SY" "4"
 SYSTEM_CONSTANT "NUMPSICCHP_SY" "1"
 SYSTEM_CONSTANT "NUM_CHIP" "1"
 SYSTEM_CONSTANT "O2MPT_RES_REV" "100"
 SYSTEM_CONSTANT "O2_RES" "1e-005"
 SYSTEM_CONSTANT "OBDUDSACTVN_SC" "1"
 SYSTEM_CONSTANT "OBD_PHYSMEDM_SY" "0"
 SYSTEM_CONSTANT "OBS_SY" "0"
 SYSTEM_CONSTANT "OILCOOLRDST_TYPAVL_SC" "0"
 SYSTEM_CONSTANT "OILLVL_MMQ0P004_RES" "0.004"
 SYSTEM_CONSTANT "OILLVL_MMQ0P004_RESREV" "250"
 SYSTEM_CONSTANT "OILMFL_MGPS_Q0P1_RES" "0.1"
 SYSTEM_CONSTANT "OILMFL_MGPS_Q0P1_RES_REV" "10"
 SYSTEM_CONSTANT "OILMSPRCQ0P01_100" "100"
 SYSTEM_CONSTANT "OILMSPRC_Q0P01_RES" "0.01"
 SYSTEM_CONSTANT "OILMSPRC_Q0P01_RES_REV" "100"
 SYSTEM_CONSTANT "OILMS_MG_RES" "1"
 SYSTEM_CONSTANT "OILMS_MG_RES_REV" "1"
 SYSTEM_CONSTANT "OILMS_Q0P1_RES" "0.1"
 SYSTEM_CONSTANT "OILMS_Q0P1_RES_REV" "10"
 SYSTEM_CONSTANT "OILMS_Q10_RES" "10"
 SYSTEM_CONSTANT "OILP_TYPAVL_SY" "0"
 SYSTEM_CONSTANT "OILT_TYPAVL_SY" "0"
 SYSTEM_CONSTANT "OTA_SC" "0"
 SYSTEM_CONSTANT "PAIRFLTDS_TYPAVL_SY" "0"
 SYSTEM_CONSTANT "PASSDOORRDNT_TYPAVL_SC" "0"
 SYSTEM_CONSTANT "PERMSPLYSYS_SY" "0"
 SYSTEM_CONSTANT "PEXHMNFLD_TYPAVL_SC" "0"
 SYSTEM_CONSTANT "PFLTLD_RO2EG" "0.2315"
 SYSTEM_CONSTANT "PFLTLD_RO2EGONE" "1"
 SYSTEM_CONSTANT "PFLTLD_RO2STOICH" "0.2315"
 SYSTEM_CONSTANT "PFLTLD_RO2STOICHONE" "1"
 SYSTEM_CONSTANT "PFLTPOPPRC_RES" "0.1"
 SYSTEM_CONSTANT "PFLT_ACTV_BP" "0"
 SYSTEM_CONSTANT "PHASE_DETECT_SY" "0"
 SYSTEM_CONSTANT "PHI_COR_MAX" "10"
 SYSTEM_CONSTANT "PHI_MI_EARL" "40"
 SYSTEM_CONSTANT "PHI_MI_LATE" "-10"
 SYSTEM_CONSTANT "PHI_PII_EARL_ABS" "100"
 SYSTEM_CONSTANT "PHI_PII_EARL_REL" "90"
 SYSTEM_CONSTANT "PHI_PII_LATE_REL" "5"
 SYSTEM_CONSTANT "PHI_POI0_EARLY" "-40"
 SYSTEM_CONSTANT "PHI_POI0_LATE" "-100"
 SYSTEM_CONSTANT "PHI_POI1_EARL" "-40"
 SYSTEM_CONSTANT "PHI_POI1_LATE" "-100"
 SYSTEM_CONSTANT "PHI_POI1_ZERO" "0"
 SYSTEM_CONSTANT "PHI_POI2_LATE" "-40"
 SYSTEM_CONSTANT "PHI_ZERO" "0"
 SYSTEM_CONSTANT "PI" "3.14159265359"
 SYSTEM_CONSTANT "PII321_MI1_POI321" "0"
 SYSTEM_CONSTANT "PII321_UNDEFD_MI1_POI21" "1"
 SYSTEM_CONSTANT "PIICLB_ANGLE32FAC2ANGLE_CNV" "6553600"
 SYSTEM_CONSTANT "PIICLB_FACTS32_RES" "65536"
 SYSTEM_CONSTANT "PIICLB_INJMASSS32_RES" "6553600"
 SYSTEM_CONSTANT "PIICLB_INJMASSS32_ZERO" "0"
 SYSTEM_CONSTANT "PIICLB_RCNFDMAX" "32766"
 SYSTEM_CONSTANT "PIICLB_STATE_CALC" "2"
 SYSTEM_CONSTANT "PIICLB_STATE_CLB" "1"
 SYSTEM_CONSTANT "PIICLB_STATE_INIT" "255"
 SYSTEM_CONSTANT "PIICLB_STATE_START" "0"
 SYSTEM_CONSTANT "PIICLB_STRLS_DISABLED" "1"
 SYSTEM_CONSTANT "PIICLB_STRLS_RELEASED" "0"
 SYSTEM_CONSTANT "PIICLB_TRQBYETA2QNT32_CNV" "83886080"
 SYSTEM_CONSTANT "PIICLB_TRQDT1KDMUL" "65536000"
 SYSTEM_CONSTANT "PIICLB_TRQPERSEC_RES" "1000"
 SYSTEM_CONSTANT "PIICLB_UPDT_COL" "1"
 SYSTEM_CONSTANT "PIICLB_UPDT_SEQ" "0"
 SYSTEM_CONSTANT "PIICLB_VARIANT_NONE" "0"
 SYSTEM_CONSTANT "PIICLB_VARIANT_PIC" "1"
 SYSTEM_CONSTANT "PIICLB_VARIANT_PICALL" "2"
 SYSTEM_CONSTANT "PINTKVUS_TYPAVL_SY" "0"
 SYSTEM_CONSTANT "PMAXCTL_FACKPNRM8" "8"
 SYSTEM_CONSTANT "PMP_QNT_MAX" "1500"
 SYSTEM_CONSTANT "PMP_QNT_RES" "0.1"
 SYSTEM_CONSTANT "PMP_QNT_ZERO" "0"
 SYSTEM_CONSTANT "PNRM" "1013"
 SYSTEM_CONSTANT "POSMCCTL_FACKDNRM4" "4"
 SYSTEM_CONSTANT "POSMCCTL_FACKINRM2" "2"
 SYSTEM_CONSTANT "POSMCCTL_FACKPNRM32" "32"
 SYSTEM_CONSTANT "POSTDRV_SOFTRST_SY" "0"
 SYSTEM_CONSTANT "POSTDRV_T15RST_SY" "0"
 SYSTEM_CONSTANT "PPFITDIFF_TYPAVL_SY" "0"
 SYSTEM_CONSTANT "PPFLTDIFFASICT_TYPAVL_SC" "0"
 SYSTEM_CONSTANT "PPFLTDIFFCH1_TYPAVL_SC" "0"
 SYSTEM_CONSTANT "PPFLTDIFFCH2_TYPAVL_SC" "0"
 SYSTEM_CONSTANT "PPFLTDIFF_TYPAVL_SY" "0"
 SYSTEM_CONSTANT "PPFLTDS_TYPAVL_SC" "0"
 SYSTEM_CONSTANT "PPFLTUS_TYPAVL_SY" "0"
 SYSTEM_CONSTANT "PRCFACT100_FULLNEG" "-100"
 SYSTEM_CONSTANT "PRCFACT100_FULLPOS" "100"
 SYSTEM_CONSTANT "PRCFACT100_ZERO" "0"
 SYSTEM_CONSTANT "PRC_M_100" "-100"
 SYSTEM_CONSTANT "PREDRV_T15RST_SY" "0"
 SYSTEM_CONSTANT "PREFSCALE_RES" "1000"
 SYSTEM_CONSTANT "PRES_AIR_MAX" "3500"
 SYSTEM_CONSTANT "PRES_AIR_MIN" "0"
 SYSTEM_CONSTANT "PRES_BAR_RES" "1"
 SYSTEM_CONSTANT "PRES_HPA_2000" "2000"
 SYSTEM_CONSTANT "PRES_RAIL_GRADHI_TO_VAL" "60"
 SYSTEM_CONSTANT "PRES_RAIL_GRAD_TO_VAL" "4"
 SYSTEM_CONSTANT "PRES_RAIL_RES" "100"
 SYSTEM_CONSTANT "PRES_RAIL_RES_REV" "100"
 SYSTEM_CONSTANT "PRES_TIME_RES" "400"
 SYSTEM_CONSTANT "PRES_TIME_RES_REV" "400"
 SYSTEM_CONSTANT "PS_NUMSENS_SY" "0"
 SYSTEM_CONSTANT "PTACTVN_SC" "0"
 SYSTEM_CONSTANT "PTHRVLVDS_TYPAVL_SC" "0"
 SYSTEM_CONSTANT "PTO_SY" "0"
 SYSTEM_CONSTANT "PTRBNABSLTUS_TYPAVL_SC" "0"
 SYSTEM_CONSTANT "PTRBNDS_TYPAVL_SY" "0"
 SYSTEM_CONSTANT "PTRBNUS_TYPAVL_SY" "0"
 SYSTEM_CONSTANT "PWRSQ_TEMPSQQ0P01_RES" "0.01"
 SYSTEM_CONSTANT "PWR_HIGH_RES_REV" "10"
 SYSTEM_CONSTANT "PWR_KW_RES" "0.01"
 SYSTEM_CONSTANT "PWR_Q1_RES" "1"
 SYSTEM_CONSTANT "PWR_Q50_RES" "50"
 SYSTEM_CONSTANT "PWR_TEMPQ0P001_RES" "0.01"
 SYSTEM_CONSTANT "PWR_TEMPQ0P1_RES" "0.1"
 SYSTEM_CONSTANT "PWR_ZERO" "0"
 SYSTEM_CONSTANT "QCKSTRTSPCVERS_SC" "2"
 SYSTEM_CONSTANT "QNTR_EXP" "10"
 SYSTEM_CONSTANT "QNTR_MAX" "24"
 SYSTEM_CONSTANT "QNTR_MIN" "0.0009765625"
 SYSTEM_CONSTANT "QNTR_RES" "0.0009765625"
 SYSTEM_CONSTANT "QNTR_RES_REV" "1024"
 SYSTEM_CONSTANT "QNTSEL_SY" "0"
 SYSTEM_CONSTANT "Qp_RES" "10"
 SYSTEM_CONSTANT "RAIL_MEUN" "1"
 SYSTEM_CONSTANT "RAIL_PCV" "0"
 SYSTEM_CONSTANT "RAIL_PRES_ZERO" "0"
 SYSTEM_CONSTANT "RATAM_RES" "0.01"
 SYSTEM_CONSTANT "RATAM_RES_HIGH" "0.001"
 SYSTEM_CONSTANT "RATAM_RES_REV" "100"
 SYSTEM_CONSTANT "RATAM_RES_REV_HIGH" "1000"
 SYSTEM_CONSTANT "RATCM_RES" "1e-006"
 SYSTEM_CONSTANT "RATO2DRYAIR" "0.2315"
 SYSTEM_CONSTANT "RATPCRITAIR" "0.52828199"
 SYSTEM_CONSTANT "RAT_AIR_PRES_RES" "0.001"
 SYSTEM_CONSTANT "RAT_HIGH_RES" "0.001"
 SYSTEM_CONSTANT "RAT_HIGH_RES_REV" "1000"
 SYSTEM_CONSTANT "RAT_HIRES_CPP" "0.0001"
 SYSTEM_CONSTANT "RAT_HIRES_CPP_REV" "10000"
 SYSTEM_CONSTANT "RBA_SWTRACEENA_SC" "1"
 SYSTEM_CONSTANT "rbg_AdcIf_FlxIo_NumChn_SY" "27"
 SYSTEM_CONSTANT "rbg_AdcIf_NumChn_SY" "10"
 SYSTEM_CONSTANT "RBG_AdcIn_nrChPdd_SC" "9"
 SYSTEM_CONSTANT "RBG_AdcIn_nrChRdnt_SC" "10"
 SYSTEM_CONSTANT "RBG_BATTSPLY_NRCH_SY" "1"
 SYSTEM_CONSTANT "rbg_CrntCtrlIf_NumChn_SY" "20"
 SYSTEM_CONSTANT "rbg_CtrlMotIf_NumMot_SY" "2"
 SYSTEM_CONSTANT "rbg_DataLogger_nrBufEntry_SY" "40"
 SYSTEM_CONSTANT "rbg_DataLogger_nrElmRngFltSupr_SY" "3"
 SYSTEM_CONSTANT "RBG_DBGL9966_BufferArraySize_SY" "9"
 SYSTEM_CONSTANT "RBG_DBGL9966_NumBytesPerRecord_SY" "6"
 SYSTEM_CONSTANT "RBG_DBGL9966_SignalArraySize_SY" "9"
 SYSTEM_CONSTANT "rbg_DcmCommon_WrEepErNumResets_SY" "5"
 SYSTEM_CONSTANT "RBG_DCM_APPSWVERNUM_LEN" "4"
 SYSTEM_CONSTANT "RBG_DCM_ASAMODXFILEID_LEN" "25"
 SYSTEM_CONSTANT "RBG_DCM_ASAMODXFILEVER_LEN" "6"
 SYSTEM_CONSTANT "RBG_DCM_AUTOSARSTDAPPSWID_LEN" "14"
 SYSTEM_CONSTANT "RBG_DCM_CALID_LEN" "16"
 SYSTEM_CONSTANT "RBG_DCM_FDSPROJECTDATA_LEN" "7"
 SYSTEM_CONSTANT "RBG_DCM_MAINVER_LEN" "3"
 SYSTEM_CONSTANT "RBG_DCM_MINORVER_LEN" "3"
 SYSTEM_CONSTANT "RBG_DCM_SPAREPARTNUM_LEN" "11"
 SYSTEM_CONSTANT "RBG_DCM_SWBLKVERSION_LEN" "4"
 SYSTEM_CONSTANT "RBG_DCM_SYSNAMEENGTYPE_LEN" "13"
 SYSTEM_CONSTANT "RBG_DCM_TECHSPECVER_LEN" "26"
 SYSTEM_CONSTANT "RBG_DCM_WSSYSNAME_LEN" "5"
 SYSTEM_CONSTANT "RBG_DSMCFG_NUMSUPSWSHPID_SY" "8"
 SYSTEM_CONSTANT "RBG_DSMCFG_SUPPID01_SY" "1"
 SYSTEM_CONSTANT "RBG_DSMCFG_SUPPID04_SY" "1"
 SYSTEM_CONSTANT "RBG_DSMCFG_SUPPID05_SY" "1"
 SYSTEM_CONSTANT "RBG_DSMCFG_SUPPID0C_SY" "1"
 SYSTEM_CONSTANT "RBG_DSMCFG_SUPPID0D_SY" "1"
 SYSTEM_CONSTANT "RBG_DSMCFG_SUPPID11_SY" "0"
 SYSTEM_CONSTANT "RBG_DSMCFG_SUPPID1C_SY" "0"
 SYSTEM_CONSTANT "RBG_DSMCFG_SUPPID1F_SY" "1"
 SYSTEM_CONSTANT "RBG_DSMCFG_SUPPID21_SY" "1"
 SYSTEM_CONSTANT "RBG_DSMCFG_SUPPID30_SY" "0"
 SYSTEM_CONSTANT "RBG_DSMCFG_SUPPID31_SY" "1"
 SYSTEM_CONSTANT "RBG_DSMCFG_SUPPID33_SY" "1"
 SYSTEM_CONSTANT "RBG_DSMCFG_SUPPID41_SY" "1"
 SYSTEM_CONSTANT "RBG_DSMCFG_SUPPID42_SY" "1"
 SYSTEM_CONSTANT "RBG_DSMCFG_SUPPID43_SY" "0"
 SYSTEM_CONSTANT "RBG_DSMCFG_SUPPID46_SY" "0"
 SYSTEM_CONSTANT "RBG_DSMCFG_SUPPID49_SY" "1"
 SYSTEM_CONSTANT "RBG_DSMCFG_SUPPID4A_SY" "0"
 SYSTEM_CONSTANT "RBG_DSMCFG_SUPPID4D_SY" "1"
 SYSTEM_CONSTANT "RBG_DSMCFG_SUPPID4E_SY" "1"
 SYSTEM_CONSTANT "RBG_DSMCFG_SUPPID65_SY" "0"
 SYSTEM_CONSTANT "RBG_DSMCFG_SUPPIDA4_SY" "0"
 SYSTEM_CONSTANT "RBG_DSMCFG_SUPPIDA6_SY" "1"
 SYSTEM_CONSTANT "RBG_DSMCFG_SUPPOBD_SY" "1"
 SYSTEM_CONSTANT "RBG_DSMIF_NUMDID_SY" "32"
 SYSTEM_CONSTANT "RBG_FlxAdc_nrAdcChPerDev_SC" "14"
 SYSTEM_CONSTANT "RBG_FlxAdc_nrTotFlxInDev_SC" "3"
 SYSTEM_CONSTANT "rbg_FlxRMeas_NrChp_SY" "3"
 SYSTEM_CONSTANT "rbg_FlxRMeas_NrDiagCh_SY" "9"
 SYSTEM_CONSTANT "RBG_GtmClkMon_nrTbuChMon_SC" "2"
 SYSTEM_CONSTANT "rbg_NvmIfConf_NumBlk_SY" "4"
 SYSTEM_CONSTANT "rbg_NvmIfConf_NumMaxWrite_SY" "255"
 SYSTEM_CONSTANT "rbg_PwmInIf_FlxIo_NumChn_SY" "27"
 SYSTEM_CONSTANT "rbg_PwmInIf_NumChn_SY" "12"
 SYSTEM_CONSTANT "rbg_PwmOutIf_NumChnCJ950_SY" "12"
 SYSTEM_CONSTANT "rbg_PwmOutIf_NumChnTot_SY" "32"
 SYSTEM_CONSTANT "rbg_PwrSplyIf_HiSide_NumChn_SY" "6"
 SYSTEM_CONSTANT "rbg_RMeasIf_NrCh_SY" "27"
 SYSTEM_CONSTANT "rbg_SftyLib_NumTstC0_SY" "18"
 SYSTEM_CONSTANT "rbg_SftyLib_NumTstC1_SY" "20"
 SYSTEM_CONSTANT "rbg_SftyLib_NumTstC2_SY" "18"
 SYSTEM_CONSTANT "rbg_SnsrSply_NumChn_SY" "6"
 SYSTEM_CONSTANT "rbg_SpdSnsrIf_SpdSns_NumChn_SY" "5"
 SYSTEM_CONSTANT "rbg_SpdSns_NrDisCh_SY" "2"
 SYSTEM_CONSTANT "rbg_SpdSns_NumChannels_SY" "5"
 SYSTEM_CONSTANT "RBG_SWSYSCTRL_CANSTRTUPSTGY_COMMON" "0"
 SYSTEM_CONSTANT "RBG_SWSYSCTRL_CANSTRTUPSTGY_CUSTOM" "1"
 SYSTEM_CONSTANT "RBG_SWSYSCTRL_CANSTRTUPSTGY_SY" "0"
 SYSTEM_CONSTANT "rbg_SwSysCtrl_Cfg_Nr_CanTrcv_SY" "4"
 SYSTEM_CONSTANT "rbg_SwSysCtrl_LBTCU_SY" "1"
 SYSTEM_CONSTANT "rbg_TSnsrIf_NumChn_SY" "5"
 SYSTEM_CONSTANT "RBG_TUNPROTN_BLKEXIST_SY" "1"
 SYSTEM_CONSTANT "RBPTCEL_A_ZR" "0"
 SYSTEM_CONSTANT "RBPTCEL_BMS_STHAD_ENAD" "0"
 SYSTEM_CONSTANT "RBPTCEL_BMS_STHAD_NOTUSED" "1"
 SYSTEM_CONSTANT "RBPTCEL_BMS_STHAD_PRMNTNOTENAD" "3"
 SYSTEM_CONSTANT "RBPTCEL_BMS_STHAD_SIGNOTAVL" "7"
 SYSTEM_CONSTANT "RBPTCEL_BMS_STHAD_TMPNOTENAD" "2"
 SYSTEM_CONSTANT "RBPTCEL_CLUCLSD" "0"
 SYSTEM_CONSTANT "RBPTCEL_CLUGEARDISENGMT" "5"
 SYSTEM_CONSTANT "RBPTCEL_CLUGEARSHIFT" "7"
 SYSTEM_CONSTANT "RBPTCEL_CLULNCH" "3"
 SYSTEM_CONSTANT "RBPTCEL_CLUOPEN" "1"
 SYSTEM_CONSTANT "RBPTCEL_CLUSHIFTSUPRT" "6"
 SYSTEM_CONSTANT "RBPTCEL_CLUTQTRCK" "4"
 SYSTEM_CONSTANT "RBPTCEL_CLUTRAN" "2"
 SYSTEM_CONSTANT "RBPTCEL_CNVN_F_ZR" "0"
 SYSTEM_CONSTANT "RBPTCEL_CNVN_P_ZR" "0"
 SYSTEM_CONSTANT "RBPTCEL_DST_ZR" "0"
 SYSTEM_CONSTANT "RBPTCEL_FRQ_ZR" "0"
 SYSTEM_CONSTANT "RBPTCEL_F_ZR" "0"
 SYSTEM_CONSTANT "RBPTCEL_GRDTN_ZR" "0"
 SYSTEM_CONSTANT "RBPTCEL_GRDTRAT_ZR" "0"
 SYSTEM_CONSTANT "RBPTCEL_I_ZR" "0"
 SYSTEM_CONSTANT "RBPTCEL_MOFDISCNCT_CMDCHRGCLSD" "4"
 SYSTEM_CONSTANT "RBPTCEL_MOFDISCNCT_CMDCLSD" "2"
 SYSTEM_CONSTANT "RBPTCEL_MOFDISCNCT_CMDDCHACLSD" "5"
 SYSTEM_CONSTANT "RBPTCEL_MOFDISCNCT_CMDOPEN" "0"
 SYSTEM_CONSTANT "RBPTCEL_P_ZR" "0"
 SYSTEM_CONSTANT "RBPTCEL_RAT" "0"
 SYSTEM_CONSTANT "RBPTCEL_RAT_1" "100"
 SYSTEM_CONSTANT "RBPTCEL_RAT_ZR" "0"
 SYSTEM_CONSTANT "RBPTCEL_RMDETNUS_BITPOSN_0" "0"
 SYSTEM_CONSTANT "RBPTCEL_SPD_ZR" "0"
 SYSTEM_CONSTANT "RBPTCEL_SSWTSECVC_DISAD" "0"
 SYSTEM_CONSTANT "RBPTCEL_SSWTSECVC_ENAD" "1"
 SYSTEM_CONSTANT "RBPTCEL_TI_ZR" "0"
 SYSTEM_CONSTANT "RBPTCEL_TQ_ZR" "0"
 SYSTEM_CONSTANT "RBPTCEL_T_ZR" "0"
 SYSTEM_CONSTANT "RBPTCEL_U_ZR" "0"
 SYSTEM_CONSTANT "RBPTCEL_VF_ZR" "0"
 SYSTEM_CONSTANT "RBPTCEL_V_ZR" "0"
 SYSTEM_CONSTANT "RBT_AdcBkg_flgMonEna_SY" "1"
 SYSTEM_CONSTANT "RBT_BattSply_nrCh_SY" "1"
 SYSTEM_CONSTANT "RBT_CanTrcvTst_nrTrcv_SY" "2"
 SYSTEM_CONSTANT "RBT_CfgSwSysCtrl_EcuMShtDwn_SY" "1"
 SYSTEM_CONSTANT "RBT_CfgSwSysCtrl_nrCnclPreps_SY" "2"
 SYSTEM_CONSTANT "RBT_CfgSwSysCtrl_nrFrcdPreps_SY" "2"
 SYSTEM_CONSTANT "RBT_CfgSwSysCtrl_nrNormPreps_SY" "6"
 SYSTEM_CONSTANT "RBT_CfgSwSysCtrl_SuprtFrcdShtDwn_SY" "1"
 SYSTEM_CONSTANT "RBT_Cg129_nrSply_SY" "0"
 SYSTEM_CONSTANT "RBT_Cg135wdTst_tiWaitTi_SY" "1000"
 SYSTEM_CONSTANT "RBT_Cg270a_nrCh_SY" "20"
 SYSTEM_CONSTANT "RBT_Cg270a_nrDev_SY" "2"
 SYSTEM_CONSTANT "RBT_Cg270a_nrPwmBuf_SY" "30"
 SYSTEM_CONSTANT "RBT_Cg270a_stEnaSwExtFct_SY" "45"
 SYSTEM_CONSTANT "RBT_CrntCtrlSwa_nrCh_SY" "1"
 SYSTEM_CONSTANT "RBT_CrntCtrlSwa_nrDlyRingBufSize_SY" "16"
 SYSTEM_CONSTANT "RBT_CrntCtrl_nrOutpCh_SY" "20"
 SYSTEM_CONSTANT "RBT_CrntIf_nrCh_SY" "20"
 SYSTEM_CONSTANT "RBT_CrntMon_nrCh_SY" "20"
 SYSTEM_CONSTANT "RBT_CrntMon_nrFltTyp_SY" "4"
 SYSTEM_CONSTANT "RBT_CrntMon_nr_Ch_FltTyp_SY" "80"
 SYSTEM_CONSTANT "RBT_CrntProf_nrStep_SY" "100"
 SYSTEM_CONSTANT "RBT_CtrlMot_nrMot_SY" "2"
 SYSTEM_CONSTANT "RBT_Cy328_flgEnaWakEvent_SY" "1"
 SYSTEM_CONSTANT "RBT_Cy729_flgApplPrmActv_SY" "1"
 SYSTEM_CONSTANT "RBT_Cy729_flgEnaSuspndFct_SY" "0"
 SYSTEM_CONSTANT "RBT_Cy729_nrOutp_SY" "4"
 SYSTEM_CONSTANT "RBT_Cy729_nrSsply_SY" "6"
 SYSTEM_CONSTANT "RBT_Det_flgUseCode_SY" "1"
 SYSTEM_CONSTANT "RBT_Det_nrElmRngFltSupr_SY" "3"
 SYSTEM_CONSTANT "RBT_Det_nrErrEntryBuf_SY" "20"
 SYSTEM_CONSTANT "RBT_DvlpDflFil_nrElmFil_SY" "3"
 SYSTEM_CONSTANT "RBT_DvlpDflFil_nrElmFltReactn_SY" "4"
 SYSTEM_CONSTANT "RBT_DvlpDflFil_nrElmSupr_SY" "2"
 SYSTEM_CONSTANT "RBT_DvlpDflFil_nrFilTab_SY" "40"
 SYSTEM_CONSTANT "RBT_DvlpDflFil_nrFil_SY" "50"
 SYSTEM_CONSTANT "RBT_DvlpDflFil_nrSupr_SY" "60"
 SYSTEM_CONSTANT "RBT_DvlpDfl_nrBufEntry_SY" "40"
 SYSTEM_CONSTANT "RBT_DvplDflFil_nrFltReactn_SY" "50"
 SYSTEM_CONSTANT "RBT_ExtWdgMgr_UsrFctSumNr" "7"
 SYSTEM_CONSTANT "RBT_ExtWdgMgr_UsrFctUnit0Nr" "1"
 SYSTEM_CONSTANT "RBT_ExtWdgMgr_UsrFctUnit1Nr" "5"
 SYSTEM_CONSTANT "RBT_ExtWdgMgr_UsrFctUnit2Nr" "1"
 SYSTEM_CONSTANT "RBT_ExtWdgMgr_UsrFctUnit3Nr" "0"
 SYSTEM_CONSTANT "RBT_ExtWdgMgr_UsrFctUnit4Nr" "0"
 SYSTEM_CONSTANT "RBT_ExtWdgMgr_UsrFctUnit5Nr" "0"
 SYSTEM_CONSTANT "RBT_IntSply_nrCh_SY" "6"
 SYSTEM_CONSTANT "RBT_McuFltInjIfx_flgEnaMpuFltInj" "1"
 SYSTEM_CONSTANT "RBT_McuFltInjIfx_flgEnaMpuRstSrcChk" "1"
 SYSTEM_CONSTANT "RBT_McuFltInjIfx_nrLocTestDataSt" "3"
 SYSTEM_CONSTANT "RBT_McuFltInjIfx_xMpuMaxLocRamAdrBufSize" "64"
 SYSTEM_CONSTANT "RBT_McuFltInjIfx_xSizeBufErrRprt" "10"
 SYSTEM_CONSTANT "RBT_MdlActr_nrCh_SY" "20"
 SYSTEM_CONSTANT "RBT_MdlActr_nrTempCh_SY" "2"
 SYSTEM_CONSTANT "RBT_Mlx80070Tst_nrTrcv_SY" "1"
 SYSTEM_CONSTANT "RBT_Ops_flgIptVltgMonTest_SY" "1"
 SYSTEM_CONSTANT "RBT_Ops_nrOutpSys_SY" "1"
 SYSTEM_CONSTANT "RBT_Ops_nrPsplyTest_SY" "4"
 SYSTEM_CONSTANT "RBT_PlaData_nrCfgBlk_SY" "4"
 SYSTEM_CONSTANT "RBT_Psply_flgUseAdcHsiDetn_SY" "0"
 SYSTEM_CONSTANT "RBT_Psply_flgUseCg135Dev_SY" "1"
 SYSTEM_CONSTANT "RBT_Psply_flgUseDioHsiDetn_SY" "1"
 SYSTEM_CONSTANT "RBT_Psply_nrChHw_SY" "6"
 SYSTEM_CONSTANT "RBT_Psply_nrCh_SY" "6"
 SYSTEM_CONSTANT "RBT_Psply_stUseLssDev_SY" "2"
 SYSTEM_CONSTANT "RBT_PwmIf_nrCh_SY" "20"
 SYSTEM_CONSTANT "RBT_PwmProf_nrStep_SY" "10"
 SYSTEM_CONSTANT "RBT_RefSplyVirt_stDrvAvl_SY" "2"
 SYSTEM_CONSTANT "RBT_SsplyVirt_stDrvAvl_SY" "1"
 SYSTEM_CONSTANT "RBT_SysTempVirt_stDevAvl_SY" "63"
 SYSTEM_CONSTANT "RCPTSRC_BRKPEDL" "2"
 SYSTEM_CONSTANT "RESIST_RES" "0.1"
 SYSTEM_CONSTANT "RESO_T_INC_PER_DUR_TTH_ADAP" "10"
 SYSTEM_CONSTANT "REVCNT_RES" "16"
 SYSTEM_CONSTANT "REVCNT_RES_EXP" "4"
 SYSTEM_CONSTANT "REVGEAR1" "-1"
 SYSTEM_CONSTANT "REVVARCOD_SY" "0"
 SYSTEM_CONSTANT "RHO_FUEL_RES" "0.1"
 SYSTEM_CONSTANT "RHUSTGYPRS_SY" "0"
 SYSTEM_CONSTANT "RMPSQRVLG_S_1000_REF" "1000"
 SYSTEM_CONSTANT "RMPSQRVLG_S_100_REF" "100"
 SYSTEM_CONSTANT "RMPSQRVLG_S_REF" "1000"
 SYSTEM_CONSTANT "RMPSQRVLG_S_RES" "65536"
 SYSTEM_CONSTANT "RNOX_ZERO" "0"
 SYSTEM_CONSTANT "R_COIL_MAX" "5000"
 SYSTEM_CONSTANT "R_COIL_MIN" "0"
 SYSTEM_CONSTANT "R_RES" "1"
 SYSTEM_CONSTANT "SCALEFACDIV_RES" "200"
 SYSTEM_CONSTANT "SCR_AMPERE_RES_REV" "5"
 SYSTEM_CONSTANT "SCR_DTTEMP_RES_REV" "10"
 SYSTEM_CONSTANT "SCR_FLVOL_RES_REV" "20"
 SYSTEM_CONSTANT "SCR_KPA_100_RES_REV" "0.01"
 SYSTEM_CONSTANT "SCR_KPA_10_RES_REV" "0.1"
 SYSTEM_CONSTANT "SCR_NOXFLW_RES_REV" "1000"
 SYSTEM_CONSTANT "SCR_ONEMIOPPMNOX_SY" "1000000"
 SYSTEM_CONSTANT "SCR_PRES_HPA_RES_REV" "1"
 SYSTEM_CONSTANT "SCR_SY" "0"
 SYSTEM_CONSTANT "SCR_SYSGEN_SY" "0"
 SYSTEM_CONSTANT "SCR_UC_VOLT_RES_REV" "10"
 SYSTEM_CONSTANT "SCR_VOLTQ0P0001227_RES" "0.0001220703125"
 SYSTEM_CONSTANT "SCR_VOLT_Q0P002_RES_REV" "500"
 SYSTEM_CONSTANT "SCTPMP1T_TYPAVL_SY" "0"
 SYSTEM_CONSTANT "SEAWTRP_TYPAVL_SC" "0"
 SYSTEM_CONSTANT "SEAWTRT_TYPAVL_SC" "0"
 SYSTEM_CONSTANT "SECUPCK_SC" "2"
 SYSTEM_CONSTANT "SEC_RES" "1"
 SYSTEM_CONSTANT "SENT_SC" "1"
 SYSTEM_CONSTANT "SETPOINTCALC_TRQBASED_SY" "0"
 SYSTEM_CONSTANT "SIA_OEM" "1"
 SYSTEM_CONSTANT "SIA_RB" "0"
 SYSTEM_CONSTANT "SIGNALS_AUTOPIDTABLE_SUPPORTED" "0"
 SYSTEM_CONSTANT "SIGNALS_BIT_DATATYPE_SUPPORTED" "0"
 SYSTEM_CONSTANT "SIGNALS_EXT2INT_2DARRAY_SUPPORTED" "0"
 SYSTEM_CONSTANT "SIGNALS_FLOAT_SUPPORTED" "0"
 SYSTEM_CONSTANT "SIGNALS_FORCE_PAVAST_IMPORT_STANDARD_SUPPORTED" "0"
 SYSTEM_CONSTANT "SIGNALS_INT2EXT_2DARRAY_SUPPORTED" "0"
 SYSTEM_CONSTANT "Signals_Mode1F5PidSize_SY" "6"
 SYSTEM_CONSTANT "Signals_Mode1PidSize_SY" "15"
 SYSTEM_CONSTANT "Signals_NumberPID_SY" "16"
 SYSTEM_CONSTANT "Signals_NumberSigNumExt_SY" "295"
 SYSTEM_CONSTANT "Signals_NumberSigNumIntStd_SY" "259"
 SYSTEM_CONSTANT "Signals_NumberSigNumInt_SY" "319"
 SYSTEM_CONSTANT "SIGNALS_OBDDIDSUPRT_SC" "0"
 SYSTEM_CONSTANT "SIGNALS_STDARRSIG_SUPPORTED" "0"
 SYSTEM_CONSTANT "Signals_SupportArrayF5rng_Length_SY" "0"
 SYSTEM_CONSTANT "Signals_SupportArray_Length_SY" "66"
 SYSTEM_CONSTANT "SIGNALS_VIRTUAL_DIAGDATFLXADCCHP0CHAN00" "260"
 SYSTEM_CONSTANT "SIGNALS_VIRTUAL_DIAGDATFLXADCCHP0CHAN01" "261"
 SYSTEM_CONSTANT "SIGNALS_VIRTUAL_DIAGDATFLXADCCHP0CHAN02" "262"
 SYSTEM_CONSTANT "SIGNALS_VIRTUAL_DIAGDATFLXADCCHP0CHAN03" "263"
 SYSTEM_CONSTANT "SIGNALS_VIRTUAL_DIAGDATFLXADCCHP0CHAN04" "264"
 SYSTEM_CONSTANT "SIGNALS_VIRTUAL_DIAGDATFLXADCCHP0CHAN05" "265"
 SYSTEM_CONSTANT "SIGNALS_VIRTUAL_DIAGDATFLXADCCHP0CHAN06" "266"
 SYSTEM_CONSTANT "SIGNALS_VIRTUAL_DIAGDATFLXADCCHP0CHAN07" "267"
 SYSTEM_CONSTANT "SIGNALS_VIRTUAL_DIAGDATFLXADCCHP0CHAN08" "268"
 SYSTEM_CONSTANT "SIGNALS_VIRTUAL_DIAGDATFLXADCCHP0CHAN09" "269"
 SYSTEM_CONSTANT "SIGNALS_VIRTUAL_DIAGDATFLXADCCHP0CHAN10" "270"
 SYSTEM_CONSTANT "SIGNALS_VIRTUAL_DIAGDATFLXADCCHP0CHAN11" "271"
 SYSTEM_CONSTANT "SIGNALS_VIRTUAL_DIAGDATFLXADCCHP0CHAN12" "272"
 SYSTEM_CONSTANT "SIGNALS_VIRTUAL_DIAGDATFLXADCCHP0CHAN13" "273"
 SYSTEM_CONSTANT "SIGNALS_VIRTUAL_DIAGDATFLXADCCHP1CHAN00" "274"
 SYSTEM_CONSTANT "SIGNALS_VIRTUAL_DIAGDATFLXADCCHP1CHAN01" "275"
 SYSTEM_CONSTANT "SIGNALS_VIRTUAL_DIAGDATFLXADCCHP1CHAN02" "276"
 SYSTEM_CONSTANT "SIGNALS_VIRTUAL_DIAGDATFLXADCCHP1CHAN03" "277"
 SYSTEM_CONSTANT "SIGNALS_VIRTUAL_DIAGDATFLXADCCHP1CHAN04" "278"
 SYSTEM_CONSTANT "SIGNALS_VIRTUAL_DIAGDATFLXADCCHP1CHAN05" "279"
 SYSTEM_CONSTANT "SIGNALS_VIRTUAL_DIAGDATFLXADCCHP1CHAN06" "280"
 SYSTEM_CONSTANT "SIGNALS_VIRTUAL_DIAGDATFLXADCCHP1CHAN07" "281"
 SYSTEM_CONSTANT "SIGNALS_VIRTUAL_DIAGDATFLXADCCHP1CHAN08" "282"
 SYSTEM_CONSTANT "SIGNALS_VIRTUAL_DIAGDATFLXADCCHP1CHAN09" "283"
 SYSTEM_CONSTANT "SIGNALS_VIRTUAL_DIAGDATFLXADCCHP1CHAN10" "284"
 SYSTEM_CONSTANT "SIGNALS_VIRTUAL_DIAGDATFLXADCCHP1CHAN11" "285"
 SYSTEM_CONSTANT "SIGNALS_VIRTUAL_DIAGDATFLXADCCHP1CHAN12" "286"
 SYSTEM_CONSTANT "SIGNALS_VIRTUAL_DIAGDATFLXADCCHP1CHAN13" "287"
 SYSTEM_CONSTANT "SIGNALS_VIRTUAL_DIAGDATFLXADCCHP2CHAN00" "288"
 SYSTEM_CONSTANT "SIGNALS_VIRTUAL_DIAGDATFLXADCCHP2CHAN01" "289"
 SYSTEM_CONSTANT "SIGNALS_VIRTUAL_DIAGDATFLXADCCHP2CHAN02" "290"
 SYSTEM_CONSTANT "SIGNALS_VIRTUAL_DIAGDATFLXADCCHP2CHAN03" "291"
 SYSTEM_CONSTANT "SIGNALS_VIRTUAL_DIAGDATFLXADCCHP2CHAN04" "292"
 SYSTEM_CONSTANT "SIGNALS_VIRTUAL_DIAGDATFLXADCCHP2CHAN05" "293"
 SYSTEM_CONSTANT "SIGNALS_VIRTUAL_DIAGDATFLXADCCHP2CHAN06" "294"
 SYSTEM_CONSTANT "SIGNALS_VIRTUAL_DIAGDATFLXADCCHP2CHAN07" "295"
 SYSTEM_CONSTANT "SIGNALS_VIRTUAL_DIAGDATFLXADCCHP2CHAN08" "296"
 SYSTEM_CONSTANT "SIGNALS_VIRTUAL_DIAGDATFLXADCCHP2CHAN09" "297"
 SYSTEM_CONSTANT "SIGNALS_VIRTUAL_DIAGDATFLXADCCHP2CHAN10" "298"
 SYSTEM_CONSTANT "SIGNALS_VIRTUAL_DIAGDATFLXADCCHP2CHAN11" "299"
 SYSTEM_CONSTANT "SIGNALS_VIRTUAL_DIAGDATFLXADCCHP2CHAN12" "300"
 SYSTEM_CONSTANT "SIGNALS_VIRTUAL_DIAGDATFLXADCCHP2CHAN13" "301"
 SYSTEM_CONSTANT "SIGNALS_VIRTUAL_RBG_DGBL9966_APPERRIDCNTR_00" "302"
 SYSTEM_CONSTANT "SIGNALS_VIRTUAL_RBG_DGBL9966_APPERRIDCNTR_01" "303"
 SYSTEM_CONSTANT "SIGNALS_VIRTUAL_RBG_DGBL9966_APPERRIDCNTR_02" "304"
 SYSTEM_CONSTANT "SIGNALS_VIRTUAL_RBG_DGBL9966_APPERRIDCNTR_03" "305"
 SYSTEM_CONSTANT "SIGNALS_VIRTUAL_RBG_DGBL9966_APPERRIDCNTR_04" "306"
 SYSTEM_CONSTANT "SIGNALS_VIRTUAL_RBG_DGBL9966_APPERRIDCNTR_05" "307"
 SYSTEM_CONSTANT "SIGNALS_VIRTUAL_RBG_DGBL9966_APPERRIDCNTR_06" "308"
 SYSTEM_CONSTANT "SIGNALS_VIRTUAL_RBG_DGBL9966_APPERRIDCNTR_07" "309"
 SYSTEM_CONSTANT "SIGNALS_VIRTUAL_RBG_DGBL9966_APPERRIDCNTR_08" "310"
 SYSTEM_CONSTANT "SIGNALS_VIRTUAL_RBG_DGBL9966_UBATSTSPI_00" "311"
 SYSTEM_CONSTANT "SIGNALS_VIRTUAL_RBG_DGBL9966_UBATSTSPI_01" "312"
 SYSTEM_CONSTANT "SIGNALS_VIRTUAL_RBG_DGBL9966_UBATSTSPI_02" "313"
 SYSTEM_CONSTANT "SIGNALS_VIRTUAL_RBG_DGBL9966_UBATSTSPI_03" "314"
 SYSTEM_CONSTANT "SIGNALS_VIRTUAL_RBG_DGBL9966_UBATSTSPI_04" "315"
 SYSTEM_CONSTANT "SIGNALS_VIRTUAL_RBG_DGBL9966_UBATSTSPI_05" "316"
 SYSTEM_CONSTANT "SIGNALS_VIRTUAL_RBG_DGBL9966_UBATSTSPI_06" "317"
 SYSTEM_CONSTANT "SIGNALS_VIRTUAL_RBG_DGBL9966_UBATSTSPI_07" "318"
 SYSTEM_CONSTANT "SIGNALS_VIRTUAL_RBG_DGBL9966_UBATSTSPI_08" "319"
 SYSTEM_CONSTANT "SIGQLY_FROZEN" "32"
 SYSTEM_CONSTANT "SIGQLY_INIT" "2"
 SYSTEM_CONSTANT "SIGQLY_INVALID" "64"
 SYSTEM_CONSTANT "SIGQLY_MODEL" "8"
 SYSTEM_CONSTANT "SIGQLY_NOTCALC" "1"
 SYSTEM_CONSTANT "SIGQLY_OK" "4"
 SYSTEM_CONSTANT "SIGQLY_REPLACEMENT" "16"
 SYSTEM_CONSTANT "Sig_I15031_LeanAppl_SY" "0"
 SYSTEM_CONSTANT "SOTMASSPERSEC_RES" "0.1"
 SYSTEM_CONSTANT "SOTMASSPERSEC_RES_REV" "10"
 SYSTEM_CONSTANT "SPAVEL_RES" "10"
 SYSTEM_CONSTANT "SPECHEATFINE_RES_REV" "5"
 SYSTEM_CONSTANT "SPECHEAT_RES" "2"
 SYSTEM_CONSTANT "SPECIFICHEAT_RES" "0.0001"
 SYSTEM_CONSTANT "SPECIFICHEAT_RES_REV" "10000"
 SYSTEM_CONSTANT "STRTTRQ_OFF" "0"
 SYSTEM_CONSTANT "STRTTRQ_ON" "1"
 SYSTEM_CONSTANT "STSP_SY" "1"
 SYSTEM_CONSTANT "SVSLMP_DISPSUPRT_SC" "1"
 SYSTEM_CONSTANT "SVSLMP_LAMPTESTDISBL_SC" "0"
 SYSTEM_CONSTANT "SVSLMP_PWRSTG_SY" "0"
 SYSTEM_CONSTANT "SVSLMP_SUPRT_ATS_SY" "0"
 SYSTEM_CONSTANT "SVS_SY" "1"
 SYSTEM_CONSTANT "SWSVW_DSCHED_SC" "0"
 SYSTEM_CONSTANT "SWT_DISABLED" "0"
 SYSTEM_CONSTANT "SWT_ENABLED" "1"
 SYSTEM_CONSTANT "SYC_AFTRUNDIAG_SC" "0"
 SYSTEM_CONSTANT "SYC_CAL_PERMSPLYSYS_SY" "0"
 SYSTEM_CONSTANT "SYC_CNTPOSTDRV_SC" "0"
 SYSTEM_CONSTANT "SYC_COORD_SC" "0"
 SYSTEM_CONSTANT "SYC_DRIVE" "4"
 SYSTEM_CONSTANT "SYC_ENALCYPROLG_SC" "0"
 SYSTEM_CONSTANT "SYC_ENAPROLGPREDRV_SC" "0"
 SYSTEM_CONSTANT "SYC_ENASYSCTRLSUBST_SC" "0"
 SYSTEM_CONSTANT "SYC_FSTSWOFF_SY" "0"
 SYSTEM_CONSTANT "SYC_INI" "0"
 SYSTEM_CONSTANT "SYC_INIEND" "2"
 SYSTEM_CONSTANT "SYC_INISYN" "1"
 SYSTEM_CONSTANT "SYC_MRLY_SC" "0"
 SYSTEM_CONSTANT "SYC_POSTDRIVE" "5"
 SYSTEM_CONSTANT "SYC_POST_OS_EXIT" "6"
 SYSTEM_CONSTANT "SYC_POWERUNDERVOLTAGE_SC" "0"
 SYSTEM_CONSTANT "SYC_POWER_SC" "1"
 SYSTEM_CONSTANT "SYC_PREDRIVE" "3"
 SYSTEM_CONSTANT "SYC_PROLGPREDRV_SC" "0"
 SYSTEM_CONSTANT "SYC_SHUTDOWNSERVICES_SC" "1"
 SYSTEM_CONSTANT "SYC_SYSTYP_SC" "0"
 SYSTEM_CONSTANT "SYC_T15POSTPREDRV_SWRST_SY" "0"
 SYSTEM_CONSTANT "SYC_UNLIMNWM_SY" "0"
 SYSTEM_CONSTANT "SYC_X2ME_SC" "0"
 SYSTEM_CONSTANT "SYSA_DSQACTVT_SC" "1"
 SYSTEM_CONSTANT "SYSB_PHYTERMINAL15_SC" "1"
 SYSTEM_CONSTANT "SYSDIAG_MCSPENA_SC" "0"
 SYSTEM_CONSTANT "SYSDIAG_NRAFTRUNCOORRARRELEM_SC" "0"
 SYSTEM_CONSTANT "SY_2HDP2" "0"
 SYSTEM_CONSTANT "SY_2SG" "0"
 SYSTEM_CONSTANT "SY_ABMZND" "1"
 SYSTEM_CONSTANT "SY_AIRBAG" "1"
 SYSTEM_CONSTANT "SY_ASG" "0"
 SYSTEM_CONSTANT "SY_ATMTURB" "0"
 SYSTEM_CONSTANT "SY_BDE" "1"
 SYSTEM_CONSTANT "SY_CAMNMSV" "4"
 SYSTEM_CONSTANT "SY_CIDSIZE" "0"
 SYSTEM_CONSTANT "SY_CJ840" "1"
 SYSTEM_CONSTANT "SY_CJ841" "0"
 SYSTEM_CONSTANT "SY_CJ870" "0"
 SYSTEM_CONSTANT "SY_CK200" "0"
 SYSTEM_CONSTANT "SY_CK240" "0"
 SYSTEM_CONSTANT "SY_CK260" "0"
 SYSTEM_CONSTANT "SY_CNG" "0"
 SYSTEM_CONSTANT "SY_CVNSIZE" "0"
 SYSTEM_CONSTANT "SY_DHDEVOE" "0"
 SYSTEM_CONSTANT "SY_DLDP" "0"
 SYSTEM_CONSTANT "SY_DMDSTQ" "1"
 SYSTEM_CONSTANT "SY_DMDZAG" "2"
 SYSTEM_CONSTANT "SY_DMDZMS" "0"
 SYSTEM_CONSTANT "SY_DMTL" "0"
 SYSTEM_CONSTANT "SY_DNWVPSA" "1"
 SYSTEM_CONSTANT "SY_DNWVPSE" "1"
 SYSTEM_CONSTANT "SY_DOPZW" "0"
 SYSTEM_CONSTANT "SY_DPCS" "0"
 SYSTEM_CONSTANT "SY_DSPACE" "0"
 SYSTEM_CONSTANT "SY_DSS" "0"
 SYSTEM_CONSTANT "SY_DSU" "0"
 SYSTEM_CONSTANT "SY_DTCWCS" "0"
 SYSTEM_CONSTANT "SY_DTHM" "0"
 SYSTEM_CONSTANT "SY_DZKTDBG" "0"
 SYSTEM_CONSTANT "SY_EGAS" "0"
 SYSTEM_CONSTANT "SY_EKPRMK" "0"
 SYSTEM_CONSTANT "SY_ESDFPMN" "350"
 SYSTEM_CONSTANT "SY_FFV" "0"
 SYSTEM_CONSTANT "SY_FFZ" "0"
 SYSTEM_CONSTANT "SY_GDIPFI" "0"
 SYSTEM_CONSTANT "SY_GRDWOF" "60"
 SYSTEM_CONSTANT "SY_GRDWRT" "72"
 SYSTEM_CONSTANT "SY_GRDWRTB" "72"
 SYSTEM_CONSTANT "SY_HDRFREQ" "1"
 SYSTEM_CONSTANT "SY_HDST" "1"
 SYSTEM_CONSTANT "SY_HEV" "0"
 SYSTEM_CONSTANT "SY_HFM" "0"
 SYSTEM_CONSTANT "SY_HKS" "0"
 SYSTEM_CONSTANT "SY_HMM" "0"
 SYSTEM_CONSTANT "SY_HOS" "0"
 SYSTEM_CONSTANT "SY_HSP" "0"
 SYSTEM_CONSTANT "SY_IGNMX" "63"
 SYSTEM_CONSTANT "SY_INI_OBD" "5"
 SYSTEM_CONSTANT "SY_IPRCRSH" "0"
 SYSTEM_CONSTANT "SY_IUMPR" "1"
 SYSTEM_CONSTANT "SY_KORRZ" "1"
 SYSTEM_CONSTANT "SY_KT" "0"
 SYSTEM_CONSTANT "SY_KTIGNBI" "1"
 SYSTEM_CONSTANT "SY_M9CALID" "0"
 SYSTEM_CONSTANT "SY_M9CVN" "0"
 SYSTEM_CONSTANT "SY_M9ENM" "0"
 SYSTEM_CONSTANT "SY_M9IPT" "0"
 SYSTEM_CONSTANT "SY_M9VIN" "0"
 SYSTEM_CONSTANT "SY_MDI" "1"
 SYSTEM_CONSTANT "SY_MDMXEXC" "0"
 SYSTEM_CONSTANT "SY_MSVKOMP" "2"
 SYSTEM_CONSTANT "SY_MSVRCUR" "1"
 SYSTEM_CONSTANT "SY_NG" "0"
 SYSTEM_CONSTANT "SY_NLZOFF" "1"
 SYSTEM_CONSTANT "SY_NSP" "1"
 SYSTEM_CONSTANT "SY_NVLD" "0"
 SYSTEM_CONSTANT "SY_NWGA" "0"
 SYSTEM_CONSTANT "SY_NWGA2" "0"
 SYSTEM_CONSTANT "SY_NWGE" "1"
 SYSTEM_CONSTANT "SY_NWGE2" "0"
 SYSTEM_CONSTANT "SY_NWMSV" "0"
 SYSTEM_CONSTANT "SY_NWS" "1"
 SYSTEM_CONSTANT "SY_NWSA" "1"
 SYSTEM_CONSTANT "SY_PRIOHKS" "0"
 SYSTEM_CONSTANT "SY_PRIOHMM" "0"
 SYSTEM_CONSTANT "SY_PRIOHOM" "0"
 SYSTEM_CONSTANT "SY_PRIOHOS" "0"
 SYSTEM_CONSTANT "SY_PRIOHSP" "0"
 SYSTEM_CONSTANT "SY_PRIOMOD" "0"
 SYSTEM_CONSTANT "SY_PRIOSCH" "0"
 SYSTEM_CONSTANT "SY_PRIOSKH" "0"
 SYSTEM_CONSTANT "SY_PSTDRST" "0"
 SYSTEM_CONSTANT "SY_PTL" "0"
 SYSTEM_CONSTANT "SY_PTO" "0"
 SYSTEM_CONSTANT "SY_SCH" "0"
 SYSTEM_CONSTANT "SY_SGANZ" "1"
 SYSTEM_CONSTANT "SY_SKH" "0"
 SYSTEM_CONSTANT "SY_STA" "0"
 SYSTEM_CONSTANT "SY_STASTO" "1"
 SYSTEM_CONSTANT "SY_STATYPE" "0"
 SYSTEM_CONSTANT "SY_STERHK" "0"
 SYSTEM_CONSTANT "SY_STERVK" "0"
 SYSTEM_CONSTANT "SY_SVBB" "1"
 SYSTEM_CONSTANT "SY_TEETH" "60"
 SYSTEM_CONSTANT "SY_TFUEL" "0"
 SYSTEM_CONSTANT "SY_TMMSV" "0"
 SYSTEM_CONSTANT "SY_TUMG" "0"
 SYSTEM_CONSTANT "SY_UBSQ_W" "1"
 SYSTEM_CONSTANT "SY_VARL" "0"
 SYSTEM_CONSTANT "SY_WFS" "2"
 SYSTEM_CONSTANT "SY_WMIN" "-72"
 SYSTEM_CONSTANT "SY_WNBM" "1"
 SYSTEM_CONSTANT "SY_WNWADM" "0"
 SYSTEM_CONSTANT "SY_ZNDAUS" "1"
 SYSTEM_CONSTANT "SY_ZYLZA" "6"
 SYSTEM_CONSTANT "SY_ZYLZG" "0"
 SYSTEM_CONSTANT "T15RAWDSQENA_SC" "0"
 SYSTEM_CONSTANT "T15_DBGMD_VD_SY" "0"
 SYSTEM_CONSTANT "T15_ON_VLDT_COM_SY" "0"
 SYSTEM_CONSTANT "T15_WKDETN_SC" "0"
 SYSTEM_CONSTANT "TDC_ADAP_SY" "0"
 SYSTEM_CONSTANT "TDC_UNEQLGEOM_SY" "0"
 SYSTEM_CONSTANT "TECU_SMP480SENSPRS_SC" "1"
 SYSTEM_CONSTANT "TECU_TMSGFMT_SC" "1"
 SYSTEM_CONSTANT "TEGMOD_HEATFLOWKW_RES" "100000"
 SYSTEM_CONSTANT "TEGMOD_HEATFLOW_INTER_RES" "360"
 SYSTEM_CONSTANT "TEGMOD_HEATKJ_RES" "100"
 SYSTEM_CONSTANT "TEGMOD_INTER_RES" "1"
 SYSTEM_CONSTANT "TEGRCLR2DS_TYPAVL_SY" "0"
 SYSTEM_CONSTANT "TEGRCLRDS_TYPAVL_SY" "0"
 SYSTEM_CONSTANT "TEGRCLRLPDS_TYPAVL_SC" "0"
 SYSTEM_CONSTANT "TEGRCLRUS_TYPAVL_SY" "0"
 SYSTEM_CONSTANT "TEGRVLVHOTDS_TYPAVL_SC" "0"
 SYSTEM_CONSTANT "TEMP_20_CELS" "20"
 SYSTEM_CONSTANT "TEMP_CELS_1200" "1200"
 SYSTEM_CONSTANT "TEMP_CELS_150" "150"
 SYSTEM_CONSTANT "TEMP_CELS_1500" "1500"
 SYSTEM_CONSTANT "TEMP_CELS_MAX" "3003.56"
 SYSTEM_CONSTANT "TEMP_CELS_MIN" "-3549.94"
 SYSTEM_CONSTANT "TEMP_CELS_M_100" "-100"
 SYSTEM_CONSTANT "TEMP_CELS_M_200" "-200"
 SYSTEM_CONSTANT "TEMP_KELV_1000" "1000"
 SYSTEM_CONSTANT "TEMP_KELV_1200" "1200"
 SYSTEM_CONSTANT "TEMP_KELV_M_1000" "-1000"
 SYSTEM_CONSTANT "TEMP_KELV_M_200" "-200"
 SYSTEM_CONSTANT "THRVLV_TYPAVL_SY" "0"
 SYSTEM_CONSTANT "TIMEDELAY_S_2_MIN" "0.001"
 SYSTEM_CONSTANT "TIMEDELAY_S_2_NRM" "8"
 SYSTEM_CONSTANT "TIME_5S_NRM_SY" "5"
 SYSTEM_CONSTANT "TIME_DEB_10MS" "10000"
 SYSTEM_CONSTANT "TIME_DT_1000MS" "1000000"
 SYSTEM_CONSTANT "TIME_DT_100MS" "100000"
 SYSTEM_CONSTANT "TIME_DT_10MS" "10000"
 SYSTEM_CONSTANT "TIME_DT_1S" "1000000"
 SYSTEM_CONSTANT "TIME_DT_200MS" "200000"
 SYSTEM_CONSTANT "TIME_MS_10MS_RES" "10"
 SYSTEM_CONSTANT "TIME_S_12000" "12000"
 SYSTEM_CONSTANT "TIME_S_LORES_ONE" "1"
 SYSTEM_CONSTANT "Time_s_LORES_RES" "1"
 SYSTEM_CONSTANT "Time_s_LORES_RES_REV" "1"
 SYSTEM_CONSTANT "TIME_S_LORES_ZERO" "0"
 SYSTEM_CONSTANT "TIME_S_NSCRGN_MAX" "327.66"
 SYSTEM_CONSTANT "TIME_TICK_SEC_INV" "100"
 SYSTEM_CONSTANT "TINTKVUS_TYPAVL_SY" "0"
 SYSTEM_CONSTANT "TI_PII_EARL_REL" "13000"
 SYSTEM_CONSTANT "TI_POI2_LATE_REL" "-13000"
 SYSTEM_CONSTANT "TLE7244_SC" "0"
 SYSTEM_CONSTANT "TLE75602_SC" "0"
 SYSTEM_CONSTANT "TNRM" "0"
 SYSTEM_CONSTANT "TOTENGREV_SC" "1"
 SYSTEM_CONSTANT "TOXICATDS_TYPAVL_SY" "0"
 SYSTEM_CONSTANT "TOXICATUS_TYPAVL_SY" "0"
 SYSTEM_CONSTANT "TPFLTDS_TYPAVL_SY" "0"
 SYSTEM_CONSTANT "TPFLTUS_TYPAVL_SY" "0"
 SYSTEM_CONSTANT "TPS65917_SC" "0"
 SYSTEM_CONSTANT "TRA_AST" "2"
 SYSTEM_CONSTANT "TRA_AT" "1"
 SYSTEM_CONSTANT "TRA_CVT" "3"
 SYSTEM_CONSTANT "TRA_DCT" "4"
 SYSTEM_CONSTANT "TRA_MT" "0"
 SYSTEM_CONSTANT "TRBCHINSDT_TYPAVL_SC" "0"
 SYSTEM_CONSTANT "TRQSEL_SY" "1"
 SYSTEM_CONSTANT "TRQ_ZERO" "0"
 SYSTEM_CONSTANT "TTRBNUS_TYPAVL_SY" "0"
 SYSTEM_CONSTANT "TTRBUSASICT_TYPAVL_SC" "0"
 SYSTEM_CONSTANT "TWALLTC_MDLAVL_SC" "0"
 SYSTEM_CONSTANT "TWCOR_HIRES_SC" "0"
 SYSTEM_CONSTANT "TWO_POW_NRM_EXP_RES_TRIGO_FUNC" "4096"
 SYSTEM_CONSTANT "TWTRCOOLRDS_TYPAVL_SC" "0"
 SYSTEM_CONSTANT "T_EXHGS_MAX" "1050"
 SYSTEM_CONSTANT "T_EXHGS_MIN" "-45"
 SYSTEM_CONSTANT "UART_SY" "0"
 SYSTEM_CONSTANT "UCATDST_TYPAVL_SC" "0"
 SYSTEM_CONSTANT "UCATUST_TYPAVL_SC" "0"
 SYSTEM_CONSTANT "VCRTYP_SC" "0"
 SYSTEM_CONSTANT "VEHTYP_SC" "2"
 SYSTEM_CONSTANT "VEL_KMH_0" "0"
 SYSTEM_CONSTANT "VEL_KMH_300" "300"
 SYSTEM_CONSTANT "VEL_KMH_M_300" "-300"
 SYSTEM_CONSTANT "VLVLFT_UNIAIRINTK_SC" "0"
 SYSTEM_CONSTANT "VNQ6040_SC" "0"
 SYSTEM_CONSTANT "VOL_FILGLVL_RES" "1"
 SYSTEM_CONSTANT "VOL_FILGLVL_RES_REV" "1"
 SYSTEM_CONSTANT "VOL_NSC_RES" "0.0001"
 SYSTEM_CONSTANT "VOL_NSC_RES_FL" "0.0001"
 SYSTEM_CONSTANT "VOL_NSC_RES_REV" "10000"
 SYSTEM_CONSTANT "VOL_RES_REV" "100"
 SYSTEM_CONSTANT "VSWVLV_TYPAVL_SY" "0"
 SYSTEM_CONSTANT "V_CAM_RES_REV" "256"
 SYSTEM_CONSTANT "WDGS_CFGADPR_SC" "1"
 SYSTEM_CONSTANT "WHRCOOLTPDIF_TYPAVL_SC" "0"
 SYSTEM_CONSTANT "WTRCACT_TYPAVL_SC" "0"
 SYSTEM_CONSTANT "WTRCOOLTP1_TYPAVL_SY" "0"
 SYSTEM_CONSTANT "WTRCOOLTP_TYPAVL_SY" "0"
 SYSTEM_CONSTANT "XCORECDD_SC" "1"
 SYSTEM_CONSTANT "XCPVERS_SC" "3"
 SYSTEM_CONSTANT "XCP_SY" "0"
 SYSTEM_CONSTANT "XDI_SC" "0"
 SYSTEM_CONSTANT "ZERO" "0" /end MOD_PAR
/begin MOD_COMMON "" BYTE_ORDER MSB_LAST ALIGNMENT_BYTE 1 ALIGNMENT_WORD 2 ALIGNMENT_LONG 4 ALIGNMENT_INT64 4 ALIGNMENT_FLOAT32_IEEE 4 ALIGNMENT_FLOAT64_IEEE 4 DATA_SIZE 32 /end MOD_COMMON
/begin IF_DATA ASAP1B_Bypass
 /begin TP_BLOB 0x102 /* Bypass version */ 0x102 /* Blob version */ /end TP_BLOB
/end IF_DATA
/begin IF_DATA ETK_XETK
 /begin ETK_XETK_LIST /* version */ ETK_XETK_AML_VERSION_2_0_0
  /begin ETK 1 /* ETK_XETK_ID */ INTERFACE_SPEED_100MBIT /* Interface */ CONFIG "CpuType" "TC29xED_A" CONFIG "EtkId" "162" CONFIG "EtkSubId" "0" CONFIG "HardwAdvId" "0" CONFIG "TriggerInterface" "reg" CONFIG "PullCalWakeup" "0" CONFIG "WatchdogDisable" "1" CONFIG "RegPollRate" "50" CONFIG "PowerFailDetection" "SBRAM" CONFIG "Startup" "reg" CONFIG "StartupTimeout" "-1" CONFIG "DebArb" "1" CONFIG "WatchdogPolarity" "1" CONFIG "DapClockSpeed" "100" CONFIG "DapBlock" "1" CONFIG "Dap2Pin" "0" /end ETK
  /begin XETK 2 /* ETK_XETK_ID XETK-S2x */ CONFIG "CpuType" "TC29xED" CONFIG "BaseId" "11" CONFIG "Extension" "1" CONFIG "DapClockSpeed" "100" CONFIG "DapBlock" "1" CONFIG "Dap2Pin" "0" CONFIG "EcuWatchdogControlDisabled" "0" CONFIG "EcuWatchdogEnabled" "0" CONFIG "EcuWatchdogPolarity" "1" CONFIG "HandshakeTimeout" "-1" CONFIG "EcuTrigRegPollRate" "50" CONFIG "PowerFailDetection" "SBRAM" CONFIG "TriggerInterface" "reg" /end XETK
  /begin XETK 3 /* ETK_XETK_ID BR-XETK-Sx */ CONFIG "CpuType" "TC29xED" CONFIG "BaseId" "16" CONFIG "Extension" "1" CONFIG "DapClockSpeed" "100" CONFIG "DapBlock" "1" CONFIG "Dap2Pin" "0" CONFIG "EcuWatchdogControlDisabled" "0" CONFIG "EcuWatchdogEnabled" "0" CONFIG "EcuWatchdogPolarity" "1" CONFIG "HandshakeTimeout" "-1" CONFIG "EcuTrigRegPollRate" "50" CONFIG "PowerFailDetection" "SBRAM" CONFIG "TriggerInterface" "reg" /end XETK
  /begin XETK 4 /* ETK_XETK_ID XETK-S3x */ CONFIG "CpuType" "TC29xED" CONFIG "BaseId" "14" CONFIG "Extension" "1" CONFIG "DapClockSpeed" "100" CONFIG "DapBlock" "1" CONFIG "Dap2Pin" "0" CONFIG "EcuWatchdogControlDisabled" "0" CONFIG "EcuWatchdogEnabled" "0" CONFIG "EcuWatchdogPolarity" "1" CONFIG "HandshakeTimeout" "-1" CONFIG "EcuTrigRegPollRate" "50" CONFIG "PowerFailDetection" "SBRAM" CONFIG "TriggerInterface" "reg" /end XETK
  /begin RASTER_CHECK OFFLINE_DEVICE 1 /* device with id 1 is the default device for offline raster check */ ONLINE_RESPECT_OFFLINE_LIMIT /end RASTER_CHECK
 /end ETK_XETK_LIST
 /begin TP_BLOB /* ByteOrder */ BYTE_ORDER_MSB_LAST /begin DISTAB_CFG /* Distab Type */ 17 /end DISTAB_CFG
  /begin ECU_EVENT_LIST 0xBF1FE7E4 /* start address of ECU event list */ ETK_XETK_REF 1 2 3 4 /end ECU_EVENT_LIST
  TABLE_ALIGNMENT ALIGNMENT_4_BYTE
  /begin EVENT_CONFIG_OUTPUT_AREA 0xBF1FB7C0 /* start of event config area */ 12324 /* size in bytes of event config area */ 0xBF1FE7FC /* start of event output area */ 6144 /* size in bytes of event output area */ ETK_XETK_REF 1 2 3 4 /end EVENT_CONFIG_OUTPUT_AREA
  /begin DATA_ACQUISITION PRIORITY_RANGE 1 5 ETK_XETK_REF 1 2 3 4 /end DATA_ACQUISITION
  /begin ECU_PROPERTY OVERALL_PERFORMANCE 820895 3283580 CORE_PERFORMANCE 0 149254 597016 CORE_PERFORMANCE 1 134328 537312 CORE_PERFORMANCE 2 537313 2149252 ETK_XETK_REF 1 2 3 4 /end ECU_PROPERTY
  /begin TRIGGER_CFG TRIGGER 20 DIRECT TRIGGER 21 DIRECT TRIGGER 22 DIRECT TRIGGER 23 DIRECT TRIGGER 24 DIRECT ETK_XETK_REF 1 2 3 4 /end TRIGGER_CFG
  /begin CODE_CHK /* Address ECU DATA section */ 0x80600118 /* Address ECU RAM section */ 0xBF1FB784 /* Length ECU DATA sections */ 8 PATTERN_REFRESH_TIMEOUT 0x200 ERROR_BEHAVIOR PERMANENT_RESET ETK_XETK_REF 1 2 3 4 /end CODE_CHK
  /begin COLDSTART_HANDSHAKE /* Address of ETKS coldstart pattern */ 0xBF1FB79C WAIT /* Dyn. length for wait pattern */ 0xE5 0xAD 0xEC 0x4D READY /* Dyn. length for ready pattern */ 0xDE 0xC0 0xED 0xFE ETK_XETK_REF 1 2 3 4 /end COLDSTART_HANDSHAKE
  /begin PAGE_SWITCH_METHOD 2 /* version */ MAILBOX 3 /* MBX_Version */ /* Version of mailbox */ 200 /* MBX_PageSetupTime */ /* max time the ECU needs to set up page in ms */ 0xBF1FB7B4 /* MBX_StartAddress */ /* Start address of table */ AUTOSTART_BEHAVIOR LAST_ACTIVE_PAGE /* Table to be filled by INCA with info */ /* for the current active page */ OMD 0xBF1FB6E0 /* OMD_ADDRESS */ 1 /* OMD_CID */ 0 /* OMD_VERSION */ 0xA0 /* OMD_MAX_LEN */ 31 /* OMD_NUMBER_OF_EMU_HANDLES */ CODE_CHK_PATTERN_WP 0xBF1FB78C /* Start address of WP CodeCheck Pattern */ ETK_XETK_REF 1 2 3 4 /end PAGE_SWITCH_METHOD
  /begin ECU_DEFINED_ERRORCODES ERROR_ENTRY 0x00000001 "OMD error" ERROR_ENTRY 0x45525201 "ECU will be reset - STOP engine!" ERROR_ENTRY 0x45525202 "ECU does not support Programming at T15 OFF" ERROR_ENTRY 0x45525203 "Mail Box Version is invalid" ERROR_ENTRY 0x45525204 "Call Back Function is not configured" /end ECU_DEFINED_ERRORCODES
  /begin DATA_FREEZE CONFIG "SAFETY_MAILBOX_ADDRESS" "0xBF1FB7A8" CONFIG "SAFETY_MAILBOX_VERSION" "0x4D310100" CONFIG "SAFETY_MAILBOX_WAITMSG" "Datafreeze is pending" CONFIG "SAFETY_MAILBOX_WAITTOUT" "2000" CONFIG "STARTUP_MAILBOX_ADDRESS" "0x7001DE00" CONFIG "STARTUP_MAILBOX_VERSION" "0x4D320100" CONFIG "VALIDATE_PATTERN" "0x80600000 0x100" CONFIG "INVALIDATE_PATTERN" "0x80600120 0x00044408000004009011000208408C0090508808031010614000280812047640" ETK_XETK_REF 1 2 3 4 /end DATA_FREEZE
 /end TP_BLOB
 /begin SOURCE "1ms time synchronous" 3 1
  /begin QP_BLOB 1 5 900
   /begin ETK_XETK_SPECIFIC TRG_NBR 0 /begin ECU_PROPERTY PERFORMANCE 1 89500 358000 /end ECU_PROPERTY ETK_XETK_REF 1 2 3 4 /end ETK_XETK_SPECIFIC
  /end QP_BLOB
 /end SOURCE
 /begin SOURCE "2p5ms time synchronous" 3 1
  /begin QP_BLOB 2 4 900
   /begin ETK_XETK_SPECIFIC TRG_NBR 0 /begin ECU_PROPERTY PERFORMANCE 1 89500 358000 /end ECU_PROPERTY ETK_XETK_REF 1 2 3 4 /end ETK_XETK_SPECIFIC
  /end QP_BLOB
 /end SOURCE
 /begin SOURCE "5ms time synchronous" 3 5
  /begin QP_BLOB 3 3 4500
   /begin ETK_XETK_SPECIFIC TRG_NBR 0 /begin ECU_PROPERTY PERFORMANCE 2 89500 358000 /end ECU_PROPERTY ETK_XETK_REF 1 2 3 4 /end ETK_XETK_SPECIFIC
  /end QP_BLOB
 /end SOURCE
 /begin SOURCE "10ms time synchronous" 4 1
  /begin QP_BLOB 4 2 9000
   /begin ETK_XETK_SPECIFIC TRG_NBR 0 /begin ECU_PROPERTY PERFORMANCE 1 89500 358000 /end ECU_PROPERTY ETK_XETK_REF 1 2 3 4 /end ETK_XETK_SPECIFIC
  /end QP_BLOB
 /end SOURCE
 /begin SOURCE "100ms time synchronous" 5 1
  /begin QP_BLOB 5 1 90000
   /begin ETK_XETK_SPECIFIC TRG_NBR 0 /begin ECU_PROPERTY PERFORMANCE 2 33580 134320 /end ECU_PROPERTY ETK_XETK_REF 1 2 3 4 /end ETK_XETK_SPECIFIC
  /end QP_BLOB
 /end SOURCE
/end IF_DATA
/begin IF_DATA XCPplus 0x0102
 /begin PAG /* MAX_SEGMENTS */ 13 /end PAG
 /begin PROTOCOL_LAYER 0x0102 1000 1000 0 0 0 0 0 8 8 BYTE_ORDER_MSB_LAST ADDRESS_GRANULARITY_BYTE OPTIONAL_CMD GET_ID OPTIONAL_CMD GET_SEED OPTIONAL_CMD UNLOCK OPTIONAL_CMD SET_MTA OPTIONAL_CMD UPLOAD OPTIONAL_CMD SHORT_UPLOAD OPTIONAL_CMD BUILD_CHECKSUM OPTIONAL_CMD DOWNLOAD OPTIONAL_CMD DOWNLOAD_NEXT OPTIONAL_CMD DOWNLOAD_MAX OPTIONAL_CMD SET_CAL_PAGE OPTIONAL_CMD GET_CAL_PAGE OPTIONAL_CMD COPY_CAL_PAGE OPTIONAL_CMD CLEAR_DAQ_LIST OPTIONAL_CMD SET_DAQ_PTR OPTIONAL_CMD WRITE_DAQ OPTIONAL_CMD SET_DAQ_LIST_MODE OPTIONAL_CMD START_STOP_DAQ_LIST OPTIONAL_CMD START_STOP_SYNCH OPTIONAL_CMD FREE_DAQ OPTIONAL_CMD ALLOC_DAQ OPTIONAL_CMD ALLOC_ODT OPTIONAL_CMD ALLOC_ODT_ENTRY COMMUNICATION_MODE_SUPPORTED BLOCK SLAVE MASTER 255 10 SEED_AND_KEY_EXTERNAL_FUNCTION "LBTCU_SeedKey_XCP_0001.dll" /end PROTOCOL_LAYER
 /begin DAQ DYNAMIC 65535 5 0 OPTIMISATION_TYPE_DEFAULT ADDRESS_EXTENSION_FREE IDENTIFICATION_FIELD_TYPE_ABSOLUTE GRANULARITY_ODT_ENTRY_SIZE_DAQ_BYTE 255 OVERLOAD_INDICATION_EVENT PRESCALER_SUPPORTED /begin STIM GRANULARITY_ODT_ENTRY_SIZE_STIM_BYTE 255 /end STIM /begin DAQ_MEMORY_CONSUMPTION 5995 60 6 5 2 3 /end DAQ_MEMORY_CONSUMPTION
  /begin EVENT "1ms time synchronous" "1_ms" 0 DAQ 1 1 6 8 CONSISTENCY EVENT /begin MIN_CYCLE_TIME 1 6 /end MIN_CYCLE_TIME /end EVENT
  /begin EVENT "2p5ms time synchronous" "2p5_ms" 1 DAQ 1 2 6 7 CONSISTENCY EVENT /begin MIN_CYCLE_TIME 2 6 /end MIN_CYCLE_TIME /end EVENT
  /begin EVENT "5ms time synchronous" "5_ms" 2 DAQ 1 5 6 6 CONSISTENCY EVENT /end EVENT
  /begin EVENT "10ms time synchronous" "10_ms" 3 DAQ 1 10 6 5 CONSISTENCY EVENT /end EVENT
  /begin EVENT "100ms time synchronous" "100_ms" 4 DAQ 1 100 6 3 CONSISTENCY EVENT /end EVENT
 /end DAQ
 /begin XCP_ON_CAN 0x0102 CAN_ID_MASTER 0x7F0 CAN_ID_SLAVE 0x7F1 BAUDRATE 1000000 SAMPLE_POINT 80 BTL_CYCLES 20 SJW 1 /begin EVENT_CAN_ID_LIST 0 /* reference to EVENT_NUMBER: 1_ms */ FIXED 0x7EA /end EVENT_CAN_ID_LIST /begin EVENT_CAN_ID_LIST 1 /* reference to EVENT_NUMBER: 2p5_ms */ FIXED 0x7F8 /end EVENT_CAN_ID_LIST /begin EVENT_CAN_ID_LIST 2 /* reference to EVENT_NUMBER: 5_ms */ FIXED 0x7DB /end EVENT_CAN_ID_LIST /begin EVENT_CAN_ID_LIST 3 /* reference to EVENT_NUMBER: 10_ms */ FIXED 0x7F9 /end EVENT_CAN_ID_LIST /begin EVENT_CAN_ID_LIST 4 /* reference to EVENT_NUMBER: 100_ms */ FIXED 0x7FD /end EVENT_CAN_ID_LIST MAX_BUS_LOAD 100
  /begin PROTOCOL_LAYER 0x0102 1000 1000 0 0 0 0 0 8 8 BYTE_ORDER_MSB_LAST ADDRESS_GRANULARITY_BYTE OPTIONAL_CMD GET_ID OPTIONAL_CMD GET_SEED OPTIONAL_CMD UNLOCK OPTIONAL_CMD SET_MTA OPTIONAL_CMD UPLOAD OPTIONAL_CMD SHORT_UPLOAD OPTIONAL_CMD BUILD_CHECKSUM OPTIONAL_CMD DOWNLOAD OPTIONAL_CMD DOWNLOAD_NEXT OPTIONAL_CMD DOWNLOAD_MAX OPTIONAL_CMD SET_CAL_PAGE OPTIONAL_CMD GET_CAL_PAGE OPTIONAL_CMD COPY_CAL_PAGE OPTIONAL_CMD CLEAR_DAQ_LIST OPTIONAL_CMD SET_DAQ_PTR OPTIONAL_CMD WRITE_DAQ OPTIONAL_CMD SET_DAQ_LIST_MODE OPTIONAL_CMD START_STOP_DAQ_LIST OPTIONAL_CMD START_STOP_SYNCH OPTIONAL_CMD FREE_DAQ OPTIONAL_CMD ALLOC_DAQ OPTIONAL_CMD ALLOC_ODT OPTIONAL_CMD ALLOC_ODT_ENTRY COMMUNICATION_MODE_SUPPORTED BLOCK SLAVE MASTER 255 10 SEED_AND_KEY_EXTERNAL_FUNCTION "LBTCU_SeedKey_XCP_0001.dll" /end PROTOCOL_LAYER
  /begin DAQ DYNAMIC 65535 5 0 OPTIMISATION_TYPE_DEFAULT ADDRESS_EXTENSION_FREE IDENTIFICATION_FIELD_TYPE_ABSOLUTE GRANULARITY_ODT_ENTRY_SIZE_DAQ_BYTE 255 OVERLOAD_INDICATION_EVENT PRESCALER_SUPPORTED /begin STIM GRANULARITY_ODT_ENTRY_SIZE_STIM_BYTE 255 /end STIM /begin DAQ_MEMORY_CONSUMPTION 5995 60 6 5 2 3 /end DAQ_MEMORY_CONSUMPTION
   /begin EVENT "1ms time synchronous" "1_ms" 0 DAQ 1 1 6 8 CONSISTENCY EVENT /begin MIN_CYCLE_TIME 1 6 /end MIN_CYCLE_TIME /end EVENT
   /begin EVENT "2p5ms time synchronous" "2p5_ms" 1 DAQ 1 2 6 7 CONSISTENCY EVENT /begin MIN_CYCLE_TIME 2 6 /end MIN_CYCLE_TIME /end EVENT
   /begin EVENT "5ms time synchronous" "5_ms" 2 DAQ 1 5 6 6 CONSISTENCY EVENT /end EVENT
   /begin EVENT "10ms time synchronous" "10_ms" 3 DAQ 1 10 6 5 CONSISTENCY EVENT /end EVENT
   /begin EVENT "100ms time synchronous" "100_ms" 4 DAQ 1 100 6 3 CONSISTENCY EVENT /end EVENT
  /end DAQ
  TRANSPORT_LAYER_INSTANCE "CAN2_1MBd_Heavy" /end XCP_ON_CAN
 /begin XCP_ON_CAN 0x0102 CAN_ID_MASTER 0x7F0 CAN_ID_SLAVE 0x7F1 BAUDRATE 1000000 SAMPLE_POINT 80 BTL_CYCLES 20 SJW 1 /begin EVENT_CAN_ID_LIST 0 /* reference to EVENT_NUMBER: 1_ms */ FIXED 0x7EA /end EVENT_CAN_ID_LIST /begin EVENT_CAN_ID_LIST 1 /* reference to EVENT_NUMBER: 2p5_ms */ FIXED 0x7F8 /end EVENT_CAN_ID_LIST /begin EVENT_CAN_ID_LIST 2 /* reference to EVENT_NUMBER: 5_ms */ FIXED 0x7DB /end EVENT_CAN_ID_LIST /begin EVENT_CAN_ID_LIST 3 /* reference to EVENT_NUMBER: 10_ms */ FIXED 0x7F9 /end EVENT_CAN_ID_LIST /begin EVENT_CAN_ID_LIST 4 /* reference to EVENT_NUMBER: 100_ms */ FIXED 0x7FD /end EVENT_CAN_ID_LIST MAX_BUS_LOAD 100
  /begin PROTOCOL_LAYER 0x0102 1000 1000 0 0 0 0 0 8 8 BYTE_ORDER_MSB_LAST ADDRESS_GRANULARITY_BYTE OPTIONAL_CMD GET_ID OPTIONAL_CMD GET_SEED OPTIONAL_CMD UNLOCK OPTIONAL_CMD SET_MTA OPTIONAL_CMD UPLOAD OPTIONAL_CMD SHORT_UPLOAD OPTIONAL_CMD BUILD_CHECKSUM OPTIONAL_CMD DOWNLOAD OPTIONAL_CMD DOWNLOAD_NEXT OPTIONAL_CMD DOWNLOAD_MAX OPTIONAL_CMD SET_CAL_PAGE OPTIONAL_CMD GET_CAL_PAGE OPTIONAL_CMD COPY_CAL_PAGE OPTIONAL_CMD CLEAR_DAQ_LIST OPTIONAL_CMD SET_DAQ_PTR OPTIONAL_CMD WRITE_DAQ OPTIONAL_CMD SET_DAQ_LIST_MODE OPTIONAL_CMD START_STOP_DAQ_LIST OPTIONAL_CMD START_STOP_SYNCH OPTIONAL_CMD FREE_DAQ OPTIONAL_CMD ALLOC_DAQ OPTIONAL_CMD ALLOC_ODT OPTIONAL_CMD ALLOC_ODT_ENTRY COMMUNICATION_MODE_SUPPORTED BLOCK SLAVE MASTER 255 10 SEED_AND_KEY_EXTERNAL_FUNCTION "LBTCU_SeedKey_XCP_0001.dll" /end PROTOCOL_LAYER
  /begin DAQ DYNAMIC 65535 5 0 OPTIMISATION_TYPE_DEFAULT ADDRESS_EXTENSION_FREE IDENTIFICATION_FIELD_TYPE_ABSOLUTE GRANULARITY_ODT_ENTRY_SIZE_DAQ_BYTE 255 OVERLOAD_INDICATION_EVENT PRESCALER_SUPPORTED /begin STIM GRANULARITY_ODT_ENTRY_SIZE_STIM_BYTE 255 /end STIM /begin DAQ_MEMORY_CONSUMPTION 14995 60 6 5 2 3 /end DAQ_MEMORY_CONSUMPTION
   /begin EVENT "1ms time synchronous" "1_ms" 0 DAQ 1 1 6 8 CONSISTENCY EVENT /begin MIN_CYCLE_TIME 1 6 /end MIN_CYCLE_TIME /end EVENT
   /begin EVENT "2p5ms time synchronous" "2p5_ms" 1 DAQ 1 2 6 7 CONSISTENCY EVENT /begin MIN_CYCLE_TIME 2 6 /end MIN_CYCLE_TIME /end EVENT
   /begin EVENT "5ms time synchronous" "5_ms" 2 DAQ 1 5 6 6 CONSISTENCY EVENT /end EVENT
   /begin EVENT "10ms time synchronous" "10_ms" 3 DAQ 1 10 6 5 CONSISTENCY EVENT /end EVENT
   /begin EVENT "100ms time synchronous" "100_ms" 4 DAQ 1 100 6 3 CONSISTENCY EVENT /end EVENT
  /end DAQ
  TRANSPORT_LAYER_INSTANCE "CAN2_1MBd_Heavy (ED-RAM)" /end XCP_ON_CAN
 /begin XCP_ON_CAN 0x0102 CAN_ID_MASTER 0x7F4 CAN_ID_SLAVE 0x7EF BAUDRATE 1000000 SAMPLE_POINT 80 BTL_CYCLES 20 SJW 1 MAX_BUS_LOAD 100
  /begin PROTOCOL_LAYER 0x0102 1000 1000 0 0 0 0 0 8 8 BYTE_ORDER_MSB_LAST ADDRESS_GRANULARITY_BYTE OPTIONAL_CMD GET_ID OPTIONAL_CMD GET_SEED OPTIONAL_CMD UNLOCK OPTIONAL_CMD SET_MTA OPTIONAL_CMD UPLOAD OPTIONAL_CMD SHORT_UPLOAD OPTIONAL_CMD BUILD_CHECKSUM OPTIONAL_CMD DOWNLOAD OPTIONAL_CMD DOWNLOAD_NEXT OPTIONAL_CMD DOWNLOAD_MAX OPTIONAL_CMD SET_CAL_PAGE OPTIONAL_CMD GET_CAL_PAGE OPTIONAL_CMD COPY_CAL_PAGE OPTIONAL_CMD CLEAR_DAQ_LIST OPTIONAL_CMD SET_DAQ_PTR OPTIONAL_CMD WRITE_DAQ OPTIONAL_CMD SET_DAQ_LIST_MODE OPTIONAL_CMD START_STOP_DAQ_LIST OPTIONAL_CMD START_STOP_SYNCH OPTIONAL_CMD FREE_DAQ OPTIONAL_CMD ALLOC_DAQ OPTIONAL_CMD ALLOC_ODT OPTIONAL_CMD ALLOC_ODT_ENTRY COMMUNICATION_MODE_SUPPORTED BLOCK SLAVE MASTER 255 10 SEED_AND_KEY_EXTERNAL_FUNCTION "LBTCU_SeedKey_XCP_0001.dll" /end PROTOCOL_LAYER
  /begin DAQ DYNAMIC 65535 5 0 OPTIMISATION_TYPE_DEFAULT ADDRESS_EXTENSION_FREE IDENTIFICATION_FIELD_TYPE_ABSOLUTE GRANULARITY_ODT_ENTRY_SIZE_DAQ_BYTE 255 OVERLOAD_INDICATION_EVENT PRESCALER_SUPPORTED /begin STIM GRANULARITY_ODT_ENTRY_SIZE_STIM_BYTE 255 /end STIM /begin DAQ_MEMORY_CONSUMPTION 8995 60 6 5 2 3 /end DAQ_MEMORY_CONSUMPTION
   /begin EVENT "2p5ms time synchronous" "2p5_ms" 1 DAQ 1 2 6 7 CONSISTENCY EVENT /begin MIN_CYCLE_TIME 2 6 /end MIN_CYCLE_TIME /end EVENT
   /begin EVENT "5ms time synchronous" "5_ms" 2 DAQ 1 5 6 6 CONSISTENCY EVENT /end EVENT
   /begin EVENT "10ms time synchronous" "10_ms" 3 DAQ 1 10 6 5 CONSISTENCY EVENT /end EVENT
   /begin EVENT "100ms time synchronous" "100_ms" 4 DAQ 1 100 6 3 CONSISTENCY EVENT /end EVENT
  /end DAQ
  TRANSPORT_LAYER_INSTANCE "CAN2_1MBd_Light" /end XCP_ON_CAN
 /begin XCP_ON_CAN 0x0102 CAN_ID_MASTER 0x9E394018 CAN_ID_SLAVE 0x9E3D4018 BAUDRATE 500000 SAMPLE_POINT 80 BTL_CYCLES 20 SJW 1 MAX_BUS_LOAD 100
  /begin PROTOCOL_LAYER 0x0102 1000 1000 0 0 0 0 0 8 8 BYTE_ORDER_MSB_LAST ADDRESS_GRANULARITY_BYTE OPTIONAL_CMD GET_ID OPTIONAL_CMD GET_SEED OPTIONAL_CMD UNLOCK OPTIONAL_CMD SET_MTA OPTIONAL_CMD UPLOAD OPTIONAL_CMD SHORT_UPLOAD OPTIONAL_CMD BUILD_CHECKSUM OPTIONAL_CMD DOWNLOAD OPTIONAL_CMD DOWNLOAD_NEXT OPTIONAL_CMD DOWNLOAD_MAX OPTIONAL_CMD SET_CAL_PAGE OPTIONAL_CMD GET_CAL_PAGE OPTIONAL_CMD COPY_CAL_PAGE OPTIONAL_CMD CLEAR_DAQ_LIST OPTIONAL_CMD SET_DAQ_PTR OPTIONAL_CMD WRITE_DAQ OPTIONAL_CMD SET_DAQ_LIST_MODE OPTIONAL_CMD START_STOP_DAQ_LIST OPTIONAL_CMD START_STOP_SYNCH OPTIONAL_CMD FREE_DAQ OPTIONAL_CMD ALLOC_DAQ OPTIONAL_CMD ALLOC_ODT OPTIONAL_CMD ALLOC_ODT_ENTRY COMMUNICATION_MODE_SUPPORTED BLOCK SLAVE MASTER 255 10 SEED_AND_KEY_EXTERNAL_FUNCTION "LBTCU_SeedKey_XCP_0001.dll" /end PROTOCOL_LAYER
  /begin DAQ DYNAMIC 65535 5 0 OPTIMISATION_TYPE_DEFAULT ADDRESS_EXTENSION_FREE IDENTIFICATION_FIELD_TYPE_ABSOLUTE GRANULARITY_ODT_ENTRY_SIZE_DAQ_BYTE 255 OVERLOAD_INDICATION_EVENT PRESCALER_SUPPORTED /begin STIM GRANULARITY_ODT_ENTRY_SIZE_STIM_BYTE 255 /end STIM /begin DAQ_MEMORY_CONSUMPTION 2995 60 6 5 2 3 /end DAQ_MEMORY_CONSUMPTION
   /begin EVENT "2p5ms time synchronous" "2p5_ms" 1 DAQ 1 2 6 7 CONSISTENCY EVENT /begin MIN_CYCLE_TIME 2 6 /end MIN_CYCLE_TIME /end EVENT
   /begin EVENT "5ms time synchronous" "5_ms" 2 DAQ 1 5 6 6 CONSISTENCY EVENT /end EVENT
   /begin EVENT "10ms time synchronous" "10_ms" 3 DAQ 1 10 6 5 CONSISTENCY EVENT /end EVENT
   /begin EVENT "100ms time synchronous" "100_ms" 4 DAQ 1 100 6 3 CONSISTENCY EVENT /end EVENT
  /end DAQ
  TRANSPORT_LAYER_INSTANCE "CAN0_500kBd_Light" /end XCP_ON_CAN
 /begin XCP_ON_FLX 0x0102 0x03E8 "" "" 0x77 HEADER_NAX_CTR_FILL_LEN PACKET_ALIGNMENT_16
  /begin INITIAL_CMD_BUFFER 0xFF MAX_FLX_LEN_BUF FIXED 0xAA
   /begin LPDU_ID FLX_SLOT_ID FIXED 0x55 OFFSET FIXED 0x00 CYCLE_REPETITION FIXED 0x01 CHANNEL FIXED A /end LPDU_ID
   /begin XCP_PACKET CMD FIXED RES_ERR NOT_ALLOWED EV_SERV NOT_ALLOWED DAQ NOT_ALLOWED STIM NOT_ALLOWED /end XCP_PACKET
  /end INITIAL_CMD_BUFFER
  /begin INITIAL_RES_ERR_BUFFER 0x00 MAX_FLX_LEN_BUF FIXED 0xAA
   /begin LPDU_ID FLX_SLOT_ID FIXED 0x56 OFFSET FIXED 0x00 CYCLE_REPETITION FIXED 0x01 CHANNEL FIXED A /end LPDU_ID
   /begin XCP_PACKET CMD NOT_ALLOWED RES_ERR FIXED EV_SERV NOT_ALLOWED DAQ NOT_ALLOWED STIM NOT_ALLOWED /end XCP_PACKET
  /end INITIAL_RES_ERR_BUFFER
  /begin POOL_BUFFER 0x01 MAX_FLX_LEN_BUF FIXED 0xAA
   /begin LPDU_ID FLX_SLOT_ID FIXED 0x57 OFFSET FIXED 0x00 CYCLE_REPETITION FIXED 0x01 CHANNEL FIXED A /end LPDU_ID
   /begin XCP_PACKET CMD NOT_ALLOWED RES_ERR VARIABLE EV_SERV VARIABLE DAQ VARIABLE STIM NOT_ALLOWED /end XCP_PACKET
  /end POOL_BUFFER
  /begin POOL_BUFFER 0x02 MAX_FLX_LEN_BUF FIXED 0xAA
   /begin LPDU_ID FLX_SLOT_ID FIXED 0x58 OFFSET FIXED 0x00 CYCLE_REPETITION FIXED 0x01 CHANNEL FIXED A /end LPDU_ID
   /begin XCP_PACKET CMD NOT_ALLOWED RES_ERR VARIABLE EV_SERV VARIABLE DAQ VARIABLE STIM NOT_ALLOWED /end XCP_PACKET
  /end POOL_BUFFER
  /begin POOL_BUFFER 0x03 MAX_FLX_LEN_BUF FIXED 0xAA
   /begin LPDU_ID FLX_SLOT_ID FIXED 0x59 OFFSET FIXED 0x00 CYCLE_REPETITION FIXED 0x01 CHANNEL FIXED A /end LPDU_ID
   /begin XCP_PACKET CMD NOT_ALLOWED RES_ERR VARIABLE EV_SERV VARIABLE DAQ VARIABLE STIM NOT_ALLOWED /end XCP_PACKET
  /end POOL_BUFFER
  /begin POOL_BUFFER 0x04 MAX_FLX_LEN_BUF FIXED 0xAA
   /begin LPDU_ID FLX_SLOT_ID FIXED 0x5A OFFSET FIXED 0x00 CYCLE_REPETITION FIXED 0x01 CHANNEL FIXED A /end LPDU_ID
   /begin XCP_PACKET CMD NOT_ALLOWED RES_ERR VARIABLE EV_SERV VARIABLE DAQ VARIABLE STIM NOT_ALLOWED /end XCP_PACKET
  /end POOL_BUFFER
  /begin POOL_BUFFER 0x05 MAX_FLX_LEN_BUF FIXED 0x2C
   /begin LPDU_ID FLX_SLOT_ID FIXED 0x5F OFFSET FIXED 0x00 CYCLE_REPETITION FIXED 0x01 CHANNEL FIXED A /end LPDU_ID
   /begin XCP_PACKET CMD NOT_ALLOWED RES_ERR VARIABLE EV_SERV VARIABLE DAQ VARIABLE STIM NOT_ALLOWED /end XCP_PACKET
  /end POOL_BUFFER
  /begin POOL_BUFFER 0x06 MAX_FLX_LEN_BUF FIXED 0x2C
   /begin LPDU_ID FLX_SLOT_ID FIXED 0x60 OFFSET FIXED 0x00 CYCLE_REPETITION FIXED 0x01 CHANNEL FIXED A /end LPDU_ID
   /begin XCP_PACKET CMD NOT_ALLOWED RES_ERR VARIABLE EV_SERV VARIABLE DAQ VARIABLE STIM NOT_ALLOWED /end XCP_PACKET
  /end POOL_BUFFER
  /begin POOL_BUFFER 0x07 MAX_FLX_LEN_BUF FIXED 0x2C
   /begin LPDU_ID FLX_SLOT_ID FIXED 0x61 OFFSET FIXED 0x00 CYCLE_REPETITION FIXED 0x01 CHANNEL FIXED A /end LPDU_ID
   /begin XCP_PACKET CMD NOT_ALLOWED RES_ERR VARIABLE EV_SERV VARIABLE DAQ VARIABLE STIM NOT_ALLOWED /end XCP_PACKET
  /end POOL_BUFFER
  /begin POOL_BUFFER 0x08 MAX_FLX_LEN_BUF FIXED 0x2C
   /begin LPDU_ID FLX_SLOT_ID FIXED 0x62 OFFSET FIXED 0x00 CYCLE_REPETITION FIXED 0x01 CHANNEL FIXED A /end LPDU_ID
   /begin XCP_PACKET CMD NOT_ALLOWED RES_ERR VARIABLE EV_SERV VARIABLE DAQ VARIABLE STIM NOT_ALLOWED /end XCP_PACKET
  /end POOL_BUFFER
  /begin POOL_BUFFER 0x09 MAX_FLX_LEN_BUF FIXED 0x2C
   /begin LPDU_ID FLX_SLOT_ID FIXED 0x63 OFFSET FIXED 0x00 CYCLE_REPETITION FIXED 0x01 CHANNEL FIXED A /end LPDU_ID
   /begin XCP_PACKET CMD NOT_ALLOWED RES_ERR VARIABLE EV_SERV VARIABLE DAQ VARIABLE STIM NOT_ALLOWED /end XCP_PACKET
  /end POOL_BUFFER
  /begin POOL_BUFFER 0x0A MAX_FLX_LEN_BUF FIXED 0x2C
   /begin LPDU_ID FLX_SLOT_ID FIXED 0x64 OFFSET FIXED 0x00 CYCLE_REPETITION FIXED 0x01 CHANNEL FIXED A /end LPDU_ID
   /begin XCP_PACKET CMD NOT_ALLOWED RES_ERR VARIABLE EV_SERV VARIABLE DAQ VARIABLE STIM NOT_ALLOWED /end XCP_PACKET
  /end POOL_BUFFER
  /begin POOL_BUFFER 0x0B MAX_FLX_LEN_BUF FIXED 0x2C
   /begin LPDU_ID FLX_SLOT_ID FIXED 0x65 OFFSET FIXED 0x00 CYCLE_REPETITION FIXED 0x01 CHANNEL FIXED A /end LPDU_ID
   /begin XCP_PACKET CMD NOT_ALLOWED RES_ERR VARIABLE EV_SERV VARIABLE DAQ VARIABLE STIM NOT_ALLOWED /end XCP_PACKET
  /end POOL_BUFFER
  /begin POOL_BUFFER 0x0C MAX_FLX_LEN_BUF FIXED 0x2C
   /begin LPDU_ID FLX_SLOT_ID FIXED 0x66 OFFSET FIXED 0x00 CYCLE_REPETITION FIXED 0x01 CHANNEL FIXED A /end LPDU_ID
   /begin XCP_PACKET CMD NOT_ALLOWED RES_ERR VARIABLE EV_SERV VARIABLE DAQ VARIABLE STIM NOT_ALLOWED /end XCP_PACKET
  /end POOL_BUFFER
  /begin POOL_BUFFER 0x0D MAX_FLX_LEN_BUF FIXED 0xAA
   /begin LPDU_ID FLX_SLOT_ID FIXED 0x5E OFFSET FIXED 0x00 CYCLE_REPETITION FIXED 0x01 CHANNEL FIXED A /end LPDU_ID
   /begin XCP_PACKET CMD VARIABLE RES_ERR NOT_ALLOWED EV_SERV NOT_ALLOWED DAQ NOT_ALLOWED STIM VARIABLE /end XCP_PACKET
  /end POOL_BUFFER
  /begin POOL_BUFFER 0x0E MAX_FLX_LEN_BUF FIXED 0xAA
   /begin LPDU_ID FLX_SLOT_ID FIXED 0x5D OFFSET FIXED 0x00 CYCLE_REPETITION FIXED 0x01 CHANNEL FIXED A /end LPDU_ID
   /begin XCP_PACKET CMD VARIABLE RES_ERR NOT_ALLOWED EV_SERV NOT_ALLOWED DAQ NOT_ALLOWED STIM VARIABLE /end XCP_PACKET
  /end POOL_BUFFER
  /begin POOL_BUFFER 0x0F MAX_FLX_LEN_BUF FIXED 0xAA
   /begin LPDU_ID FLX_SLOT_ID FIXED 0x5C OFFSET FIXED 0x00 CYCLE_REPETITION FIXED 0x01 CHANNEL FIXED A /end LPDU_ID
   /begin XCP_PACKET CMD VARIABLE RES_ERR NOT_ALLOWED EV_SERV NOT_ALLOWED DAQ NOT_ALLOWED STIM VARIABLE /end XCP_PACKET
  /end POOL_BUFFER
  /begin POOL_BUFFER 0x10 MAX_FLX_LEN_BUF FIXED 0xAA
   /begin LPDU_ID FLX_SLOT_ID FIXED 0x5B OFFSET FIXED 0x00 CYCLE_REPETITION FIXED 0x01 CHANNEL FIXED A /end LPDU_ID
   /begin XCP_PACKET CMD VARIABLE RES_ERR NOT_ALLOWED EV_SERV NOT_ALLOWED DAQ NOT_ALLOWED STIM VARIABLE /end XCP_PACKET
  /end POOL_BUFFER
  /begin PROTOCOL_LAYER 0x0102 0x07D0 0x2710 0x00 0x00 0x00 0x00 0x00 0xA6 0x28 BYTE_ORDER_MSB_FIRST ADDRESS_GRANULARITY_BYTE OPTIONAL_CMD GET_COMM_MODE_INFO OPTIONAL_CMD UNLOCK OPTIONAL_CMD SET_MTA OPTIONAL_CMD UPLOAD OPTIONAL_CMD SHORT_UPLOAD OPTIONAL_CMD BUILD_CHECKSUM OPTIONAL_CMD TRANSPORT_LAYER_CMD OPTIONAL_CMD DOWNLOAD OPTIONAL_CMD DOWNLOAD_MAX OPTIONAL_CMD SHORT_DOWNLOAD OPTIONAL_CMD SET_CAL_PAGE OPTIONAL_CMD GET_CAL_PAGE OPTIONAL_CMD GET_PAG_PROCESSOR_INFO OPTIONAL_CMD GET_PAGE_INFO OPTIONAL_CMD COPY_CAL_PAGE OPTIONAL_CMD SET_DAQ_PTR OPTIONAL_CMD WRITE_DAQ OPTIONAL_CMD SET_DAQ_LIST_MODE OPTIONAL_CMD GET_DAQ_LIST_MODE OPTIONAL_CMD START_STOP_DAQ_LIST OPTIONAL_CMD START_STOP_SYNCH OPTIONAL_CMD GET_DAQ_CLOCK OPTIONAL_CMD GET_DAQ_PROCESSOR_INFO OPTIONAL_CMD GET_DAQ_RESOLUTION_INFO OPTIONAL_CMD GET_DAQ_EVENT_INFO OPTIONAL_CMD FREE_DAQ OPTIONAL_CMD ALLOC_DAQ OPTIONAL_CMD ALLOC_ODT OPTIONAL_CMD ALLOC_ODT_ENTRY COMMUNICATION_MODE_SUPPORTED BLOCK SLAVE /end PROTOCOL_LAYER
  /begin DAQ DYNAMIC 0x00 0x03 0x00 OPTIMISATION_TYPE_DEFAULT ADDRESS_EXTENSION_FREE IDENTIFICATION_FIELD_TYPE_ABSOLUTE GRANULARITY_ODT_ENTRY_SIZE_DAQ_BYTE 0x07 OVERLOAD_INDICATION_PID PRESCALER_SUPPORTED /begin TIMESTAMP_SUPPORTED 0x01 SIZE_WORD UNIT_1MS /end TIMESTAMP_SUPPORTED /begin EVENT "DAQ0 10ms" "DAQ0 10m" 0x00 DAQ 0x01 0x0A 0x06 0x00 /end EVENT /begin EVENT "DAQ1 30ms" "DAQ1 30m" 0x01 DAQ 0x01 0x1E 0x06 0x00 /end EVENT /begin EVENT "DAQ2 100ms" "DAQ2 100" 0x02 DAQ 0x01 0x64 0x06 0x00 /end EVENT /end DAQ
  /begin PAG 0x01 /end PAG
  TRANSPORT_LAYER_INSTANCE "XcpTransportLayer_FLX_Dummy" /end XCP_ON_FLX
/end IF_DATA
/*********** Start of merged CHARACTERISTIC blocks ***********/
/begin CHARACTERISTIC CPT_Lodi_GlobalParameterInterface_DST_GEARRATIOS "" VAL_BLK 0x8061CF60 DefaultValueRecordLayout_AUTOSAR_Platform_BaseTypes_sint16 200.0 RB_PT_PCT_SWC_IOP_SensorInputs_CompuMethods_ratio_0p01 -100. 100. FORMAT "%10.5"
 /begin ANNOTATION ANNOTATION_LABEL "Description (coming from AUTOSAR DESC field)" /begin ANNOTATION_TEXT "Array of gear ratios for the transmission\r\n" /end ANNOTATION_TEXT /end ANNOTATION
 MATRIX_DIM 12 1 1 /end CHARACTERISTIC
/begin CHARACTERISTIC SYS_DEPENDENTGEARS "" VAL_BLK 0x8061CC81 DefaultValueRecordLayout_AUTOSAR_Platform_BaseTypes_uint8 11.0 RB_PT_PCT_SWC_IOP_SensorInputs_CompuMethods_ident 0.0 11. FORMAT "%10.5"
 /begin ANNOTATION ANNOTATION_LABEL "Description (coming from AUTOSAR DESC field)"
  /begin ANNOTATION_TEXT "Array of dependent gears for any given target gear (eg. 1st gear must be engaged to get the torque path for reverse).\r\n" /end ANNOTATION_TEXT
 /end ANNOTATION
 MATRIX_DIM 12 1 1 /end CHARACTERISTIC
/begin CHARACTERISTIC SYS_GEARTOCLUTCH1MAPPING "" VAL_BLK 0x8061CC75 DefaultValueRecordLayout_AUTOSAR_Platform_BaseTypes_boolean 255.0 AUTOSAR_Platform_CompuMethods_boolean 0.0 255. FORMAT "%10.5"
 /begin ANNOTATION ANNOTATION_LABEL "Description (coming from AUTOSAR DESC field)" /begin ANNOTATION_TEXT "Driver selected gears which are driven by clutch 1.\r\n" /end ANNOTATION_TEXT /end ANNOTATION
 MATRIX_DIM 12 1 1 /end CHARACTERISTIC
/begin CHARACTERISTIC SYS_GEARTOCLUTCH2MAPPING "" VAL_BLK 0x8061CC69 DefaultValueRecordLayout_AUTOSAR_Platform_BaseTypes_boolean 255.0 AUTOSAR_Platform_CompuMethods_boolean 0.0 255. FORMAT "%10.5"
 /begin ANNOTATION ANNOTATION_LABEL "Description (coming from AUTOSAR DESC field)" /begin ANNOTATION_TEXT "Driver selected gears which are driven by clutch 2.\r\n" /end ANNOTATION_TEXT /end ANNOTATION
 MATRIX_DIM 12 1 1 /end CHARACTERISTIC
/begin CHARACTERISTIC Can_CanController_0BaudrateCfgId_C "Calibration parameter for the Baudrate of Can Node CanController_0" VALUE 0x8061CF4E DefaultValueRecordLayout_AUTOSAR_PlatformTypes_SwBaseTypes_uint16 0.0 AUTOSAR_Can_CompuMethods_Can_CompuMethod_CtrlBdRateId_CanController_0 0.0 0.0 FORMAT "%5.0" /end CHARACTERISTIC
/begin CHARACTERISTIC Can_CanController_1BaudrateCfgId_C "Calibration parameter for the Baudrate of Can Node CanController_1" VALUE 0x8061CF4C DefaultValueRecordLayout_AUTOSAR_PlatformTypes_SwBaseTypes_uint16 0.0 AUTOSAR_Can_CompuMethods_Can_CompuMethod_CtrlBdRateId_CanController_1 0.0 0.0 FORMAT "%5.0" /end CHARACTERISTIC
/begin CHARACTERISTIC Can_CanController_2BaudrateCfgId_C "Calibration parameter for the Baudrate of Can Node CanController_2" VALUE 0x8061CF4A DefaultValueRecordLayout_AUTOSAR_PlatformTypes_SwBaseTypes_uint16 0.0 AUTOSAR_Can_CompuMethods_Can_CompuMethod_CtrlBdRateId_CanController_2 0.0 0.0 FORMAT "%5.0" /end CHARACTERISTIC
/begin CHARACTERISTIC Can_CanController_3BaudrateCfgId_C "Calibration parameter for the Baudrate of Can Node CanController_3" VALUE 0x8061CF48 DefaultValueRecordLayout_AUTOSAR_PlatformTypes_SwBaseTypes_uint16 0.0 AUTOSAR_Can_CompuMethods_Can_CompuMethod_CtrlBdRateId_CanController_3 0.0 0.0 FORMAT "%5.0" /end CHARACTERISTIC
/begin CHARACTERISTIC Can_CanHwObject_BYPASS_TDG1_11_RXCanId_C "Calibration parameter for Can-Id of Message CanHwObject_BYPASS_TDG1_11_RX" VALUE 0x8061CE2C DefaultValueRecordLayout_AUTOSAR_Platform_BaseTypes_uint32 2047.0 RB_RBA_Common_CentralElements_CompuMethods_Identical 0.0 2047. FORMAT "%5.0" /end CHARACTERISTIC
/begin CHARACTERISTIC Can_CanHwObject_BYPASS_TDG1_12_RXCanId_C "Calibration parameter for Can-Id of Message CanHwObject_BYPASS_TDG1_12_RX" VALUE 0x8061CE28 DefaultValueRecordLayout_AUTOSAR_Platform_BaseTypes_uint32 2047.0 RB_RBA_Common_CentralElements_CompuMethods_Identical 0.0 2047. FORMAT "%5.0" /end CHARACTERISTIC
/begin CHARACTERISTIC Can_CanHwObject_BYPASS_TDG1_13_RXCanId_C "Calibration parameter for Can-Id of Message CanHwObject_BYPASS_TDG1_13_RX" VALUE 0x8061CE24 DefaultValueRecordLayout_AUTOSAR_Platform_BaseTypes_uint32 2047.0 RB_RBA_Common_CentralElements_CompuMethods_Identical 0.0 2047. FORMAT "%5.0" /end CHARACTERISTIC
/begin CHARACTERISTIC Can_CanHwObject_BYPASS_TDG1_14_RXCanId_C "Calibration parameter for Can-Id of Message CanHwObject_BYPASS_TDG1_14_RX" VALUE 0x8061CE20 DefaultValueRecordLayout_AUTOSAR_Platform_BaseTypes_uint32 2047.0 RB_RBA_Common_CentralElements_CompuMethods_Identical 0.0 2047. FORMAT "%5.0" /end CHARACTERISTIC
/begin CHARACTERISTIC Can_CanHwObject_BYPASS_TDG1_15_RXCanId_C "Calibration parameter for Can-Id of Message CanHwObject_BYPASS_TDG1_15_RX" VALUE 0x8061CE1C DefaultValueRecordLayout_AUTOSAR_Platform_BaseTypes_uint32 2047.0 RB_RBA_Common_CentralElements_CompuMethods_Identical 0.0 2047. FORMAT "%5.0" /end CHARACTERISTIC
/begin CHARACTERISTIC Can_CanHwObject_BYPASS_TDG1_16_PlaceHolder_RXCanId_C "Calibration parameter for Can-Id of Message CanHwObject_BYPASS_TDG1_16_PlaceHolder_RX" VALUE 0x8061CE18 DefaultValueRecordLayout_AUTOSAR_Platform_BaseTypes_uint32 2047.0 RB_RBA_Common_CentralElements_CompuMethods_Identical 0.0 2047. FORMAT "%5.0" /end CHARACTERISTIC
/begin CHARACTERISTIC Can_CanHwObject_BYPASS_TDG1_17_PlaceHolder_RXCanId_C "Calibration parameter for Can-Id of Message CanHwObject_BYPASS_TDG1_17_PlaceHolder_RX" VALUE 0x8061CE14 DefaultValueRecordLayout_AUTOSAR_Platform_BaseTypes_uint32 2047.0 RB_RBA_Common_CentralElements_CompuMethods_Identical 0.0 2047. FORMAT "%5.0" /end CHARACTERISTIC
/begin CHARACTERISTIC Can_CanHwObject_BYPASS_TDG1_18_PlaceHolder_RXCanId_C "Calibration parameter for Can-Id of Message CanHwObject_BYPASS_TDG1_18_PlaceHolder_RX" VALUE 0x8061CE10 DefaultValueRecordLayout_AUTOSAR_Platform_BaseTypes_uint32 2047.0 RB_RBA_Common_CentralElements_CompuMethods_Identical 0.0 2047. FORMAT "%5.0" /end CHARACTERISTIC
/begin CHARACTERISTIC Can_CanHwObject_BYPASS_TDG1_19_Placeholder_RXCanId_C "Calibration parameter for Can-Id of Message CanHwObject_BYPASS_TDG1_19_Placeholder_RX" VALUE 0x8061CE0C DefaultValueRecordLayout_AUTOSAR_Platform_BaseTypes_uint32 2047.0 RB_RBA_Common_CentralElements_CompuMethods_Identical 0.0 2047. FORMAT "%5.0" /end CHARACTERISTIC
/begin CHARACTERISTIC Can_CanHwObject_BYPASS_TDG1_20_Placeholder_RXCanId_C "Calibration parameter for Can-Id of Message CanHwObject_BYPASS_TDG1_20_Placeholder_RX" VALUE 0x8061CE08 DefaultValueRecordLayout_AUTOSAR_Platform_BaseTypes_uint32 2047.0 RB_RBA_Common_CentralElements_CompuMethods_Identical 0.0 2047. FORMAT "%5.0" /end CHARACTERISTIC
/begin CHARACTERISTIC Can_CanHwObject_BYPASS_TDG1_21_RXCanId_C "Calibration parameter for Can-Id of Message CanHwObject_BYPASS_TDG1_21_RX" VALUE 0x8061CE04 DefaultValueRecordLayout_AUTOSAR_Platform_BaseTypes_uint32 2047.0 RB_RBA_Common_CentralElements_CompuMethods_Identical 0.0 2047. FORMAT "%5.0" /end CHARACTERISTIC
/begin CHARACTERISTIC Can_CanHwObject_BYPASS_TDG1_22_RXCanId_C "Calibration parameter for Can-Id of Message CanHwObject_BYPASS_TDG1_22_RX" VALUE 0x8061CE00 DefaultValueRecordLayout_AUTOSAR_Platform_BaseTypes_uint32 2047.0 RB_RBA_Common_CentralElements_CompuMethods_Identical 0.0 2047. FORMAT "%5.0" /end CHARACTERISTIC
/begin CHARACTERISTIC Can_CanHwObject_Cool_Act_Sts_RXCanId_C "Calibration parameter for Can-Id of Message CanHwObject_Cool_Act_Sts_RX" VALUE 0x8061CDFC DefaultValueRecordLayout_AUTOSAR_Platform_BaseTypes_uint32 2047.0 RB_RBA_Common_CentralElements_CompuMethods_Identical 0.0 2047. FORMAT "%5.0" /end CHARACTERISTIC
/begin CHARACTERISTIC Can_CanHwObject_Motor_01_RXCanId_C "Calibration parameter for Can-Id of Message CanHwObject_Motor_01_RX" VALUE 0x8061CDF8 DefaultValueRecordLayout_AUTOSAR_Platform_BaseTypes_uint32 2047.0 RB_RBA_Common_CentralElements_CompuMethods_Identical 0.0 2047. FORMAT "%5.0" /end CHARACTERISTIC
/begin CHARACTERISTIC Can_CanHwObject_Motor_02_RXCanId_C "Calibration parameter for Can-Id of Message CanHwObject_Motor_02_RX" VALUE 0x8061CDF4 DefaultValueRecordLayout_AUTOSAR_Platform_BaseTypes_uint32 2047.0 RB_RBA_Common_CentralElements_CompuMethods_Identical 0.0 2047. FORMAT "%5.0" /end CHARACTERISTIC
/begin CHARACTERISTIC Can_CanHwObject_Motor_03_RXCanId_C "Calibration parameter for Can-Id of Message CanHwObject_Motor_03_RX" VALUE 0x8061CDF0 DefaultValueRecordLayout_AUTOSAR_Platform_BaseTypes_uint32 2047.0 RB_RBA_Common_CentralElements_CompuMethods_Identical 0.0 2047. FORMAT "%5.0" /end CHARACTERISTIC
/begin CHARACTERISTIC Can_CanTp_Rx_0x611CanId_C "Calibration parameter for Can-Id of Message CanTp_Rx_0x611" VALUE 0x8061CDEC DefaultValueRecordLayout_AUTOSAR_Platform_BaseTypes_uint32 2047.0 RB_RBA_Common_CentralElements_CompuMethods_Identical 0.0 2047. FORMAT "%5.0" /end CHARACTERISTIC
/begin CHARACTERISTIC Can_XcpRx2_CMDCanId_C "Calibration parameter for Can-Id of Message XcpRx2_CMD" VALUE 0x8061CDE8 DefaultValueRecordLayout_AUTOSAR_Platform_BaseTypes_uint32 2047.0 RB_RBA_Common_CentralElements_CompuMethods_Identical 0.0 2047. FORMAT "%5.0" /end CHARACTERISTIC
/begin CHARACTERISTIC Can_XcpRx2_CMD_1CanId_C "Calibration parameter for Can-Id of Message XcpRx2_CMD_1" VALUE 0x8061CDE4 DefaultValueRecordLayout_AUTOSAR_Platform_BaseTypes_uint32 5.36870911E8 RB_RBA_Common_CentralElements_CompuMethods_Identical 0.0 5.36870911E8 FORMAT "%5.0" /end CHARACTERISTIC
/begin CHARACTERISTIC Can_XcpRx_CMDCanId_C "Calibration parameter for Can-Id of Message XcpRx_CMD" VALUE 0x8061CDE0 DefaultValueRecordLayout_AUTOSAR_Platform_BaseTypes_uint32 2047.0 RB_RBA_Common_CentralElements_CompuMethods_Identical 0.0 2047. FORMAT "%5.0" /end CHARACTERISTIC
/begin CHARACTERISTIC Can_XcpRx_STIMCanId_C "Calibration parameter for Can-Id of Message XcpRx_STIM" VALUE 0x8061CDDC DefaultValueRecordLayout_AUTOSAR_Platform_BaseTypes_uint32 2047.0 RB_RBA_Common_CentralElements_CompuMethods_Identical 0.0 2047. FORMAT "%5.0" /end CHARACTERISTIC
/begin CHARACTERISTIC CanIf_CanIfHthCfg_CanController_0_Getriebe_01CanNod_C "Calibration parameter for Can Node of the message CanIfHthCfg_CanController_0_Getriebe_01" VALUE 0x8061CD69 DefaultValueRecordLayout_AUTOSAR_PlatformTypes_SwBaseTypes_uint8 4.0 AUTOSAR_CanIf_CompuMethods_CanIf_CompuMethod_CtrlId 0.0 4. FORMAT "%5.0" /end CHARACTERISTIC
/begin CHARACTERISTIC CanIf_CanIfHthCfg_CanController_1_BYPASS_TDG1_AACanNod_C "Calibration parameter for Can Node of the message CanIfHthCfg_CanController_1_BYPASS_TDG1_AA" VALUE 0x8061CD68 DefaultValueRecordLayout_AUTOSAR_PlatformTypes_SwBaseTypes_uint8 4.0 AUTOSAR_CanIf_CompuMethods_CanIf_CompuMethod_CtrlId 0.0 4. FORMAT "%5.0" /end CHARACTERISTIC
/begin CHARACTERISTIC CanIf_CanIfHthCfg_CanController_1_BYPASS_TDG1_ABCanNod_C "Calibration parameter for Can Node of the message CanIfHthCfg_CanController_1_BYPASS_TDG1_AB" VALUE 0x8061CD67 DefaultValueRecordLayout_AUTOSAR_PlatformTypes_SwBaseTypes_uint8 4.0 AUTOSAR_CanIf_CompuMethods_CanIf_CompuMethod_CtrlId 0.0 4. FORMAT "%5.0" /end CHARACTERISTIC
/begin CHARACTERISTIC CanIf_CanIfHthCfg_CanController_1_BYPASS_TDG1_ACCanNod_C "Calibration parameter for Can Node of the message CanIfHthCfg_CanController_1_BYPASS_TDG1_AC" VALUE 0x8061CD66 DefaultValueRecordLayout_AUTOSAR_PlatformTypes_SwBaseTypes_uint8 4.0 AUTOSAR_CanIf_CompuMethods_CanIf_CompuMethod_CtrlId 0.0 4. FORMAT "%5.0" /end CHARACTERISTIC
/begin CHARACTERISTIC CanIf_CanIfHthCfg_CanController_1_BYPASS_TDG1_ADCanNod_C "Calibration parameter for Can Node of the message CanIfHthCfg_CanController_1_BYPASS_TDG1_AD" VALUE 0x8061CD65 DefaultValueRecordLayout_AUTOSAR_PlatformTypes_SwBaseTypes_uint8 4.0 AUTOSAR_CanIf_CompuMethods_CanIf_CompuMethod_CtrlId 0.0 4. FORMAT "%5.0" /end CHARACTERISTIC
/begin CHARACTERISTIC CanIf_CanIfHthCfg_CanController_1_BYPASS_TDG1_AECanNod_C "Calibration parameter for Can Node of the message CanIfHthCfg_CanController_1_BYPASS_TDG1_AE" VALUE 0x8061CD64 DefaultValueRecordLayout_AUTOSAR_PlatformTypes_SwBaseTypes_uint8 4.0 AUTOSAR_CanIf_CompuMethods_CanIf_CompuMethod_CtrlId 0.0 4. FORMAT "%5.0" /end CHARACTERISTIC
/begin CHARACTERISTIC CanIf_CanIfHthCfg_CanController_1_BYPASS_TDG1_AFCanNod_C "Calibration parameter for Can Node of the message CanIfHthCfg_CanController_1_BYPASS_TDG1_AF" VALUE 0x8061CD63 DefaultValueRecordLayout_AUTOSAR_PlatformTypes_SwBaseTypes_uint8 4.0 AUTOSAR_CanIf_CompuMethods_CanIf_CompuMethod_CtrlId 0.0 4. FORMAT "%5.0" /end CHARACTERISTIC
/begin CHARACTERISTIC CanIf_CanIfHthCfg_CanController_1_BYPASS_TDG1_BACanNod_C "Calibration parameter for Can Node of the message CanIfHthCfg_CanController_1_BYPASS_TDG1_BA" VALUE 0x8061CD62 DefaultValueRecordLayout_AUTOSAR_PlatformTypes_SwBaseTypes_uint8 4.0 AUTOSAR_CanIf_CompuMethods_CanIf_CompuMethod_CtrlId 0.0 4. FORMAT "%5.0" /end CHARACTERISTIC
/begin CHARACTERISTIC CanIf_CanIfHthCfg_CanController_1_BYPASS_TDG1_BBCanNod_C "Calibration parameter for Can Node of the message CanIfHthCfg_CanController_1_BYPASS_TDG1_BB" VALUE 0x8061CD61 DefaultValueRecordLayout_AUTOSAR_PlatformTypes_SwBaseTypes_uint8 4.0 AUTOSAR_CanIf_CompuMethods_CanIf_CompuMethod_CtrlId 0.0 4. FORMAT "%5.0" /end CHARACTERISTIC
/begin CHARACTERISTIC CanIf_CanIfHthCfg_CanController_1_BYPASS_TDG1_BCCanNod_C "Calibration parameter for Can Node of the message CanIfHthCfg_CanController_1_BYPASS_TDG1_BC" VALUE 0x8061CD60 DefaultValueRecordLayout_AUTOSAR_PlatformTypes_SwBaseTypes_uint8 4.0 AUTOSAR_CanIf_CompuMethods_CanIf_CompuMethod_CtrlId 0.0 4. FORMAT "%5.0" /end CHARACTERISTIC
/begin CHARACTERISTIC CanIf_CanIfHthCfg_CanController_1_BYPASS_TDG1_BDCanNod_C "Calibration parameter for Can Node of the message CanIfHthCfg_CanController_1_BYPASS_TDG1_BD" VALUE 0x8061CD5F DefaultValueRecordLayout_AUTOSAR_PlatformTypes_SwBaseTypes_uint8 4.0 AUTOSAR_CanIf_CompuMethods_CanIf_CompuMethod_CtrlId 0.0 4. FORMAT "%5.0" /end CHARACTERISTIC
/begin CHARACTERISTIC CanIf_CanIfHthCfg_CanController_1_BYPASS_TDG1_BE_PlaceHolderCanNod_C "Calibration parameter for Can Node of the message CanIfHthCfg_CanController_1_BYPASS_TDG1_BE_PlaceHolder" VALUE 0x8061CD5E DefaultValueRecordLayout_AUTOSAR_PlatformTypes_SwBaseTypes_uint8 4.0 AUTOSAR_CanIf_CompuMethods_CanIf_CompuMethod_CtrlId 0.0 4. FORMAT "%5.0" /end CHARACTERISTIC
/begin CHARACTERISTIC CanIf_CanIfHthCfg_CanController_1_BYPASS_TDG1_BF_PlaceHolderCanNod_C "Calibration parameter for Can Node of the message CanIfHthCfg_CanController_1_BYPASS_TDG1_BF_PlaceHolder" VALUE 0x8061CD5D DefaultValueRecordLayout_AUTOSAR_PlatformTypes_SwBaseTypes_uint8 4.0 AUTOSAR_CanIf_CompuMethods_CanIf_CompuMethod_CtrlId 0.0 4. FORMAT "%5.0" /end CHARACTERISTIC
/begin CHARACTERISTIC CanIf_CanIfHthCfg_CanController_1_BYPASS_TDG1_CA_PlaceHolderCanNod_C "Calibration parameter for Can Node of the message CanIfHthCfg_CanController_1_BYPASS_TDG1_CA_PlaceHolder" VALUE 0x8061CD5C DefaultValueRecordLayout_AUTOSAR_PlatformTypes_SwBaseTypes_uint8 4.0 AUTOSAR_CanIf_CompuMethods_CanIf_CompuMethod_CtrlId 0.0 4. FORMAT "%5.0" /end CHARACTERISTIC
/begin CHARACTERISTIC CanIf_CanIfHthCfg_CanController_1_BYPASS_TDG1_CB_PlaceHolderCanNod_C "Calibration parameter for Can Node of the message CanIfHthCfg_CanController_1_BYPASS_TDG1_CB_PlaceHolder" VALUE 0x8061CD5B DefaultValueRecordLayout_AUTOSAR_PlatformTypes_SwBaseTypes_uint8 4.0 AUTOSAR_CanIf_CompuMethods_CanIf_CompuMethod_CtrlId 0.0 4. FORMAT "%5.0" /end CHARACTERISTIC
/begin CHARACTERISTIC CanIf_CanIfHthCfg_CanController_1_BYPASS_TDG1_CC_PlaceHolderCanNod_C "Calibration parameter for Can Node of the message CanIfHthCfg_CanController_1_BYPASS_TDG1_CC_PlaceHolder" VALUE 0x8061CD5A DefaultValueRecordLayout_AUTOSAR_PlatformTypes_SwBaseTypes_uint8 4.0 AUTOSAR_CanIf_CompuMethods_CanIf_CompuMethod_CtrlId 0.0 4. FORMAT "%5.0" /end CHARACTERISTIC
/begin CHARACTERISTIC CanIf_CanIfHthCfg_CanController_1_Cool_Act_CmdCanNod_C "Calibration parameter for Can Node of the message CanIfHthCfg_CanController_1_Cool_Act_Cmd" VALUE 0x8061CD59 DefaultValueRecordLayout_AUTOSAR_PlatformTypes_SwBaseTypes_uint8 4.0 AUTOSAR_CanIf_CompuMethods_CanIf_CompuMethod_CtrlId 0.0 4. FORMAT "%5.0" /end CHARACTERISTIC
/begin CHARACTERISTIC CanIf_CanIfRxPduCfg_BYPASS_TDG1_11_RXCanDlc_C "Calibration parameter for the Data length of CAN frame CanIfRxPduCfg_BYPASS_TDG1_11_RX" VALUE 0x8061CD58 DefaultValueRecordLayout_AUTOSAR_PlatformTypes_SwBaseTypes_uint8 8.0 RB_RBA_Common_CentralElements_CompuMethods_Identical 0.0 8. FORMAT "%5.0" /end CHARACTERISTIC
/begin CHARACTERISTIC CanIf_CanIfRxPduCfg_BYPASS_TDG1_12_RXCanDlc_C "Calibration parameter for the Data length of CAN frame CanIfRxPduCfg_BYPASS_TDG1_12_RX" VALUE 0x8061CD57 DefaultValueRecordLayout_AUTOSAR_PlatformTypes_SwBaseTypes_uint8 8.0 RB_RBA_Common_CentralElements_CompuMethods_Identical 0.0 8. FORMAT "%5.0" /end CHARACTERISTIC
/begin CHARACTERISTIC CanIf_CanIfRxPduCfg_BYPASS_TDG1_13_RXCanDlc_C "Calibration parameter for the Data length of CAN frame CanIfRxPduCfg_BYPASS_TDG1_13_RX" VALUE 0x8061CD56 DefaultValueRecordLayout_AUTOSAR_PlatformTypes_SwBaseTypes_uint8 8.0 RB_RBA_Common_CentralElements_CompuMethods_Identical 0.0 8. FORMAT "%5.0" /end CHARACTERISTIC
/begin CHARACTERISTIC CanIf_CanIfRxPduCfg_BYPASS_TDG1_14_RXCanDlc_C "Calibration parameter for the Data length of CAN frame CanIfRxPduCfg_BYPASS_TDG1_14_RX" VALUE 0x8061CD55 DefaultValueRecordLayout_AUTOSAR_PlatformTypes_SwBaseTypes_uint8 8.0 RB_RBA_Common_CentralElements_CompuMethods_Identical 0.0 8. FORMAT "%5.0" /end CHARACTERISTIC
/begin CHARACTERISTIC CanIf_CanIfRxPduCfg_BYPASS_TDG1_15_RXCanDlc_C "Calibration parameter for the Data length of CAN frame CanIfRxPduCfg_BYPASS_TDG1_15_RX" VALUE 0x8061CD54 DefaultValueRecordLayout_AUTOSAR_PlatformTypes_SwBaseTypes_uint8 8.0 RB_RBA_Common_CentralElements_CompuMethods_Identical 0.0 8. FORMAT "%5.0" /end CHARACTERISTIC
/begin CHARACTERISTIC CanIf_CanIfRxPduCfg_BYPASS_TDG1_16_PlaceHolder_RXCanDlc_C "Calibration parameter for the Data length of CAN frame CanIfRxPduCfg_BYPASS_TDG1_16_PlaceHolder_RX" VALUE 0x8061CD53 DefaultValueRecordLayout_AUTOSAR_PlatformTypes_SwBaseTypes_uint8 8.0 RB_RBA_Common_CentralElements_CompuMethods_Identical 0.0 8. FORMAT "%5.0" /end CHARACTERISTIC
/begin CHARACTERISTIC CanIf_CanIfRxPduCfg_BYPASS_TDG1_17_PlaceHolder_RXCanDlc_C "Calibration parameter for the Data length of CAN frame CanIfRxPduCfg_BYPASS_TDG1_17_PlaceHolder_RX" VALUE 0x8061CD52 DefaultValueRecordLayout_AUTOSAR_PlatformTypes_SwBaseTypes_uint8 8.0 RB_RBA_Common_CentralElements_CompuMethods_Identical 0.0 8. FORMAT "%5.0" /end CHARACTERISTIC
/begin CHARACTERISTIC CanIf_CanIfRxPduCfg_BYPASS_TDG1_18_PlaceHolder_RXCanDlc_C "Calibration parameter for the Data length of CAN frame CanIfRxPduCfg_BYPASS_TDG1_18_PlaceHolder_RX" VALUE 0x8061CD51 DefaultValueRecordLayout_AUTOSAR_PlatformTypes_SwBaseTypes_uint8 8.0 RB_RBA_Common_CentralElements_CompuMethods_Identical 0.0 8. FORMAT "%5.0" /end CHARACTERISTIC
/begin CHARACTERISTIC CanIf_CanIfRxPduCfg_BYPASS_TDG1_19_Placeholder_RXCanDlc_C "Calibration parameter for the Data length of CAN frame CanIfRxPduCfg_BYPASS_TDG1_19_Placeholder_RX" VALUE 0x8061CD50 DefaultValueRecordLayout_AUTOSAR_PlatformTypes_SwBaseTypes_uint8 8.0 RB_RBA_Common_CentralElements_CompuMethods_Identical 0.0 8. FORMAT "%5.0" /end CHARACTERISTIC
/begin CHARACTERISTIC CanIf_CanIfRxPduCfg_BYPASS_TDG1_20_Placeholder_RXCanDlc_C "Calibration parameter for the Data length of CAN frame CanIfRxPduCfg_BYPASS_TDG1_20_Placeholder_RX" VALUE 0x8061CD4F DefaultValueRecordLayout_AUTOSAR_PlatformTypes_SwBaseTypes_uint8 8.0 RB_RBA_Common_CentralElements_CompuMethods_Identical 0.0 8. FORMAT "%5.0" /end CHARACTERISTIC
/begin CHARACTERISTIC CanIf_CanIfRxPduCfg_BYPASS_TDG1_21_RXCanDlc_C "Calibration parameter for the Data length of CAN frame CanIfRxPduCfg_BYPASS_TDG1_21_RX" VALUE 0x8061CD4E DefaultValueRecordLayout_AUTOSAR_PlatformTypes_SwBaseTypes_uint8 7.0 RB_RBA_Common_CentralElements_CompuMethods_Identical 0.0 7. FORMAT "%5.0" /end CHARACTERISTIC
/begin CHARACTERISTIC CanIf_CanIfRxPduCfg_BYPASS_TDG1_22_RXCanDlc_C "Calibration parameter for the Data length of CAN frame CanIfRxPduCfg_BYPASS_TDG1_22_RX" VALUE 0x8061CD4D DefaultValueRecordLayout_AUTOSAR_PlatformTypes_SwBaseTypes_uint8 8.0 RB_RBA_Common_CentralElements_CompuMethods_Identical 0.0 8. FORMAT "%5.0" /end CHARACTERISTIC
/begin CHARACTERISTIC CanIf_CanIfRxPduCfg_Cool_Act_Sts_RXCanDlc_C "Calibration parameter for the Data length of CAN frame CanIfRxPduCfg_Cool_Act_Sts_RX" VALUE 0x8061CD4C DefaultValueRecordLayout_AUTOSAR_PlatformTypes_SwBaseTypes_uint8 8.0 RB_RBA_Common_CentralElements_CompuMethods_Identical 0.0 8. FORMAT "%5.0" /end CHARACTERISTIC
/begin CHARACTERISTIC CanIf_CanIfRxPduCfg_Motor_01_RXCanDlc_C "Calibration parameter for the Data length of CAN frame CanIfRxPduCfg_Motor_01_RX" VALUE 0x8061CD4B DefaultValueRecordLayout_AUTOSAR_PlatformTypes_SwBaseTypes_uint8 8.0 RB_RBA_Common_CentralElements_CompuMethods_Identical 0.0 8. FORMAT "%5.0" /end CHARACTERISTIC
/begin CHARACTERISTIC CanIf_CanIfRxPduCfg_Motor_02_RXCanDlc_C "Calibration parameter for the Data length of CAN frame CanIfRxPduCfg_Motor_02_RX" VALUE 0x8061CD4A DefaultValueRecordLayout_AUTOSAR_PlatformTypes_SwBaseTypes_uint8 8.0 RB_RBA_Common_CentralElements_CompuMethods_Identical 0.0 8. FORMAT "%5.0" /end CHARACTERISTIC
/begin CHARACTERISTIC CanIf_CanIfRxPduCfg_Motor_03_RXCanDlc_C "Calibration parameter for the Data length of CAN frame CanIfRxPduCfg_Motor_03_RX" VALUE 0x8061CD49 DefaultValueRecordLayout_AUTOSAR_PlatformTypes_SwBaseTypes_uint8 8.0 RB_RBA_Common_CentralElements_CompuMethods_Identical 0.0 8. FORMAT "%5.0" /end CHARACTERISTIC
/begin CHARACTERISTIC CanIf_CanIfTxPduCfg_BYPASS_TDG1_AA_TX_4CanDlc_C "Calibration parameter for the Data length of CAN frame CanIfTxPduCfg_BYPASS_TDG1_AA_TX_4" VALUE 0x8061CD48 DefaultValueRecordLayout_AUTOSAR_PlatformTypes_SwBaseTypes_uint8 8.0 RB_RBA_Common_CentralElements_CompuMethods_Identical 0.0 8. FORMAT "%5.0" /end CHARACTERISTIC
/begin CHARACTERISTIC CanIf_CanIfTxPduCfg_BYPASS_TDG1_AA_TX_4CanId_C "Calibration parameter for the CanId of CAN frame CanIfTxPduCfg_BYPASS_TDG1_AA_TX_4" VALUE 0x8061CE94 DefaultValueRecordLayout_AUTOSAR_PlatformTypes_SwBaseTypes_uint32 2047.0 RB_RBA_Common_CentralElements_CompuMethods_Identical 0.0 2047. FORMAT "%5.0" /end CHARACTERISTIC
/begin CHARACTERISTIC CanIf_CanIfTxPduCfg_BYPASS_TDG1_AB_TX_5CanDlc_C "Calibration parameter for the Data length of CAN frame CanIfTxPduCfg_BYPASS_TDG1_AB_TX_5" VALUE 0x8061CD47 DefaultValueRecordLayout_AUTOSAR_PlatformTypes_SwBaseTypes_uint8 8.0 RB_RBA_Common_CentralElements_CompuMethods_Identical 0.0 8. FORMAT "%5.0" /end CHARACTERISTIC
/begin CHARACTERISTIC CanIf_CanIfTxPduCfg_BYPASS_TDG1_AB_TX_5CanId_C "Calibration parameter for the CanId of CAN frame CanIfTxPduCfg_BYPASS_TDG1_AB_TX_5" VALUE 0x8061CE90 DefaultValueRecordLayout_AUTOSAR_PlatformTypes_SwBaseTypes_uint32 2047.0 RB_RBA_Common_CentralElements_CompuMethods_Identical 0.0 2047. FORMAT "%5.0" /end CHARACTERISTIC
/begin CHARACTERISTIC CanIf_CanIfTxPduCfg_BYPASS_TDG1_AC_TX_6CanDlc_C "Calibration parameter for the Data length of CAN frame CanIfTxPduCfg_BYPASS_TDG1_AC_TX_6" VALUE 0x8061CD46 DefaultValueRecordLayout_AUTOSAR_PlatformTypes_SwBaseTypes_uint8 8.0 RB_RBA_Common_CentralElements_CompuMethods_Identical 0.0 8. FORMAT "%5.0" /end CHARACTERISTIC
/begin CHARACTERISTIC CanIf_CanIfTxPduCfg_BYPASS_TDG1_AC_TX_6CanId_C "Calibration parameter for the CanId of CAN frame CanIfTxPduCfg_BYPASS_TDG1_AC_TX_6" VALUE 0x8061CE8C DefaultValueRecordLayout_AUTOSAR_PlatformTypes_SwBaseTypes_uint32 2047.0 RB_RBA_Common_CentralElements_CompuMethods_Identical 0.0 2047. FORMAT "%5.0" /end CHARACTERISTIC
/begin CHARACTERISTIC CanIf_CanIfTxPduCfg_BYPASS_TDG1_AD_TX_7CanDlc_C "Calibration parameter for the Data length of CAN frame CanIfTxPduCfg_BYPASS_TDG1_AD_TX_7" VALUE 0x8061CD45 DefaultValueRecordLayout_AUTOSAR_PlatformTypes_SwBaseTypes_uint8 8.0 RB_RBA_Common_CentralElements_CompuMethods_Identical 0.0 8. FORMAT "%5.0" /end CHARACTERISTIC
/begin CHARACTERISTIC CanIf_CanIfTxPduCfg_BYPASS_TDG1_AD_TX_7CanId_C "Calibration parameter for the CanId of CAN frame CanIfTxPduCfg_BYPASS_TDG1_AD_TX_7" VALUE 0x8061CE88 DefaultValueRecordLayout_AUTOSAR_PlatformTypes_SwBaseTypes_uint32 2047.0 RB_RBA_Common_CentralElements_CompuMethods_Identical 0.0 2047. FORMAT "%5.0" /end CHARACTERISTIC
/begin CHARACTERISTIC CanIf_CanIfTxPduCfg_BYPASS_TDG1_AE_TX_8CanDlc_C "Calibration parameter for the Data length of CAN frame CanIfTxPduCfg_BYPASS_TDG1_AE_TX_8" VALUE 0x8061CD44 DefaultValueRecordLayout_AUTOSAR_PlatformTypes_SwBaseTypes_uint8 8.0 RB_RBA_Common_CentralElements_CompuMethods_Identical 0.0 8. FORMAT "%5.0" /end CHARACTERISTIC
/begin CHARACTERISTIC CanIf_CanIfTxPduCfg_BYPASS_TDG1_AE_TX_8CanId_C "Calibration parameter for the CanId of CAN frame CanIfTxPduCfg_BYPASS_TDG1_AE_TX_8" VALUE 0x8061CE84 DefaultValueRecordLayout_AUTOSAR_PlatformTypes_SwBaseTypes_uint32 2047.0 RB_RBA_Common_CentralElements_CompuMethods_Identical 0.0 2047. FORMAT "%5.0" /end CHARACTERISTIC
/begin CHARACTERISTIC CanIf_CanIfTxPduCfg_BYPASS_TDG1_AF_TX_10CanDlc_C "Calibration parameter for the Data length of CAN frame CanIfTxPduCfg_BYPASS_TDG1_AF_TX_10" VALUE 0x8061CD43 DefaultValueRecordLayout_AUTOSAR_PlatformTypes_SwBaseTypes_uint8 8.0 RB_RBA_Common_CentralElements_CompuMethods_Identical 0.0 8. FORMAT "%5.0" /end CHARACTERISTIC
/begin CHARACTERISTIC CanIf_CanIfTxPduCfg_BYPASS_TDG1_AF_TX_10CanId_C "Calibration parameter for the CanId of CAN frame CanIfTxPduCfg_BYPASS_TDG1_AF_TX_10" VALUE 0x8061CE80 DefaultValueRecordLayout_AUTOSAR_PlatformTypes_SwBaseTypes_uint32 2047.0 RB_RBA_Common_CentralElements_CompuMethods_Identical 0.0 2047. FORMAT "%5.0" /end CHARACTERISTIC
/begin CHARACTERISTIC CanIf_CanIfTxPduCfg_BYPASS_TDG1_BA_TX_9CanDlc_C "Calibration parameter for the Data length of CAN frame CanIfTxPduCfg_BYPASS_TDG1_BA_TX_9" VALUE 0x8061CD42 DefaultValueRecordLayout_AUTOSAR_PlatformTypes_SwBaseTypes_uint8 8.0 RB_RBA_Common_CentralElements_CompuMethods_Identical 0.0 8. FORMAT "%5.0" /end CHARACTERISTIC
/begin CHARACTERISTIC CanIf_CanIfTxPduCfg_BYPASS_TDG1_BA_TX_9CanId_C "Calibration parameter for the CanId of CAN frame CanIfTxPduCfg_BYPASS_TDG1_BA_TX_9" VALUE 0x8061CE7C DefaultValueRecordLayout_AUTOSAR_PlatformTypes_SwBaseTypes_uint32 2047.0 RB_RBA_Common_CentralElements_CompuMethods_Identical 0.0 2047. FORMAT "%5.0" /end CHARACTERISTIC
/begin CHARACTERISTIC CanIf_CanIfTxPduCfg_BYPASS_TDG1_BB_TX_11CanDlc_C "Calibration parameter for the Data length of CAN frame CanIfTxPduCfg_BYPASS_TDG1_BB_TX_11" VALUE 0x8061CD41 DefaultValueRecordLayout_AUTOSAR_PlatformTypes_SwBaseTypes_uint8 8.0 RB_RBA_Common_CentralElements_CompuMethods_Identical 0.0 8. FORMAT "%5.0" /end CHARACTERISTIC
/begin CHARACTERISTIC CanIf_CanIfTxPduCfg_BYPASS_TDG1_BB_TX_11CanId_C "Calibration parameter for the CanId of CAN frame CanIfTxPduCfg_BYPASS_TDG1_BB_TX_11" VALUE 0x8061CE78 DefaultValueRecordLayout_AUTOSAR_PlatformTypes_SwBaseTypes_uint32 2047.0 RB_RBA_Common_CentralElements_CompuMethods_Identical 0.0 2047. FORMAT "%5.0" /end CHARACTERISTIC
/begin CHARACTERISTIC CanIf_CanIfTxPduCfg_BYPASS_TDG1_BC_TX_12CanDlc_C "Calibration parameter for the Data length of CAN frame CanIfTxPduCfg_BYPASS_TDG1_BC_TX_12" VALUE 0x8061CD40 DefaultValueRecordLayout_AUTOSAR_PlatformTypes_SwBaseTypes_uint8 8.0 RB_RBA_Common_CentralElements_CompuMethods_Identical 0.0 8. FORMAT "%5.0" /end CHARACTERISTIC
/begin CHARACTERISTIC CanIf_CanIfTxPduCfg_BYPASS_TDG1_BC_TX_12CanId_C "Calibration parameter for the CanId of CAN frame CanIfTxPduCfg_BYPASS_TDG1_BC_TX_12" VALUE 0x8061CE74 DefaultValueRecordLayout_AUTOSAR_PlatformTypes_SwBaseTypes_uint32 2047.0 RB_RBA_Common_CentralElements_CompuMethods_Identical 0.0 2047. FORMAT "%5.0" /end CHARACTERISTIC
/begin CHARACTERISTIC CanIf_CanIfTxPduCfg_BYPASS_TDG1_BD_TX_13CanDlc_C "Calibration parameter for the Data length of CAN frame CanIfTxPduCfg_BYPASS_TDG1_BD_TX_13" VALUE 0x8061CD3F DefaultValueRecordLayout_AUTOSAR_PlatformTypes_SwBaseTypes_uint8 8.0 RB_RBA_Common_CentralElements_CompuMethods_Identical 0.0 8. FORMAT "%5.0" /end CHARACTERISTIC
/begin CHARACTERISTIC CanIf_CanIfTxPduCfg_BYPASS_TDG1_BD_TX_13CanId_C "Calibration parameter for the CanId of CAN frame CanIfTxPduCfg_BYPASS_TDG1_BD_TX_13" VALUE 0x8061CE70 DefaultValueRecordLayout_AUTOSAR_PlatformTypes_SwBaseTypes_uint32 2047.0 RB_RBA_Common_CentralElements_CompuMethods_Identical 0.0 2047. FORMAT "%5.0" /end CHARACTERISTIC
/begin CHARACTERISTIC CanIf_CanIfTxPduCfg_BYPASS_TDG1_BE_PlaceHolder_TX_2CanDlc_C "Calibration parameter for the Data length of CAN frame CanIfTxPduCfg_BYPASS_TDG1_BE_PlaceHolder_TX_2" VALUE 0x8061CD3E DefaultValueRecordLayout_AUTOSAR_PlatformTypes_SwBaseTypes_uint8 8.0 RB_RBA_Common_CentralElements_CompuMethods_Identical 0.0 8. FORMAT "%5.0" /end CHARACTERISTIC
/begin CHARACTERISTIC CanIf_CanIfTxPduCfg_BYPASS_TDG1_BE_PlaceHolder_TX_2CanId_C "Calibration parameter for the CanId of CAN frame CanIfTxPduCfg_BYPASS_TDG1_BE_PlaceHolder_TX_2" VALUE 0x8061CE6C DefaultValueRecordLayout_AUTOSAR_PlatformTypes_SwBaseTypes_uint32 2047.0 RB_RBA_Common_CentralElements_CompuMethods_Identical 0.0 2047. FORMAT "%5.0" /end CHARACTERISTIC
/begin CHARACTERISTIC CanIf_CanIfTxPduCfg_BYPASS_TDG1_BF_PlaceHolder_TX_3CanDlc_C "Calibration parameter for the Data length of CAN frame CanIfTxPduCfg_BYPASS_TDG1_BF_PlaceHolder_TX_3" VALUE 0x8061CD3D DefaultValueRecordLayout_AUTOSAR_PlatformTypes_SwBaseTypes_uint8 8.0 RB_RBA_Common_CentralElements_CompuMethods_Identical 0.0 8. FORMAT "%5.0" /end CHARACTERISTIC
/begin CHARACTERISTIC CanIf_CanIfTxPduCfg_BYPASS_TDG1_BF_PlaceHolder_TX_3CanId_C "Calibration parameter for the CanId of CAN frame CanIfTxPduCfg_BYPASS_TDG1_BF_PlaceHolder_TX_3" VALUE 0x8061CE68 DefaultValueRecordLayout_AUTOSAR_PlatformTypes_SwBaseTypes_uint32 2047.0 RB_RBA_Common_CentralElements_CompuMethods_Identical 0.0 2047. FORMAT "%5.0" /end CHARACTERISTIC
/begin CHARACTERISTIC CanIf_CanIfTxPduCfg_BYPASS_TDG1_CA_PlaceHolder_TX_14CanDlc_C "Calibration parameter for the Data length of CAN frame CanIfTxPduCfg_BYPASS_TDG1_CA_PlaceHolder_TX_14" VALUE 0x8061CD3C DefaultValueRecordLayout_AUTOSAR_PlatformTypes_SwBaseTypes_uint8 8.0 RB_RBA_Common_CentralElements_CompuMethods_Identical 0.0 8. FORMAT "%5.0" /end CHARACTERISTIC
/begin CHARACTERISTIC CanIf_CanIfTxPduCfg_BYPASS_TDG1_CA_PlaceHolder_TX_14CanId_C "Calibration parameter for the CanId of CAN frame CanIfTxPduCfg_BYPASS_TDG1_CA_PlaceHolder_TX_14" VALUE 0x8061CE64 DefaultValueRecordLayout_AUTOSAR_PlatformTypes_SwBaseTypes_uint32 2047.0 RB_RBA_Common_CentralElements_CompuMethods_Identical 0.0 2047. FORMAT "%5.0" /end CHARACTERISTIC
/begin CHARACTERISTIC CanIf_CanIfTxPduCfg_BYPASS_TDG1_CB_PlaceHolder_TX_15CanDlc_C "Calibration parameter for the Data length of CAN frame CanIfTxPduCfg_BYPASS_TDG1_CB_PlaceHolder_TX_15" VALUE 0x8061CD3B DefaultValueRecordLayout_AUTOSAR_PlatformTypes_SwBaseTypes_uint8 8.0 RB_RBA_Common_CentralElements_CompuMethods_Identical 0.0 8. FORMAT "%5.0" /end CHARACTERISTIC
/begin CHARACTERISTIC CanIf_CanIfTxPduCfg_BYPASS_TDG1_CB_PlaceHolder_TX_15CanId_C "Calibration parameter for the CanId of CAN frame CanIfTxPduCfg_BYPASS_TDG1_CB_PlaceHolder_TX_15" VALUE 0x8061CE60 DefaultValueRecordLayout_AUTOSAR_PlatformTypes_SwBaseTypes_uint32 2047.0 RB_RBA_Common_CentralElements_CompuMethods_Identical 0.0 2047. FORMAT "%5.0" /end CHARACTERISTIC
/begin CHARACTERISTIC CanIf_CanIfTxPduCfg_BYPASS_TDG1_CC_PlaceHolder_TX_16CanDlc_C "Calibration parameter for the Data length of CAN frame CanIfTxPduCfg_BYPASS_TDG1_CC_PlaceHolder_TX_16" VALUE 0x8061CD3A DefaultValueRecordLayout_AUTOSAR_PlatformTypes_SwBaseTypes_uint8 8.0 RB_RBA_Common_CentralElements_CompuMethods_Identical 0.0 8. FORMAT "%5.0" /end CHARACTERISTIC
/begin CHARACTERISTIC CanIf_CanIfTxPduCfg_BYPASS_TDG1_CC_PlaceHolder_TX_16CanId_C "Calibration parameter for the CanId of CAN frame CanIfTxPduCfg_BYPASS_TDG1_CC_PlaceHolder_TX_16" VALUE 0x8061CE5C DefaultValueRecordLayout_AUTOSAR_PlatformTypes_SwBaseTypes_uint32 2047.0 RB_RBA_Common_CentralElements_CompuMethods_Identical 0.0 2047. FORMAT "%5.0" /end CHARACTERISTIC
/begin CHARACTERISTIC CanIf_CanIfTxPduCfg_Cool_Act_Cmd_TX_1CanDlc_C "Calibration parameter for the Data length of CAN frame CanIfTxPduCfg_Cool_Act_Cmd_TX_1" VALUE 0x8061CD39 DefaultValueRecordLayout_AUTOSAR_PlatformTypes_SwBaseTypes_uint8 8.0 RB_RBA_Common_CentralElements_CompuMethods_Identical 0.0 8. FORMAT "%5.0" /end CHARACTERISTIC
/begin CHARACTERISTIC CanIf_CanIfTxPduCfg_Cool_Act_Cmd_TX_1CanId_C "Calibration parameter for the CanId of CAN frame CanIfTxPduCfg_Cool_Act_Cmd_TX_1" VALUE 0x8061CE58 DefaultValueRecordLayout_AUTOSAR_PlatformTypes_SwBaseTypes_uint32 2047.0 RB_RBA_Common_CentralElements_CompuMethods_Identical 0.0 2047. FORMAT "%5.0" /end CHARACTERISTIC
/begin CHARACTERISTIC CanIf_CanIfTxPduCfg_Getriebe_01_TX_0CanDlc_C "Calibration parameter for the Data length of CAN frame CanIfTxPduCfg_Getriebe_01_TX_0" VALUE 0x8061CD38 DefaultValueRecordLayout_AUTOSAR_PlatformTypes_SwBaseTypes_uint8 8.0 RB_RBA_Common_CentralElements_CompuMethods_Identical 0.0 8. FORMAT "%5.0" /end CHARACTERISTIC
/begin CHARACTERISTIC CanIf_CanIfTxPduCfg_Getriebe_01_TX_0CanId_C "Calibration parameter for the CanId of CAN frame CanIfTxPduCfg_Getriebe_01_TX_0" VALUE 0x8061CE54 DefaultValueRecordLayout_AUTOSAR_PlatformTypes_SwBaseTypes_uint32 2047.0 RB_RBA_Common_CentralElements_CompuMethods_Identical 0.0 2047. FORMAT "%5.0" /end CHARACTERISTIC
/begin CHARACTERISTIC CanIf_Uds2OnCan_Rx_FuncCanDlc_C "Calibration parameter for the Data length of CAN frame Uds2OnCan_Rx_Func" VALUE 0x8061CD37 DefaultValueRecordLayout_AUTOSAR_PlatformTypes_SwBaseTypes_uint8 1.0 RB_RBA_Common_CentralElements_CompuMethods_Identical 0.0 1. FORMAT "%5.0" /end CHARACTERISTIC
/begin CHARACTERISTIC CanIf_Uds2OnCan_TxCanId_C "Calibration parameter for the CanId of CAN frame Uds2OnCan_Tx" VALUE 0x8061CE50 DefaultValueRecordLayout_AUTOSAR_PlatformTypes_SwBaseTypes_uint32 2047.0 RB_RBA_Common_CentralElements_CompuMethods_Identical 0.0 2047. FORMAT "%5.0" /end CHARACTERISTIC
/begin CHARACTERISTIC CanIf_Uds2OnCan_TxCanNod_C "Calibration parameter for Can Node of the message Uds2OnCan_Tx" VALUE 0x8061CD36 DefaultValueRecordLayout_AUTOSAR_PlatformTypes_SwBaseTypes_uint8 4.0 AUTOSAR_CanIf_CompuMethods_CanIf_CompuMethod_CtrlId 0.0 4. FORMAT "%5.0" /end CHARACTERISTIC
/begin CHARACTERISTIC CanIf_XcpTx2_RESCanId_C "Calibration parameter for the CanId of CAN frame XcpTx2_RES" VALUE 0x8061CE4C DefaultValueRecordLayout_AUTOSAR_PlatformTypes_SwBaseTypes_uint32 2047.0 RB_RBA_Common_CentralElements_CompuMethods_Identical 0.0 2047. FORMAT "%5.0" /end CHARACTERISTIC
/begin CHARACTERISTIC CanIf_XcpTx2_RESCanNod_C "Calibration parameter for Can Node of the message XcpTx2_RES" VALUE 0x8061CD35 DefaultValueRecordLayout_AUTOSAR_PlatformTypes_SwBaseTypes_uint8 4.0 AUTOSAR_CanIf_CompuMethods_CanIf_CompuMethod_CtrlId 0.0 4. FORMAT "%5.0" /end CHARACTERISTIC
/begin CHARACTERISTIC CanIf_XcpTx2_RES_1CanId_C "Calibration parameter for the CanId of CAN frame XcpTx2_RES_1" VALUE 0x8061CE48 DefaultValueRecordLayout_AUTOSAR_PlatformTypes_SwBaseTypes_uint32 5.36870911E8 RB_RBA_Common_CentralElements_CompuMethods_Identical 0.0 5.36870911E8 FORMAT "%5.0" /end CHARACTERISTIC
/begin CHARACTERISTIC CanIf_XcpTx2_RES_1CanNod_C "Calibration parameter for Can Node of the message XcpTx2_RES_1" VALUE 0x8061CD34 DefaultValueRecordLayout_AUTOSAR_PlatformTypes_SwBaseTypes_uint8 4.0 AUTOSAR_CanIf_CompuMethods_CanIf_CompuMethod_CtrlId 0.0 4. FORMAT "%5.0" /end CHARACTERISTIC
/begin CHARACTERISTIC CanIf_XcpTx_DAQ_100_msCanId_C "Calibration parameter for the CanId of CAN frame XcpTx_DAQ_100_ms" VALUE 0x8061CE44 DefaultValueRecordLayout_AUTOSAR_PlatformTypes_SwBaseTypes_uint32 2047.0 RB_RBA_Common_CentralElements_CompuMethods_Identical 0.0 2047. FORMAT "%5.0" /end CHARACTERISTIC
/begin CHARACTERISTIC CanIf_XcpTx_DAQ_100_msCanNod_C "Calibration parameter for Can Node of the message XcpTx_DAQ_100_ms" VALUE 0x8061CD33 DefaultValueRecordLayout_AUTOSAR_PlatformTypes_SwBaseTypes_uint8 4.0 AUTOSAR_CanIf_CompuMethods_CanIf_CompuMethod_CtrlId 0.0 4. FORMAT "%5.0" /end CHARACTERISTIC
/begin CHARACTERISTIC CanIf_XcpTx_DAQ_10_msCanId_C "Calibration parameter for the CanId of CAN frame XcpTx_DAQ_10_ms" VALUE 0x8061CE40 DefaultValueRecordLayout_AUTOSAR_PlatformTypes_SwBaseTypes_uint32 2047.0 RB_RBA_Common_CentralElements_CompuMethods_Identical 0.0 2047. FORMAT "%5.0" /end CHARACTERISTIC
/begin CHARACTERISTIC CanIf_XcpTx_DAQ_10_msCanNod_C "Calibration parameter for Can Node of the message XcpTx_DAQ_10_ms" VALUE 0x8061CD32 DefaultValueRecordLayout_AUTOSAR_PlatformTypes_SwBaseTypes_uint8 4.0 AUTOSAR_CanIf_CompuMethods_CanIf_CompuMethod_CtrlId 0.0 4. FORMAT "%5.0" /end CHARACTERISTIC
/begin CHARACTERISTIC CanIf_XcpTx_DAQ_1_msCanId_C "Calibration parameter for the CanId of CAN frame XcpTx_DAQ_1_ms" VALUE 0x8061CE3C DefaultValueRecordLayout_AUTOSAR_PlatformTypes_SwBaseTypes_uint32 2047.0 RB_RBA_Common_CentralElements_CompuMethods_Identical 0.0 2047. FORMAT "%5.0" /end CHARACTERISTIC
/begin CHARACTERISTIC CanIf_XcpTx_DAQ_1_msCanNod_C "Calibration parameter for Can Node of the message XcpTx_DAQ_1_ms" VALUE 0x8061CD31 DefaultValueRecordLayout_AUTOSAR_PlatformTypes_SwBaseTypes_uint8 4.0 AUTOSAR_CanIf_CompuMethods_CanIf_CompuMethod_CtrlId 0.0 4. FORMAT "%5.0" /end CHARACTERISTIC
/begin CHARACTERISTIC CanIf_XcpTx_DAQ_2p5_msCanId_C "Calibration parameter for the CanId of CAN frame XcpTx_DAQ_2p5_ms" VALUE 0x8061CE38 DefaultValueRecordLayout_AUTOSAR_PlatformTypes_SwBaseTypes_uint32 2047.0 RB_RBA_Common_CentralElements_CompuMethods_Identical 0.0 2047. FORMAT "%5.0" /end CHARACTERISTIC
/begin CHARACTERISTIC CanIf_XcpTx_DAQ_2p5_msCanNod_C "Calibration parameter for Can Node of the message XcpTx_DAQ_2p5_ms" VALUE 0x8061CD30 DefaultValueRecordLayout_AUTOSAR_PlatformTypes_SwBaseTypes_uint8 4.0 AUTOSAR_CanIf_CompuMethods_CanIf_CompuMethod_CtrlId 0.0 4. FORMAT "%5.0" /end CHARACTERISTIC
/begin CHARACTERISTIC CanIf_XcpTx_DAQ_5_msCanId_C "Calibration parameter for the CanId of CAN frame XcpTx_DAQ_5_ms" VALUE 0x8061CE34 DefaultValueRecordLayout_AUTOSAR_PlatformTypes_SwBaseTypes_uint32 2047.0 RB_RBA_Common_CentralElements_CompuMethods_Identical 0.0 2047. FORMAT "%5.0" /end CHARACTERISTIC
/begin CHARACTERISTIC CanIf_XcpTx_DAQ_5_msCanNod_C "Calibration parameter for Can Node of the message XcpTx_DAQ_5_ms" VALUE 0x8061CD2F DefaultValueRecordLayout_AUTOSAR_PlatformTypes_SwBaseTypes_uint8 4.0 AUTOSAR_CanIf_CompuMethods_CanIf_CompuMethod_CtrlId 0.0 4. FORMAT "%5.0" /end CHARACTERISTIC
/begin CHARACTERISTIC CanIf_XcpTx_RESCanId_C "Calibration parameter for the CanId of CAN frame XcpTx_RES" VALUE 0x8061CE30 DefaultValueRecordLayout_AUTOSAR_PlatformTypes_SwBaseTypes_uint32 2047.0 RB_RBA_Common_CentralElements_CompuMethods_Identical 0.0 2047. FORMAT "%5.0" /end CHARACTERISTIC
/begin CHARACTERISTIC CanIf_XcpTx_RESCanNod_C "Calibration parameter for Can Node of the message XcpTx_RES" VALUE 0x8061CD2E DefaultValueRecordLayout_AUTOSAR_PlatformTypes_SwBaseTypes_uint8 4.0 AUTOSAR_CanIf_CompuMethods_CanIf_CompuMethod_CtrlId 0.0 4. FORMAT "%5.0" /end CHARACTERISTIC
/begin CHARACTERISTIC Can_BusOffRecoveryTime_CanSMManagerNetwork_0L1Time_C "Calibration parameter for Busoff recovery timer L1 of CanSMManagerNetwork_0" VALUE 0x8061CF5E DefaultValueRecordLayout_AUTOSAR_Platform_BaseTypes_uint16 65535.0 RB_RBA_Common_CentralElements_CompuMethods_Identical 0.0 65535. FORMAT "%5.0" /end CHARACTERISTIC
/begin CHARACTERISTIC Can_BusOffRecoveryTime_CanSMManagerNetwork_0L2Time_C "Calibration parameter for Busoff recovery timer L2 of CanSMManagerNetwork_0" VALUE 0x8061CF5C DefaultValueRecordLayout_AUTOSAR_Platform_BaseTypes_uint16 65535.0 RB_RBA_Common_CentralElements_CompuMethods_Identical 0.0 65535. FORMAT "%5.0" /end CHARACTERISTIC
/begin CHARACTERISTIC Can_BusOffRecoveryTime_CanSMManagerNetwork_1L1Time_C "Calibration parameter for Busoff recovery timer L1 of CanSMManagerNetwork_1" VALUE 0x8061CF5A DefaultValueRecordLayout_AUTOSAR_Platform_BaseTypes_uint16 65535.0 RB_RBA_Common_CentralElements_CompuMethods_Identical 0.0 65535. FORMAT "%5.0" /end CHARACTERISTIC
/begin CHARACTERISTIC Can_BusOffRecoveryTime_CanSMManagerNetwork_1L2Time_C "Calibration parameter for Busoff recovery timer L2 of CanSMManagerNetwork_1" VALUE 0x8061CF58 DefaultValueRecordLayout_AUTOSAR_Platform_BaseTypes_uint16 65535.0 RB_RBA_Common_CentralElements_CompuMethods_Identical 0.0 65535. FORMAT "%5.0" /end CHARACTERISTIC
/begin CHARACTERISTIC Can_BusOffRecoveryTime_CanSMManagerNetwork_2L1Time_C "Calibration parameter for Busoff recovery timer L1 of CanSMManagerNetwork_2" VALUE 0x8061CF56 DefaultValueRecordLayout_AUTOSAR_Platform_BaseTypes_uint16 65535.0 RB_RBA_Common_CentralElements_CompuMethods_Identical 0.0 65535. FORMAT "%5.0" /end CHARACTERISTIC
/begin CHARACTERISTIC Can_BusOffRecoveryTime_CanSMManagerNetwork_2L2Time_C "Calibration parameter for Busoff recovery timer L2 of CanSMManagerNetwork_2" VALUE 0x8061CF54 DefaultValueRecordLayout_AUTOSAR_Platform_BaseTypes_uint16 65535.0 RB_RBA_Common_CentralElements_CompuMethods_Identical 0.0 65535. FORMAT "%5.0" /end CHARACTERISTIC
/begin CHARACTERISTIC Can_BusOffRecoveryTime_CanSMManagerNetwork_3L1Time_C "Calibration parameter for Busoff recovery timer L1 of CanSMManagerNetwork_3" VALUE 0x8061CF52 DefaultValueRecordLayout_AUTOSAR_Platform_BaseTypes_uint16 65535.0 RB_RBA_Common_CentralElements_CompuMethods_Identical 0.0 65535. FORMAT "%5.0" /end CHARACTERISTIC
/begin CHARACTERISTIC Can_BusOffRecoveryTime_CanSMManagerNetwork_3L2Time_C "Calibration parameter for Busoff recovery timer L2 of CanSMManagerNetwork_3" VALUE 0x8061CF50 DefaultValueRecordLayout_AUTOSAR_Platform_BaseTypes_uint16 65535.0 RB_RBA_Common_CentralElements_CompuMethods_Identical 0.0 65535. FORMAT "%5.0" /end CHARACTERISTIC
/begin CHARACTERISTIC Com_stACC_06_RxPduCtrl_C "Calibration parameter to control Ipdu ACC_06_Rx" VALUE 0x8061CD2D DefaultValueRecordLayout_AUTOSAR_Platform_BaseTypes_boolean 1.0 AUTOSAR_Com_CompuMethods_Com_IPduStatus_enum_type 0.0 1. FORMAT "%5.0" /end CHARACTERISTIC
/begin CHARACTERISTIC Com_stACC_07_RxPduCtrl_C "Calibration parameter to control Ipdu ACC_07_Rx" VALUE 0x8061CD2C DefaultValueRecordLayout_AUTOSAR_Platform_BaseTypes_boolean 1.0 AUTOSAR_Com_CompuMethods_Com_IPduStatus_enum_type 0.0 1. FORMAT "%5.0" /end CHARACTERISTIC
/begin CHARACTERISTIC Com_stAirbag_01_RxPduCtrl_C "Calibration parameter to control Ipdu Airbag_01_Rx" VALUE 0x8061CD2B DefaultValueRecordLayout_AUTOSAR_Platform_BaseTypes_boolean 1.0 AUTOSAR_Com_CompuMethods_Com_IPduStatus_enum_type 0.0 1. FORMAT "%5.0" /end CHARACTERISTIC
/begin CHARACTERISTIC Com_stAirbag_02_RxPduCtrl_C "Calibration parameter to control Ipdu Airbag_02_Rx" VALUE 0x8061CD2A DefaultValueRecordLayout_AUTOSAR_Platform_BaseTypes_boolean 1.0 AUTOSAR_Com_CompuMethods_Com_IPduStatus_enum_type 0.0 1. FORMAT "%5.0" /end CHARACTERISTIC
/begin CHARACTERISTIC Com_stBCM_01_RxPduCtrl_C "Calibration parameter to control Ipdu BCM_01_Rx" VALUE 0x8061CD29 DefaultValueRecordLayout_AUTOSAR_Platform_BaseTypes_boolean 1.0 AUTOSAR_Com_CompuMethods_Com_IPduStatus_enum_type 0.0 1. FORMAT "%5.0" /end CHARACTERISTIC
/begin CHARACTERISTIC Com_stBYPASS_TDG1_11_RxPduCtrl_C "Calibration parameter to control Ipdu BYPASS_TDG1_11_Rx" VALUE 0x8061CD28 DefaultValueRecordLayout_AUTOSAR_Platform_BaseTypes_boolean 1.0 AUTOSAR_Com_CompuMethods_Com_IPduStatus_enum_type 0.0 1. FORMAT "%5.0" /end CHARACTERISTIC
/begin CHARACTERISTIC Com_stBYPASS_TDG1_12_RxPduCtrl_C "Calibration parameter to control Ipdu BYPASS_TDG1_12_Rx" VALUE 0x8061CD27 DefaultValueRecordLayout_AUTOSAR_Platform_BaseTypes_boolean 1.0 AUTOSAR_Com_CompuMethods_Com_IPduStatus_enum_type 0.0 1. FORMAT "%5.0" /end CHARACTERISTIC
/begin CHARACTERISTIC Com_stBYPASS_TDG1_13_RxPduCtrl_C "Calibration parameter to control Ipdu BYPASS_TDG1_13_Rx" VALUE 0x8061CD26 DefaultValueRecordLayout_AUTOSAR_Platform_BaseTypes_boolean 1.0 AUTOSAR_Com_CompuMethods_Com_IPduStatus_enum_type 0.0 1. FORMAT "%5.0" /end CHARACTERISTIC
/begin CHARACTERISTIC Com_stBYPASS_TDG1_14_RxPduCtrl_C "Calibration parameter to control Ipdu BYPASS_TDG1_14_Rx" VALUE 0x8061CD25 DefaultValueRecordLayout_AUTOSAR_Platform_BaseTypes_boolean 1.0 AUTOSAR_Com_CompuMethods_Com_IPduStatus_enum_type 0.0 1. FORMAT "%5.0" /end CHARACTERISTIC
/begin CHARACTERISTIC Com_stBYPASS_TDG1_15_RxPduCtrl_C "Calibration parameter to control Ipdu BYPASS_TDG1_15_Rx" VALUE 0x8061CD24 DefaultValueRecordLayout_AUTOSAR_Platform_BaseTypes_boolean 1.0 AUTOSAR_Com_CompuMethods_Com_IPduStatus_enum_type 0.0 1. FORMAT "%5.0" /end CHARACTERISTIC
/begin CHARACTERISTIC Com_stBYPASS_TDG1_16_PlaceHolder_RxPduCtrl_C "Calibration parameter to control Ipdu BYPASS_TDG1_16_PlaceHolder_Rx" VALUE 0x8061CD23 DefaultValueRecordLayout_AUTOSAR_Platform_BaseTypes_boolean 1.0 AUTOSAR_Com_CompuMethods_Com_IPduStatus_enum_type 0.0 1. FORMAT "%5.0" /end CHARACTERISTIC
/begin CHARACTERISTIC Com_stBYPASS_TDG1_17_PlaceHolder_RxPduCtrl_C "Calibration parameter to control Ipdu BYPASS_TDG1_17_PlaceHolder_Rx" VALUE 0x8061CD22 DefaultValueRecordLayout_AUTOSAR_Platform_BaseTypes_boolean 1.0 AUTOSAR_Com_CompuMethods_Com_IPduStatus_enum_type 0.0 1. FORMAT "%5.0" /end CHARACTERISTIC
/begin CHARACTERISTIC Com_stBYPASS_TDG1_18_PlaceHolder_RxPduCtrl_C "Calibration parameter to control Ipdu BYPASS_TDG1_18_PlaceHolder_Rx" VALUE 0x8061CD21 DefaultValueRecordLayout_AUTOSAR_Platform_BaseTypes_boolean 1.0 AUTOSAR_Com_CompuMethods_Com_IPduStatus_enum_type 0.0 1. FORMAT "%5.0" /end CHARACTERISTIC
/begin CHARACTERISTIC Com_stBYPASS_TDG1_19_Placeholder_RxPduCtrl_C "Calibration parameter to control Ipdu BYPASS_TDG1_19_Placeholder_Rx" VALUE 0x8061CD20 DefaultValueRecordLayout_AUTOSAR_Platform_BaseTypes_boolean 1.0 AUTOSAR_Com_CompuMethods_Com_IPduStatus_enum_type 0.0 1. FORMAT "%5.0" /end CHARACTERISTIC
/begin CHARACTERISTIC Com_stBYPASS_TDG1_20_Placeholder_RxPduCtrl_C "Calibration parameter to control Ipdu BYPASS_TDG1_20_Placeholder_Rx" VALUE 0x8061CD1F DefaultValueRecordLayout_AUTOSAR_Platform_BaseTypes_boolean 1.0 AUTOSAR_Com_CompuMethods_Com_IPduStatus_enum_type 0.0 1. FORMAT "%5.0" /end CHARACTERISTIC
/begin CHARACTERISTIC Com_stBYPASS_TDG1_21_RxPduCtrl_C "Calibration parameter to control Ipdu BYPASS_TDG1_21_Rx" VALUE 0x8061CD1E DefaultValueRecordLayout_AUTOSAR_Platform_BaseTypes_boolean 1.0 AUTOSAR_Com_CompuMethods_Com_IPduStatus_enum_type 0.0 1. FORMAT "%5.0" /end CHARACTERISTIC
/begin CHARACTERISTIC Com_stBYPASS_TDG1_22_RxPduCtrl_C "Calibration parameter to control Ipdu BYPASS_TDG1_22_Rx" VALUE 0x8061CD1D DefaultValueRecordLayout_AUTOSAR_Platform_BaseTypes_boolean 1.0 AUTOSAR_Com_CompuMethods_Com_IPduStatus_enum_type 0.0 1. FORMAT "%5.0" /end CHARACTERISTIC
/begin CHARACTERISTIC Com_stBYPASS_TDG1_AA_TxPduCtrl_C "Calibration parameter to control Ipdu BYPASS_TDG1_AA_Tx" VALUE 0x8061CD1C DefaultValueRecordLayout_AUTOSAR_Platform_BaseTypes_boolean 1.0 AUTOSAR_Com_CompuMethods_Com_IPduStatus_enum_type 0.0 1. FORMAT "%5.0" /end CHARACTERISTIC
/begin CHARACTERISTIC Com_stBYPASS_TDG1_AB_TxPduCtrl_C "Calibration parameter to control Ipdu BYPASS_TDG1_AB_Tx" VALUE 0x8061CD1B DefaultValueRecordLayout_AUTOSAR_Platform_BaseTypes_boolean 1.0 AUTOSAR_Com_CompuMethods_Com_IPduStatus_enum_type 0.0 1. FORMAT "%5.0" /end CHARACTERISTIC
/begin CHARACTERISTIC Com_stBYPASS_TDG1_AC_TxPduCtrl_C "Calibration parameter to control Ipdu BYPASS_TDG1_AC_Tx" VALUE 0x8061CD1A DefaultValueRecordLayout_AUTOSAR_Platform_BaseTypes_boolean 1.0 AUTOSAR_Com_CompuMethods_Com_IPduStatus_enum_type 0.0 1. FORMAT "%5.0" /end CHARACTERISTIC
/begin CHARACTERISTIC Com_stBYPASS_TDG1_AD_TxPduCtrl_C "Calibration parameter to control Ipdu BYPASS_TDG1_AD_Tx" VALUE 0x8061CD19 DefaultValueRecordLayout_AUTOSAR_Platform_BaseTypes_boolean 1.0 AUTOSAR_Com_CompuMethods_Com_IPduStatus_enum_type 0.0 1. FORMAT "%5.0" /end CHARACTERISTIC
/begin CHARACTERISTIC Com_stBYPASS_TDG1_AE_TxPduCtrl_C "Calibration parameter to control Ipdu BYPASS_TDG1_AE_Tx" VALUE 0x8061CD18 DefaultValueRecordLayout_AUTOSAR_Platform_BaseTypes_boolean 1.0 AUTOSAR_Com_CompuMethods_Com_IPduStatus_enum_type 0.0 1. FORMAT "%5.0" /end CHARACTERISTIC
/begin CHARACTERISTIC Com_stBYPASS_TDG1_AF_TxPduCtrl_C "Calibration parameter to control Ipdu BYPASS_TDG1_AF_Tx" VALUE 0x8061CD17 DefaultValueRecordLayout_AUTOSAR_Platform_BaseTypes_boolean 1.0 AUTOSAR_Com_CompuMethods_Com_IPduStatus_enum_type 0.0 1. FORMAT "%5.0" /end CHARACTERISTIC
/begin CHARACTERISTIC Com_stBYPASS_TDG1_BA_TxPduCtrl_C "Calibration parameter to control Ipdu BYPASS_TDG1_BA_Tx" VALUE 0x8061CD16 DefaultValueRecordLayout_AUTOSAR_Platform_BaseTypes_boolean 1.0 AUTOSAR_Com_CompuMethods_Com_IPduStatus_enum_type 0.0 1. FORMAT "%5.0" /end CHARACTERISTIC
/begin CHARACTERISTIC Com_stBYPASS_TDG1_BB_TxPduCtrl_C "Calibration parameter to control Ipdu BYPASS_TDG1_BB_Tx" VALUE 0x8061CD15 DefaultValueRecordLayout_AUTOSAR_Platform_BaseTypes_boolean 1.0 AUTOSAR_Com_CompuMethods_Com_IPduStatus_enum_type 0.0 1. FORMAT "%5.0" /end CHARACTERISTIC
/begin CHARACTERISTIC Com_stBYPASS_TDG1_BC_TxPduCtrl_C "Calibration parameter to control Ipdu BYPASS_TDG1_BC_Tx" VALUE 0x8061CD14 DefaultValueRecordLayout_AUTOSAR_Platform_BaseTypes_boolean 1.0 AUTOSAR_Com_CompuMethods_Com_IPduStatus_enum_type 0.0 1. FORMAT "%5.0" /end CHARACTERISTIC
/begin CHARACTERISTIC Com_stBYPASS_TDG1_BD_TxPduCtrl_C "Calibration parameter to control Ipdu BYPASS_TDG1_BD_Tx" VALUE 0x8061CD13 DefaultValueRecordLayout_AUTOSAR_Platform_BaseTypes_boolean 1.0 AUTOSAR_Com_CompuMethods_Com_IPduStatus_enum_type 0.0 1. FORMAT "%5.0" /end CHARACTERISTIC
/begin CHARACTERISTIC Com_stBYPASS_TDG1_BE_PlaceHolder_TxPduCtrl_C "Calibration parameter to control Ipdu BYPASS_TDG1_BE_PlaceHolder_Tx" VALUE 0x8061CD12 DefaultValueRecordLayout_AUTOSAR_Platform_BaseTypes_boolean 1.0 AUTOSAR_Com_CompuMethods_Com_IPduStatus_enum_type 0.0 1. FORMAT "%5.0" /end CHARACTERISTIC
/begin CHARACTERISTIC Com_stBYPASS_TDG1_BF_PlaceHolder_TxPduCtrl_C "Calibration parameter to control Ipdu BYPASS_TDG1_BF_PlaceHolder_Tx" VALUE 0x8061CD11 DefaultValueRecordLayout_AUTOSAR_Platform_BaseTypes_boolean 1.0 AUTOSAR_Com_CompuMethods_Com_IPduStatus_enum_type 0.0 1. FORMAT "%5.0" /end CHARACTERISTIC
/begin CHARACTERISTIC Com_stBYPASS_TDG1_CA_PlaceHolder_TxPduCtrl_C "Calibration parameter to control Ipdu BYPASS_TDG1_CA_PlaceHolder_Tx" VALUE 0x8061CD10 DefaultValueRecordLayout_AUTOSAR_Platform_BaseTypes_boolean 1.0 AUTOSAR_Com_CompuMethods_Com_IPduStatus_enum_type 0.0 1. FORMAT "%5.0" /end CHARACTERISTIC
/begin CHARACTERISTIC Com_stBYPASS_TDG1_CB_PlaceHolder_TxPduCtrl_C "Calibration parameter to control Ipdu BYPASS_TDG1_CB_PlaceHolder_Tx" VALUE 0x8061CD0F DefaultValueRecordLayout_AUTOSAR_Platform_BaseTypes_boolean 1.0 AUTOSAR_Com_CompuMethods_Com_IPduStatus_enum_type 0.0 1. FORMAT "%5.0" /end CHARACTERISTIC
/begin CHARACTERISTIC Com_stBYPASS_TDG1_CC_PlaceHolder_TxPduCtrl_C "Calibration parameter to control Ipdu BYPASS_TDG1_CC_PlaceHolder_Tx" VALUE 0x8061CD0E DefaultValueRecordLayout_AUTOSAR_Platform_BaseTypes_boolean 1.0 AUTOSAR_Com_CompuMethods_Com_IPduStatus_enum_type 0.0 1. FORMAT "%5.0" /end CHARACTERISTIC
/begin CHARACTERISTIC Com_stBremse_EV_01_RxPduCtrl_C "Calibration parameter to control Ipdu Bremse_EV_01_Rx" VALUE 0x8061CD0D DefaultValueRecordLayout_AUTOSAR_Platform_BaseTypes_boolean 1.0 AUTOSAR_Com_CompuMethods_Com_IPduStatus_enum_type 0.0 1. FORMAT "%5.0" /end CHARACTERISTIC
/begin CHARACTERISTIC Com_stBremse_EV_02_RxPduCtrl_C "Calibration parameter to control Ipdu Bremse_EV_02_Rx" VALUE 0x8061CD0C DefaultValueRecordLayout_AUTOSAR_Platform_BaseTypes_boolean 1.0 AUTOSAR_Com_CompuMethods_Com_IPduStatus_enum_type 0.0 1. FORMAT "%5.0" /end CHARACTERISTIC
/begin CHARACTERISTIC Com_stCharisma_01_RxPduCtrl_C "Calibration parameter to control Ipdu Charisma_01_Rx" VALUE 0x8061CD0B DefaultValueRecordLayout_AUTOSAR_Platform_BaseTypes_boolean 1.0 AUTOSAR_Com_CompuMethods_Com_IPduStatus_enum_type 0.0 1. FORMAT "%5.0" /end CHARACTERISTIC
/begin CHARACTERISTIC Com_stCool_Act_Cmd_TxPduCtrl_C "Calibration parameter to control Ipdu Cool_Act_Cmd_Tx" VALUE 0x8061CD0A DefaultValueRecordLayout_AUTOSAR_Platform_BaseTypes_boolean 1.0 AUTOSAR_Com_CompuMethods_Com_IPduStatus_enum_type 0.0 1. FORMAT "%5.0" /end CHARACTERISTIC
/begin CHARACTERISTIC Com_stCool_Act_Sts_RxPduCtrl_C "Calibration parameter to control Ipdu Cool_Act_Sts_Rx" VALUE 0x8061CD09 DefaultValueRecordLayout_AUTOSAR_Platform_BaseTypes_boolean 1.0 AUTOSAR_Com_CompuMethods_Com_IPduStatus_enum_type 0.0 1. FORMAT "%5.0" /end CHARACTERISTIC
/begin CHARACTERISTIC Com_stDiagnose_01_RxPduCtrl_C "Calibration parameter to control Ipdu Diagnose_01_Rx" VALUE 0x8061CD08 DefaultValueRecordLayout_AUTOSAR_Platform_BaseTypes_boolean 1.0 AUTOSAR_Com_CompuMethods_Com_IPduStatus_enum_type 0.0 1. FORMAT "%5.0" /end CHARACTERISTIC
/begin CHARACTERISTIC Com_stEBKV_01_RxPduCtrl_C "Calibration parameter to control Ipdu EBKV_01_Rx" VALUE 0x8061CD07 DefaultValueRecordLayout_AUTOSAR_Platform_BaseTypes_boolean 1.0 AUTOSAR_Com_CompuMethods_Com_IPduStatus_enum_type 0.0 1. FORMAT "%5.0" /end CHARACTERISTIC
/begin CHARACTERISTIC Com_stEM1_HYB_06_RxPduCtrl_C "Calibration parameter to control Ipdu EM1_HYB_06_Rx" VALUE 0x8061CD06 DefaultValueRecordLayout_AUTOSAR_Platform_BaseTypes_boolean 1.0 AUTOSAR_Com_CompuMethods_Com_IPduStatus_enum_type 0.0 1. FORMAT "%5.0" /end CHARACTERISTIC
/begin CHARACTERISTIC Com_stEM1_HYB_12_RxPduCtrl_C "Calibration parameter to control Ipdu EM1_HYB_12_Rx" VALUE 0x8061CD05 DefaultValueRecordLayout_AUTOSAR_Platform_BaseTypes_boolean 1.0 AUTOSAR_Com_CompuMethods_Com_IPduStatus_enum_type 0.0 1. FORMAT "%5.0" /end CHARACTERISTIC
/begin CHARACTERISTIC Com_stEPB_01_RxPduCtrl_C "Calibration parameter to control Ipdu EPB_01_Rx" VALUE 0x8061CD04 DefaultValueRecordLayout_AUTOSAR_Platform_BaseTypes_boolean 1.0 AUTOSAR_Com_CompuMethods_Com_IPduStatus_enum_type 0.0 1. FORMAT "%5.0" /end CHARACTERISTIC
/begin CHARACTERISTIC Com_stESP_03_RxPduCtrl_C "Calibration parameter to control Ipdu ESP_03_Rx" VALUE 0x8061CD03 DefaultValueRecordLayout_AUTOSAR_Platform_BaseTypes_boolean 1.0 AUTOSAR_Com_CompuMethods_Com_IPduStatus_enum_type 0.0 1. FORMAT "%5.0" /end CHARACTERISTIC
/begin CHARACTERISTIC Com_stESP_05_RxPduCtrl_C "Calibration parameter to control Ipdu ESP_05_Rx" VALUE 0x8061CD02 DefaultValueRecordLayout_AUTOSAR_Platform_BaseTypes_boolean 1.0 AUTOSAR_Com_CompuMethods_Com_IPduStatus_enum_type 0.0 1. FORMAT "%5.0" /end CHARACTERISTIC
/begin CHARACTERISTIC Com_stESP_07_RxPduCtrl_C "Calibration parameter to control Ipdu ESP_07_Rx" VALUE 0x8061CD01 DefaultValueRecordLayout_AUTOSAR_Platform_BaseTypes_boolean 1.0 AUTOSAR_Com_CompuMethods_Com_IPduStatus_enum_type 0.0 1. FORMAT "%5.0" /end CHARACTERISTIC
/begin CHARACTERISTIC Com_stESP_08_RxPduCtrl_C "Calibration parameter to control Ipdu ESP_08_Rx" VALUE 0x8061CD00 DefaultValueRecordLayout_AUTOSAR_Platform_BaseTypes_boolean 1.0 AUTOSAR_Com_CompuMethods_Com_IPduStatus_enum_type 0.0 1. FORMAT "%5.0" /end CHARACTERISTIC
/begin CHARACTERISTIC Com_stESP_15_RxPduCtrl_C "Calibration parameter to control Ipdu ESP_15_Rx" VALUE 0x8061CCFF DefaultValueRecordLayout_AUTOSAR_Platform_BaseTypes_boolean 1.0 AUTOSAR_Com_CompuMethods_Com_IPduStatus_enum_type 0.0 1. FORMAT "%5.0" /end CHARACTERISTIC
/begin CHARACTERISTIC Com_stESP_20_RxPduCtrl_C "Calibration parameter to control Ipdu ESP_20_Rx" VALUE 0x8061CCFE DefaultValueRecordLayout_AUTOSAR_Platform_BaseTypes_boolean 1.0 AUTOSAR_Com_CompuMethods_Com_IPduStatus_enum_type 0.0 1. FORMAT "%5.0" /end CHARACTERISTIC
/begin CHARACTERISTIC Com_stESP_21_RxPduCtrl_C "Calibration parameter to control Ipdu ESP_21_Rx" VALUE 0x8061CCFD DefaultValueRecordLayout_AUTOSAR_Platform_BaseTypes_boolean 1.0 AUTOSAR_Com_CompuMethods_Com_IPduStatus_enum_type 0.0 1. FORMAT "%5.0" /end CHARACTERISTIC
/begin CHARACTERISTIC Com_stESP_22_RxPduCtrl_C "Calibration parameter to control Ipdu ESP_22_Rx" VALUE 0x8061CCFC DefaultValueRecordLayout_AUTOSAR_Platform_BaseTypes_boolean 1.0 AUTOSAR_Com_CompuMethods_Com_IPduStatus_enum_type 0.0 1. FORMAT "%5.0" /end CHARACTERISTIC
/begin CHARACTERISTIC Com_stESP_23_RxPduCtrl_C "Calibration parameter to control Ipdu ESP_23_Rx" VALUE 0x8061CCFB DefaultValueRecordLayout_AUTOSAR_Platform_BaseTypes_boolean 1.0 AUTOSAR_Com_CompuMethods_Com_IPduStatus_enum_type 0.0 1. FORMAT "%5.0" /end CHARACTERISTIC
/begin CHARACTERISTIC Com_stESP_24_RxPduCtrl_C "Calibration parameter to control Ipdu ESP_24_Rx" VALUE 0x8061CCFA DefaultValueRecordLayout_AUTOSAR_Platform_BaseTypes_boolean 1.0 AUTOSAR_Com_CompuMethods_Com_IPduStatus_enum_type 0.0 1. FORMAT "%5.0" /end CHARACTERISTIC
/begin CHARACTERISTIC Com_stESP_26_RxPduCtrl_C "Calibration parameter to control Ipdu ESP_26_Rx" VALUE 0x8061CCF9 DefaultValueRecordLayout_AUTOSAR_Platform_BaseTypes_boolean 1.0 AUTOSAR_Com_CompuMethods_Com_IPduStatus_enum_type 0.0 1. FORMAT "%5.0" /end CHARACTERISTIC
/begin CHARACTERISTIC Com_stESP_28_RxPduCtrl_C "Calibration parameter to control Ipdu ESP_28_Rx" VALUE 0x8061CCF8 DefaultValueRecordLayout_AUTOSAR_Platform_BaseTypes_boolean 1.0 AUTOSAR_Com_CompuMethods_Com_IPduStatus_enum_type 0.0 1. FORMAT "%5.0" /end CHARACTERISTIC
/begin CHARACTERISTIC Com_stESP_31_RxPduCtrl_C "Calibration parameter to control Ipdu ESP_31_Rx" VALUE 0x8061CCF7 DefaultValueRecordLayout_AUTOSAR_Platform_BaseTypes_boolean 1.0 AUTOSAR_Com_CompuMethods_Com_IPduStatus_enum_type 0.0 1. FORMAT "%5.0" /end CHARACTERISTIC
/begin CHARACTERISTIC Com_stESP_32_RxPduCtrl_C "Calibration parameter to control Ipdu ESP_32_Rx" VALUE 0x8061CCF6 DefaultValueRecordLayout_AUTOSAR_Platform_BaseTypes_boolean 1.0 AUTOSAR_Com_CompuMethods_Com_IPduStatus_enum_type 0.0 1. FORMAT "%5.0" /end CHARACTERISTIC
/begin CHARACTERISTIC Com_stESP_33_RxPduCtrl_C "Calibration parameter to control Ipdu ESP_33_Rx" VALUE 0x8061CCF5 DefaultValueRecordLayout_AUTOSAR_Platform_BaseTypes_boolean 1.0 AUTOSAR_Com_CompuMethods_Com_IPduStatus_enum_type 0.0 1. FORMAT "%5.0" /end CHARACTERISTIC
/begin CHARACTERISTIC Com_stESP_41_RxPduCtrl_C "Calibration parameter to control Ipdu ESP_41_Rx" VALUE 0x8061CCF4 DefaultValueRecordLayout_AUTOSAR_Platform_BaseTypes_boolean 1.0 AUTOSAR_Com_CompuMethods_Com_IPduStatus_enum_type 0.0 1. FORMAT "%5.0" /end CHARACTERISTIC
/begin CHARACTERISTIC Com_stESP_44_RxPduCtrl_C "Calibration parameter to control Ipdu ESP_44_Rx" VALUE 0x8061CCF3 DefaultValueRecordLayout_AUTOSAR_Platform_BaseTypes_boolean 1.0 AUTOSAR_Com_CompuMethods_Com_IPduStatus_enum_type 0.0 1. FORMAT "%5.0" /end CHARACTERISTIC
/begin CHARACTERISTIC Com_stFD_Getriebe_TxPduCtrl_C "Calibration parameter to control Ipdu FD_Getriebe_Tx" VALUE 0x8061CCF2 DefaultValueRecordLayout_AUTOSAR_Platform_BaseTypes_boolean 1.0 AUTOSAR_Com_CompuMethods_Com_IPduStatus_enum_type 0.0 1. FORMAT "%5.0" /end CHARACTERISTIC
/begin CHARACTERISTIC Com_stGetriebe_01_TxPduCtrl_C "Calibration parameter to control Ipdu Getriebe_01_Tx" VALUE 0x8061CCF1 DefaultValueRecordLayout_AUTOSAR_Platform_BaseTypes_boolean 1.0 AUTOSAR_Com_CompuMethods_Com_IPduStatus_enum_type 0.0 1. FORMAT "%5.0" /end CHARACTERISTIC
/begin CHARACTERISTIC Com_stGetriebe_11_TxPduCtrl_C "Calibration parameter to control Ipdu Getriebe_11_Tx" VALUE 0x8061CCF0 DefaultValueRecordLayout_AUTOSAR_Platform_BaseTypes_boolean 1.0 AUTOSAR_Com_CompuMethods_Com_IPduStatus_enum_type 0.0 1. FORMAT "%5.0" /end CHARACTERISTIC
/begin CHARACTERISTIC Com_stGetriebe_12_TxPduCtrl_C "Calibration parameter to control Ipdu Getriebe_12_Tx" VALUE 0x8061CCEF DefaultValueRecordLayout_AUTOSAR_Platform_BaseTypes_boolean 1.0 AUTOSAR_Com_CompuMethods_Com_IPduStatus_enum_type 0.0 1. FORMAT "%5.0" /end CHARACTERISTIC
/begin CHARACTERISTIC Com_stGetriebe_13_TxPduCtrl_C "Calibration parameter to control Ipdu Getriebe_13_Tx" VALUE 0x8061CCEE DefaultValueRecordLayout_AUTOSAR_Platform_BaseTypes_boolean 1.0 AUTOSAR_Com_CompuMethods_Com_IPduStatus_enum_type 0.0 1. FORMAT "%5.0" /end CHARACTERISTIC
/begin CHARACTERISTIC Com_stGetriebe_14_TxPduCtrl_C "Calibration parameter to control Ipdu Getriebe_14_Tx" VALUE 0x8061CCED DefaultValueRecordLayout_AUTOSAR_Platform_BaseTypes_boolean 1.0 AUTOSAR_Com_CompuMethods_Com_IPduStatus_enum_type 0.0 1. FORMAT "%5.0" /end CHARACTERISTIC
/begin CHARACTERISTIC Com_stGetriebe_15_TxPduCtrl_C "Calibration parameter to control Ipdu Getriebe_15_Tx" VALUE 0x8061CCEC DefaultValueRecordLayout_AUTOSAR_Platform_BaseTypes_boolean 1.0 AUTOSAR_Com_CompuMethods_Com_IPduStatus_enum_type 0.0 1. FORMAT "%5.0" /end CHARACTERISTIC
/begin CHARACTERISTIC Com_stGetriebe_16_TxPduCtrl_C "Calibration parameter to control Ipdu Getriebe_16_Tx" VALUE 0x8061CCEB DefaultValueRecordLayout_AUTOSAR_Platform_BaseTypes_boolean 1.0 AUTOSAR_Com_CompuMethods_Com_IPduStatus_enum_type 0.0 1. FORMAT "%5.0" /end CHARACTERISTIC
/begin CHARACTERISTIC Com_stGetriebe_17_TxPduCtrl_C "Calibration parameter to control Ipdu Getriebe_17_Tx" VALUE 0x8061CCEA DefaultValueRecordLayout_AUTOSAR_Platform_BaseTypes_boolean 1.0 AUTOSAR_Com_CompuMethods_Com_IPduStatus_enum_type 0.0 1. FORMAT "%5.0" /end CHARACTERISTIC
/begin CHARACTERISTIC Com_stGetriebe_18_TxPduCtrl_C "Calibration parameter to control Ipdu Getriebe_18_Tx" VALUE 0x8061CCE9 DefaultValueRecordLayout_AUTOSAR_Platform_BaseTypes_boolean 1.0 AUTOSAR_Com_CompuMethods_Com_IPduStatus_enum_type 0.0 1. FORMAT "%5.0" /end CHARACTERISTIC
/begin CHARACTERISTIC Com_stGetriebe_22_TxPduCtrl_C "Calibration parameter to control Ipdu Getriebe_22_Tx" VALUE 0x8061CCE8 DefaultValueRecordLayout_AUTOSAR_Platform_BaseTypes_boolean 1.0 AUTOSAR_Com_CompuMethods_Com_IPduStatus_enum_type 0.0 1. FORMAT "%5.0" /end CHARACTERISTIC
/begin CHARACTERISTIC Com_stGetriebe_HYB_12_TxPduCtrl_C "Calibration parameter to control Ipdu Getriebe_HYB_12_Tx" VALUE 0x8061CCE7 DefaultValueRecordLayout_AUTOSAR_Platform_BaseTypes_boolean 1.0 AUTOSAR_Com_CompuMethods_Com_IPduStatus_enum_type 0.0 1. FORMAT "%5.0" /end CHARACTERISTIC
/begin CHARACTERISTIC Com_stKN_Getriebe_TxPduCtrl_C "Calibration parameter to control Ipdu KN_Getriebe_Tx" VALUE 0x8061CCE6 DefaultValueRecordLayout_AUTOSAR_Platform_BaseTypes_boolean 1.0 AUTOSAR_Com_CompuMethods_Com_IPduStatus_enum_type 0.0 1. FORMAT "%5.0" /end CHARACTERISTIC
/begin CHARACTERISTIC Com_stKlemmen_Status_01_RxPduCtrl_C "Calibration parameter to control Ipdu Klemmen_Status_01_Rx" VALUE 0x8061CCE5 DefaultValueRecordLayout_AUTOSAR_Platform_BaseTypes_boolean 1.0 AUTOSAR_Com_CompuMethods_Com_IPduStatus_enum_type 0.0 1. FORMAT "%5.0" /end CHARACTERISTIC
/begin CHARACTERISTIC Com_stKlima_11_RxPduCtrl_C "Calibration parameter to control Ipdu Klima_11_Rx" VALUE 0x8061CCE4 DefaultValueRecordLayout_AUTOSAR_Platform_BaseTypes_boolean 1.0 AUTOSAR_Com_CompuMethods_Com_IPduStatus_enum_type 0.0 1. FORMAT "%5.0" /end CHARACTERISTIC
/begin CHARACTERISTIC Com_stKombi_02_RxPduCtrl_C "Calibration parameter to control Ipdu Kombi_02_Rx" VALUE 0x8061CCE3 DefaultValueRecordLayout_AUTOSAR_Platform_BaseTypes_boolean 1.0 AUTOSAR_Com_CompuMethods_Com_IPduStatus_enum_type 0.0 1. FORMAT "%5.0" /end CHARACTERISTIC
/begin CHARACTERISTIC Com_stLCV_01_RxPduCtrl_C "Calibration parameter to control Ipdu LCV_01_Rx" VALUE 0x8061CCE2 DefaultValueRecordLayout_AUTOSAR_Platform_BaseTypes_boolean 1.0 AUTOSAR_Com_CompuMethods_Com_IPduStatus_enum_type 0.0 1. FORMAT "%5.0" /end CHARACTERISTIC
/begin CHARACTERISTIC Com_stLWI_01_RxPduCtrl_C "Calibration parameter to control Ipdu LWI_01_Rx" VALUE 0x8061CCE1 DefaultValueRecordLayout_AUTOSAR_Platform_BaseTypes_boolean 1.0 AUTOSAR_Com_CompuMethods_Com_IPduStatus_enum_type 0.0 1. FORMAT "%5.0" /end CHARACTERISTIC
/begin CHARACTERISTIC Com_stMFL_Tasten_01_RxPduCtrl_C "Calibration parameter to control Ipdu MFL_Tasten_01_Rx" VALUE 0x8061CCE0 DefaultValueRecordLayout_AUTOSAR_Platform_BaseTypes_boolean 1.0 AUTOSAR_Com_CompuMethods_Com_IPduStatus_enum_type 0.0 1. FORMAT "%5.0" /end CHARACTERISTIC
/begin CHARACTERISTIC Com_stMSG_EM1_18_RxPduCtrl_C "Calibration parameter to control Ipdu MSG_EM1_18_Rx" VALUE 0x8061CCDF DefaultValueRecordLayout_AUTOSAR_Platform_BaseTypes_boolean 1.0 AUTOSAR_Com_CompuMethods_Com_IPduStatus_enum_type 0.0 1. FORMAT "%5.0" /end CHARACTERISTIC
/begin CHARACTERISTIC Com_stMSG_EM1_29_RxPduCtrl_C "Calibration parameter to control Ipdu MSG_EM1_29_Rx" VALUE 0x8061CCDE DefaultValueRecordLayout_AUTOSAR_Platform_BaseTypes_boolean 1.0 AUTOSAR_Com_CompuMethods_Com_IPduStatus_enum_type 0.0 1. FORMAT "%5.0" /end CHARACTERISTIC
/begin CHARACTERISTIC Com_stMotor_01_RxPduCtrl_C "Calibration parameter to control Ipdu Motor_01_Rx" VALUE 0x8061CCDD DefaultValueRecordLayout_AUTOSAR_Platform_BaseTypes_boolean 1.0 AUTOSAR_Com_CompuMethods_Com_IPduStatus_enum_type 0.0 1. FORMAT "%5.0" /end CHARACTERISTIC
/begin CHARACTERISTIC Com_stMotor_02_RxPduCtrl_C "Calibration parameter to control Ipdu Motor_02_Rx" VALUE 0x8061CCDC DefaultValueRecordLayout_AUTOSAR_Platform_BaseTypes_boolean 1.0 AUTOSAR_Com_CompuMethods_Com_IPduStatus_enum_type 0.0 1. FORMAT "%5.0" /end CHARACTERISTIC
/begin CHARACTERISTIC Com_stMotor_03_RxPduCtrl_C "Calibration parameter to control Ipdu Motor_03_Rx" VALUE 0x8061CCDB DefaultValueRecordLayout_AUTOSAR_Platform_BaseTypes_boolean 1.0 AUTOSAR_Com_CompuMethods_Com_IPduStatus_enum_type 0.0 1. FORMAT "%5.0" /end CHARACTERISTIC
/begin CHARACTERISTIC Com_stMotor_07_RxPduCtrl_C "Calibration parameter to control Ipdu Motor_07_Rx" VALUE 0x8061CCDA DefaultValueRecordLayout_AUTOSAR_Platform_BaseTypes_boolean 1.0 AUTOSAR_Com_CompuMethods_Com_IPduStatus_enum_type 0.0 1. FORMAT "%5.0" /end CHARACTERISTIC
/begin CHARACTERISTIC Com_stMotor_11_RxPduCtrl_C "Calibration parameter to control Ipdu Motor_11_Rx" VALUE 0x8061CCD9 DefaultValueRecordLayout_AUTOSAR_Platform_BaseTypes_boolean 1.0 AUTOSAR_Com_CompuMethods_Com_IPduStatus_enum_type 0.0 1. FORMAT "%5.0" /end CHARACTERISTIC
/begin CHARACTERISTIC Com_stMotor_12_RxPduCtrl_C "Calibration parameter to control Ipdu Motor_12_Rx" VALUE 0x8061CCD8 DefaultValueRecordLayout_AUTOSAR_Platform_BaseTypes_boolean 1.0 AUTOSAR_Com_CompuMethods_Com_IPduStatus_enum_type 0.0 1. FORMAT "%5.0" /end CHARACTERISTIC
/begin CHARACTERISTIC Com_stMotor_14_RxPduCtrl_C "Calibration parameter to control Ipdu Motor_14_Rx" VALUE 0x8061CCD7 DefaultValueRecordLayout_AUTOSAR_Platform_BaseTypes_boolean 1.0 AUTOSAR_Com_CompuMethods_Com_IPduStatus_enum_type 0.0 1. FORMAT "%5.0" /end CHARACTERISTIC
/begin CHARACTERISTIC Com_stMotor_16_RxPduCtrl_C "Calibration parameter to control Ipdu Motor_16_Rx" VALUE 0x8061CCD6 DefaultValueRecordLayout_AUTOSAR_Platform_BaseTypes_boolean 1.0 AUTOSAR_Com_CompuMethods_Com_IPduStatus_enum_type 0.0 1. FORMAT "%5.0" /end CHARACTERISTIC
/begin CHARACTERISTIC Com_stMotor_17_RxPduCtrl_C "Calibration parameter to control Ipdu Motor_17_Rx" VALUE 0x8061CCD5 DefaultValueRecordLayout_AUTOSAR_Platform_BaseTypes_boolean 1.0 AUTOSAR_Com_CompuMethods_Com_IPduStatus_enum_type 0.0 1. FORMAT "%5.0" /end CHARACTERISTIC
/begin CHARACTERISTIC Com_stMotor_18_RxPduCtrl_C "Calibration parameter to control Ipdu Motor_18_Rx" VALUE 0x8061CCD4 DefaultValueRecordLayout_AUTOSAR_Platform_BaseTypes_boolean 1.0 AUTOSAR_Com_CompuMethods_Com_IPduStatus_enum_type 0.0 1. FORMAT "%5.0" /end CHARACTERISTIC
/begin CHARACTERISTIC Com_stMotor_20_RxPduCtrl_C "Calibration parameter to control Ipdu Motor_20_Rx" VALUE 0x8061CCD3 DefaultValueRecordLayout_AUTOSAR_Platform_BaseTypes_boolean 1.0 AUTOSAR_Com_CompuMethods_Com_IPduStatus_enum_type 0.0 1. FORMAT "%5.0" /end CHARACTERISTIC
/begin CHARACTERISTIC Com_stMotor_27_RxPduCtrl_C "Calibration parameter to control Ipdu Motor_27_Rx" VALUE 0x8061CCD2 DefaultValueRecordLayout_AUTOSAR_Platform_BaseTypes_boolean 1.0 AUTOSAR_Com_CompuMethods_Com_IPduStatus_enum_type 0.0 1. FORMAT "%5.0" /end CHARACTERISTIC
/begin CHARACTERISTIC Com_stMotor_28_RxPduCtrl_C "Calibration parameter to control Ipdu Motor_28_Rx" VALUE 0x8061CCD1 DefaultValueRecordLayout_AUTOSAR_Platform_BaseTypes_boolean 1.0 AUTOSAR_Com_CompuMethods_Com_IPduStatus_enum_type 0.0 1. FORMAT "%5.0" /end CHARACTERISTIC
/begin CHARACTERISTIC Com_stMotor_35_RxPduCtrl_C "Calibration parameter to control Ipdu Motor_35_Rx" VALUE 0x8061CCD0 DefaultValueRecordLayout_AUTOSAR_Platform_BaseTypes_boolean 1.0 AUTOSAR_Com_CompuMethods_Com_IPduStatus_enum_type 0.0 1. FORMAT "%5.0" /end CHARACTERISTIC
/begin CHARACTERISTIC Com_stMotor_38_LB_RxPduCtrl_C "Calibration parameter to control Ipdu Motor_38_LB_Rx" VALUE 0x8061CCCF DefaultValueRecordLayout_AUTOSAR_Platform_BaseTypes_boolean 1.0 AUTOSAR_Com_CompuMethods_Com_IPduStatus_enum_type 0.0 1. FORMAT "%5.0" /end CHARACTERISTIC
/begin CHARACTERISTIC Com_stMotor_47_RxPduCtrl_C "Calibration parameter to control Ipdu Motor_47_Rx" VALUE 0x8061CCCE DefaultValueRecordLayout_AUTOSAR_Platform_BaseTypes_boolean 1.0 AUTOSAR_Com_CompuMethods_Com_IPduStatus_enum_type 0.0 1. FORMAT "%5.0" /end CHARACTERISTIC
/begin CHARACTERISTIC Com_stMotor_67_OBD_RxPduCtrl_C "Calibration parameter to control Ipdu Motor_67_OBD_Rx" VALUE 0x8061CCCD DefaultValueRecordLayout_AUTOSAR_Platform_BaseTypes_boolean 1.0 AUTOSAR_Com_CompuMethods_Com_IPduStatus_enum_type 0.0 1. FORMAT "%5.0" /end CHARACTERISTIC
/begin CHARACTERISTIC Com_stMotor_82_RxPduCtrl_C "Calibration parameter to control Ipdu Motor_82_Rx" VALUE 0x8061CCCC DefaultValueRecordLayout_AUTOSAR_Platform_BaseTypes_boolean 1.0 AUTOSAR_Com_CompuMethods_Com_IPduStatus_enum_type 0.0 1. FORMAT "%5.0" /end CHARACTERISTIC
/begin CHARACTERISTIC Com_stMotor_Code_01_RxPduCtrl_C "Calibration parameter to control Ipdu Motor_Code_01_Rx" VALUE 0x8061CCCB DefaultValueRecordLayout_AUTOSAR_Platform_BaseTypes_boolean 1.0 AUTOSAR_Com_CompuMethods_Com_IPduStatus_enum_type 0.0 1. FORMAT "%5.0" /end CHARACTERISTIC
/begin CHARACTERISTIC Com_stMotor_Hybrid_11_RxPduCtrl_C "Calibration parameter to control Ipdu Motor_Hybrid_11_Rx" VALUE 0x8061CCCA DefaultValueRecordLayout_AUTOSAR_Platform_BaseTypes_boolean 1.0 AUTOSAR_Com_CompuMethods_Com_IPduStatus_enum_type 0.0 1. FORMAT "%5.0" /end CHARACTERISTIC
/begin CHARACTERISTIC Com_stMotor_TS_01_RxPduCtrl_C "Calibration parameter to control Ipdu Motor_TS_01_Rx" VALUE 0x8061CCC9 DefaultValueRecordLayout_AUTOSAR_Platform_BaseTypes_boolean 1.0 AUTOSAR_Com_CompuMethods_Com_IPduStatus_enum_type 0.0 1. FORMAT "%5.0" /end CHARACTERISTIC
/begin CHARACTERISTIC Com_stMotor_TS_02_RxPduCtrl_C "Calibration parameter to control Ipdu Motor_TS_02_Rx" VALUE 0x8061CCC8 DefaultValueRecordLayout_AUTOSAR_Platform_BaseTypes_boolean 1.0 AUTOSAR_Com_CompuMethods_Com_IPduStatus_enum_type 0.0 1. FORMAT "%5.0" /end CHARACTERISTIC
/begin CHARACTERISTIC Com_stMotor_TS_03_RxPduCtrl_C "Calibration parameter to control Ipdu Motor_TS_03_Rx" VALUE 0x8061CCC7 DefaultValueRecordLayout_AUTOSAR_Platform_BaseTypes_boolean 1.0 AUTOSAR_Com_CompuMethods_Com_IPduStatus_enum_type 0.0 1. FORMAT "%5.0" /end CHARACTERISTIC
/begin CHARACTERISTIC Com_stNVEM_02_RxPduCtrl_C "Calibration parameter to control Ipdu NVEM_02_Rx" VALUE 0x8061CCC6 DefaultValueRecordLayout_AUTOSAR_Platform_BaseTypes_boolean 1.0 AUTOSAR_Com_CompuMethods_Com_IPduStatus_enum_type 0.0 1. FORMAT "%5.0" /end CHARACTERISTIC
/begin CHARACTERISTIC Com_stNVEM_05_RxPduCtrl_C "Calibration parameter to control Ipdu NVEM_05_Rx" VALUE 0x8061CCC5 DefaultValueRecordLayout_AUTOSAR_Platform_BaseTypes_boolean 1.0 AUTOSAR_Com_CompuMethods_Com_IPduStatus_enum_type 0.0 1. FORMAT "%5.0" /end CHARACTERISTIC
/begin CHARACTERISTIC Com_stOBD_01_RxPduCtrl_C "Calibration parameter to control Ipdu OBD_01_Rx" VALUE 0x8061CCC4 DefaultValueRecordLayout_AUTOSAR_Platform_BaseTypes_boolean 1.0 AUTOSAR_Com_CompuMethods_Com_IPduStatus_enum_type 0.0 1. FORMAT "%5.0" /end CHARACTERISTIC
/begin CHARACTERISTIC Com_stOBD_02_RxPduCtrl_C "Calibration parameter to control Ipdu OBD_02_Rx" VALUE 0x8061CCC3 DefaultValueRecordLayout_AUTOSAR_Platform_BaseTypes_boolean 1.0 AUTOSAR_Com_CompuMethods_Com_IPduStatus_enum_type 0.0 1. FORMAT "%5.0" /end CHARACTERISTIC
/begin CHARACTERISTIC Com_stSARA_06_RxPduCtrl_C "Calibration parameter to control Ipdu SARA_06_Rx" VALUE 0x8061CCC2 DefaultValueRecordLayout_AUTOSAR_Platform_BaseTypes_boolean 1.0 AUTOSAR_Com_CompuMethods_Com_IPduStatus_enum_type 0.0 1. FORMAT "%5.0" /end CHARACTERISTIC
/begin CHARACTERISTIC Com_stSysteminfo_01_RxPduCtrl_C "Calibration parameter to control Ipdu Systeminfo_01_Rx" VALUE 0x8061CCC1 DefaultValueRecordLayout_AUTOSAR_Platform_BaseTypes_boolean 1.0 AUTOSAR_Com_CompuMethods_Com_IPduStatus_enum_type 0.0 1. FORMAT "%5.0" /end CHARACTERISTIC
/begin CHARACTERISTIC Com_stTSG_FT_02_RxPduCtrl_C "Calibration parameter to control Ipdu TSG_FT_02_Rx" VALUE 0x8061CCC0 DefaultValueRecordLayout_AUTOSAR_Platform_BaseTypes_boolean 1.0 AUTOSAR_Com_CompuMethods_Com_IPduStatus_enum_type 0.0 1. FORMAT "%5.0" /end CHARACTERISTIC
/begin CHARACTERISTIC Com_stTSK_06_RxPduCtrl_C "Calibration parameter to control Ipdu TSK_06_Rx" VALUE 0x8061CCBF DefaultValueRecordLayout_AUTOSAR_Platform_BaseTypes_boolean 1.0 AUTOSAR_Com_CompuMethods_Com_IPduStatus_enum_type 0.0 1. FORMAT "%5.0" /end CHARACTERISTIC
/begin CHARACTERISTIC Com_stTSK_08_RxPduCtrl_C "Calibration parameter to control Ipdu TSK_08_Rx" VALUE 0x8061CCBE DefaultValueRecordLayout_AUTOSAR_Platform_BaseTypes_boolean 1.0 AUTOSAR_Com_CompuMethods_Com_IPduStatus_enum_type 0.0 1. FORMAT "%5.0" /end CHARACTERISTIC
/begin CHARACTERISTIC Com_stVIN_01_0_RxPduCtrl_C "Calibration parameter to control Ipdu VIN_01_0_Rx" VALUE 0x8061CCBD DefaultValueRecordLayout_AUTOSAR_Platform_BaseTypes_boolean 1.0 AUTOSAR_Com_CompuMethods_Com_IPduStatus_enum_type 0.0 1. FORMAT "%5.0" /end CHARACTERISTIC
/begin CHARACTERISTIC Com_stVIN_01_1_RxPduCtrl_C "Calibration parameter to control Ipdu VIN_01_1_Rx" VALUE 0x8061CCBC DefaultValueRecordLayout_AUTOSAR_Platform_BaseTypes_boolean 1.0 AUTOSAR_Com_CompuMethods_Com_IPduStatus_enum_type 0.0 1. FORMAT "%5.0" /end CHARACTERISTIC
/begin CHARACTERISTIC Com_stVIN_01_2_RxPduCtrl_C "Calibration parameter to control Ipdu VIN_01_2_Rx" VALUE 0x8061CCBB DefaultValueRecordLayout_AUTOSAR_Platform_BaseTypes_boolean 1.0 AUTOSAR_Com_CompuMethods_Com_IPduStatus_enum_type 0.0 1. FORMAT "%5.0" /end CHARACTERISTIC
/begin CHARACTERISTIC Com_stWBA_03_TxPduCtrl_C "Calibration parameter to control Ipdu WBA_03_Tx" VALUE 0x8061CCBA DefaultValueRecordLayout_AUTOSAR_Platform_BaseTypes_boolean 1.0 AUTOSAR_Com_CompuMethods_Com_IPduStatus_enum_type 0.0 1. FORMAT "%5.0" /end CHARACTERISTIC
/begin CHARACTERISTIC Com_tiACC_06_RxRxTout_C "Calibration parameter to control Rx Ipdu Timeout for ACC_06_Rx (multiplied by 0.005s)" VALUE 0x8061CF46 DefaultValueRecordLayout_AUTOSAR_Platform_BaseTypes_uint16 65535.0 RB_RBA_Common_CentralElements_CompuMethods_Identical 0.0 65535. FORMAT "%5.0" /end CHARACTERISTIC
/begin CHARACTERISTIC Com_tiACC_07_RxRxTout_C "Calibration parameter to control Rx Ipdu Timeout for ACC_07_Rx (multiplied by 0.005s)" VALUE 0x8061CF44 DefaultValueRecordLayout_AUTOSAR_Platform_BaseTypes_uint16 65535.0 RB_RBA_Common_CentralElements_CompuMethods_Identical 0.0 65535. FORMAT "%5.0" /end CHARACTERISTIC
/begin CHARACTERISTIC Com_tiAirbag_01_RxRxTout_C "Calibration parameter to control Rx Ipdu Timeout for Airbag_01_Rx (multiplied by 0.005s)" VALUE 0x8061CF42 DefaultValueRecordLayout_AUTOSAR_Platform_BaseTypes_uint16 65535.0 RB_RBA_Common_CentralElements_CompuMethods_Identical 0.0 65535. FORMAT "%5.0" /end CHARACTERISTIC
/begin CHARACTERISTIC Com_tiAirbag_02_RxRxTout_C "Calibration parameter to control Rx Ipdu Timeout for Airbag_02_Rx (multiplied by 0.005s)" VALUE 0x8061CF40 DefaultValueRecordLayout_AUTOSAR_Platform_BaseTypes_uint16 65535.0 RB_RBA_Common_CentralElements_CompuMethods_Identical 0.0 65535. FORMAT "%5.0" /end CHARACTERISTIC
/begin CHARACTERISTIC Com_tiBCM_01_RxRxTout_C "Calibration parameter to control Rx Ipdu Timeout for BCM_01_Rx (multiplied by 0.005s)" VALUE 0x8061CF3E DefaultValueRecordLayout_AUTOSAR_Platform_BaseTypes_uint16 65535.0 RB_RBA_Common_CentralElements_CompuMethods_Identical 0.0 65535. FORMAT "%5.0" /end CHARACTERISTIC
/begin CHARACTERISTIC Com_tiBYPASS_TDG1_11_RxRxTout_C "Calibration parameter to control Rx Ipdu Timeout for BYPASS_TDG1_11_Rx (multiplied by 0.005s)" VALUE 0x8061CF3C DefaultValueRecordLayout_AUTOSAR_Platform_BaseTypes_uint16 65535.0 RB_RBA_Common_CentralElements_CompuMethods_Identical 0.0 65535. FORMAT "%5.0" /end CHARACTERISTIC
/begin CHARACTERISTIC Com_tiBYPASS_TDG1_12_RxRxTout_C "Calibration parameter to control Rx Ipdu Timeout for BYPASS_TDG1_12_Rx (multiplied by 0.005s)" VALUE 0x8061CF3A DefaultValueRecordLayout_AUTOSAR_Platform_BaseTypes_uint16 65535.0 RB_RBA_Common_CentralElements_CompuMethods_Identical 0.0 65535. FORMAT "%5.0" /end CHARACTERISTIC
/begin CHARACTERISTIC Com_tiBYPASS_TDG1_13_RxRxTout_C "Calibration parameter to control Rx Ipdu Timeout for BYPASS_TDG1_13_Rx (multiplied by 0.005s)" VALUE 0x8061CF38 DefaultValueRecordLayout_AUTOSAR_Platform_BaseTypes_uint16 65535.0 RB_RBA_Common_CentralElements_CompuMethods_Identical 0.0 65535. FORMAT "%5.0" /end CHARACTERISTIC
/begin CHARACTERISTIC Com_tiBYPASS_TDG1_14_RxRxTout_C "Calibration parameter to control Rx Ipdu Timeout for BYPASS_TDG1_14_Rx (multiplied by 0.005s)" VALUE 0x8061CF36 DefaultValueRecordLayout_AUTOSAR_Platform_BaseTypes_uint16 65535.0 RB_RBA_Common_CentralElements_CompuMethods_Identical 0.0 65535. FORMAT "%5.0" /end CHARACTERISTIC
/begin CHARACTERISTIC Com_tiBYPASS_TDG1_15_RxRxTout_C "Calibration parameter to control Rx Ipdu Timeout for BYPASS_TDG1_15_Rx (multiplied by 0.005s)" VALUE 0x8061CF34 DefaultValueRecordLayout_AUTOSAR_Platform_BaseTypes_uint16 65535.0 RB_RBA_Common_CentralElements_CompuMethods_Identical 0.0 65535. FORMAT "%5.0" /end CHARACTERISTIC
/begin CHARACTERISTIC Com_tiBYPASS_TDG1_16_PlaceHolder_RxRxTout_C "Calibration parameter to control Rx Ipdu Timeout for BYPASS_TDG1_16_PlaceHolder_Rx (multiplied by 0.005s)" VALUE 0x8061CF32 DefaultValueRecordLayout_AUTOSAR_Platform_BaseTypes_uint16 65535.0 RB_RBA_Common_CentralElements_CompuMethods_Identical 0.0 65535. FORMAT "%5.0" /end CHARACTERISTIC
/begin CHARACTERISTIC Com_tiBYPASS_TDG1_17_PlaceHolder_RxRxTout_C "Calibration parameter to control Rx Ipdu Timeout for BYPASS_TDG1_17_PlaceHolder_Rx (multiplied by 0.005s)" VALUE 0x8061CF30 DefaultValueRecordLayout_AUTOSAR_Platform_BaseTypes_uint16 65535.0 RB_RBA_Common_CentralElements_CompuMethods_Identical 0.0 65535. FORMAT "%5.0" /end CHARACTERISTIC
/begin CHARACTERISTIC Com_tiBYPASS_TDG1_18_PlaceHolder_RxRxTout_C "Calibration parameter to control Rx Ipdu Timeout for BYPASS_TDG1_18_PlaceHolder_Rx (multiplied by 0.005s)" VALUE 0x8061CF2E DefaultValueRecordLayout_AUTOSAR_Platform_BaseTypes_uint16 65535.0 RB_RBA_Common_CentralElements_CompuMethods_Identical 0.0 65535. FORMAT "%5.0" /end CHARACTERISTIC
/begin CHARACTERISTIC Com_tiBYPASS_TDG1_19_Placeholder_RxRxTout_C "Calibration parameter to control Rx Ipdu Timeout for BYPASS_TDG1_19_Placeholder_Rx (multiplied by 0.005s)" VALUE 0x8061CF2C DefaultValueRecordLayout_AUTOSAR_Platform_BaseTypes_uint16 65535.0 RB_RBA_Common_CentralElements_CompuMethods_Identical 0.0 65535. FORMAT "%5.0" /end CHARACTERISTIC
/begin CHARACTERISTIC Com_tiBYPASS_TDG1_20_Placeholder_RxRxTout_C "Calibration parameter to control Rx Ipdu Timeout for BYPASS_TDG1_20_Placeholder_Rx (multiplied by 0.005s)" VALUE 0x8061CF2A DefaultValueRecordLayout_AUTOSAR_Platform_BaseTypes_uint16 65535.0 RB_RBA_Common_CentralElements_CompuMethods_Identical 0.0 65535. FORMAT "%5.0" /end CHARACTERISTIC
/begin CHARACTERISTIC Com_tiBYPASS_TDG1_21_RxRxTout_C "Calibration parameter to control Rx Ipdu Timeout for BYPASS_TDG1_21_Rx (multiplied by 0.005s)" VALUE 0x8061CF28 DefaultValueRecordLayout_AUTOSAR_Platform_BaseTypes_uint16 65535.0 RB_RBA_Common_CentralElements_CompuMethods_Identical 0.0 65535. FORMAT "%5.0" /end CHARACTERISTIC
/begin CHARACTERISTIC Com_tiBYPASS_TDG1_22_RxRxTout_C "Calibration parameter to control Rx Ipdu Timeout for BYPASS_TDG1_22_Rx (multiplied by 0.005s)" VALUE 0x8061CF26 DefaultValueRecordLayout_AUTOSAR_Platform_BaseTypes_uint16 65535.0 RB_RBA_Common_CentralElements_CompuMethods_Identical 0.0 65535. FORMAT "%5.0" /end CHARACTERISTIC
/begin CHARACTERISTIC Com_tiBremse_EV_01_RxRxTout_C "Calibration parameter to control Rx Ipdu Timeout for Bremse_EV_01_Rx (multiplied by 0.005s)" VALUE 0x8061CF24 DefaultValueRecordLayout_AUTOSAR_Platform_BaseTypes_uint16 65535.0 RB_RBA_Common_CentralElements_CompuMethods_Identical 0.0 65535. FORMAT "%5.0" /end CHARACTERISTIC
/begin CHARACTERISTIC Com_tiBremse_EV_02_RxRxTout_C "Calibration parameter to control Rx Ipdu Timeout for Bremse_EV_02_Rx (multiplied by 0.005s)" VALUE 0x8061CF22 DefaultValueRecordLayout_AUTOSAR_Platform_BaseTypes_uint16 65535.0 RB_RBA_Common_CentralElements_CompuMethods_Identical 0.0 65535. FORMAT "%5.0" /end CHARACTERISTIC
/begin CHARACTERISTIC Com_tiCharisma_01_RxRxTout_C "Calibration parameter to control Rx Ipdu Timeout for Charisma_01_Rx (multiplied by 0.005s)" VALUE 0x8061CF20 DefaultValueRecordLayout_AUTOSAR_Platform_BaseTypes_uint16 65535.0 RB_RBA_Common_CentralElements_CompuMethods_Identical 0.0 65535. FORMAT "%5.0" /end CHARACTERISTIC
/begin CHARACTERISTIC Com_tiCool_Act_Sts_RxRxTout_C "Calibration parameter to control Rx Ipdu Timeout for Cool_Act_Sts_Rx (multiplied by 0.005s)" VALUE 0x8061CF1E DefaultValueRecordLayout_AUTOSAR_Platform_BaseTypes_uint16 65535.0 RB_RBA_Common_CentralElements_CompuMethods_Identical 0.0 65535. FORMAT "%5.0" /end CHARACTERISTIC
/begin CHARACTERISTIC Com_tiDiagnose_01_RxRxTout_C "Calibration parameter to control Rx Ipdu Timeout for Diagnose_01_Rx (multiplied by 0.005s)" VALUE 0x8061CF1C DefaultValueRecordLayout_AUTOSAR_Platform_BaseTypes_uint16 65535.0 RB_RBA_Common_CentralElements_CompuMethods_Identical 0.0 65535. FORMAT "%5.0" /end CHARACTERISTIC
/begin CHARACTERISTIC Com_tiEBKV_01_RxRxTout_C "Calibration parameter to control Rx Ipdu Timeout for EBKV_01_Rx (multiplied by 0.005s)" VALUE 0x8061CF1A DefaultValueRecordLayout_AUTOSAR_Platform_BaseTypes_uint16 65535.0 RB_RBA_Common_CentralElements_CompuMethods_Identical 0.0 65535. FORMAT "%5.0" /end CHARACTERISTIC
/begin CHARACTERISTIC Com_tiEM1_HYB_06_RxRxTout_C "Calibration parameter to control Rx Ipdu Timeout for EM1_HYB_06_Rx (multiplied by 0.005s)" VALUE 0x8061CF18 DefaultValueRecordLayout_AUTOSAR_Platform_BaseTypes_uint16 65535.0 RB_RBA_Common_CentralElements_CompuMethods_Identical 0.0 65535. FORMAT "%5.0" /end CHARACTERISTIC
/begin CHARACTERISTIC Com_tiEM1_HYB_12_RxRxTout_C "Calibration parameter to control Rx Ipdu Timeout for EM1_HYB_12_Rx (multiplied by 0.005s)" VALUE 0x8061CF16 DefaultValueRecordLayout_AUTOSAR_Platform_BaseTypes_uint16 65535.0 RB_RBA_Common_CentralElements_CompuMethods_Identical 0.0 65535. FORMAT "%5.0" /end CHARACTERISTIC
/begin CHARACTERISTIC Com_tiEPB_01_RxRxTout_C "Calibration parameter to control Rx Ipdu Timeout for EPB_01_Rx (multiplied by 0.005s)" VALUE 0x8061CF14 DefaultValueRecordLayout_AUTOSAR_Platform_BaseTypes_uint16 65535.0 RB_RBA_Common_CentralElements_CompuMethods_Identical 0.0 65535. FORMAT "%5.0" /end CHARACTERISTIC
/end MODULE
/end PROJECT
