ASAP2_VERSION 1 60
/begin PROJECT LB74x_TCU "5201C621"
/begin HEADER "" VERSION "5201C621" PROJECT_NO LB74x_TCU /end HEADER
/begin MODULE DIM ""
/begin MOD_COMMON "" BYTE_ORDER MSB_LAST ALIGNMENT_BYTE 1 ALIGNMENT_WORD 2 ALIGNMENT_LONG 4 ALIGNMENT_INT64 4 ALIGNMENT_FLOAT32_IEEE 4 ALIGNMENT_FLOAT64_IEEE 4 DATA_SIZE 32 /end MOD_COMMON
/begin CHARACTERISTIC GAC_CALIB.GAC_GracC.GAC_InGearLearn.GAC_POSNMAXINGRLRN "" VALUE 0x806126F6 DefaultValueRecordLayout_AUTOSAR_Platform_BaseTypes_sint16 40.0 RB_PT_PCT_SWC_GAC_CompuMethods_ratio_0p001 -20. 20. FORMAT "%10.5"
 /begin ANNOTATION ANNOTATION_LABEL "Description (coming from AUTOSAR DESC field)" /begin ANNOTATION_TEXT "Maximum allowed position for in gear learn.\r\n" /end ANNOTATION_TEXT /end ANNOTATION
/end CHARACTERISTIC
/begin CHARACTERISTIC GAC_CALIB.GAC_GracC.GAC_InGearLearn.GAC_POSNMININGRLRN "" VALUE 0x806126F8 DefaultValueRecordLayout_AUTOSAR_Platform_BaseTypes_sint16 40.0 RB_PT_PCT_SWC_GAC_CompuMethods_ratio_0p001 -20. 20. FORMAT "%10.5"
 /begin ANNOTATION ANNOTATION_LABEL "Description (coming from AUTOSAR DESC field)" /begin ANNOTATION_TEXT "Minimum allowed position for in gear learn.\r\n" /end ANNOTATION_TEXT /end ANNOTATION
/end CHARACTERISTIC
/begin CHARACTERISTIC GAC_CALIB.GAC_GracC.GAC_InGearLearnTrig.GAC_BOBFLGFORCEINGEARLEARN "" VALUE 0x8061270C DefaultValueRecordLayout_AUTOSAR_Platform_BaseTypes_uint8 255.0 DefaultIdenticalCompu 0.0 255. FORMAT "%10.5"
 /begin ANNOTATION ANNOTATION_LABEL "Description (coming from AUTOSAR DESC field)" /begin ANNOTATION_TEXT "Flag to force in gear position learn\r\n" /end ANNOTATION_TEXT /end ANNOTATION
/end CHARACTERISTIC
/begin CHARACTERISTIC GAC_CALIB.GAC_GracC.GAC_InGearLearnTrig.GAC_CNTTRIGADPINGRPOS "" VALUE 0x8061270D DefaultValueRecordLayout_AUTOSAR_Platform_BaseTypes_uint8 10.0 RB_PT_PCT_SWC_GAC_CompuMethods_ident 0.0 10. FORMAT "%10.5"
 /begin ANNOTATION ANNOTATION_LABEL "Description (coming from AUTOSAR DESC field)"
  /begin ANNOTATION_TEXT "Counter value used to trigger the request for in positive gear learn.\r\n" /end ANNOTATION_TEXT
 /end ANNOTATION
/end CHARACTERISTIC
/begin CHARACTERISTIC GAC_CALIB.GAC_GracC.GAC_InGearLearnTrig.GAC_CNTTRIGAPPINGRNEG "" VALUE 0x8061270E DefaultValueRecordLayout_AUTOSAR_Platform_BaseTypes_uint8 10.0 RB_PT_PCT_SWC_GAC_CompuMethods_ident 0.0 10. FORMAT "%10.5"
 /begin ANNOTATION ANNOTATION_LABEL "Description (coming from AUTOSAR DESC field)"
  /begin ANNOTATION_TEXT "Counter value used to trigger the request for in negative gear learn.\r\n" /end ANNOTATION_TEXT
 /end ANNOTATION
/end CHARACTERISTIC
/begin CHARACTERISTIC GAC_CALIB.GAC_GracC.GAC_InGearLearnTrig.GAC_FLGSADPINGRNEGAGGOK "" VAL_BLK 0x80612704 DefaultValueRecordLayout_AUTOSAR_Platform_BaseTypes_boolean 255.0 AUTOSAR_Platform_CompuMethods_boolean 0.0 255. FORMAT "%10.5"
 /begin ANNOTATION ANNOTATION_LABEL "Description (coming from AUTOSAR DESC field)"
  /begin ANNOTATION_TEXT "Array of flags indicating in negative gear learn allowed, for each actuation aggression.\r\n" /end ANNOTATION_TEXT
 /end ANNOTATION
 MATRIX_DIM 4 1 1 /end CHARACTERISTIC
/begin CHARACTERISTIC GAC_CALIB.GAC_GracC.GAC_InGearLearnTrig.GAC_FLGSADPINGRPOSAGGOK "" VAL_BLK 0x80612708 DefaultValueRecordLayout_AUTOSAR_Platform_BaseTypes_boolean 255.0 AUTOSAR_Platform_CompuMethods_boolean 0.0 255. FORMAT "%10.5"
 /begin ANNOTATION ANNOTATION_LABEL "Description (coming from AUTOSAR DESC field)"
  /begin ANNOTATION_TEXT "Array of flags indicating in positive gear learn allowed, for each actuation aggression.\r\n" /end ANNOTATION_TEXT
 /end ANNOTATION
 MATRIX_DIM 4 1 1 /end CHARACTERISTIC
/begin CHARACTERISTIC GAC_CALIB.GAC_GracC.GAC_InGrDebTmr.LIB_DT "" VALUE 0x80612710 DefaultValueRecordLayout_AUTOSAR_Platform_BaseTypes_uint16 65.535 RB_PT_PCT_SWC_GAC_CompuMethods_ratio_0p001 0.0 65.535 FORMAT "%10.5"
 /begin ANNOTATION ANNOTATION_LABEL "Description (coming from AUTOSAR DESC field)" /begin ANNOTATION_TEXT "Timer decrement value.\r\n" /end ANNOTATION_TEXT /end ANNOTATION
/end CHARACTERISTIC
/begin CHARACTERISTIC GAC_CALIB.GAC_GracC.GAC_InGrPressToEndStopTmr.LIB_DT "" VALUE 0x80612712 DefaultValueRecordLayout_AUTOSAR_Platform_BaseTypes_uint16 65.535 RB_PT_PCT_SWC_GAC_CompuMethods_ratio_0p001 0.0 65.535 FORMAT "%10.5"
 /begin ANNOTATION ANNOTATION_LABEL "Description (coming from AUTOSAR DESC field)" /begin ANNOTATION_TEXT "Timer decrement value.\r\n" /end ANNOTATION_TEXT /end ANNOTATION
/end CHARACTERISTIC
/begin CHARACTERISTIC GAC_CALIB.GAC_GracC.GAC_InNDebTmr.LIB_DT "" VALUE 0x80612714 DefaultValueRecordLayout_AUTOSAR_Platform_BaseTypes_uint16 65.535 RB_PT_PCT_SWC_GAC_CompuMethods_ratio_0p001 0.0 65.535 FORMAT "%10.5"
 /begin ANNOTATION ANNOTATION_LABEL "Description (coming from AUTOSAR DESC field)" /begin ANNOTATION_TEXT "Timer decrement value.\r\n" /end ANNOTATION_TEXT /end ANNOTATION
/end CHARACTERISTIC
/begin CHARACTERISTIC GAC_CALIB.GAC_GracC.GAC_POSNADPPUSHINGR "" VALUE 0x80612438 DefaultValueRecordLayout_AUTOSAR_Platform_BaseTypes_uint16 100.0 RB_PT_PCT_SWC_GAC_CompuMethods_ident 0.0 100. FORMAT "%10.5"
 /begin ANNOTATION ANNOTATION_LABEL "Description (coming from AUTOSAR DESC field)"
  /begin ANNOTATION_TEXT "Gear actuator position used for adaptation 'push in gear'.\r\n" /end ANNOTATION_TEXT
 /end ANNOTATION
/end CHARACTERISTIC
/begin CHARACTERISTIC GAC_CALIB.GAC_GracC.GAC_POSNGRACCLOSEOUTTHRESH "" VALUE 0x8061243A DefaultValueRecordLayout_AUTOSAR_Platform_BaseTypes_uint16 20.0 RB_PT_PCT_SWC_GAC_CompuMethods_ratio_0p001 0.0 20. FORMAT "%10.5"
 /begin ANNOTATION ANNOTATION_LABEL "Description (coming from AUTOSAR DESC field)"
  /begin ANNOTATION_TEXT "Maximum absolute synchroniser position for the neutral close out to activate\r\n" /end ANNOTATION_TEXT
 /end ANNOTATION
/end CHARACTERISTIC
/begin CHARACTERISTIC GAC_CALIB.GAC_GracC.GAC_POSNGRACFAILPUSHINGR "" VALUE 0x8061243C DefaultValueRecordLayout_AUTOSAR_Platform_BaseTypes_uint16 100.0 RB_PT_PCT_SWC_GAC_CompuMethods_ident 0.0 100. FORMAT "%10.5"
 /begin ANNOTATION ANNOTATION_LABEL "Description (coming from AUTOSAR DESC field)"
  /begin ANNOTATION_TEXT "Gear actuator position used for 'fail push in gear' active.\r\n" /end ANNOTATION_TEXT
 /end ANNOTATION
/end CHARACTERISTIC
/begin CHARACTERISTIC GAC_CALIB.GAC_GracC.GAC_POSNGRACNSTOPRESETI "" VALUE 0x8061243E DefaultValueRecordLayout_AUTOSAR_Platform_BaseTypes_uint16 20.0 RB_PT_PCT_SWC_GAC_CompuMethods_ratio_0p001 0.0 20. FORMAT "%10.5"
 /begin ANNOTATION ANNOTATION_LABEL "Description (coming from AUTOSAR DESC field)"
  /begin ANNOTATION_TEXT "Gear actuator position used for resetting the I term during NStop phase.\r\n" /end ANNOTATION_TEXT
 /end ANNOTATION
/end CHARACTERISTIC
/begin CHARACTERISTIC GAC_CALIB.GAC_GracC.GAC_POSNGRACSYNCDEFAULT "" VALUE 0x80612440 DefaultValueRecordLayout_AUTOSAR_Platform_BaseTypes_sint16 40.0 RB_PT_PCT_SWC_GAC_CompuMethods_ratio_0p001 -20. 20. FORMAT "%10.5"
 /begin ANNOTATION ANNOTATION_LABEL "Description (coming from AUTOSAR DESC field)"
  /begin ANNOTATION_TEXT "Gear actuator limit position used for synchronisation end detection.\r\n" /end ANNOTATION_TEXT
 /end ANNOTATION
/end CHARACTERISTIC
/begin CHARACTERISTIC GAC_CALIB.GAC_GracC.GAC_POSNGRACSYNCEXITMIN "" VALUE 0x80612442 DefaultValueRecordLayout_AUTOSAR_Platform_BaseTypes_sint16 40.0 RB_PT_PCT_SWC_GAC_CompuMethods_ratio_0p001 -20. 20. FORMAT "%10.5"
 /begin ANNOTATION ANNOTATION_LABEL "Description (coming from AUTOSAR DESC field)"
  /begin ANNOTATION_TEXT "Gear actuator low position used for synchronisation start detection on the positive gear.\r\n" /end ANNOTATION_TEXT
 /end ANNOTATION
/end CHARACTERISTIC
/begin CHARACTERISTIC GAC_CALIB.GAC_GracC.GAC_POSNGRACSYNCHIGR "" VALUE 0x80612444 DefaultValueRecordLayout_AUTOSAR_Platform_BaseTypes_sint16 40.0 RB_PT_PCT_SWC_GAC_CompuMethods_ratio_0p001 -20. 20. FORMAT "%10.5"
 /begin ANNOTATION ANNOTATION_LABEL "Description (coming from AUTOSAR DESC field)"
  /begin ANNOTATION_TEXT "Gear actuator high position used for synchronisation start detection on the positive gear.\r\n" /end ANNOTATION_TEXT
 /end ANNOTATION
/end CHARACTERISTIC
/begin CHARACTERISTIC GAC_CALIB.GAC_GracC.GAC_POSNGRACSYNCLOWGR "" VALUE 0x80612446 DefaultValueRecordLayout_AUTOSAR_Platform_BaseTypes_sint16 40.0 RB_PT_PCT_SWC_GAC_CompuMethods_ratio_0p001 -20. 20. FORMAT "%10.5"
 /begin ANNOTATION ANNOTATION_LABEL "Description (coming from AUTOSAR DESC field)"
  /begin ANNOTATION_TEXT "Gear actuator low position used for synchronisation start detection on the positive gear.\r\n" /end ANNOTATION_TEXT
 /end ANNOTATION
/end CHARACTERISTIC
/begin CHARACTERISTIC GAC_CALIB.GAC_GracC.GAC_POSNMAXINGRLRN "" VALUE 0x80612448 DefaultValueRecordLayout_AUTOSAR_Platform_BaseTypes_sint16 40.0 RB_PT_PCT_SWC_GAC_CompuMethods_ratio_0p001 -20. 20. FORMAT "%10.5"
 /begin ANNOTATION ANNOTATION_LABEL "Description (coming from AUTOSAR DESC field)" /begin ANNOTATION_TEXT "Maximum allowed position for in negative gear learn.\r\n" /end ANNOTATION_TEXT /end ANNOTATION
/end CHARACTERISTIC
/begin CHARACTERISTIC GAC_CALIB.GAC_GracC.GAC_POSNMAXMODNBAND "" VALUE 0x8061244A DefaultValueRecordLayout_AUTOSAR_Platform_BaseTypes_sint16 40.0 RB_PT_PCT_SWC_GAC_CompuMethods_ratio_0p001 -20. 20. FORMAT "%10.5"
 /begin ANNOTATION ANNOTATION_LABEL "Description (coming from AUTOSAR DESC field)"
  /begin ANNOTATION_TEXT "Maximum allowed position that GAC can modify the neutral offset band for drifting actuators\r\n" /end ANNOTATION_TEXT
 /end ANNOTATION
/end CHARACTERISTIC
/begin CHARACTERISTIC GAC_CALIB.GAC_GracC.GAC_POSNNMODIFY "" VALUE 0x8061244C DefaultValueRecordLayout_AUTOSAR_Platform_BaseTypes_sint16 40.0 RB_PT_PCT_SWC_GAC_CompuMethods_ratio_0p001 -20. 20. FORMAT "%10.5"
 /begin ANNOTATION ANNOTATION_LABEL "Description (coming from AUTOSAR DESC field)" /begin ANNOTATION_TEXT "Position offset for the neutral window detection\r\n" /end ANNOTATION_TEXT /end ANNOTATION
/end CHARACTERISTIC
/begin CHARACTERISTIC GAC_CALIB.GAC_GracC.GAC_POSNOFFSETGHOLD "" VALUE 0x8061244E DefaultValueRecordLayout_AUTOSAR_Platform_BaseTypes_sint16 40.0 RB_PT_PCT_SWC_GAC_CompuMethods_ratio_0p001 -20. 20. FORMAT "%10.5"
 /begin ANNOTATION ANNOTATION_LABEL "Description (coming from AUTOSAR DESC field)"
  /begin ANNOTATION_TEXT "Position tolerance used for gear hold phase target position.\r\n" /end ANNOTATION_TEXT
 /end ANNOTATION
/end CHARACTERISTIC
/begin CHARACTERISTIC GAC_CALIB.GAC_GracC.GAC_POSNSFRKBENDGRNEG "" CURVE 0x8061297A RB_PT_PCT_SWC_GAC_RecordLayouts_RL_Curve_sint16_6_uint16_6 4.0 RB_PT_PCT_SWC_GAC_CompuMethods_ratio_0p001 -2. 2. FORMAT "%10.5"
 /begin ANNOTATION ANNOTATION_LABEL "Description (coming from AUTOSAR DESC field)"
  /begin ANNOTATION_TEXT "map for pressure to fork bend in the negative direction\r\n" /end ANNOTATION_TEXT
 /end ANNOTATION
 /begin AXIS_DESCR STD_AXIS NO_INPUT_QUANTITY RB_PT_PCT_SWC_GAC_CompuMethods_ratio_0p001 6 0.0 32. FORMAT "%10.5" DEPOSIT ABSOLUTE /end AXIS_DESCR
/end CHARACTERISTIC
/begin CHARACTERISTIC GAC_CALIB.GAC_GracC.GAC_POSNSFRKBENDGRPOS "" CURVE 0x80612994 RB_PT_PCT_SWC_GAC_RecordLayouts_RL_Curve_sint16_6_uint16_6 4.0 RB_PT_PCT_SWC_GAC_CompuMethods_ratio_0p001 -2. 2. FORMAT "%10.5"
 /begin ANNOTATION ANNOTATION_LABEL "Description (coming from AUTOSAR DESC field)"
  /begin ANNOTATION_TEXT "map for pressure to fork bend in the positive direction\r\n" /end ANNOTATION_TEXT
 /end ANNOTATION
 /begin AXIS_DESCR STD_AXIS NO_INPUT_QUANTITY RB_PT_PCT_SWC_GAC_CompuMethods_ratio_0p001 6 0.0 32. FORMAT "%10.5" DEPOSIT ABSOLUTE /end AXIS_DESCR
/end CHARACTERISTIC
/begin CHARACTERISTIC GAC_CALIB.GAC_GracC.GAC_POSNSTRIGNSTOPGRNEG "" CURVE 0x806129AE RB_PT_PCT_SWC_GAC_RecordLayouts_RL_Curve_sint16_4_sint16_4 40.0 RB_PT_PCT_SWC_GAC_CompuMethods_ratio_0p001 -20. 20. FORMAT "%10.5"
 /begin ANNOTATION ANNOTATION_LABEL "Description (coming from AUTOSAR DESC field)"
  /begin ANNOTATION_TEXT "Actuator position which NStop phase is activated - negative gear case.\r\n" /end ANNOTATION_TEXT
 /end ANNOTATION
 /begin AXIS_DESCR STD_AXIS NO_INPUT_QUANTITY RB_PT_PCT_SWC_GAC_CompuMethods_ident 4 -50. 200. FORMAT "%10.5" DEPOSIT ABSOLUTE /end AXIS_DESCR
/end CHARACTERISTIC
/begin CHARACTERISTIC GAC_CALIB.GAC_GracC.GAC_POSNSTRIGNSTOPGRPOS "" CURVE 0x806129C0 RB_PT_PCT_SWC_GAC_RecordLayouts_RL_Curve_sint16_4_sint16_4 40.0 RB_PT_PCT_SWC_GAC_CompuMethods_ratio_0p001 -20. 20. FORMAT "%10.5"
 /begin ANNOTATION ANNOTATION_LABEL "Description (coming from AUTOSAR DESC field)"
  /begin ANNOTATION_TEXT "Actuator position which NStop phase is activated - positive gear case.\r\n" /end ANNOTATION_TEXT
 /end ANNOTATION
 /begin AXIS_DESCR STD_AXIS NO_INPUT_QUANTITY RB_PT_PCT_SWC_GAC_CompuMethods_ident 4 -50. 200. FORMAT "%10.5" DEPOSIT ABSOLUTE /end AXIS_DESCR
/end CHARACTERISTIC
/begin CHARACTERISTIC GAC_CALIB.GAC_GracC.GAC_POSNSYNCFORCEEND "" VALUE 0x80612450 DefaultValueRecordLayout_AUTOSAR_Platform_BaseTypes_uint16 20.0 RB_PT_PCT_SWC_GAC_CompuMethods_ratio_0p001 0.0 20. FORMAT "%10.5"
 /begin ANNOTATION ANNOTATION_LABEL "Description (coming from AUTOSAR DESC field)"
  /begin ANNOTATION_TEXT "Position that the synchronisation phase is forced to end\r\n" /end ANNOTATION_TEXT
 /end ANNOTATION
/end CHARACTERISTIC
/begin CHARACTERISTIC GAC_CALIB.GAC_GracC.GAC_POSNTOLEXITNEOLDONE "" VALUE 0x80612452 DefaultValueRecordLayout_AUTOSAR_Platform_BaseTypes_sint16 40.0 RB_PT_PCT_SWC_GAC_CompuMethods_ratio_0p001 -20. 20. FORMAT "%10.5"
 /begin ANNOTATION ANNOTATION_LABEL "Description (coming from AUTOSAR DESC field)"
  /begin ANNOTATION_TEXT "Neutral position tolerance when EOL Neutral learn has completed.\r\n" /end ANNOTATION_TEXT
 /end ANNOTATION
/end CHARACTERISTIC
/begin CHARACTERISTIC GAC_CALIB.GAC_GracC.GAC_POSNTOLGHOLD "" VALUE 0x80612454 DefaultValueRecordLayout_AUTOSAR_Platform_BaseTypes_uint16 5.0 RB_PT_PCT_SWC_GAC_CompuMethods_ratio_0p001 0.0 5. FORMAT "%10.5"
 /begin ANNOTATION ANNOTATION_LABEL "Description (coming from AUTOSAR DESC field)"
  /begin ANNOTATION_TEXT "Position tolerance used for gear hold phase target position.\r\n" /end ANNOTATION_TEXT
 /end ANNOTATION
/end CHARACTERISTIC
/begin CHARACTERISTIC GAC_CALIB.GAC_GracC.GAC_POSNTOLINNEOLDONE "" VALUE 0x80612456 DefaultValueRecordLayout_AUTOSAR_Platform_BaseTypes_sint16 40.0 RB_PT_PCT_SWC_GAC_CompuMethods_ratio_0p001 -20. 20. FORMAT "%10.5"
 /begin ANNOTATION ANNOTATION_LABEL "Description (coming from AUTOSAR DESC field)"
  /begin ANNOTATION_TEXT "Neutral position tolerance when EOL Neutral learn has completed.\r\n" /end ANNOTATION_TEXT
 /end ANNOTATION
/end CHARACTERISTIC
/begin CHARACTERISTIC GAC_CALIB.GAC_GracC.GAC_POSNTRIGNSTOPDFLT "" VALUE 0x80612458 DefaultValueRecordLayout_AUTOSAR_Platform_BaseTypes_sint16 40.0 RB_PT_PCT_SWC_GAC_CompuMethods_ratio_0p001 -20. 20. FORMAT "%10.5"
 /begin ANNOTATION ANNOTATION_LABEL "Description (coming from AUTOSAR DESC field)"
  /begin ANNOTATION_TEXT "Actuator position which NStop phase is activated - default value.\r\n" /end ANNOTATION_TEXT
 /end ANNOTATION
/end CHARACTERISTIC
/begin CHARACTERISTIC GAC_CALIB.GAC_GracC.GAC_PPPULSETMC "" VALUE 0x8061245A DefaultValueRecordLayout_AUTOSAR_Platform_BaseTypes_sint16 200.0 RB_PT_PCT_SWC_GAC_CompuMethods_ident -100. 100. FORMAT "%10.5"
 /begin ANNOTATION ANNOTATION_LABEL "Description (coming from AUTOSAR DESC field)"
  /begin ANNOTATION_TEXT "pP valve pressure pulse time linear function - intercept value.\r\n" /end ANNOTATION_TEXT
 /end ANNOTATION
/end CHARACTERISTIC
/begin CHARACTERISTIC GAC_CALIB.GAC_GracC.GAC_PPPULSETMM "" VALUE 0x8061245C DefaultValueRecordLayout_AUTOSAR_Platform_BaseTypes_sint16 2.0 RB_PT_PCT_SWC_GAC_CompuMethods_ratio_0p01 -1. 1. FORMAT "%10.5"
 /begin ANNOTATION ANNOTATION_LABEL "Description (coming from AUTOSAR DESC field)"
  /begin ANNOTATION_TEXT "pP valve pressure pulse time linear function - gradient value.\r\n" /end ANNOTATION_TEXT
 /end ANNOTATION
/end CHARACTERISTIC
/begin CHARACTERISTIC GAC_CALIB.GAC_GracC.GAC_PRESSADDGBLKTMOUT "" VALUE 0x8061245E DefaultValueRecordLayout_AUTOSAR_Platform_BaseTypes_uint16 32.0 RB_PT_PCT_SWC_GAC_CompuMethods_ratio_0p001 0.0 32. FORMAT "%10.5"
 /begin ANNOTATION ANNOTATION_LABEL "Description (coming from AUTOSAR DESC field)" /begin ANNOTATION_TEXT "Pressure step added for gear block timeout.\r\n" /end ANNOTATION_TEXT /end ANNOTATION
/end CHARACTERISTIC
/begin CHARACTERISTIC GAC_CALIB.GAC_GracC.GAC_PRESSFFVELCTRLNOSYNC "" MAP 0x806129D2 RB_PT_PCT_SWC_GAC_RecordLayouts_RL_Map_uint16_12_uint16_6_sint16_2 32.0 RB_PT_PCT_SWC_GAC_CompuMethods_ratio_0p001 0.0 32. FORMAT "%10.5"
 /begin ANNOTATION ANNOTATION_LABEL "Description (coming from AUTOSAR DESC field)"
  /begin ANNOTATION_TEXT "Feedforward pressure gains for velocity control before the synchro phase or Neutral actuation.\r\n" /end ANNOTATION_TEXT
 /end ANNOTATION
 /begin AXIS_DESCR STD_AXIS NO_INPUT_QUANTITY RB_PT_PCT_SWC_GAC_CompuMethods_ratio_0p001 6 0.0 1.2 FORMAT "%10.5" DEPOSIT ABSOLUTE /end AXIS_DESCR
 /begin AXIS_DESCR STD_AXIS NO_INPUT_QUANTITY RB_PT_PCT_SWC_GAC_CompuMethods_ident 2 -50. 200. FORMAT "%10.5" DEPOSIT ABSOLUTE /end AXIS_DESCR
/end CHARACTERISTIC
/begin CHARACTERISTIC GAC_CALIB.GAC_GracC.GAC_PRESSFFVELCTRLNOSYNC2 "" CURVE 0x806129FE RB_PT_PCT_SWC_GAC_RecordLayouts_RL_Curve_uint16_5_uint16_5 32.0 RB_PT_PCT_SWC_GAC_CompuMethods_ratio_0p001 0.0 32. FORMAT "%10.5"
 /begin ANNOTATION ANNOTATION_LABEL "Description (coming from AUTOSAR DESC field)"
  /begin ANNOTATION_TEXT "Feedforward pressure gains for velocity control before the synchro phase or Neutral actuation.\r\n" /end ANNOTATION_TEXT
 /end ANNOTATION
 /begin AXIS_DESCR STD_AXIS NO_INPUT_QUANTITY RB_PT_PCT_SWC_GAC_CompuMethods_ratio_0p001 5 0.0 1.2 FORMAT "%10.5" DEPOSIT ABSOLUTE /end AXIS_DESCR
/end CHARACTERISTIC
/begin CHARACTERISTIC GAC_CALIB.GAC_GracC.GAC_PRESSFFVELCTRLSYNC "" MAP 0x80612A14 RB_PT_PCT_SWC_GAC_RecordLayouts_RL_Map_uint16_10_uint16_5_sint16_2 32.0 RB_PT_PCT_SWC_GAC_CompuMethods_ratio_0p001 0.0 32. FORMAT "%10.5"
 /begin ANNOTATION ANNOTATION_LABEL "Description (coming from AUTOSAR DESC field)"
  /begin ANNOTATION_TEXT "Feedforward pressure gains for velocity control after the synchro phase.\r\n" /end ANNOTATION_TEXT
 /end ANNOTATION
 /begin AXIS_DESCR STD_AXIS NO_INPUT_QUANTITY RB_PT_PCT_SWC_GAC_CompuMethods_ratio_0p001 5 0.0 1.2 FORMAT "%10.5" DEPOSIT ABSOLUTE /end AXIS_DESCR
 /begin AXIS_DESCR STD_AXIS NO_INPUT_QUANTITY RB_PT_PCT_SWC_GAC_CompuMethods_ident 2 -50. 200. FORMAT "%10.5" DEPOSIT ABSOLUTE /end AXIS_DESCR
/end CHARACTERISTIC
/begin CHARACTERISTIC GAC_CALIB.GAC_GracC.GAC_PRESSFFVELCTRLSYNC2 "" CURVE 0x80612A3A RB_PT_PCT_SWC_GAC_RecordLayouts_RL_Curve_uint16_4_uint16_4 32.0 RB_PT_PCT_SWC_GAC_CompuMethods_ratio_0p001 0.0 32. FORMAT "%10.5"
 /begin ANNOTATION ANNOTATION_LABEL "Description (coming from AUTOSAR DESC field)"
  /begin ANNOTATION_TEXT "Feedforward pressure gains for velocity control after the synchro phase.\r\n" /end ANNOTATION_TEXT
 /end ANNOTATION
 /begin AXIS_DESCR STD_AXIS NO_INPUT_QUANTITY RB_PT_PCT_SWC_GAC_CompuMethods_ratio_0p001 4 0.0 1.2 FORMAT "%10.5" DEPOSIT ABSOLUTE /end AXIS_DESCR
/end CHARACTERISTIC
/begin CHARACTERISTIC GAC_CALIB.GAC_GracC.GAC_PRESSGHOLDACTV "" VALUE 0x80612460 DefaultValueRecordLayout_AUTOSAR_Platform_BaseTypes_uint16 32.0 RB_PT_PCT_SWC_GAC_CompuMethods_ratio_0p001 0.0 32. FORMAT "%10.5"
 /begin ANNOTATION ANNOTATION_LABEL "Description (coming from AUTOSAR DESC field)" /begin ANNOTATION_TEXT "Pressure request for GHold active.\r\n" /end ANNOTATION_TEXT /end ANNOTATION
/end CHARACTERISTIC
/begin CHARACTERISTIC GAC_CALIB.GAC_GracC.GAC_PRESSGHOLDACTVNOADAPTION "" VALUE 0x80612462 DefaultValueRecordLayout_AUTOSAR_Platform_BaseTypes_uint16 32.0 RB_PT_PCT_SWC_GAC_CompuMethods_ratio_0p001 0.0 32. FORMAT "%10.5"
 /begin ANNOTATION ANNOTATION_LABEL "Description (coming from AUTOSAR DESC field)" /begin ANNOTATION_TEXT "Pressure request for GHold active.\r\n" /end ANNOTATION_TEXT /end ANNOTATION
/end CHARACTERISTIC
/begin CHARACTERISTIC GAC_CALIB.GAC_GracC.GAC_PRESSGHOLDACTVNOOTHERSHIFT "" VALUE 0x80612464 DefaultValueRecordLayout_AUTOSAR_Platform_BaseTypes_uint16 32.0 RB_PT_PCT_SWC_GAC_CompuMethods_ratio_0p001 0.0 32. FORMAT "%10.5"
 /begin ANNOTATION ANNOTATION_LABEL "Description (coming from AUTOSAR DESC field)" /begin ANNOTATION_TEXT "Pressure request for GHold active.\r\n" /end ANNOTATION_TEXT /end ANNOTATION
/end CHARACTERISTIC
/begin CHARACTERISTIC GAC_CALIB.GAC_GracC.GAC_PRESSGHOLDACTVRULE26 "" VALUE 0x80612466 DefaultValueRecordLayout_AUTOSAR_Platform_BaseTypes_uint16 32.0 RB_PT_PCT_SWC_GAC_CompuMethods_ratio_0p001 0.0 32. FORMAT "%10.5"
 /begin ANNOTATION ANNOTATION_LABEL "Description (coming from AUTOSAR DESC field)" /begin ANNOTATION_TEXT "Pressure request for GHold active.\r\n" /end ANNOTATION_TEXT /end ANNOTATION
/end CHARACTERISTIC
/begin CHARACTERISTIC GAC_CALIB.GAC_GracC.GAC_PRESSGHOLDACTVSTATIC "" VALUE 0x80612468 DefaultValueRecordLayout_AUTOSAR_Platform_BaseTypes_uint16 32.0 RB_PT_PCT_SWC_GAC_CompuMethods_ratio_0p001 0.0 32. FORMAT "%10.5"
 /begin ANNOTATION ANNOTATION_LABEL "Description (coming from AUTOSAR DESC field)" /begin ANNOTATION_TEXT "Pressure request for GHold active static cases\r\n" /end ANNOTATION_TEXT /end ANNOTATION
/end CHARACTERISTIC
/begin CHARACTERISTIC GAC_CALIB.GAC_GracC.GAC_PRESSIVELCTRL "" CURVE 0x80612A4C RB_PT_PCT_SWC_GAC_RecordLayouts_RL_Curve_sint16_7_sint16_7 64.0 RB_PT_PCT_SWC_GAC_CompuMethods_ratio_0p001 -32. 32. FORMAT "%10.5"
 /begin ANNOTATION ANNOTATION_LABEL "Description (coming from AUTOSAR DESC field)" /begin ANNOTATION_TEXT "Integral pressure gains for velocity control.\r\n" /end ANNOTATION_TEXT /end ANNOTATION
 /begin AXIS_DESCR STD_AXIS NO_INPUT_QUANTITY RB_PT_PCT_SWC_GAC_CompuMethods_ratio_0p001 7 -1.2 1.2 FORMAT "%10.5" DEPOSIT ABSOLUTE /end AXIS_DESCR
/end CHARACTERISTIC
/begin CHARACTERISTIC GAC_CALIB.GAC_GracC.GAC_PRESSIVELCTRLGBLOCK2 "" CURVE 0x80612A6A RB_PT_PCT_SWC_GAC_RecordLayouts_RL_Curve_sint16_7_sint16_7 64.0 RB_PT_PCT_SWC_GAC_CompuMethods_ratio_0p001 -32. 32. FORMAT "%10.5"
 /begin ANNOTATION ANNOTATION_LABEL "Description (coming from AUTOSAR DESC field)" /begin ANNOTATION_TEXT "Integral pressure gains for velocity control.\r\n" /end ANNOTATION_TEXT /end ANNOTATION
 /begin AXIS_DESCR STD_AXIS NO_INPUT_QUANTITY RB_PT_PCT_SWC_GAC_CompuMethods_ratio_0p001 7 -1.2 1.2 FORMAT "%10.5" DEPOSIT ABSOLUTE /end AXIS_DESCR
/end CHARACTERISTIC
/begin CHARACTERISTIC GAC_CALIB.GAC_GracC.GAC_PRESSIVELCTRLGBLOCK3 "" CURVE 0x80612A88 RB_PT_PCT_SWC_GAC_RecordLayouts_RL_Curve_sint16_4_sint16_4 64.0 RB_PT_PCT_SWC_GAC_CompuMethods_ratio_0p001 -32. 32. FORMAT "%10.5"
 /begin ANNOTATION ANNOTATION_LABEL "Description (coming from AUTOSAR DESC field)" /begin ANNOTATION_TEXT "Integral pressure gains for velocity control.\r\n" /end ANNOTATION_TEXT /end ANNOTATION
 /begin AXIS_DESCR STD_AXIS NO_INPUT_QUANTITY RB_PT_PCT_SWC_GAC_CompuMethods_ratio_0p001 4 -1.2 1.2 FORMAT "%10.5" DEPOSIT ABSOLUTE /end AXIS_DESCR
/end CHARACTERISTIC
/begin CHARACTERISTIC GAC_CALIB.GAC_GracC.GAC_PRESSMINEVPOSTSYNC "" VALUE 0x8061246A DefaultValueRecordLayout_AUTOSAR_Platform_BaseTypes_uint16 32.0 RB_PT_PCT_SWC_GAC_CompuMethods_ratio_0p001 0.0 32. FORMAT "%10.5"
 /begin ANNOTATION ANNOTATION_LABEL "Description (coming from AUTOSAR DESC field)" /begin ANNOTATION_TEXT "Minimum pressure demand during velocity control.\r\n" /end ANNOTATION_TEXT /end ANNOTATION
/end CHARACTERISTIC
/begin CHARACTERISTIC GAC_CALIB.GAC_GracC.GAC_PRESSMINVELCTRLDEM "" VALUE 0x8061246C DefaultValueRecordLayout_AUTOSAR_Platform_BaseTypes_uint16 32.0 RB_PT_PCT_SWC_GAC_CompuMethods_ratio_0p001 0.0 32. FORMAT "%10.5"
 /begin ANNOTATION ANNOTATION_LABEL "Description (coming from AUTOSAR DESC field)" /begin ANNOTATION_TEXT "Minimum pressure demand during velocity control.\r\n" /end ANNOTATION_TEXT /end ANNOTATION
/end CHARACTERISTIC
/begin CHARACTERISTIC GAC_CALIB.GAC_GracC.GAC_PRESSMINVELCTRLDEMMAP "" CURVE 0x80612A9A RB_PT_PCT_SWC_GAC_RecordLayouts_RL_Curve_uint16_4_sint16_4 32.0 RB_PT_PCT_SWC_GAC_CompuMethods_ratio_0p001 0.0 32. FORMAT "%10.5"
 /begin ANNOTATION ANNOTATION_LABEL "Description (coming from AUTOSAR DESC field)"
  /begin ANNOTATION_TEXT "Minimum pressure demand during velocity control based on temperature\r\n" /end ANNOTATION_TEXT
 /end ANNOTATION
 /begin AXIS_DESCR STD_AXIS NO_INPUT_QUANTITY RB_PT_PCT_SWC_GAC_CompuMethods_ident 4 -50. 200. FORMAT "%10.5" DEPOSIT ABSOLUTE /end AXIS_DESCR
/end CHARACTERISTIC
/begin CHARACTERISTIC GAC_CALIB.GAC_GracC.GAC_PRESSONFLWVELCTRLNOSYNC "" MAP 0x80612AAC RB_PT_PCT_SWC_GAC_RecordLayouts_RL_Map_uint16_10_uint16_5_sint16_2 32.0 RB_PT_PCT_SWC_GAC_CompuMethods_ratio_0p001 0.0 32. FORMAT "%10.5"
 /begin ANNOTATION ANNOTATION_LABEL "Description (coming from AUTOSAR DESC field)"
  /begin ANNOTATION_TEXT "Flow based pressure gains for velocity control before the synchro phase.\r\n" /end ANNOTATION_TEXT
 /end ANNOTATION
 /begin AXIS_DESCR STD_AXIS NO_INPUT_QUANTITY RB_PT_PCT_SWC_GAC_CompuMethods_ratio_0p001 5 0.0 32. FORMAT "%10.5" DEPOSIT ABSOLUTE /end AXIS_DESCR
 /begin AXIS_DESCR STD_AXIS NO_INPUT_QUANTITY RB_PT_PCT_SWC_GAC_CompuMethods_ident 2 -50. 200. FORMAT "%10.5" DEPOSIT ABSOLUTE /end AXIS_DESCR
/end CHARACTERISTIC
/begin CHARACTERISTIC GAC_CALIB.GAC_GracC.GAC_PRESSONFLWVELCTRLNOSYNC2 "" CURVE 0x80612AD2 RB_PT_PCT_SWC_GAC_RecordLayouts_RL_Curve_uint16_3_uint16_3 32.0 RB_PT_PCT_SWC_GAC_CompuMethods_ratio_0p001 0.0 32. FORMAT "%10.5"
 /begin ANNOTATION ANNOTATION_LABEL "Description (coming from AUTOSAR DESC field)"
  /begin ANNOTATION_TEXT "Flow based pressure gains for velocity control before the synchro phase.\r\n" /end ANNOTATION_TEXT
 /end ANNOTATION
 /begin AXIS_DESCR STD_AXIS NO_INPUT_QUANTITY RB_PT_PCT_SWC_GAC_CompuMethods_ratio_0p001 3 0.0 32. FORMAT "%10.5" DEPOSIT ABSOLUTE /end AXIS_DESCR
/end CHARACTERISTIC
/begin CHARACTERISTIC GAC_CALIB.GAC_GracC.GAC_PRESSONFLWVELCTRLSYNC "" CURVE 0x80612AE0 RB_PT_PCT_SWC_GAC_RecordLayouts_RL_Curve_uint16_5_uint16_5 32.0 RB_PT_PCT_SWC_GAC_CompuMethods_ratio_0p001 0.0 32. FORMAT "%10.5"
 /begin ANNOTATION ANNOTATION_LABEL "Description (coming from AUTOSAR DESC field)"
  /begin ANNOTATION_TEXT "Flow based pressure gains for velocity control after the synchro phase.\r\n" /end ANNOTATION_TEXT
 /end ANNOTATION
 /begin AXIS_DESCR STD_AXIS NO_INPUT_QUANTITY RB_PT_PCT_SWC_GAC_CompuMethods_ratio_0p001 5 0.0 32. FORMAT "%10.5" DEPOSIT ABSOLUTE /end AXIS_DESCR
/end CHARACTERISTIC
/begin CHARACTERISTIC GAC_CALIB.GAC_GracC.GAC_PRESSPVLVPULSE "" VALUE 0x8061246E DefaultValueRecordLayout_AUTOSAR_Platform_BaseTypes_uint16 32.0 RB_PT_PCT_SWC_GAC_CompuMethods_ratio_0p001 0.0 32. FORMAT "%10.5"
 /begin ANNOTATION ANNOTATION_LABEL "Description (coming from AUTOSAR DESC field)" /begin ANNOTATION_TEXT "Pressure request for pressure valve pulse phase.\r\n" /end ANNOTATION_TEXT /end ANNOTATION
/end CHARACTERISTIC
/begin CHARACTERISTIC GAC_CALIB.GAC_GracC.GAC_PRESSPVLVPULSEDRAIN "" VALUE 0x80612470 DefaultValueRecordLayout_AUTOSAR_Platform_BaseTypes_uint16 32.0 RB_PT_PCT_SWC_GAC_CompuMethods_ratio_0p001 0.0 32. FORMAT "%10.5"
 /begin ANNOTATION ANNOTATION_LABEL "Description (coming from AUTOSAR DESC field)"
  /begin ANNOTATION_TEXT "Pressure request for pressure valve pulse if drain phase not yet completed.\r\n" /end ANNOTATION_TEXT
 /end ANNOTATION
/end CHARACTERISTIC
/begin CHARACTERISTIC GAC_CALIB.GAC_GracC.GAC_PRESSSYNCENDEVMAX "" VALUE 0x80612472 DefaultValueRecordLayout_AUTOSAR_Platform_BaseTypes_uint16 32.0 RB_PT_PCT_SWC_GAC_CompuMethods_ratio_0p001 0.0 32. FORMAT "%10.5"
 /begin ANNOTATION ANNOTATION_LABEL "Description (coming from AUTOSAR DESC field)"
  /begin ANNOTATION_TEXT "Max pressure to hand over into the sync end phase in EV mode\r\n" /end ANNOTATION_TEXT
 /end ANNOTATION
/end CHARACTERISTIC
/begin CHARACTERISTIC GAC_CALIB.GAC_GracC.GAC_PVlvPulseTmr.LIB_DT "" VALUE 0x80612716 DefaultValueRecordLayout_AUTOSAR_Platform_BaseTypes_uint16 65.535 RB_PT_PCT_SWC_GAC_CompuMethods_ratio_0p001 0.0 65.535 FORMAT "%10.5"
 /begin ANNOTATION ANNOTATION_LABEL "Description (coming from AUTOSAR DESC field)" /begin ANNOTATION_TEXT "Timer decrement value.\r\n" /end ANNOTATION_TEXT /end ANNOTATION
/end CHARACTERISTIC
/begin CHARACTERISTIC GAC_CALIB.GAC_GracC.GAC_ROCSPDSYNCSLIPTGTMAX "" VALUE 0x8061241C DefaultValueRecordLayout_AUTOSAR_Platform_BaseTypes_uint32 100000.0 RB_PT_PCT_SWC_GAC_CompuMethods_ratio_10p0 0.0 100000. FORMAT "%10.5"
 /begin ANNOTATION ANNOTATION_LABEL "Description (coming from AUTOSAR DESC field)"
  /begin ANNOTATION_TEXT "Maximum limit for target rate of change of synchro slip.\r\n" /end ANNOTATION_TEXT
 /end ANNOTATION
/end CHARACTERISTIC
/begin CHARACTERISTIC GAC_CALIB.GAC_GracC.GAC_ROCSPDSYNCSLIPTGTMIN "" VALUE 0x80612420 DefaultValueRecordLayout_AUTOSAR_Platform_BaseTypes_uint32 100000.0 RB_PT_PCT_SWC_GAC_CompuMethods_ratio_10p0 0.0 100000. FORMAT "%10.5"
 /begin ANNOTATION ANNOTATION_LABEL "Description (coming from AUTOSAR DESC field)"
  /begin ANNOTATION_TEXT "Minimum limit for target rate of change of synchro slip.\r\n" /end ANNOTATION_TEXT
 /end ANNOTATION
/end CHARACTERISTIC
/begin CHARACTERISTIC GAC_CALIB.GAC_GracC.GAC_ROCSYNCSLIPGRPOS "" VALUE 0x80612474 DefaultValueRecordLayout_AUTOSAR_Platform_BaseTypes_sint16 655350.0 RB_PT_PCT_SWC_GAC_CompuMethods_ratio_10p0 -327680. 327670. FORMAT "%10.5"
 /begin ANNOTATION ANNOTATION_LABEL "Description (coming from AUTOSAR DESC field)"
  /begin ANNOTATION_TEXT "Rate of change of synchro slip used for synchro start detection on the positive gear.\r\n" /end ANNOTATION_TEXT
 /end ANNOTATION
/end CHARACTERISTIC
/begin CHARACTERISTIC GAC_CALIB.GAC_GracC.GAC_SPDSLIPSYNCFORGBLK0 "" VALUE 0x80612476 DefaultValueRecordLayout_AUTOSAR_Platform_BaseTypes_sint16 40000.0 RB_PT_PCT_SWC_GAC_CompuMethods_ident -20000. 20000. FORMAT "%10.5"
 /begin ANNOTATION ANNOTATION_LABEL "Description (coming from AUTOSAR DESC field)"
  /begin ANNOTATION_TEXT "Initial synchroniser slip used for allowing synchoniser start detection.\r\n" /end ANNOTATION_TEXT
 /end ANNOTATION
/end CHARACTERISTIC
/begin CHARACTERISTIC GAC_CALIB.GAC_GracC.GAC_SPDSLIPSYNCFORONSYNC "" VALUE 0x80612478 DefaultValueRecordLayout_AUTOSAR_Platform_BaseTypes_sint16 40000.0 RB_PT_PCT_SWC_GAC_CompuMethods_ident -20000. 20000. FORMAT "%10.5"
 /begin ANNOTATION ANNOTATION_LABEL "Description (coming from AUTOSAR DESC field)"
  /begin ANNOTATION_TEXT "Initial synchroniser slip used for allowing synchoniser start detection.\r\n" /end ANNOTATION_TEXT
 /end ANNOTATION
/end CHARACTERISTIC
/begin CHARACTERISTIC GAC_CALIB.GAC_GracC.GAC_SPDSSLIPSYNCEND "" CURVE 0x80612AF6 RB_PT_PCT_SWC_GAC_RecordLayouts_RL_Curve_uint16_5_sint16_5 20000.0 RB_PT_PCT_SWC_GAC_CompuMethods_ident 0.0 20000. FORMAT "%10.5"
 /begin ANNOTATION ANNOTATION_LABEL "Description (coming from AUTOSAR DESC field)"
  /begin ANNOTATION_TEXT "Synchro slip speed thresholds for detection of synchronisation end, based on transmission output speed.\r\n" /end ANNOTATION_TEXT
 /end ANNOTATION
 /begin AXIS_DESCR STD_AXIS NO_INPUT_QUANTITY RB_PT_PCT_SWC_GAC_CompuMethods_ident 5 -20000. 20000. FORMAT "%10.5" DEPOSIT ABSOLUTE /end AXIS_DESCR
/end CHARACTERISTIC
/begin CHARACTERISTIC GAC_CALIB.GAC_GracC.GAC_SPEEDSLIPTHRESHAGAINSTDRAG "" VALUE 0x8061247A DefaultValueRecordLayout_AUTOSAR_Platform_BaseTypes_sint16 40000.0 RB_PT_PCT_SWC_GAC_CompuMethods_ident -20000. 20000. FORMAT "%10.5"
 /begin ANNOTATION ANNOTATION_LABEL "Description (coming from AUTOSAR DESC field)"
  /begin ANNOTATION_TEXT "slip speed required to complete synchronise against drag strategy\r\n" /end ANNOTATION_TEXT
 /end ANNOTATION
/end CHARACTERISTIC
/begin CHARACTERISTIC GAC_CALIB.GAC_GracC.GAC_SyncAgainstDragTmr.LIB_DT "" VALUE 0x80612718 DefaultValueRecordLayout_AUTOSAR_Platform_BaseTypes_uint16 65.535 RB_PT_PCT_SWC_GAC_CompuMethods_ratio_0p001 0.0 65.535 FORMAT "%10.5"
 /begin ANNOTATION ANNOTATION_LABEL "Description (coming from AUTOSAR DESC field)" /begin ANNOTATION_TEXT "Timer decrement value.\r\n" /end ANNOTATION_TEXT /end ANNOTATION
/end CHARACTERISTIC
/begin CHARACTERISTIC GAC_CALIB.GAC_GracC.GAC_SyncCtrl.GAC_FCTSYNCPRESSBLEND "" CURVE 0x80612778 RB_PT_PCT_SWC_GAC_RecordLayouts_RL_Curve_uint8_6_uint8_6 1.0 RB_PT_PCT_SWC_GAC_CompuMethods_ratio_0p01 0.0 1. FORMAT "%10.5"
 /begin ANNOTATION ANNOTATION_LABEL "Description (coming from AUTOSAR DESC field)"
  /begin ANNOTATION_TEXT "Pressure blending multiplication factor as a function of synchronisation progression\r\n" /end ANNOTATION_TEXT
 /end ANNOTATION
 /begin AXIS_DESCR STD_AXIS NO_INPUT_QUANTITY RB_PT_PCT_SWC_GAC_CompuMethods_ratio_0p01 6 0.0 1. FORMAT "%10.5" DEPOSIT ABSOLUTE /end AXIS_DESCR
/end CHARACTERISTIC
/begin CHARACTERISTIC GAC_CALIB.GAC_GracC.GAC_SyncCtrl.GAC_FLGENBLBLK0HIRAMP "" VALUE 0x8061276E DefaultValueRecordLayout_AUTOSAR_Platform_BaseTypes_uint8 255.0 DefaultIdenticalCompu 0.0 255. FORMAT "%10.5"
 /begin ANNOTATION ANNOTATION_LABEL "Description (coming from AUTOSAR DESC field)"
  /begin ANNOTATION_TEXT "enable/disable flag for ramping the pressure aggressively when gear blocking type 0 occurs\r\n" /end ANNOTATION_TEXT
 /end ANNOTATION
/end CHARACTERISTIC
/begin CHARACTERISTIC GAC_CALIB.GAC_GracC.GAC_SyncCtrl.GAC_FLGENBLCALCSYNCPRESSTGT "" VALUE 0x8061276F DefaultValueRecordLayout_AUTOSAR_Platform_BaseTypes_uint8 255.0 DefaultIdenticalCompu 0.0 255. FORMAT "%10.5"
 /begin ANNOTATION ANNOTATION_LABEL "Description (coming from AUTOSAR DESC field)" /begin ANNOTATION_TEXT "flag to enable calculated pressure target\r\n" /end ANNOTATION_TEXT /end ANNOTATION
/end CHARACTERISTIC
/begin CHARACTERISTIC GAC_CALIB.GAC_GracC.GAC_SyncCtrl.GAC_FLGENBLPRESSURESHUNT "" VALUE 0x80612770 DefaultValueRecordLayout_AUTOSAR_Platform_BaseTypes_uint8 255.0 DefaultIdenticalCompu 0.0 255. FORMAT "%10.5"
 /begin ANNOTATION ANNOTATION_LABEL "Description (coming from AUTOSAR DESC field)" /begin ANNOTATION_TEXT "flag to enable pressure shunt feature\r\n" /end ANNOTATION_TEXT /end ANNOTATION
/end CHARACTERISTIC
/begin CHARACTERISTIC GAC_CALIB.GAC_GracC.GAC_SyncCtrl.GAC_FLGENBLPRESSURESHUNT1STATTEMPT "" VALUE 0x80612771 DefaultValueRecordLayout_AUTOSAR_Platform_BaseTypes_uint8 255.0 DefaultIdenticalCompu 0.0 255. FORMAT "%10.5"
 /begin ANNOTATION ANNOTATION_LABEL "Description (coming from AUTOSAR DESC field)"
  /begin ANNOTATION_TEXT "flag to enable pressure shunt feature at the first engagement attempt\r\n" /end ANNOTATION_TEXT
 /end ANNOTATION
/end CHARACTERISTIC
/begin CHARACTERISTIC GAC_CALIB.GAC_GracC.GAC_SyncCtrl.GAC_FLGEVMODEGBLK0ENBL "" VALUE 0x80612772 DefaultValueRecordLayout_AUTOSAR_Platform_BaseTypes_uint8 255.0 DefaultIdenticalCompu 0.0 255. FORMAT "%10.5"
 /begin ANNOTATION ANNOTATION_LABEL "Description (coming from AUTOSAR DESC field)" /begin ANNOTATION_TEXT "Flag to enable EV mode gblock 0 pressure spike\r\n" /end ANNOTATION_TEXT /end ANNOTATION
/end CHARACTERISTIC
/begin CHARACTERISTIC GAC_CALIB.GAC_GracC.GAC_SyncCtrl.GAC_FLGLATCHSYNCBLENDUNTILEND "" VALUE 0x80612773 DefaultValueRecordLayout_AUTOSAR_Platform_BaseTypes_uint8 255.0 DefaultIdenticalCompu 0.0 255. FORMAT "%10.5"
 /begin ANNOTATION ANNOTATION_LABEL "Description (coming from AUTOSAR DESC field)" /begin ANNOTATION_TEXT "latch the synchronisation blend until end\r\n" /end ANNOTATION_TEXT /end ANNOTATION
/end CHARACTERISTIC
/begin CHARACTERISTIC GAC_CALIB.GAC_GracC.GAC_SyncCtrl.GAC_FLGSSTEPTOMAXFRKPEAK1STATTEMPT "" VAL_BLK 0x8061274A DefaultValueRecordLayout_AUTOSAR_Platform_BaseTypes_uint8 255.0 DefaultIdenticalCompu 0.0 255. FORMAT "%10.5"
 /begin ANNOTATION ANNOTATION_LABEL "Description (coming from AUTOSAR DESC field)"
  /begin ANNOTATION_TEXT "allow the pressure command to go from the lower to the higher pressure limit based on aggression command\r\n" /end ANNOTATION_TEXT
 /end ANNOTATION
 MATRIX_DIM 5 1 1 /end CHARACTERISTIC
/begin CHARACTERISTIC GAC_CALIB.GAC_GracC.GAC_SyncCtrl.GAC_FLWSSYNCCTRLTGT "" VAL_BLK 0x8061271A DefaultValueRecordLayout_AUTOSAR_Platform_BaseTypes_sint16 64.0 RB_PT_PCT_SWC_GAC_CompuMethods_ratio_0p001 -32. 32. FORMAT "%10.5"
 /begin ANNOTATION ANNOTATION_LABEL "Description (coming from AUTOSAR DESC field)"
  /begin ANNOTATION_TEXT "Flow targets for synchro control for each actuation aggression.\r\n" /end ANNOTATION_TEXT
 /end ANNOTATION
 MATRIX_DIM 4 1 1 /end CHARACTERISTIC
/begin CHARACTERISTIC GAC_CALIB.GAC_GracC.GAC_SyncCtrl.GAC_FLWSYNCCTRLVLOWTGT "" VALUE 0x80612750 DefaultValueRecordLayout_AUTOSAR_Platform_BaseTypes_sint16 64.0 RB_PT_PCT_SWC_GAC_CompuMethods_ratio_0p001 -32. 32. FORMAT "%10.5"
 /begin ANNOTATION ANNOTATION_LABEL "Description (coming from AUTOSAR DESC field)"
  /begin ANNOTATION_TEXT "Flow target for synchro control for very low aggression actuation.\r\n" /end ANNOTATION_TEXT
 /end ANNOTATION
/end CHARACTERISTIC
/begin CHARACTERISTIC GAC_CALIB.GAC_GracC.GAC_SyncCtrl.GAC_PRESSIADDGBLOCK "" VALUE 0x80612752 DefaultValueRecordLayout_AUTOSAR_Platform_BaseTypes_sint16 64.0 RB_PT_PCT_SWC_GAC_CompuMethods_ratio_0p001 -32. 32. FORMAT "%10.5"
 /begin ANNOTATION ANNOTATION_LABEL "Description (coming from AUTOSAR DESC field)"
  /begin ANNOTATION_TEXT "Additive integral pressure term for synchro control when gear blocking type 0 occurs\r\n" /end ANNOTATION_TEXT
 /end ANNOTATION
/end CHARACTERISTIC
/begin CHARACTERISTIC GAC_CALIB.GAC_GracC.GAC_SyncCtrl.GAC_PRESSIADDNOSLIP "" VALUE 0x80612754 DefaultValueRecordLayout_AUTOSAR_Platform_BaseTypes_sint16 64.0 RB_PT_PCT_SWC_GAC_CompuMethods_ratio_0p001 -32. 32. FORMAT "%10.5"
 /begin ANNOTATION ANNOTATION_LABEL "Description (coming from AUTOSAR DESC field)"
  /begin ANNOTATION_TEXT "Additive integral pressure term for synchro control when syncrhro slip is negligible\r\n" /end ANNOTATION_TEXT
 /end ANNOTATION
/end CHARACTERISTIC
/begin CHARACTERISTIC GAC_CALIB.GAC_GracC.GAC_SyncCtrl.GAC_PRESSIADDSYNCHIGRNEG "" CURVE 0x80612786 RB_PT_PCT_SWC_GAC_RecordLayouts_RL_Curve_sint16_5_uint16_5 64.0 RB_PT_PCT_SWC_GAC_CompuMethods_ratio_0p001 -32. 32. FORMAT "%10.5"
 /begin ANNOTATION ANNOTATION_LABEL "Description (coming from AUTOSAR DESC field)"
  /begin ANNOTATION_TEXT "Additive integral pressure term for synchro control engaging to negative gear with high aggression actuation.\r\n" /end ANNOTATION_TEXT
 /end ANNOTATION
 /begin AXIS_DESCR STD_AXIS NO_INPUT_QUANTITY RB_PT_PCT_SWC_GAC_CompuMethods_ratio_10p0 5 0.0 100000. FORMAT "%10.5" DEPOSIT ABSOLUTE /end AXIS_DESCR
/end CHARACTERISTIC
/begin CHARACTERISTIC GAC_CALIB.GAC_GracC.GAC_SyncCtrl.GAC_PRESSIADDSYNCHIGRPOS "" CURVE 0x8061279C RB_PT_PCT_SWC_GAC_RecordLayouts_RL_Curve_sint16_5_uint16_5 64.0 RB_PT_PCT_SWC_GAC_CompuMethods_ratio_0p001 -32. 32. FORMAT "%10.5"
 /begin ANNOTATION ANNOTATION_LABEL "Description (coming from AUTOSAR DESC field)"
  /begin ANNOTATION_TEXT "Additive integral pressure term for synchro control engaging to positive gear with high aggression actuation.\r\n" /end ANNOTATION_TEXT
 /end ANNOTATION
 /begin AXIS_DESCR STD_AXIS NO_INPUT_QUANTITY RB_PT_PCT_SWC_GAC_CompuMethods_ratio_10p0 5 0.0 100000. FORMAT "%10.5" DEPOSIT ABSOLUTE /end AXIS_DESCR
/end CHARACTERISTIC
/begin CHARACTERISTIC GAC_CALIB.GAC_GracC.GAC_SyncCtrl.GAC_PRESSIADDSYNCLIM "" VALUE 0x80612756 DefaultValueRecordLayout_AUTOSAR_Platform_BaseTypes_sint16 64.0 RB_PT_PCT_SWC_GAC_CompuMethods_ratio_0p001 -32. 32. FORMAT "%10.5"
 /begin ANNOTATION ANNOTATION_LABEL "Description (coming from AUTOSAR DESC field)"
  /begin ANNOTATION_TEXT "Limited additive integral pressure term when rate of change of sync slip not ok for sync control.\r\n" /end ANNOTATION_TEXT
 /end ANNOTATION
/end CHARACTERISTIC
/begin CHARACTERISTIC GAC_CALIB.GAC_GracC.GAC_SyncCtrl.GAC_PRESSIADDSYNCLOWGRNEG "" CURVE 0x806127B2 RB_PT_PCT_SWC_GAC_RecordLayouts_RL_Curve_sint16_5_uint16_5 64.0 RB_PT_PCT_SWC_GAC_CompuMethods_ratio_0p001 -32. 32. FORMAT "%10.5"
 /begin ANNOTATION ANNOTATION_LABEL "Description (coming from AUTOSAR DESC field)"
  /begin ANNOTATION_TEXT "Additive integral pressure term for synchro control engaging to negative gear with low aggression actuation.\r\n" /end ANNOTATION_TEXT
 /end ANNOTATION
 /begin AXIS_DESCR STD_AXIS NO_INPUT_QUANTITY RB_PT_PCT_SWC_GAC_CompuMethods_ratio_10p0 5 0.0 100000. FORMAT "%10.5" DEPOSIT ABSOLUTE /end AXIS_DESCR
/end CHARACTERISTIC
/begin CHARACTERISTIC GAC_CALIB.GAC_GracC.GAC_SyncCtrl.GAC_PRESSIADDSYNCLOWGRPOS "" CURVE 0x806127C8 RB_PT_PCT_SWC_GAC_RecordLayouts_RL_Curve_sint16_5_uint16_5 64.0 RB_PT_PCT_SWC_GAC_CompuMethods_ratio_0p001 -32. 32. FORMAT "%10.5"
 /begin ANNOTATION ANNOTATION_LABEL "Description (coming from AUTOSAR DESC field)"
  /begin ANNOTATION_TEXT "Additive integral pressure term for synchro control engaging to positive gear with low aggression actuation.\r\n" /end ANNOTATION_TEXT
 /end ANNOTATION
 /begin AXIS_DESCR STD_AXIS NO_INPUT_QUANTITY RB_PT_PCT_SWC_GAC_CompuMethods_ratio_10p0 5 0.0 100000. FORMAT "%10.5" DEPOSIT ABSOLUTE /end AXIS_DESCR
/end CHARACTERISTIC
/begin CHARACTERISTIC GAC_CALIB.GAC_GracC.GAC_SyncCtrl.GAC_PRESSIADDSYNCMEDGRNEG "" CURVE 0x806127DE RB_PT_PCT_SWC_GAC_RecordLayouts_RL_Curve_sint16_5_uint16_5 64.0 RB_PT_PCT_SWC_GAC_CompuMethods_ratio_0p001 -32. 32. FORMAT "%10.5"
 /begin ANNOTATION ANNOTATION_LABEL "Description (coming from AUTOSAR DESC field)"
  /begin ANNOTATION_TEXT "Additive integral pressure term for synchro control engaging to negative gear with medium aggression actuation.\r\n" /end ANNOTATION_TEXT
 /end ANNOTATION
 /begin AXIS_DESCR STD_AXIS NO_INPUT_QUANTITY RB_PT_PCT_SWC_GAC_CompuMethods_ratio_10p0 5 0.0 100000. FORMAT "%10.5" DEPOSIT ABSOLUTE /end AXIS_DESCR
/end CHARACTERISTIC
/begin CHARACTERISTIC GAC_CALIB.GAC_GracC.GAC_SyncCtrl.GAC_PRESSIADDSYNCMEDGRPOS "" CURVE 0x806127F4 RB_PT_PCT_SWC_GAC_RecordLayouts_RL_Curve_sint16_5_uint16_5 64.0 RB_PT_PCT_SWC_GAC_CompuMethods_ratio_0p001 -32. 32. FORMAT "%10.5"
 /begin ANNOTATION ANNOTATION_LABEL "Description (coming from AUTOSAR DESC field)"
  /begin ANNOTATION_TEXT "Additive integral pressure term for synchro control engaging to positive gear with mediium aggression actuation.\r\n" /end ANNOTATION_TEXT
 /end ANNOTATION
 /begin AXIS_DESCR STD_AXIS NO_INPUT_QUANTITY RB_PT_PCT_SWC_GAC_CompuMethods_ratio_10p0 5 0.0 100000. FORMAT "%10.5" DEPOSIT ABSOLUTE /end AXIS_DESCR
/end CHARACTERISTIC
/begin CHARACTERISTIC GAC_CALIB.GAC_GracC.GAC_SyncCtrl.GAC_PRESSIADDSYNCSLIPUDEF "" VALUE 0x80612758 DefaultValueRecordLayout_AUTOSAR_Platform_BaseTypes_sint16 64.0 RB_PT_PCT_SWC_GAC_CompuMethods_ratio_0p001 -32. 32. FORMAT "%10.5"
 /begin ANNOTATION ANNOTATION_LABEL "Description (coming from AUTOSAR DESC field)"
  /begin ANNOTATION_TEXT "Additive integral pressure term for synchro control when syncrhro slip is unknown.\r\n" /end ANNOTATION_TEXT
 /end ANNOTATION
/end CHARACTERISTIC
/begin CHARACTERISTIC GAC_CALIB.GAC_GracC.GAC_SyncCtrl.GAC_PRESSLIMSSYNCIGRNEG "" VAL_BLK 0x80612722 DefaultValueRecordLayout_AUTOSAR_Platform_BaseTypes_sint16 64.0 RB_PT_PCT_SWC_GAC_CompuMethods_ratio_0p001 -32. 32. FORMAT "%10.5"
 /begin ANNOTATION ANNOTATION_LABEL "Description (coming from AUTOSAR DESC field)"
  /begin ANNOTATION_TEXT "Integral pressure addition limit for synchro control engaging negative gear, for each actuation aggression.\r\n" /end ANNOTATION_TEXT
 /end ANNOTATION
 MATRIX_DIM 4 1 1 /end CHARACTERISTIC
/begin CHARACTERISTIC GAC_CALIB.GAC_GracC.GAC_SyncCtrl.GAC_PRESSLIMSSYNCIGRPOS "" VAL_BLK 0x8061272A DefaultValueRecordLayout_AUTOSAR_Platform_BaseTypes_sint16 64.0 RB_PT_PCT_SWC_GAC_CompuMethods_ratio_0p001 -32. 32. FORMAT "%10.5"
 /begin ANNOTATION ANNOTATION_LABEL "Description (coming from AUTOSAR DESC field)"
  /begin ANNOTATION_TEXT "Integral pressure addition limit for synchro control engaging positive gear, for each actuation aggression.\r\n" /end ANNOTATION_TEXT
 /end ANNOTATION
 MATRIX_DIM 4 1 1 /end CHARACTERISTIC
/begin CHARACTERISTIC GAC_CALIB.GAC_GracC.GAC_SyncCtrl.GAC_PRESSLIMSYNCHIMAP "" CURVE 0x8061280A RB_PT_PCT_SWC_GAC_RecordLayouts_RL_Curve_uint16_4_sint16_4 32.0 RB_PT_PCT_SWC_GAC_CompuMethods_ratio_0p001 0.0 32. FORMAT "%10.5"
 /begin ANNOTATION ANNOTATION_LABEL "Description (coming from AUTOSAR DESC field)"
  /begin ANNOTATION_TEXT "Limit for the static pressure engagements based on temperature - high aggression\r\n" /end ANNOTATION_TEXT
 /end ANNOTATION
 /begin AXIS_DESCR STD_AXIS NO_INPUT_QUANTITY RB_PT_PCT_SWC_GAC_CompuMethods_ident 4 -50. 200. FORMAT "%10.5" DEPOSIT ABSOLUTE /end AXIS_DESCR
/end CHARACTERISTIC
/begin CHARACTERISTIC GAC_CALIB.GAC_GracC.GAC_SyncCtrl.GAC_PRESSLIMSYNCLOWMAP "" CURVE 0x8061281C RB_PT_PCT_SWC_GAC_RecordLayouts_RL_Curve_uint16_4_sint16_4 32.0 RB_PT_PCT_SWC_GAC_CompuMethods_ratio_0p001 0.0 32. FORMAT "%10.5"
 /begin ANNOTATION ANNOTATION_LABEL "Description (coming from AUTOSAR DESC field)"
  /begin ANNOTATION_TEXT "Limit for the static pressure engagements based on temperature- low aggression\r\n" /end ANNOTATION_TEXT
 /end ANNOTATION
 /begin AXIS_DESCR STD_AXIS NO_INPUT_QUANTITY RB_PT_PCT_SWC_GAC_CompuMethods_ident 4 -50. 200. FORMAT "%10.5" DEPOSIT ABSOLUTE /end AXIS_DESCR
/end CHARACTERISTIC
/begin CHARACTERISTIC GAC_CALIB.GAC_GracC.GAC_SyncCtrl.GAC_PRESSLIMSYNCMEDMAP "" CURVE 0x8061282E RB_PT_PCT_SWC_GAC_RecordLayouts_RL_Curve_uint16_4_sint16_4 32.0 RB_PT_PCT_SWC_GAC_CompuMethods_ratio_0p001 0.0 32. FORMAT "%10.5"
 /begin ANNOTATION ANNOTATION_LABEL "Description (coming from AUTOSAR DESC field)"
  /begin ANNOTATION_TEXT "Limit for the static pressure engagements based on temperature - medium aggression\r\n" /end ANNOTATION_TEXT
 /end ANNOTATION
 /begin AXIS_DESCR STD_AXIS NO_INPUT_QUANTITY RB_PT_PCT_SWC_GAC_CompuMethods_ident 4 -50. 200. FORMAT "%10.5" DEPOSIT ABSOLUTE /end AXIS_DESCR
/end CHARACTERISTIC
/begin CHARACTERISTIC GAC_CALIB.GAC_GracC.GAC_SyncCtrl.GAC_PRESSLIMSYNCSTATICMAP "" CURVE 0x80612840 RB_PT_PCT_SWC_GAC_RecordLayouts_RL_Curve_uint16_4_sint16_4 32.0 RB_PT_PCT_SWC_GAC_CompuMethods_ratio_0p001 0.0 32. FORMAT "%10.5"
 /begin ANNOTATION ANNOTATION_LABEL "Description (coming from AUTOSAR DESC field)"
  /begin ANNOTATION_TEXT "Limit for the static pressure engagements based on temperature - static aggression\r\n" /end ANNOTATION_TEXT
 /end ANNOTATION
 /begin AXIS_DESCR STD_AXIS NO_INPUT_QUANTITY RB_PT_PCT_SWC_GAC_CompuMethods_ident 4 -50. 200. FORMAT "%10.5" DEPOSIT ABSOLUTE /end AXIS_DESCR
/end CHARACTERISTIC
/begin CHARACTERISTIC GAC_CALIB.GAC_GracC.GAC_SyncCtrl.GAC_PRESSLIMSYNCVLOWMAP "" CURVE 0x80612852 RB_PT_PCT_SWC_GAC_RecordLayouts_RL_Curve_uint16_4_sint16_4 32.0 RB_PT_PCT_SWC_GAC_CompuMethods_ratio_0p001 0.0 32. FORMAT "%10.5"
 /begin ANNOTATION ANNOTATION_LABEL "Description (coming from AUTOSAR DESC field)"
  /begin ANNOTATION_TEXT "Limit for the static pressure engagements based on temperature - very low aggression\r\n" /end ANNOTATION_TEXT
 /end ANNOTATION
 /begin AXIS_DESCR STD_AXIS NO_INPUT_QUANTITY RB_PT_PCT_SWC_GAC_CompuMethods_ident 4 -50. 200. FORMAT "%10.5" DEPOSIT ABSOLUTE /end AXIS_DESCR
/end CHARACTERISTIC
/begin CHARACTERISTIC GAC_CALIB.GAC_GracC.GAC_SyncCtrl.GAC_PRESSSHUNTCUT "" VALUE 0x8061275A DefaultValueRecordLayout_AUTOSAR_Platform_BaseTypes_sint16 64.0 RB_PT_PCT_SWC_GAC_CompuMethods_ratio_0p001 -32. 32. FORMAT "%10.5"
 /begin ANNOTATION ANNOTATION_LABEL "Description (coming from AUTOSAR DESC field)"
  /begin ANNOTATION_TEXT "Pressure demand when the shunt pressure cut is active\r\n" /end ANNOTATION_TEXT
 /end ANNOTATION
/end CHARACTERISTIC
/begin CHARACTERISTIC GAC_CALIB.GAC_GracC.GAC_SyncCtrl.GAC_PRESSSYNCBLENDMAX "" VALUE 0x8061275C DefaultValueRecordLayout_AUTOSAR_Platform_BaseTypes_uint16 32.0 RB_PT_PCT_SWC_GAC_CompuMethods_ratio_0p001 0.0 32. FORMAT "%10.5"
 /begin ANNOTATION ANNOTATION_LABEL "Description (coming from AUTOSAR DESC field)"
  /begin ANNOTATION_TEXT "Limited additive integral pressure term when rate of change of sync slip not ok for sync control.\r\n" /end ANNOTATION_TEXT
 /end ANNOTATION
/end CHARACTERISTIC
/begin CHARACTERISTIC GAC_CALIB.GAC_GracC.GAC_SyncCtrl.GAC_ROCSPDSYNCSLIPOK "" VALUE 0x8061275E DefaultValueRecordLayout_AUTOSAR_Platform_BaseTypes_sint16 655350.0 RB_PT_PCT_SWC_GAC_CompuMethods_ratio_10p0 -327680. 327670. FORMAT "%10.5"
 /begin ANNOTATION ANNOTATION_LABEL "Description (coming from AUTOSAR DESC field)"
  /begin ANNOTATION_TEXT "Rate of change of synchro slip for detection of sync control ok.\r\n" /end ANNOTATION_TEXT
 /end ANNOTATION
/end CHARACTERISTIC
/begin CHARACTERISTIC GAC_CALIB.GAC_GracC.GAC_SyncCtrl.GAC_SPDTHRESHHOLDITERM "" VALUE 0x80612760 DefaultValueRecordLayout_AUTOSAR_Platform_BaseTypes_sint16 40000.0 RB_PT_PCT_SWC_GAC_CompuMethods_ident -20000. 20000. FORMAT "%10.5"
 /begin ANNOTATION ANNOTATION_LABEL "Description (coming from AUTOSAR DESC field)"
  /begin ANNOTATION_TEXT "speed threshold below which, the I term is not allowed to increase\r\n" /end ANNOTATION_TEXT
 /end ANNOTATION
/end CHARACTERISTIC
/begin CHARACTERISTIC GAC_CALIB.GAC_GracC.GAC_SyncCtrl.GAC_SPEEDSLIPMAXFORPRESSUREINC "" VALUE 0x80612762 DefaultValueRecordLayout_AUTOSAR_Platform_BaseTypes_sint16 40000.0 RB_PT_PCT_SWC_GAC_CompuMethods_ident -20000. 20000. FORMAT "%10.5"
 /begin ANNOTATION ANNOTATION_LABEL "Description (coming from AUTOSAR DESC field)"
  /begin ANNOTATION_TEXT "slip speed limit to step to the retry pressure on the first attempt\r\n" /end ANNOTATION_TEXT
 /end ANNOTATION
/end CHARACTERISTIC
/begin CHARACTERISTIC GAC_CALIB.GAC_GracC.GAC_SyncCtrl.GAC_SYNCCTRLFLOWTC "" VALUE 0x80612764 DefaultValueRecordLayout_AUTOSAR_Platform_BaseTypes_uint16 0.999 RB_PT_PCT_SWC_GAC_CompuMethods_ratio_0p001 0.001 1. FORMAT "%10.5"
 /begin ANNOTATION ANNOTATION_LABEL "Description (coming from AUTOSAR DESC field)" /begin ANNOTATION_TEXT "Synchro control flow demand time constant.\r\n" /end ANNOTATION_TEXT /end ANNOTATION
/end CHARACTERISTIC
/begin CHARACTERISTIC GAC_CALIB.GAC_GracC.GAC_SyncCtrl.GAC_SYNCCTRLPRESSMINMAP "" CURVE 0x80612864 RB_PT_PCT_SWC_GAC_RecordLayouts_RL_Curve_uint16_4_sint16_4 32.0 RB_PT_PCT_SWC_GAC_CompuMethods_ratio_0p001 0.0 32. FORMAT "%10.5"
 /begin ANNOTATION ANNOTATION_LABEL "Description (coming from AUTOSAR DESC field)"
  /begin ANNOTATION_TEXT "Synchronisation pressure minimum based on temperature\r\n" /end ANNOTATION_TEXT
 /end ANNOTATION
 /begin AXIS_DESCR STD_AXIS NO_INPUT_QUANTITY RB_PT_PCT_SWC_GAC_CompuMethods_ident 4 -50. 200. FORMAT "%10.5" DEPOSIT ABSOLUTE /end AXIS_DESCR
/end CHARACTERISTIC
/begin CHARACTERISTIC GAC_CALIB.GAC_GracC.GAC_SyncCtrl.GAC_TEMPMAXPRESSURESHUNTOKAY "" VALUE 0x80612766 DefaultValueRecordLayout_AUTOSAR_Platform_BaseTypes_sint16 250.0 RB_PT_PCT_SWC_GAC_CompuMethods_ident -50. 200. FORMAT "%10.5"
 /begin ANNOTATION ANNOTATION_LABEL "Description (coming from AUTOSAR DESC field)" /begin ANNOTATION_TEXT "Maximum temperature to enable the pressure shunt\r\n" /end ANNOTATION_TEXT /end ANNOTATION
/end CHARACTERISTIC
/begin CHARACTERISTIC GAC_CALIB.GAC_GracC.GAC_SyncCtrl.GAC_TEMPMINPRESSURESHUNTOKAY "" VALUE 0x80612768 DefaultValueRecordLayout_AUTOSAR_Platform_BaseTypes_sint16 250.0 RB_PT_PCT_SWC_GAC_CompuMethods_ident -50. 200. FORMAT "%10.5"
 /begin ANNOTATION ANNOTATION_LABEL "Description (coming from AUTOSAR DESC field)" /begin ANNOTATION_TEXT "Minimum temperature to enable the pressure shunt\r\n" /end ANNOTATION_TEXT /end ANNOTATION
/end CHARACTERISTIC
/begin CHARACTERISTIC GAC_CALIB.GAC_GracC.GAC_SyncCtrl.GAC_TMMAXPRESSURESHUNT "" VALUE 0x8061276A DefaultValueRecordLayout_AUTOSAR_Platform_BaseTypes_uint16 65.535 RB_PT_PCT_SWC_GAC_CompuMethods_ratio_0p001 0.0 65.535 FORMAT "%10.5"
 /begin ANNOTATION ANNOTATION_LABEL "Description (coming from AUTOSAR DESC field)" /begin ANNOTATION_TEXT "Maximum time the pressure shunt can operate for\r\n" /end ANNOTATION_TEXT /end ANNOTATION
/end CHARACTERISTIC
/begin CHARACTERISTIC GAC_CALIB.GAC_GracC.GAC_SyncCtrl.GAC_TmrPressureShunt.LIB_DT "" VALUE 0x80612774 DefaultValueRecordLayout_AUTOSAR_Platform_BaseTypes_uint16 65.535 RB_PT_PCT_SWC_GAC_CompuMethods_ratio_0p001 0.0 65.535 FORMAT "%10.5"
 /begin ANNOTATION ANNOTATION_LABEL "Description (coming from AUTOSAR DESC field)" /begin ANNOTATION_TEXT "Timer decrement value.\r\n" /end ANNOTATION_TEXT /end ANNOTATION
/end CHARACTERISTIC
/begin CHARACTERISTIC GAC_CALIB.GAC_GracC.GAC_SyncCtrl.GAC_TMSDEBGRACSLOWSYNCOK "" VAL_BLK 0x80612732 DefaultValueRecordLayout_AUTOSAR_Platform_BaseTypes_uint16 65.535 RB_PT_PCT_SWC_GAC_CompuMethods_ratio_0p001 0.0 65.535 FORMAT "%10.5"
 /begin ANNOTATION ANNOTATION_LABEL "Description (coming from AUTOSAR DESC field)"
  /begin ANNOTATION_TEXT "Debounce times for detecting slow enough for synchro control, for each actuation aggression.\r\n" /end ANNOTATION_TEXT
 /end ANNOTATION
 MATRIX_DIM 4 1 1 /end CHARACTERISTIC
/begin CHARACTERISTIC GAC_CALIB.GAC_GracC.GAC_SyncCtrl.GAC_TMSDEBROCSLIPFORSYNC "" VAL_BLK 0x8061273A DefaultValueRecordLayout_AUTOSAR_Platform_BaseTypes_uint16 65.535 RB_PT_PCT_SWC_GAC_CompuMethods_ratio_0p001 0.0 65.535 FORMAT "%10.5"
 /begin ANNOTATION ANNOTATION_LABEL "Description (coming from AUTOSAR DESC field)"
  /begin ANNOTATION_TEXT "Debounce times for detecting rate of change of slip ok for synchro control, for each actuation aggression.\r\n" /end ANNOTATION_TEXT
 /end ANNOTATION
 MATRIX_DIM 4 1 1 /end CHARACTERISTIC
/begin CHARACTERISTIC GAC_CALIB.GAC_GracC.GAC_SyncCtrl.GAC_TMSHUNTPRESSURECUT "" VALUE 0x8061276C DefaultValueRecordLayout_AUTOSAR_Platform_BaseTypes_uint16 65.535 RB_PT_PCT_SWC_GAC_CompuMethods_ratio_0p001 0.0 65.535 FORMAT "%10.5"
 /begin ANNOTATION ANNOTATION_LABEL "Description (coming from AUTOSAR DESC field)" /begin ANNOTATION_TEXT "Maximum time the shunt pressure cut can occur for\r\n" /end ANNOTATION_TEXT /end ANNOTATION
/end CHARACTERISTIC
/begin CHARACTERISTIC GAC_CALIB.GAC_GracC.GAC_SyncCtrl.GAC_VELSGRACSLOWABS "" VAL_BLK 0x80612742 DefaultValueRecordLayout_AUTOSAR_Platform_BaseTypes_uint16 1.2 RB_PT_PCT_SWC_GAC_CompuMethods_ratio_0p001 0.0 1.2 FORMAT "%10.5"
 /begin ANNOTATION ANNOTATION_LABEL "Description (coming from AUTOSAR DESC field)"
  /begin ANNOTATION_TEXT "Unsigned gear actuator velocities for detecting slow enough for synchro control, for each actuation aggression.\r\n" /end ANNOTATION_TEXT
 /end ANNOTATION
 MATRIX_DIM 4 1 1 /end CHARACTERISTIC
/begin CHARACTERISTIC GAC_CALIB.GAC_GracC.GAC_SyncCtrl.LIB_CountUpTimer.LIB_DT "" VALUE 0x80612776 DefaultValueRecordLayout_AUTOSAR_Platform_BaseTypes_uint16 65.535 RB_PT_PCT_SWC_GAC_CompuMethods_ratio_0p001 0.0 65.535 FORMAT "%10.5"
 /begin ANNOTATION ANNOTATION_LABEL "Description (coming from AUTOSAR DESC field)" /begin ANNOTATION_TEXT "Timer decrement value.\r\n" /end ANNOTATION_TEXT /end ANNOTATION
/end CHARACTERISTIC
/begin CHARACTERISTIC GAC_CALIB.GAC_GracC.GAC_TIMEMAXWAITUNTILAGAINSTDRAG "" VALUE 0x8061247C DefaultValueRecordLayout_AUTOSAR_Platform_BaseTypes_uint16 65.535 RB_PT_PCT_SWC_GAC_CompuMethods_ratio_0p001 0.0 65.535 FORMAT "%10.5"
 /begin ANNOTATION ANNOTATION_LABEL "Description (coming from AUTOSAR DESC field)"
  /begin ANNOTATION_TEXT "Max time to wait for the synchronisation to be against drag before engagements commence\r\n" /end ANNOTATION_TEXT
 /end ANNOTATION
/end CHARACTERISTIC
/begin CHARACTERISTIC GAC_CALIB.GAC_GracC.GAC_TMDEBFORCEONSYNC "" VALUE 0x8061247E DefaultValueRecordLayout_AUTOSAR_Platform_BaseTypes_uint16 65.535 RB_PT_PCT_SWC_GAC_CompuMethods_ratio_0p001 0.0 65.535 FORMAT "%10.5"
 /begin ANNOTATION ANNOTATION_LABEL "Description (coming from AUTOSAR DESC field)"
  /begin ANNOTATION_TEXT "Debounce time for detecting force sychronisation start.\r\n" /end ANNOTATION_TEXT
 /end ANNOTATION
/end CHARACTERISTIC
/begin CHARACTERISTIC GAC_CALIB.GAC_GracC.GAC_TMDEBFORCEONSYNCEV "" VALUE 0x80612480 DefaultValueRecordLayout_AUTOSAR_Platform_BaseTypes_uint16 65.535 RB_PT_PCT_SWC_GAC_CompuMethods_ratio_0p001 0.0 65.535 FORMAT "%10.5"
 /begin ANNOTATION ANNOTATION_LABEL "Description (coming from AUTOSAR DESC field)"
  /begin ANNOTATION_TEXT "Debounce time for detecting force sychronisation start.\r\n" /end ANNOTATION_TEXT
 /end ANNOTATION
/end CHARACTERISTIC
/begin CHARACTERISTIC GAC_CALIB.GAC_GracC.GAC_TMDEBGBLK0EVMODE "" CURVE 0x80612B0C RB_PT_PCT_SWC_GAC_RecordLayouts_RL_Curve_uint16_4_sint16_4 65.535 RB_PT_PCT_SWC_GAC_CompuMethods_ratio_0p001 0.0 65.535 FORMAT "%10.5"
 /begin ANNOTATION ANNOTATION_LABEL "Description (coming from AUTOSAR DESC field)"
  /begin ANNOTATION_TEXT "Debounce time to be stuck on the synchroniser - variable with temperature\r\n" /end ANNOTATION_TEXT
 /end ANNOTATION
 /begin AXIS_DESCR STD_AXIS NO_INPUT_QUANTITY RB_PT_PCT_SWC_GAC_CompuMethods_ident 4 -50. 200. FORMAT "%10.5" DEPOSIT ABSOLUTE /end AXIS_DESCR
/end CHARACTERISTIC
/begin CHARACTERISTIC GAC_CALIB.GAC_GracC.GAC_TMFAILPUSHINGR "" VALUE 0x80612482 DefaultValueRecordLayout_AUTOSAR_Platform_BaseTypes_uint16 10.0 RB_PT_PCT_SWC_GAC_CompuMethods_ratio_0p001 0.0 10. FORMAT "%10.5"
 /begin ANNOTATION ANNOTATION_LABEL "Description (coming from AUTOSAR DESC field)" /begin ANNOTATION_TEXT "Time used for detecting 'fail push in gear'.\r\n" /end ANNOTATION_TEXT /end ANNOTATION
/end CHARACTERISTIC
/begin CHARACTERISTIC GAC_CALIB.GAC_GracC.GAC_TMHOLDFLWISYNCEND "" VALUE 0x80612484 DefaultValueRecordLayout_AUTOSAR_Platform_BaseTypes_uint16 65.535 RB_PT_PCT_SWC_GAC_CompuMethods_ratio_0p001 0.0 65.535 FORMAT "%10.5"
 /begin ANNOTATION ANNOTATION_LABEL "Description (coming from AUTOSAR DESC field)"
  /begin ANNOTATION_TEXT "Time to hold the integral flow term for velocity control upon synchronisation end detected.\r\n" /end ANNOTATION_TEXT
 /end ANNOTATION
/end CHARACTERISTIC
/begin CHARACTERISTIC GAC_CALIB.GAC_GracC.GAC_TMHOLDFLWITOSYNC "" VALUE 0x80612486 DefaultValueRecordLayout_AUTOSAR_Platform_BaseTypes_uint16 65.535 RB_PT_PCT_SWC_GAC_CompuMethods_ratio_0p001 0.0 65.535 FORMAT "%10.5"
 /begin ANNOTATION ANNOTATION_LABEL "Description (coming from AUTOSAR DESC field)"
  /begin ANNOTATION_TEXT "Time to hold the integral flow term for velocity control upon actuation to gear from Neutral.\r\n" /end ANNOTATION_TEXT
 /end ANNOTATION
/end CHARACTERISTIC
/begin CHARACTERISTIC GAC_CALIB.GAC_GracC.GAC_TMHOLDFLWITOSYNCHIAGG "" VALUE 0x80612488 DefaultValueRecordLayout_AUTOSAR_Platform_BaseTypes_uint16 65.535 RB_PT_PCT_SWC_GAC_CompuMethods_ratio_0p001 0.0 65.535 FORMAT "%10.5"
 /begin ANNOTATION ANNOTATION_LABEL "Description (coming from AUTOSAR DESC field)"
  /begin ANNOTATION_TEXT "Time to hold the integral flow term for velocity control upon actuation to gear from Neutral - high aggression actuation.\r\n" /end ANNOTATION_TEXT
 /end ANNOTATION
/end CHARACTERISTIC
/begin CHARACTERISTIC GAC_CALIB.GAC_GracC.GAC_TMHOLDFLWITOSYNCLOW "" VALUE 0x8061248A DefaultValueRecordLayout_AUTOSAR_Platform_BaseTypes_uint16 65.535 RB_PT_PCT_SWC_GAC_CompuMethods_ratio_0p001 0.0 65.535 FORMAT "%10.5"
 /begin ANNOTATION ANNOTATION_LABEL "Description (coming from AUTOSAR DESC field)"
  /begin ANNOTATION_TEXT "Time to hold the integral flow term for velocity control upon actuation to gear from Neutral - low hold time.\r\n" /end ANNOTATION_TEXT
 /end ANNOTATION
/end CHARACTERISTIC
/begin CHARACTERISTIC GAC_CALIB.GAC_GracC.GAC_TMINITINNNOFLOAT "" VALUE 0x8061248C DefaultValueRecordLayout_AUTOSAR_Platform_BaseTypes_uint16 65.535 RB_PT_PCT_SWC_GAC_CompuMethods_ratio_0p001 0.0 65.535 FORMAT "%10.5"
 /begin ANNOTATION ANNOTATION_LABEL "Description (coming from AUTOSAR DESC field)"
  /begin ANNOTATION_TEXT "Time to determine that the gear is not floating out of neutral\r\n" /end ANNOTATION_TEXT
 /end ANNOTATION
/end CHARACTERISTIC
/begin CHARACTERISTIC GAC_CALIB.GAC_GracC.GAC_TMMAXNSTOPITERMRESET "" VALUE 0x8061248E DefaultValueRecordLayout_AUTOSAR_Platform_BaseTypes_uint16 65.535 RB_PT_PCT_SWC_GAC_CompuMethods_ratio_0p001 0.0 65.535 FORMAT "%10.5"
 /begin ANNOTATION ANNOTATION_LABEL "Description (coming from AUTOSAR DESC field)"
  /begin ANNOTATION_TEXT "Maximum time for the I term reset to be active for when the N stop condition is active\r\n" /end ANNOTATION_TEXT
 /end ANNOTATION
/end CHARACTERISTIC
/begin CHARACTERISTIC GAC_CALIB.GAC_GracC.GAC_TMPINTRPNSTOPVELTGT "" VALUE 0x80612490 DefaultValueRecordLayout_AUTOSAR_Platform_BaseTypes_sint16 250.0 RB_PT_PCT_SWC_GAC_CompuMethods_ident -50. 200. FORMAT "%10.5"
 /begin ANNOTATION ANNOTATION_LABEL "Description (coming from AUTOSAR DESC field)"
  /begin ANNOTATION_TEXT "Temperature used for assessing interpolation of the NStop velocity target.\r\n" /end ANNOTATION_TEXT
 /end ANNOTATION
/end CHARACTERISTIC
/begin CHARACTERISTIC GAC_CALIB.GAC_GracC.GAC_TMPINTRPVELCTRLPRESSFF "" VALUE 0x80612492 DefaultValueRecordLayout_AUTOSAR_Platform_BaseTypes_sint16 250.0 RB_PT_PCT_SWC_GAC_CompuMethods_ident -50. 200. FORMAT "%10.5"
 /begin ANNOTATION ANNOTATION_LABEL "Description (coming from AUTOSAR DESC field)"
  /begin ANNOTATION_TEXT "Temperature used for assessing interpolation of the velocity control feedforward pressure term.\r\n" /end ANNOTATION_TEXT
 /end ANNOTATION
/end CHARACTERISTIC
/begin CHARACTERISTIC GAC_CALIB.GAC_GracC.GAC_TMPINTRPVELCTRLPRESSONFLW "" VALUE 0x80612494 DefaultValueRecordLayout_AUTOSAR_Platform_BaseTypes_sint16 250.0 RB_PT_PCT_SWC_GAC_CompuMethods_ident -50. 200. FORMAT "%10.5"
 /begin ANNOTATION ANNOTATION_LABEL "Description (coming from AUTOSAR DESC field)"
  /begin ANNOTATION_TEXT "Temperature used for assessing interpolation of the velocity control flow based pressure term.\r\n" /end ANNOTATION_TEXT
 /end ANNOTATION
/end CHARACTERISTIC
/begin CHARACTERISTIC GAC_CALIB.GAC_GracC.GAC_TMPRESSENDSTOP "" VALUE 0x80612496 DefaultValueRecordLayout_AUTOSAR_Platform_BaseTypes_uint16 65.535 RB_PT_PCT_SWC_GAC_CompuMethods_ratio_0p001 0.0 65.535 FORMAT "%10.5"
 /begin ANNOTATION ANNOTATION_LABEL "Description (coming from AUTOSAR DESC field)" /begin ANNOTATION_TEXT "Synchronisation time target for static shifts7\r\n" /end ANNOTATION_TEXT /end ANNOTATION
/end CHARACTERISTIC
/begin CHARACTERISTIC GAC_CALIB.GAC_GracC.GAC_TMPRESSENDSTOPSYNCF "" VALUE 0x80612498 DefaultValueRecordLayout_AUTOSAR_Platform_BaseTypes_uint16 65.535 RB_PT_PCT_SWC_GAC_CompuMethods_ratio_0p001 0.0 65.535 FORMAT "%10.5"
 /begin ANNOTATION ANNOTATION_LABEL "Description (coming from AUTOSAR DESC field)" /begin ANNOTATION_TEXT "Synchronisation time target for static shifts7\r\n" /end ANNOTATION_TEXT /end ANNOTATION
/end CHARACTERISTIC
/begin CHARACTERISTIC GAC_CALIB.GAC_GracC.GAC_TMPVLVNOPULSE "" VALUE 0x8061249A DefaultValueRecordLayout_AUTOSAR_Platform_BaseTypes_uint16 65.535 RB_PT_PCT_SWC_GAC_CompuMethods_ratio_0p001 0.0 65.535 FORMAT "%10.5"
 /begin ANNOTATION ANNOTATION_LABEL "Description (coming from AUTOSAR DESC field)"
  /begin ANNOTATION_TEXT "Time for which no pulse is allowed on the pressure valve.\r\n" /end ANNOTATION_TEXT
 /end ANNOTATION
/end CHARACTERISTIC
/begin CHARACTERISTIC GAC_CALIB.GAC_GracC.GAC_TmrInNState.LIB_DT "" VALUE 0x80612876 DefaultValueRecordLayout_AUTOSAR_Platform_BaseTypes_uint16 65.535 RB_PT_PCT_SWC_GAC_CompuMethods_ratio_0p001 0.0 65.535 FORMAT "%10.5"
 /begin ANNOTATION ANNOTATION_LABEL "Description (coming from AUTOSAR DESC field)" /begin ANNOTATION_TEXT "Timer decrement value.\r\n" /end ANNOTATION_TEXT /end ANNOTATION
/end CHARACTERISTIC
/begin CHARACTERISTIC GAC_CALIB.GAC_GracC.GAC_TmrNStopITermReset.LIB_DT "" VALUE 0x80612878 DefaultValueRecordLayout_AUTOSAR_Platform_BaseTypes_uint16 65.535 RB_PT_PCT_SWC_GAC_CompuMethods_ratio_0p001 0.0 65.535 FORMAT "%10.5"
 /begin ANNOTATION ANNOTATION_LABEL "Description (coming from AUTOSAR DESC field)" /begin ANNOTATION_TEXT "Timer decrement value.\r\n" /end ANNOTATION_TEXT /end ANNOTATION
/end CHARACTERISTIC
/begin CHARACTERISTIC GAC_CALIB.GAC_GracC.GAC_TMSHOLDFLWIVELCTRLN "" CURVE 0x80612B1E RB_PT_PCT_SWC_GAC_RecordLayouts_RL_Curve_uint16_2_sint16_2 65.535 RB_PT_PCT_SWC_GAC_CompuMethods_ratio_0p001 0.0 65.535 FORMAT "%10.5"
 /begin ANNOTATION ANNOTATION_LABEL "Description (coming from AUTOSAR DESC field)"
  /begin ANNOTATION_TEXT "Times used for the hold of the integral flow term for velocity control Neutral actuation.\r\n" /end ANNOTATION_TEXT
 /end ANNOTATION
 /begin AXIS_DESCR STD_AXIS NO_INPUT_QUANTITY RB_PT_PCT_SWC_GAC_CompuMethods_ident 2 -50. 200. FORMAT "%10.5" DEPOSIT ABSOLUTE /end AXIS_DESCR
/end CHARACTERISTIC
/begin CHARACTERISTIC GAC_CALIB.GAC_GracC.GAC_TMSSYNCTGT "" VAL_BLK 0x806123F0 DefaultValueRecordLayout_AUTOSAR_Platform_BaseTypes_uint16 65.535 RB_PT_PCT_SWC_GAC_CompuMethods_ratio_0p001 0.0 65.535 FORMAT "%10.5"
 /begin ANNOTATION ANNOTATION_LABEL "Description (coming from AUTOSAR DESC field)"
  /begin ANNOTATION_TEXT "Array of times indicating the target synchronisation time for positive/negative gear and actuation aggression.\r\n" /end ANNOTATION_TEXT
 /end ANNOTATION
 MATRIX_DIM 4 2 1 /end CHARACTERISTIC
/begin CHARACTERISTIC GAC_CALIB.GAC_GracC.GAC_TMSSYNCTGTCLOW "" VALUE 0x8061249C DefaultValueRecordLayout_AUTOSAR_Platform_BaseTypes_uint16 65.535 RB_PT_PCT_SWC_GAC_CompuMethods_ratio_0p001 0.0 65.535 FORMAT "%10.5"
 /begin ANNOTATION ANNOTATION_LABEL "Description (coming from AUTOSAR DESC field)" /begin ANNOTATION_TEXT "Synchronisation time target for static shifts7\r\n" /end ANNOTATION_TEXT /end ANNOTATION
/end CHARACTERISTIC
/begin CHARACTERISTIC GAC_CALIB.GAC_GracC.GAC_TMSSYNCTGTCLOW1STGR "" VALUE 0x8061249E DefaultValueRecordLayout_AUTOSAR_Platform_BaseTypes_uint16 65.535 RB_PT_PCT_SWC_GAC_CompuMethods_ratio_0p001 0.0 65.535 FORMAT "%10.5"
 /begin ANNOTATION ANNOTATION_LABEL "Description (coming from AUTOSAR DESC field)" /begin ANNOTATION_TEXT "Synchronisation time target for static shifts7\r\n" /end ANNOTATION_TEXT /end ANNOTATION
/end CHARACTERISTIC
/begin CHARACTERISTIC GAC_CALIB.GAC_GracC.GAC_TMSSYNCTGTDR "" VALUE 0x806124A0 DefaultValueRecordLayout_AUTOSAR_Platform_BaseTypes_uint16 65.535 RB_PT_PCT_SWC_GAC_CompuMethods_ratio_0p001 0.0 65.535 FORMAT "%10.5"
 /begin ANNOTATION ANNOTATION_LABEL "Description (coming from AUTOSAR DESC field)" /begin ANNOTATION_TEXT "Synchronisation time target for static shifts7\r\n" /end ANNOTATION_TEXT /end ANNOTATION
/end CHARACTERISTIC
/begin CHARACTERISTIC GAC_CALIB.GAC_GracC.GAC_TMSSYNCTGTSTATIC "" VALUE 0x806124A2 DefaultValueRecordLayout_AUTOSAR_Platform_BaseTypes_uint16 65.535 RB_PT_PCT_SWC_GAC_CompuMethods_ratio_0p001 0.0 65.535 FORMAT "%10.5"
 /begin ANNOTATION ANNOTATION_LABEL "Description (coming from AUTOSAR DESC field)" /begin ANNOTATION_TEXT "Synchronisation time target for static shifts7\r\n" /end ANNOTATION_TEXT /end ANNOTATION
/end CHARACTERISTIC
/begin CHARACTERISTIC GAC_CALIB.GAC_GracC.GAC_VELGRACADPPUSHINGRNEGTGT "" VALUE 0x806124A4 DefaultValueRecordLayout_AUTOSAR_Platform_BaseTypes_sint16 2.4 RB_PT_PCT_SWC_GAC_CompuMethods_ratio_0p001 -1.2 1.2 FORMAT "%10.5"
 /begin ANNOTATION ANNOTATION_LABEL "Description (coming from AUTOSAR DESC field)"
  /begin ANNOTATION_TEXT "Velocity target for the gear actuator during adaptation 'push in (negative) gear' active.\r\n" /end ANNOTATION_TEXT
 /end ANNOTATION
/end CHARACTERISTIC
/begin CHARACTERISTIC GAC_CALIB.GAC_GracC.GAC_VELGRACADPPUSHINGRPOSTGT "" VALUE 0x806124A6 DefaultValueRecordLayout_AUTOSAR_Platform_BaseTypes_sint16 2.4 RB_PT_PCT_SWC_GAC_CompuMethods_ratio_0p001 -1.2 1.2 FORMAT "%10.5"
 /begin ANNOTATION ANNOTATION_LABEL "Description (coming from AUTOSAR DESC field)"
  /begin ANNOTATION_TEXT "Velocity target for the gear actuator during adaptation 'push in (positive) gear' active.\r\n" /end ANNOTATION_TEXT
 /end ANNOTATION
/end CHARACTERISTIC
/begin CHARACTERISTIC GAC_CALIB.GAC_GracC.GAC_VELGRACFAILPUSHINGR "" VALUE 0x806124A8 DefaultValueRecordLayout_AUTOSAR_Platform_BaseTypes_sint16 2.4 RB_PT_PCT_SWC_GAC_CompuMethods_ratio_0p001 -1.2 1.2 FORMAT "%10.5"
 /begin ANNOTATION ANNOTATION_LABEL "Description (coming from AUTOSAR DESC field)"
  /begin ANNOTATION_TEXT "Velocity target for the gear actuator during 'fail push in gear' active.\r\n" /end ANNOTATION_TEXT
 /end ANNOTATION
/end CHARACTERISTIC
/begin CHARACTERISTIC GAC_CALIB.GAC_GracC.GAC_VELGRACMOVING "" VALUE 0x806124AA DefaultValueRecordLayout_AUTOSAR_Platform_BaseTypes_sint16 0.6 RB_PT_PCT_SWC_GAC_CompuMethods_ratio_0p0001 -0.3 0.3 FORMAT "%10.5"
 /begin ANNOTATION ANNOTATION_LABEL "Description (coming from AUTOSAR DESC field)"
  /begin ANNOTATION_TEXT "Gear actuator velocity used for detecting synchronisation start on the positive gear.\r\n" /end ANNOTATION_TEXT
 /end ANNOTATION
/end CHARACTERISTIC
/begin CHARACTERISTIC GAC_CALIB.GAC_GracC.GAC_VELGRACMOVINGENDSYNC "" CURVE 0x80612B28 RB_PT_PCT_SWC_GAC_RecordLayouts_RL_Curve_sint16_4_uint16_4 0.6 RB_PT_PCT_SWC_GAC_CompuMethods_ratio_0p0001 -0.3 0.3 FORMAT "%10.5"
 /begin ANNOTATION ANNOTATION_LABEL "Description (coming from AUTOSAR DESC field)"
  /begin ANNOTATION_TEXT "velocity exit condition as a function of synchro position\r\n" /end ANNOTATION_TEXT
 /end ANNOTATION
 /begin AXIS_DESCR STD_AXIS NO_INPUT_QUANTITY RB_PT_PCT_SWC_GAC_CompuMethods_ratio_0p001 4 0.0 20. FORMAT "%10.5" DEPOSIT ABSOLUTE /end AXIS_DESCR
/end CHARACTERISTIC
/begin CHARACTERISTIC GAC_CALIB.GAC_GracC.GAC_VELGRACNSTOPRESETI "" VALUE 0x806124AC DefaultValueRecordLayout_AUTOSAR_Platform_BaseTypes_uint16 1.2 RB_PT_PCT_SWC_GAC_CompuMethods_ratio_0p001 0.0 1.2 FORMAT "%10.5"
 /begin ANNOTATION ANNOTATION_LABEL "Description (coming from AUTOSAR DESC field)"
  /begin ANNOTATION_TEXT "Gear actuator velocity used for resetting the I term during NStop phase.\r\n" /end ANNOTATION_TEXT
 /end ANNOTATION
/end CHARACTERISTIC
/begin CHARACTERISTIC GAC_CALIB.GAC_GracC.GAC_VELGRACSTOPPED "" VALUE 0x806124AE DefaultValueRecordLayout_AUTOSAR_Platform_BaseTypes_sint16 0.6 RB_PT_PCT_SWC_GAC_CompuMethods_ratio_0p0001 -0.3 0.3 FORMAT "%10.5"
 /begin ANNOTATION ANNOTATION_LABEL "Description (coming from AUTOSAR DESC field)"
  /begin ANNOTATION_TEXT "Gear actuator velocity used for detecting if the synchro has stopped\r\n" /end ANNOTATION_TEXT
 /end ANNOTATION
/end CHARACTERISTIC
/begin CHARACTERISTIC GAC_CALIB.GAC_GracC.GAC_VELGRACTHRESHNEUTRALCLOSEOUT "" VALUE 0x806124B0 DefaultValueRecordLayout_AUTOSAR_Platform_BaseTypes_sint16 2.4 RB_PT_PCT_SWC_GAC_CompuMethods_ratio_0p001 -1.2 1.2 FORMAT "%10.5"
 /begin ANNOTATION ANNOTATION_LABEL "Description (coming from AUTOSAR DESC field)"
  /begin ANNOTATION_TEXT "Velocity target for the gear actuator during 'fail push in gear' active.\r\n" /end ANNOTATION_TEXT
 /end ANNOTATION
/end CHARACTERISTIC
/begin CHARACTERISTIC GAC_CALIB.GAC_GracC.GAC_VELSDROPGBLK2 "" VAL_BLK 0x80612400 DefaultValueRecordLayout_AUTOSAR_Platform_BaseTypes_uint16 1.2 RB_PT_PCT_SWC_GAC_CompuMethods_ratio_0p001 0.0 1.2 FORMAT "%10.5"
 /begin ANNOTATION ANNOTATION_LABEL "Description (coming from AUTOSAR DESC field)"
  /begin ANNOTATION_TEXT "Drop velocities for gear block 2 detection, for each actuation aggression\r\n" /end ANNOTATION_TEXT
 /end ANNOTATION
 MATRIX_DIM 4 1 1 /end CHARACTERISTIC
/begin CHARACTERISTIC GAC_CALIB.GAC_GracC.GAC_VELSGRACGRNEGEVSYNCTGT "" CURVE 0x80612B3A RB_PT_PCT_SWC_GAC_RecordLayouts_RL_Curve_sint16_4_sint16_4 2.4 RB_PT_PCT_SWC_GAC_CompuMethods_ratio_0p001 -1.2 1.2 FORMAT "%10.5"
 /begin ANNOTATION ANNOTATION_LABEL "Description (coming from AUTOSAR DESC field)"
  /begin ANNOTATION_TEXT "Gear actuator velocity targets for engaging negative gear in low aggression post-synchro phase.\r\n" /end ANNOTATION_TEXT
 /end ANNOTATION
 /begin AXIS_DESCR STD_AXIS NO_INPUT_QUANTITY RB_PT_PCT_SWC_GAC_CompuMethods_ident 4 -100. 100. FORMAT "%10.5" DEPOSIT ABSOLUTE /end AXIS_DESCR
/end CHARACTERISTIC
/begin CHARACTERISTIC GAC_CALIB.GAC_GracC.GAC_VELSGRACGRNEGEVTGT "" CURVE 0x80612B4C RB_PT_PCT_SWC_GAC_RecordLayouts_RL_Curve_sint16_8_sint16_8 2.4 RB_PT_PCT_SWC_GAC_CompuMethods_ratio_0p001 -1.2 1.2 FORMAT "%10.5"
 /begin ANNOTATION ANNOTATION_LABEL "Description (coming from AUTOSAR DESC field)"
  /begin ANNOTATION_TEXT "Gear actuator velocity targets for engaging negative gear in low aggression pre-synchro phase.\r\n" /end ANNOTATION_TEXT
 /end ANNOTATION
 /begin AXIS_DESCR STD_AXIS NO_INPUT_QUANTITY RB_PT_PCT_SWC_GAC_CompuMethods_ident 8 -100. 100. FORMAT "%10.5" DEPOSIT ABSOLUTE /end AXIS_DESCR
/end CHARACTERISTIC
/begin CHARACTERISTIC GAC_CALIB.GAC_GracC.GAC_VELSGRACGRNEGHISYNCTGT "" CURVE 0x80612B6E RB_PT_PCT_SWC_GAC_RecordLayouts_RL_Curve_sint16_4_sint16_4 2.4 RB_PT_PCT_SWC_GAC_CompuMethods_ratio_0p001 -1.2 1.2 FORMAT "%10.5"
 /begin ANNOTATION ANNOTATION_LABEL "Description (coming from AUTOSAR DESC field)"
  /begin ANNOTATION_TEXT "Gear actuator velocity targets for engaging negative gear in high aggression post-synchro phase.\r\n" /end ANNOTATION_TEXT
 /end ANNOTATION
 /begin AXIS_DESCR STD_AXIS NO_INPUT_QUANTITY RB_PT_PCT_SWC_GAC_CompuMethods_ident 4 -100. 100. FORMAT "%10.5" DEPOSIT ABSOLUTE /end AXIS_DESCR
/end CHARACTERISTIC
/begin CHARACTERISTIC GAC_CALIB.GAC_GracC.GAC_VELSGRACGRNEGHITGT "" CURVE 0x80612B80 RB_PT_PCT_SWC_GAC_RecordLayouts_RL_Curve_sint16_8_sint16_8 2.4 RB_PT_PCT_SWC_GAC_CompuMethods_ratio_0p001 -1.2 1.2 FORMAT "%10.5"
 /begin ANNOTATION ANNOTATION_LABEL "Description (coming from AUTOSAR DESC field)"
  /begin ANNOTATION_TEXT "Gear actuator velocity targets for engaging negative gear in high aggression pre-synchro phase.\r\n" /end ANNOTATION_TEXT
 /end ANNOTATION
 /begin AXIS_DESCR STD_AXIS NO_INPUT_QUANTITY RB_PT_PCT_SWC_GAC_CompuMethods_ident 8 -100. 100. FORMAT "%10.5" DEPOSIT ABSOLUTE /end AXIS_DESCR
/end CHARACTERISTIC
/begin CHARACTERISTIC GAC_CALIB.GAC_GracC.GAC_VELSGRACGRNEGLOWSYNCTGT "" CURVE 0x80612BA2 RB_PT_PCT_SWC_GAC_RecordLayouts_RL_Curve_sint16_4_sint16_4 2.4 RB_PT_PCT_SWC_GAC_CompuMethods_ratio_0p001 -1.2 1.2 FORMAT "%10.5"
 /begin ANNOTATION ANNOTATION_LABEL "Description (coming from AUTOSAR DESC field)"
  /begin ANNOTATION_TEXT "Gear actuator velocity targets for engaging negative gear in low aggression post-synchro phase.\r\n" /end ANNOTATION_TEXT
 /end ANNOTATION
 /begin AXIS_DESCR STD_AXIS NO_INPUT_QUANTITY RB_PT_PCT_SWC_GAC_CompuMethods_ident 4 -100. 100. FORMAT "%10.5" DEPOSIT ABSOLUTE /end AXIS_DESCR
/end CHARACTERISTIC
/begin CHARACTERISTIC GAC_CALIB.GAC_GracC.GAC_VELSGRACGRNEGLOWTGT "" CURVE 0x80612BB4 RB_PT_PCT_SWC_GAC_RecordLayouts_RL_Curve_sint16_8_sint16_8 2.4 RB_PT_PCT_SWC_GAC_CompuMethods_ratio_0p001 -1.2 1.2 FORMAT "%10.5"
 /begin ANNOTATION ANNOTATION_LABEL "Description (coming from AUTOSAR DESC field)"
  /begin ANNOTATION_TEXT "Gear actuator velocity targets for engaging negative gear in low aggression pre-synchro phase.\r\n" /end ANNOTATION_TEXT
 /end ANNOTATION
 /begin AXIS_DESCR STD_AXIS NO_INPUT_QUANTITY RB_PT_PCT_SWC_GAC_CompuMethods_ident 8 -100. 100. FORMAT "%10.5" DEPOSIT ABSOLUTE /end AXIS_DESCR
/end CHARACTERISTIC
/begin CHARACTERISTIC GAC_CALIB.GAC_GracC.GAC_VELSGRACGRNEGMEDSYNCTGT "" CURVE 0x80612BD6 RB_PT_PCT_SWC_GAC_RecordLayouts_RL_Curve_sint16_4_sint16_4 2.4 RB_PT_PCT_SWC_GAC_CompuMethods_ratio_0p001 -1.2 1.2 FORMAT "%10.5"
 /begin ANNOTATION ANNOTATION_LABEL "Description (coming from AUTOSAR DESC field)"
  /begin ANNOTATION_TEXT "Gear actuator velocity targets for engaging negative gear in medium aggression post-synchro phase.\r\n" /end ANNOTATION_TEXT
 /end ANNOTATION
 /begin AXIS_DESCR STD_AXIS NO_INPUT_QUANTITY RB_PT_PCT_SWC_GAC_CompuMethods_ident 4 -100. 100. FORMAT "%10.5" DEPOSIT ABSOLUTE /end AXIS_DESCR
/end CHARACTERISTIC
/begin CHARACTERISTIC GAC_CALIB.GAC_GracC.GAC_VELSGRACGRNEGMEDTGT "" CURVE 0x80612BE8 RB_PT_PCT_SWC_GAC_RecordLayouts_RL_Curve_sint16_8_sint16_8 2.4 RB_PT_PCT_SWC_GAC_CompuMethods_ratio_0p001 -1.2 1.2 FORMAT "%10.5"
 /begin ANNOTATION ANNOTATION_LABEL "Description (coming from AUTOSAR DESC field)"
  /begin ANNOTATION_TEXT "Gear actuator velocity targets for engaging negative gear in medium aggression pre-synchro phase.\r\n" /end ANNOTATION_TEXT
 /end ANNOTATION
 /begin AXIS_DESCR STD_AXIS NO_INPUT_QUANTITY RB_PT_PCT_SWC_GAC_CompuMethods_ident 8 -100. 100. FORMAT "%10.5" DEPOSIT ABSOLUTE /end AXIS_DESCR
/end CHARACTERISTIC
/begin CHARACTERISTIC GAC_CALIB.GAC_GracC.GAC_VELSGRACGRNEGSTATICSYNCTGT "" CURVE 0x80612C0A RB_PT_PCT_SWC_GAC_RecordLayouts_RL_Curve_sint16_4_sint16_4 2.4 RB_PT_PCT_SWC_GAC_CompuMethods_ratio_0p001 -1.2 1.2 FORMAT "%10.5"
 /begin ANNOTATION ANNOTATION_LABEL "Description (coming from AUTOSAR DESC field)"
  /begin ANNOTATION_TEXT "Gear actuator velocity targets for engaging negative gear in low aggression post-synchro phase.\r\n" /end ANNOTATION_TEXT
 /end ANNOTATION
 /begin AXIS_DESCR STD_AXIS NO_INPUT_QUANTITY RB_PT_PCT_SWC_GAC_CompuMethods_ident 4 -100. 100. FORMAT "%10.5" DEPOSIT ABSOLUTE /end AXIS_DESCR
/end CHARACTERISTIC
/begin CHARACTERISTIC GAC_CALIB.GAC_GracC.GAC_VELSGRACGRNEGSTATICTGT "" CURVE 0x80612C1C RB_PT_PCT_SWC_GAC_RecordLayouts_RL_Curve_sint16_8_sint16_8 2.4 RB_PT_PCT_SWC_GAC_CompuMethods_ratio_0p001 -1.2 1.2 FORMAT "%10.5"
 /begin ANNOTATION ANNOTATION_LABEL "Description (coming from AUTOSAR DESC field)"
  /begin ANNOTATION_TEXT "Gear actuator velocity targets for engaging negative gear in low aggression pre-synchro phase.\r\n" /end ANNOTATION_TEXT
 /end ANNOTATION
 /begin AXIS_DESCR STD_AXIS NO_INPUT_QUANTITY RB_PT_PCT_SWC_GAC_CompuMethods_ident 8 -100. 100. FORMAT "%10.5" DEPOSIT ABSOLUTE /end AXIS_DESCR
/end CHARACTERISTIC
/begin CHARACTERISTIC GAC_CALIB.GAC_GracC.GAC_VELSGRACGRNEGVLOWSYNCTGT "" CURVE 0x80612C3E RB_PT_PCT_SWC_GAC_RecordLayouts_RL_Curve_sint16_4_sint16_4 2.4 RB_PT_PCT_SWC_GAC_CompuMethods_ratio_0p001 -1.2 1.2 FORMAT "%10.5"
 /begin ANNOTATION ANNOTATION_LABEL "Description (coming from AUTOSAR DESC field)"
  /begin ANNOTATION_TEXT "Gear actuator velocity targets for engaging negative gear in low aggression post-synchro phase.\r\n" /end ANNOTATION_TEXT
 /end ANNOTATION
 /begin AXIS_DESCR STD_AXIS NO_INPUT_QUANTITY RB_PT_PCT_SWC_GAC_CompuMethods_ident 4 -100. 100. FORMAT "%10.5" DEPOSIT ABSOLUTE /end AXIS_DESCR
/end CHARACTERISTIC
/begin CHARACTERISTIC GAC_CALIB.GAC_GracC.GAC_VELSGRACGRNEGVLOWTGT "" CURVE 0x80612C50 RB_PT_PCT_SWC_GAC_RecordLayouts_RL_Curve_sint16_8_sint16_8 2.4 RB_PT_PCT_SWC_GAC_CompuMethods_ratio_0p001 -1.2 1.2 FORMAT "%10.5"
 /begin ANNOTATION ANNOTATION_LABEL "Description (coming from AUTOSAR DESC field)"
  /begin ANNOTATION_TEXT "Gear actuator velocity targets for engaging negative gear in low aggression pre-synchro phase.\r\n" /end ANNOTATION_TEXT
 /end ANNOTATION
 /begin AXIS_DESCR STD_AXIS NO_INPUT_QUANTITY RB_PT_PCT_SWC_GAC_CompuMethods_ident 8 -100. 100. FORMAT "%10.5" DEPOSIT ABSOLUTE /end AXIS_DESCR
/end CHARACTERISTIC
/begin CHARACTERISTIC GAC_CALIB.GAC_GracC.GAC_VELSGRACGRPOSEVSYNCTGT "" CURVE 0x80612C72 RB_PT_PCT_SWC_GAC_RecordLayouts_RL_Curve_sint16_4_sint16_4 2.4 RB_PT_PCT_SWC_GAC_CompuMethods_ratio_0p001 -1.2 1.2 FORMAT "%10.5"
 /begin ANNOTATION ANNOTATION_LABEL "Description (coming from AUTOSAR DESC field)"
  /begin ANNOTATION_TEXT "Gear actuator velocity targets for engaging positive gear in low aggression post-synchro phase.\r\n" /end ANNOTATION_TEXT
 /end ANNOTATION
 /begin AXIS_DESCR STD_AXIS NO_INPUT_QUANTITY RB_PT_PCT_SWC_GAC_CompuMethods_ident 4 -100. 100. FORMAT "%10.5" DEPOSIT ABSOLUTE /end AXIS_DESCR
/end CHARACTERISTIC
/begin CHARACTERISTIC GAC_CALIB.GAC_GracC.GAC_VELSGRACGRPOSEVTGT "" CURVE 0x80612C84 RB_PT_PCT_SWC_GAC_RecordLayouts_RL_Curve_sint16_8_sint16_8 2.4 RB_PT_PCT_SWC_GAC_CompuMethods_ratio_0p001 -1.2 1.2 FORMAT "%10.5"
 /begin ANNOTATION ANNOTATION_LABEL "Description (coming from AUTOSAR DESC field)"
  /begin ANNOTATION_TEXT "Gear actuator velocity targets for engaging positive gear in low aggression pre-synchro phase.\r\n" /end ANNOTATION_TEXT
 /end ANNOTATION
 /begin AXIS_DESCR STD_AXIS NO_INPUT_QUANTITY RB_PT_PCT_SWC_GAC_CompuMethods_ident 8 -100. 100. FORMAT "%10.5" DEPOSIT ABSOLUTE /end AXIS_DESCR
/end CHARACTERISTIC
/begin CHARACTERISTIC GAC_CALIB.GAC_GracC.GAC_VELSGRACGRPOSHISYNCTGT "" CURVE 0x80612CA6 RB_PT_PCT_SWC_GAC_RecordLayouts_RL_Curve_sint16_4_sint16_4 2.4 RB_PT_PCT_SWC_GAC_CompuMethods_ratio_0p001 -1.2 1.2 FORMAT "%10.5"
 /begin ANNOTATION ANNOTATION_LABEL "Description (coming from AUTOSAR DESC field)"
  /begin ANNOTATION_TEXT "Gear actuator velocity targets for engaging positive gear in high aggression post-synchro phase.\r\n" /end ANNOTATION_TEXT
 /end ANNOTATION
 /begin AXIS_DESCR STD_AXIS NO_INPUT_QUANTITY RB_PT_PCT_SWC_GAC_CompuMethods_ident 4 -100. 100. FORMAT "%10.5" DEPOSIT ABSOLUTE /end AXIS_DESCR
/end CHARACTERISTIC
/begin CHARACTERISTIC GAC_CALIB.GAC_GracC.GAC_VELSGRACGRPOSHITGT "" CURVE 0x80612CB8 RB_PT_PCT_SWC_GAC_RecordLayouts_RL_Curve_sint16_8_sint16_8 2.4 RB_PT_PCT_SWC_GAC_CompuMethods_ratio_0p001 -1.2 1.2 FORMAT "%10.5"
 /begin ANNOTATION ANNOTATION_LABEL "Description (coming from AUTOSAR DESC field)"
  /begin ANNOTATION_TEXT "Gear actuator velocity targets for engaging positive gear in high aggression pre-synchro phase.\r\n" /end ANNOTATION_TEXT
 /end ANNOTATION
 /begin AXIS_DESCR STD_AXIS NO_INPUT_QUANTITY RB_PT_PCT_SWC_GAC_CompuMethods_ident 8 -100. 100. FORMAT "%10.5" DEPOSIT ABSOLUTE /end AXIS_DESCR
/end CHARACTERISTIC
/begin CHARACTERISTIC GAC_CALIB.GAC_GracC.GAC_VELSGRACGRPOSLOWSYNCTGT "" CURVE 0x80612CDA RB_PT_PCT_SWC_GAC_RecordLayouts_RL_Curve_sint16_4_sint16_4 2.4 RB_PT_PCT_SWC_GAC_CompuMethods_ratio_0p001 -1.2 1.2 FORMAT "%10.5"
 /begin ANNOTATION ANNOTATION_LABEL "Description (coming from AUTOSAR DESC field)"
  /begin ANNOTATION_TEXT "Gear actuator velocity targets for engaging positive gear in low aggression post-synchro phase.\r\n" /end ANNOTATION_TEXT
 /end ANNOTATION
 /begin AXIS_DESCR STD_AXIS NO_INPUT_QUANTITY RB_PT_PCT_SWC_GAC_CompuMethods_ident 4 -100. 100. FORMAT "%10.5" DEPOSIT ABSOLUTE /end AXIS_DESCR
/end CHARACTERISTIC
/begin CHARACTERISTIC GAC_CALIB.GAC_GracC.GAC_VELSGRACGRPOSLOWTGT "" CURVE 0x80612CEC RB_PT_PCT_SWC_GAC_RecordLayouts_RL_Curve_sint16_8_sint16_8 2.4 RB_PT_PCT_SWC_GAC_CompuMethods_ratio_0p001 -1.2 1.2 FORMAT "%10.5"
 /begin ANNOTATION ANNOTATION_LABEL "Description (coming from AUTOSAR DESC field)"
  /begin ANNOTATION_TEXT "Gear actuator velocity targets for engaging positive gear in low aggression pre-synchro phase.\r\n" /end ANNOTATION_TEXT
 /end ANNOTATION
 /begin AXIS_DESCR STD_AXIS NO_INPUT_QUANTITY RB_PT_PCT_SWC_GAC_CompuMethods_ident 8 -100. 100. FORMAT "%10.5" DEPOSIT ABSOLUTE /end AXIS_DESCR
/end CHARACTERISTIC
/begin CHARACTERISTIC GAC_CALIB.GAC_GracC.GAC_VELSGRACGRPOSMEDSYNCTGT "" CURVE 0x80612D0E RB_PT_PCT_SWC_GAC_RecordLayouts_RL_Curve_sint16_4_sint16_4 2.4 RB_PT_PCT_SWC_GAC_CompuMethods_ratio_0p001 -1.2 1.2 FORMAT "%10.5"
 /begin ANNOTATION ANNOTATION_LABEL "Description (coming from AUTOSAR DESC field)"
  /begin ANNOTATION_TEXT "Gear actuator velocity targets for engaging positive gear in medium aggression post-synchro phase.\r\n" /end ANNOTATION_TEXT
 /end ANNOTATION
 /begin AXIS_DESCR STD_AXIS NO_INPUT_QUANTITY RB_PT_PCT_SWC_GAC_CompuMethods_ident 4 -100. 100. FORMAT "%10.5" DEPOSIT ABSOLUTE /end AXIS_DESCR
/end CHARACTERISTIC
/begin CHARACTERISTIC GAC_CALIB.GAC_GracC.GAC_VELSGRACGRPOSMEDTGT "" CURVE 0x80612D20 RB_PT_PCT_SWC_GAC_RecordLayouts_RL_Curve_sint16_8_sint16_8 2.4 RB_PT_PCT_SWC_GAC_CompuMethods_ratio_0p001 -1.2 1.2 FORMAT "%10.5"
 /begin ANNOTATION ANNOTATION_LABEL "Description (coming from AUTOSAR DESC field)"
  /begin ANNOTATION_TEXT "Gear actuator velocity targets for engaging positive gear in medium aggression pre-synchro phase.\r\n" /end ANNOTATION_TEXT
 /end ANNOTATION
 /begin AXIS_DESCR STD_AXIS NO_INPUT_QUANTITY RB_PT_PCT_SWC_GAC_CompuMethods_ident 8 -100. 100. FORMAT "%10.5" DEPOSIT ABSOLUTE /end AXIS_DESCR
/end CHARACTERISTIC
/begin CHARACTERISTIC GAC_CALIB.GAC_GracC.GAC_VELSGRACGRPOSSTATICSYNCTGT "" CURVE 0x80612D42 RB_PT_PCT_SWC_GAC_RecordLayouts_RL_Curve_sint16_4_sint16_4 2.4 RB_PT_PCT_SWC_GAC_CompuMethods_ratio_0p001 -1.2 1.2 FORMAT "%10.5"
 /begin ANNOTATION ANNOTATION_LABEL "Description (coming from AUTOSAR DESC field)"
  /begin ANNOTATION_TEXT "Gear actuator velocity targets for engaging positive gear in low aggression post-synchro phase.\r\n" /end ANNOTATION_TEXT
 /end ANNOTATION
 /begin AXIS_DESCR STD_AXIS NO_INPUT_QUANTITY RB_PT_PCT_SWC_GAC_CompuMethods_ident 4 -100. 100. FORMAT "%10.5" DEPOSIT ABSOLUTE /end AXIS_DESCR
/end CHARACTERISTIC
/begin CHARACTERISTIC GAC_CALIB.GAC_GracC.GAC_VELSGRACGRPOSSTATICTGT "" CURVE 0x80612D54 RB_PT_PCT_SWC_GAC_RecordLayouts_RL_Curve_sint16_8_sint16_8 2.4 RB_PT_PCT_SWC_GAC_CompuMethods_ratio_0p001 -1.2 1.2 FORMAT "%10.5"
 /begin ANNOTATION ANNOTATION_LABEL "Description (coming from AUTOSAR DESC field)"
  /begin ANNOTATION_TEXT "Gear actuator velocity targets for engaging positive gear in low aggression pre-synchro phase.\r\n" /end ANNOTATION_TEXT
 /end ANNOTATION
 /begin AXIS_DESCR STD_AXIS NO_INPUT_QUANTITY RB_PT_PCT_SWC_GAC_CompuMethods_ident 8 -100. 100. FORMAT "%10.5" DEPOSIT ABSOLUTE /end AXIS_DESCR
/end CHARACTERISTIC
/begin CHARACTERISTIC GAC_CALIB.GAC_GracC.GAC_VELSGRACGRPOSVLOWSYNCTGT "" CURVE 0x80612D76 RB_PT_PCT_SWC_GAC_RecordLayouts_RL_Curve_sint16_4_sint16_4 2.4 RB_PT_PCT_SWC_GAC_CompuMethods_ratio_0p001 -1.2 1.2 FORMAT "%10.5"
 /begin ANNOTATION ANNOTATION_LABEL "Description (coming from AUTOSAR DESC field)"
  /begin ANNOTATION_TEXT "Gear actuator velocity targets for engaging positive gear in low aggression post-synchro phase.\r\n" /end ANNOTATION_TEXT
 /end ANNOTATION
 /begin AXIS_DESCR STD_AXIS NO_INPUT_QUANTITY RB_PT_PCT_SWC_GAC_CompuMethods_ident 4 -100. 100. FORMAT "%10.5" DEPOSIT ABSOLUTE /end AXIS_DESCR
/end CHARACTERISTIC
/begin CHARACTERISTIC GAC_CALIB.GAC_GracC.GAC_VELSGRACGRPOSVLOWTGT "" CURVE 0x80612D88 RB_PT_PCT_SWC_GAC_RecordLayouts_RL_Curve_sint16_8_sint16_8 2.4 RB_PT_PCT_SWC_GAC_CompuMethods_ratio_0p001 -1.2 1.2 FORMAT "%10.5"
 /begin ANNOTATION ANNOTATION_LABEL "Description (coming from AUTOSAR DESC field)"
  /begin ANNOTATION_TEXT "Gear actuator velocity targets for engaging positive gear in low aggression pre-synchro phase.\r\n" /end ANNOTATION_TEXT
 /end ANNOTATION
 /begin AXIS_DESCR STD_AXIS NO_INPUT_QUANTITY RB_PT_PCT_SWC_GAC_CompuMethods_ident 8 -100. 100. FORMAT "%10.5" DEPOSIT ABSOLUTE /end AXIS_DESCR
/end CHARACTERISTIC
/begin CHARACTERISTIC GAC_CALIB.GAC_GracC.GAC_VELSGRACNSTARTGRNEGHI "" CURVE 0x80612DAA RB_PT_PCT_SWC_GAC_RecordLayouts_RL_Curve_sint16_3_sint16_3 2.4 RB_PT_PCT_SWC_GAC_CompuMethods_ratio_0p001 -1.2 1.2 FORMAT "%10.5"
 /begin ANNOTATION ANNOTATION_LABEL "Description (coming from AUTOSAR DESC field)"
  /begin ANNOTATION_TEXT "Velocity targets for start of Neutral actuation based on temperature, from negative engagement side with high aggression actuation.\r\n" /end ANNOTATION_TEXT
 /end ANNOTATION
 /begin AXIS_DESCR STD_AXIS NO_INPUT_QUANTITY RB_PT_PCT_SWC_GAC_CompuMethods_ident 3 -50. 200. FORMAT "%10.5" DEPOSIT ABSOLUTE /end AXIS_DESCR
/end CHARACTERISTIC
/begin CHARACTERISTIC GAC_CALIB.GAC_GracC.GAC_VELSGRACNSTARTGRNEGLOW "" CURVE 0x80612DB8 RB_PT_PCT_SWC_GAC_RecordLayouts_RL_Curve_sint16_3_sint16_3 2.4 RB_PT_PCT_SWC_GAC_CompuMethods_ratio_0p001 -1.2 1.2 FORMAT "%10.5"
 /begin ANNOTATION ANNOTATION_LABEL "Description (coming from AUTOSAR DESC field)"
  /begin ANNOTATION_TEXT "Velocity targets for start of Neutral actuation based on temperature, from negative engagement side with low aggression actuation.\r\n" /end ANNOTATION_TEXT
 /end ANNOTATION
 /begin AXIS_DESCR STD_AXIS NO_INPUT_QUANTITY RB_PT_PCT_SWC_GAC_CompuMethods_ident 3 -50. 200. FORMAT "%10.5" DEPOSIT ABSOLUTE /end AXIS_DESCR
/end CHARACTERISTIC
/begin CHARACTERISTIC GAC_CALIB.GAC_GracC.GAC_VELSGRACNSTARTGRNEGMAX "" CURVE 0x80612DC6 RB_PT_PCT_SWC_GAC_RecordLayouts_RL_Curve_sint16_3_sint16_3 2.4 RB_PT_PCT_SWC_GAC_CompuMethods_ratio_0p001 -1.2 1.2 FORMAT "%10.5"
 /begin ANNOTATION ANNOTATION_LABEL "Description (coming from AUTOSAR DESC field)"
  /begin ANNOTATION_TEXT "Velocity targets for start of Neutral actuation based on temperature, from negative engagement side with max aggression actuation.\r\n" /end ANNOTATION_TEXT
 /end ANNOTATION
 /begin AXIS_DESCR STD_AXIS NO_INPUT_QUANTITY RB_PT_PCT_SWC_GAC_CompuMethods_ident 3 -50. 200. FORMAT "%10.5" DEPOSIT ABSOLUTE /end AXIS_DESCR
/end CHARACTERISTIC
/begin CHARACTERISTIC GAC_CALIB.GAC_GracC.GAC_VELSGRACNSTARTGRNEGMED "" CURVE 0x80612DD4 RB_PT_PCT_SWC_GAC_RecordLayouts_RL_Curve_sint16_3_sint16_3 2.4 RB_PT_PCT_SWC_GAC_CompuMethods_ratio_0p001 -1.2 1.2 FORMAT "%10.5"
 /begin ANNOTATION ANNOTATION_LABEL "Description (coming from AUTOSAR DESC field)"
  /begin ANNOTATION_TEXT "Velocity targets for start of Neutral actuation based on temperature, from negative engagement side with med aggression actuation.\r\n" /end ANNOTATION_TEXT
 /end ANNOTATION
 /begin AXIS_DESCR STD_AXIS NO_INPUT_QUANTITY RB_PT_PCT_SWC_GAC_CompuMethods_ident 3 -50. 200. FORMAT "%10.5" DEPOSIT ABSOLUTE /end AXIS_DESCR
/end CHARACTERISTIC
/begin CHARACTERISTIC GAC_CALIB.GAC_GracC.GAC_VELSGRACNSTARTGRPOSHI "" CURVE 0x80612DE2 RB_PT_PCT_SWC_GAC_RecordLayouts_RL_Curve_sint16_3_sint16_3 2.4 RB_PT_PCT_SWC_GAC_CompuMethods_ratio_0p001 -1.2 1.2 FORMAT "%10.5"
 /begin ANNOTATION ANNOTATION_LABEL "Description (coming from AUTOSAR DESC field)"
  /begin ANNOTATION_TEXT "Velocity targets for start of Neutral actuation based on temperature, from positive engagement side with high aggression actuation.\r\n" /end ANNOTATION_TEXT
 /end ANNOTATION
 /begin AXIS_DESCR STD_AXIS NO_INPUT_QUANTITY RB_PT_PCT_SWC_GAC_CompuMethods_ident 3 -50. 200. FORMAT "%10.5" DEPOSIT ABSOLUTE /end AXIS_DESCR
/end CHARACTERISTIC
/begin CHARACTERISTIC GAC_CALIB.GAC_GracC.GAC_VELSGRACNSTARTGRPOSLOW "" CURVE 0x80612DF0 RB_PT_PCT_SWC_GAC_RecordLayouts_RL_Curve_sint16_3_sint16_3 2.4 RB_PT_PCT_SWC_GAC_CompuMethods_ratio_0p001 -1.2 1.2 FORMAT "%10.5"
 /begin ANNOTATION ANNOTATION_LABEL "Description (coming from AUTOSAR DESC field)"
  /begin ANNOTATION_TEXT "Velocity targets for start of Neutral actuation based on temperature, from positive engagement side with low aggression actuation.\r\n" /end ANNOTATION_TEXT
 /end ANNOTATION
 /begin AXIS_DESCR STD_AXIS NO_INPUT_QUANTITY RB_PT_PCT_SWC_GAC_CompuMethods_ident 3 -50. 200. FORMAT "%10.5" DEPOSIT ABSOLUTE /end AXIS_DESCR
/end CHARACTERISTIC
/begin CHARACTERISTIC GAC_CALIB.GAC_GracC.GAC_VELSGRACNSTARTGRPOSMAX "" CURVE 0x80612DFE RB_PT_PCT_SWC_GAC_RecordLayouts_RL_Curve_sint16_3_sint16_3 2.4 RB_PT_PCT_SWC_GAC_CompuMethods_ratio_0p001 -1.2 1.2 FORMAT "%10.5"
 /begin ANNOTATION ANNOTATION_LABEL "Description (coming from AUTOSAR DESC field)"
  /begin ANNOTATION_TEXT "Velocity targets for start of Neutral actuation based on temperature, from positive engagement side with max aggression actuation.\r\n" /end ANNOTATION_TEXT
 /end ANNOTATION
 /begin AXIS_DESCR STD_AXIS NO_INPUT_QUANTITY RB_PT_PCT_SWC_GAC_CompuMethods_ident 3 -50. 200. FORMAT "%10.5" DEPOSIT ABSOLUTE /end AXIS_DESCR
/end CHARACTERISTIC
/begin CHARACTERISTIC GAC_CALIB.GAC_GracC.GAC_VELSGRACNSTARTGRPOSMED "" CURVE 0x80612E0C RB_PT_PCT_SWC_GAC_RecordLayouts_RL_Curve_sint16_3_sint16_3 2.4 RB_PT_PCT_SWC_GAC_CompuMethods_ratio_0p001 -1.2 1.2 FORMAT "%10.5"
 /begin ANNOTATION ANNOTATION_LABEL "Description (coming from AUTOSAR DESC field)"
  /begin ANNOTATION_TEXT "Velocity targets for start of Neutral actuation based on temperature, from positive engagement side with medium aggression actuation.\r\n" /end ANNOTATION_TEXT
 /end ANNOTATION
 /begin AXIS_DESCR STD_AXIS NO_INPUT_QUANTITY RB_PT_PCT_SWC_GAC_CompuMethods_ident 3 -50. 200. FORMAT "%10.5" DEPOSIT ABSOLUTE /end AXIS_DESCR
/end CHARACTERISTIC
/begin CHARACTERISTIC GAC_CALIB.GAC_GracC.GAC_VELSGRACNSTOP "" CURVE 0x80612E1A RB_PT_PCT_SWC_GAC_RecordLayouts_RL_Curve_sint16_11_sint16_11 2.4 RB_PT_PCT_SWC_GAC_CompuMethods_ratio_0p001 -1.2 1.2 FORMAT "%10.5"
 /begin ANNOTATION ANNOTATION_LABEL "Description (coming from AUTOSAR DESC field)"
  /begin ANNOTATION_TEXT "Gear actuator velocity targets for NStop phase without temperature interpolation.\r\n" /end ANNOTATION_TEXT
 /end ANNOTATION
 /begin AXIS_DESCR STD_AXIS NO_INPUT_QUANTITY RB_PT_PCT_SWC_GAC_CompuMethods_ratio_0p001 11 -20. 20. FORMAT "%10.5" DEPOSIT ABSOLUTE /end AXIS_DESCR
/end CHARACTERISTIC
/begin CHARACTERISTIC GAC_CALIB.GAC_GracC.GAC_VELSGRACNSTOPINTRP "" MAP 0x80612E48 RB_PT_PCT_SWC_GAC_RecordLayouts_RL_Map_sint16_33_sint16_11_sint16_3 2.4 RB_PT_PCT_SWC_GAC_CompuMethods_ratio_0p001 -1.2 1.2 FORMAT "%10.5"
 /begin ANNOTATION ANNOTATION_LABEL "Description (coming from AUTOSAR DESC field)"
  /begin ANNOTATION_TEXT "Gear actuator velocity targets for NStop phase with temperature interpolation.\r\n" /end ANNOTATION_TEXT
 /end ANNOTATION
 /begin AXIS_DESCR STD_AXIS NO_INPUT_QUANTITY RB_PT_PCT_SWC_GAC_CompuMethods_ratio_0p001 11 -20. 20. FORMAT "%10.5" DEPOSIT ABSOLUTE /end AXIS_DESCR
 /begin AXIS_DESCR STD_AXIS NO_INPUT_QUANTITY RB_PT_PCT_SWC_GAC_CompuMethods_ident 3 -50. 200. FORMAT "%10.5" DEPOSIT ABSOLUTE /end AXIS_DESCR
/end CHARACTERISTIC
/begin CHARACTERISTIC GAC_CALIB.GAC_GracC.GAC_VELSRISEGBLK2 "" VAL_BLK 0x80612408 DefaultValueRecordLayout_AUTOSAR_Platform_BaseTypes_uint16 1.2 RB_PT_PCT_SWC_GAC_CompuMethods_ratio_0p001 0.0 1.2 FORMAT "%10.5"
 /begin ANNOTATION ANNOTATION_LABEL "Description (coming from AUTOSAR DESC field)"
  /begin ANNOTATION_TEXT "Rise velocities for gear block 2 detection, for each actuation aggression\r\n" /end ANNOTATION_TEXT
 /end ANNOTATION
 MATRIX_DIM 4 1 1 /end CHARACTERISTIC
/begin CHARACTERISTIC GAC_CALIB.GAC_GracD.GAC_AREAPISTDEFAULT "" VALUE 0x80612EE0 DefaultValueRecordLayout_AUTOSAR_Platform_BaseTypes_uint16 0.01 RB_PT_PCT_SWC_GAC_CompuMethods_ratio_0p000001 0.0 0.01 FORMAT "%10.5"
 /begin ANNOTATION ANNOTATION_LABEL "Description (coming from AUTOSAR DESC field)" /begin ANNOTATION_TEXT "Default area of piston in calculations\r\n" /end ANNOTATION_TEXT /end ANNOTATION
/end CHARACTERISTIC
/begin CHARACTERISTIC GAC_CALIB.GAC_GracD.GAC_BlkrRlsCtrl.GAC_POSNGRACBLKRRLSEND "" VALUE 0x80612FA0 DefaultValueRecordLayout_AUTOSAR_Platform_BaseTypes_uint16 20.0 RB_PT_PCT_SWC_GAC_CompuMethods_ratio_0p001 0.0 20. FORMAT "%10.5"
 /begin ANNOTATION ANNOTATION_LABEL "Description (coming from AUTOSAR DESC field)"
  /begin ANNOTATION_TEXT "Gear actuator position used for detecting blocker release end.\r\n" /end ANNOTATION_TEXT
 /end ANNOTATION
/end CHARACTERISTIC
/begin CHARACTERISTIC GAC_CALIB.GAC_GracD.GAC_BlkrRlsCtrl.GAC_PRESSBLKRRLSGRNEG "" VAL_BLK 0x80612F8C DefaultValueRecordLayout_AUTOSAR_Platform_BaseTypes_uint16 32.0 RB_PT_PCT_SWC_GAC_CompuMethods_ratio_0p001 0.0 32. FORMAT "%10.5"
 /begin ANNOTATION ANNOTATION_LABEL "Description (coming from AUTOSAR DESC field)"
  /begin ANNOTATION_TEXT "Pressures for blocker release for engaging negative gear.\r\n" /end ANNOTATION_TEXT
 /end ANNOTATION
 MATRIX_DIM 4 1 1 /end CHARACTERISTIC
/begin CHARACTERISTIC GAC_CALIB.GAC_GracD.GAC_BlkrRlsCtrl.GAC_PRESSBLKRRLSGRPOS "" VAL_BLK 0x80612F94 DefaultValueRecordLayout_AUTOSAR_Platform_BaseTypes_uint16 32.0 RB_PT_PCT_SWC_GAC_CompuMethods_ratio_0p001 0.0 32. FORMAT "%10.5"
 /begin ANNOTATION ANNOTATION_LABEL "Description (coming from AUTOSAR DESC field)"
  /begin ANNOTATION_TEXT "Pressures for blocker release for engaging positive gear.\r\n" /end ANNOTATION_TEXT
 /end ANNOTATION
 MATRIX_DIM 4 1 1 /end CHARACTERISTIC
/begin CHARACTERISTIC GAC_CALIB.GAC_GracD.GAC_BlkrRlsCtrl.GAC_PRESSMINBLKRRLS "" VAL_BLK 0x80612F9C DefaultValueRecordLayout_AUTOSAR_Platform_BaseTypes_uint16 32.0 RB_PT_PCT_SWC_GAC_CompuMethods_ratio_0p001 0.0 32. FORMAT "%10.5"
 /begin ANNOTATION ANNOTATION_LABEL "Description (coming from AUTOSAR DESC field)"
  /begin ANNOTATION_TEXT "Minimum pressure steps for blocker release engaging negative/positive gears.\r\n" /end ANNOTATION_TEXT
 /end ANNOTATION
 MATRIX_DIM 2 1 1 /end CHARACTERISTIC
/begin CHARACTERISTIC GAC_CALIB.GAC_GracD.GAC_BlkrRlsCtrl.GAC_PRESSSTEPBLKRLSSTATIC "" VALUE 0x80612FA2 DefaultValueRecordLayout_AUTOSAR_Platform_BaseTypes_uint16 32.0 RB_PT_PCT_SWC_GAC_CompuMethods_ratio_0p001 0.0 32. FORMAT "%10.5"
 /begin ANNOTATION ANNOTATION_LABEL "Description (coming from AUTOSAR DESC field)"
  /begin ANNOTATION_TEXT "Minimum pressure step for blocker release for static shift.\r\n" /end ANNOTATION_TEXT
 /end ANNOTATION
/end CHARACTERISTIC
/begin CHARACTERISTIC GAC_CALIB.GAC_GracD.GAC_BOBFLGBYPASSSYNCVALID "" VALUE 0x80612F6E DefaultValueRecordLayout_AUTOSAR_Platform_BaseTypes_uint8 255.0 DefaultIdenticalCompu 0.0 255. FORMAT "%10.5"
 /begin ANNOTATION ANNOTATION_LABEL "Description (coming from AUTOSAR DESC field)" /begin ANNOTATION_TEXT "Bob flag to bypass valid sync check\r\n" /end ANNOTATION_TEXT /end ANNOTATION
/end CHARACTERISTIC
/begin CHARACTERISTIC GAC_CALIB.GAC_GracD.GAC_BRAKEPRESSVLOWAGGLIM "" VALUE 0x80612EE2 DefaultValueRecordLayout_AUTOSAR_Platform_BaseTypes_uint16 409.5 RB_PT_PCT_SWC_GAC_CompuMethods_ratio_0p1 0.0 409.5 FORMAT "%10.5"
 /begin ANNOTATION ANNOTATION_LABEL "Description (coming from AUTOSAR DESC field)"
  /begin ANNOTATION_TEXT "The brake pressure limit for the very low aggression to be commanded\r\n" /end ANNOTATION_TEXT
 /end ANNOTATION
/end CHARACTERISTIC
/begin CHARACTERISTIC GAC_CALIB.GAC_GracD.GAC_DIAPISTACTUATORLEFT "" VALUE 0x80612EE4 DefaultValueRecordLayout_AUTOSAR_Platform_BaseTypes_uint16 65.535 RB_PT_PCT_SWC_GAC_CompuMethods_ratio_0p001 0.0 65.535 FORMAT "%10.5"
 /begin ANNOTATION ANNOTATION_LABEL "Description (coming from AUTOSAR DESC field)" /begin ANNOTATION_TEXT "Diameter of the actuator piston - left\r\n" /end ANNOTATION_TEXT /end ANNOTATION
/end CHARACTERISTIC
/begin CHARACTERISTIC GAC_CALIB.GAC_GracD.GAC_DIAPISTACTUATORRIGHT "" VALUE 0x80612EE6 DefaultValueRecordLayout_AUTOSAR_Platform_BaseTypes_uint16 65.535 RB_PT_PCT_SWC_GAC_CompuMethods_ratio_0p001 0.0 65.535 FORMAT "%10.5"
 /begin ANNOTATION ANNOTATION_LABEL "Description (coming from AUTOSAR DESC field)" /begin ANNOTATION_TEXT "Diameter of the actuator piston - right\r\n" /end ANNOTATION_TEXT /end ANNOTATION
/end CHARACTERISTIC
/begin CHARACTERISTIC GAC_CALIB.GAC_GracD.GAC_DtntCtrl.GAC_FLGSAGGDTNTCTRLOK "" VAL_BLK 0x80612FAC DefaultValueRecordLayout_AUTOSAR_Platform_BaseTypes_boolean 255.0 AUTOSAR_Platform_CompuMethods_boolean 0.0 255. FORMAT "%10.5"
 /begin ANNOTATION ANNOTATION_LABEL "Description (coming from AUTOSAR DESC field)"
  /begin ANNOTATION_TEXT "Array of flags enabling detent control for each actuation aggression.\r\n" /end ANNOTATION_TEXT
 /end ANNOTATION
 MATRIX_DIM 4 1 1 /end CHARACTERISTIC
/begin CHARACTERISTIC GAC_CALIB.GAC_GracD.GAC_DtntCtrl.GAC_PRESSDTNTCTRLEOLGRNEG "" VALUE 0x80612FB0 DefaultValueRecordLayout_AUTOSAR_Platform_BaseTypes_sint16 64.0 RB_PT_PCT_SWC_GAC_CompuMethods_ratio_0p001 -32. 32. FORMAT "%10.5"
 /begin ANNOTATION ANNOTATION_LABEL "Description (coming from AUTOSAR DESC field)"
  /begin ANNOTATION_TEXT "Pressure for detent control engaging negative gear, during EOL Neutral learn.\r\n" /end ANNOTATION_TEXT
 /end ANNOTATION
/end CHARACTERISTIC
/begin CHARACTERISTIC GAC_CALIB.GAC_GracD.GAC_DtntCtrl.GAC_PRESSDTNTCTRLEOLGRPOS "" VALUE 0x80612FB2 DefaultValueRecordLayout_AUTOSAR_Platform_BaseTypes_sint16 64.0 RB_PT_PCT_SWC_GAC_CompuMethods_ratio_0p001 -32. 32. FORMAT "%10.5"
 /begin ANNOTATION ANNOTATION_LABEL "Description (coming from AUTOSAR DESC field)"
  /begin ANNOTATION_TEXT "Pressure for detent control engaging positive gear, during EOL Neutral learn.\r\n" /end ANNOTATION_TEXT
 /end ANNOTATION
/end CHARACTERISTIC
/begin CHARACTERISTIC GAC_CALIB.GAC_GracD.GAC_DtntCtrl.GAC_PRESSDTNTCTRLEVGRNEG "" MAP 0x80612FB4 RB_PT_PCT_SWC_GAC_RecordLayouts_RL_Map_sint16_12_uint16_3_sint16_4 64.0 RB_PT_PCT_SWC_GAC_CompuMethods_ratio_0p001 -32. 32. FORMAT "%10.5"
 /begin ANNOTATION ANNOTATION_LABEL "Description (coming from AUTOSAR DESC field)"
  /begin ANNOTATION_TEXT "Detent pressure offset for negative gear engagements - static aggression\r\n" /end ANNOTATION_TEXT
 /end ANNOTATION
 /begin AXIS_DESCR STD_AXIS NO_INPUT_QUANTITY RB_PT_PCT_SWC_GAC_CompuMethods_ratio_0p001 3 0.0 40. FORMAT "%10.5" DEPOSIT ABSOLUTE /end AXIS_DESCR
 /begin AXIS_DESCR STD_AXIS NO_INPUT_QUANTITY RB_PT_PCT_SWC_GAC_CompuMethods_ident 4 -50. 200. FORMAT "%10.5" DEPOSIT ABSOLUTE /end AXIS_DESCR
/end CHARACTERISTIC
/begin CHARACTERISTIC GAC_CALIB.GAC_GracD.GAC_DtntCtrl.GAC_PRESSDTNTCTRLEVGRPOS "" MAP 0x80612FDE RB_PT_PCT_SWC_GAC_RecordLayouts_RL_Map_sint16_12_uint16_3_sint16_4 64.0 RB_PT_PCT_SWC_GAC_CompuMethods_ratio_0p001 -32. 32. FORMAT "%10.5"
 /begin ANNOTATION ANNOTATION_LABEL "Description (coming from AUTOSAR DESC field)"
  /begin ANNOTATION_TEXT "Detent pressure offset for positive gear engagements - static aggression\r\n" /end ANNOTATION_TEXT
 /end ANNOTATION
 /begin AXIS_DESCR STD_AXIS NO_INPUT_QUANTITY RB_PT_PCT_SWC_GAC_CompuMethods_ratio_0p001 3 0.0 40. FORMAT "%10.5" DEPOSIT ABSOLUTE /end AXIS_DESCR
 /begin AXIS_DESCR STD_AXIS NO_INPUT_QUANTITY RB_PT_PCT_SWC_GAC_CompuMethods_ident 4 -50. 200. FORMAT "%10.5" DEPOSIT ABSOLUTE /end AXIS_DESCR
/end CHARACTERISTIC
/begin CHARACTERISTIC GAC_CALIB.GAC_GracD.GAC_DtntCtrl.GAC_PRESSDTNTCTRLHIGRNEG "" MAP 0x80613008 RB_PT_PCT_SWC_GAC_RecordLayouts_RL_Map_sint16_12_uint16_3_sint16_4 64.0 RB_PT_PCT_SWC_GAC_CompuMethods_ratio_0p001 -32. 32. FORMAT "%10.5"
 /begin ANNOTATION ANNOTATION_LABEL "Description (coming from AUTOSAR DESC field)"
  /begin ANNOTATION_TEXT "Detent pressure offset for negative gear engagements - high aggression\r\n" /end ANNOTATION_TEXT
 /end ANNOTATION
 /begin AXIS_DESCR STD_AXIS NO_INPUT_QUANTITY RB_PT_PCT_SWC_GAC_CompuMethods_ratio_0p001 3 0.0 40. FORMAT "%10.5" DEPOSIT ABSOLUTE /end AXIS_DESCR
 /begin AXIS_DESCR STD_AXIS NO_INPUT_QUANTITY RB_PT_PCT_SWC_GAC_CompuMethods_ident 4 -50. 200. FORMAT "%10.5" DEPOSIT ABSOLUTE /end AXIS_DESCR
/end CHARACTERISTIC
/begin CHARACTERISTIC GAC_CALIB.GAC_GracD.GAC_DtntCtrl.GAC_PRESSDTNTCTRLHIGRPOS "" MAP 0x80613032 RB_PT_PCT_SWC_GAC_RecordLayouts_RL_Map_sint16_12_uint16_3_sint16_4 64.0 RB_PT_PCT_SWC_GAC_CompuMethods_ratio_0p001 -32. 32. FORMAT "%10.5"
 /begin ANNOTATION ANNOTATION_LABEL "Description (coming from AUTOSAR DESC field)"
  /begin ANNOTATION_TEXT "Detent pressure offset for positive gear engagements - high aggression\r\n" /end ANNOTATION_TEXT
 /end ANNOTATION
 /begin AXIS_DESCR STD_AXIS NO_INPUT_QUANTITY RB_PT_PCT_SWC_GAC_CompuMethods_ratio_0p001 3 0.0 40. FORMAT "%10.5" DEPOSIT ABSOLUTE /end AXIS_DESCR
 /begin AXIS_DESCR STD_AXIS NO_INPUT_QUANTITY RB_PT_PCT_SWC_GAC_CompuMethods_ident 4 -50. 200. FORMAT "%10.5" DEPOSIT ABSOLUTE /end AXIS_DESCR
/end CHARACTERISTIC
/begin CHARACTERISTIC GAC_CALIB.GAC_GracD.GAC_DtntCtrl.GAC_PRESSDTNTCTRLLOWGRNEG "" MAP 0x8061305C RB_PT_PCT_SWC_GAC_RecordLayouts_RL_Map_sint16_12_uint16_3_sint16_4 64.0 RB_PT_PCT_SWC_GAC_CompuMethods_ratio_0p001 -32. 32. FORMAT "%10.5"
 /begin ANNOTATION ANNOTATION_LABEL "Description (coming from AUTOSAR DESC field)"
  /begin ANNOTATION_TEXT "Detent pressure offset for negative gear engagements - low aggression\r\n" /end ANNOTATION_TEXT
 /end ANNOTATION
 /begin AXIS_DESCR STD_AXIS NO_INPUT_QUANTITY RB_PT_PCT_SWC_GAC_CompuMethods_ratio_0p001 3 0.0 40. FORMAT "%10.5" DEPOSIT ABSOLUTE /end AXIS_DESCR
 /begin AXIS_DESCR STD_AXIS NO_INPUT_QUANTITY RB_PT_PCT_SWC_GAC_CompuMethods_ident 4 -50. 200. FORMAT "%10.5" DEPOSIT ABSOLUTE /end AXIS_DESCR
/end CHARACTERISTIC
/begin CHARACTERISTIC GAC_CALIB.GAC_GracD.GAC_DtntCtrl.GAC_PRESSDTNTCTRLLOWGRPOS "" MAP 0x80613086 RB_PT_PCT_SWC_GAC_RecordLayouts_RL_Map_sint16_12_uint16_3_sint16_4 64.0 RB_PT_PCT_SWC_GAC_CompuMethods_ratio_0p001 -32. 32. FORMAT "%10.5"
 /begin ANNOTATION ANNOTATION_LABEL "Description (coming from AUTOSAR DESC field)"
  /begin ANNOTATION_TEXT "Detent pressure offset for positive gear engagements - low aggression\r\n" /end ANNOTATION_TEXT
 /end ANNOTATION
 /begin AXIS_DESCR STD_AXIS NO_INPUT_QUANTITY RB_PT_PCT_SWC_GAC_CompuMethods_ratio_0p001 3 0.0 40. FORMAT "%10.5" DEPOSIT ABSOLUTE /end AXIS_DESCR
 /begin AXIS_DESCR STD_AXIS NO_INPUT_QUANTITY RB_PT_PCT_SWC_GAC_CompuMethods_ident 4 -50. 200. FORMAT "%10.5" DEPOSIT ABSOLUTE /end AXIS_DESCR
/end CHARACTERISTIC
/begin CHARACTERISTIC GAC_CALIB.GAC_GracD.GAC_DtntCtrl.GAC_PRESSDTNTCTRLMEDGRNEG "" MAP 0x806130B0 RB_PT_PCT_SWC_GAC_RecordLayouts_RL_Map_sint16_12_uint16_3_sint16_4 64.0 RB_PT_PCT_SWC_GAC_CompuMethods_ratio_0p001 -32. 32. FORMAT "%10.5"
 /begin ANNOTATION ANNOTATION_LABEL "Description (coming from AUTOSAR DESC field)"
  /begin ANNOTATION_TEXT "Detent pressure offset for negative gear engagements - medium aggression\r\n" /end ANNOTATION_TEXT
 /end ANNOTATION
 /begin AXIS_DESCR STD_AXIS NO_INPUT_QUANTITY RB_PT_PCT_SWC_GAC_CompuMethods_ratio_0p001 3 0.0 40. FORMAT "%10.5" DEPOSIT ABSOLUTE /end AXIS_DESCR
 /begin AXIS_DESCR STD_AXIS NO_INPUT_QUANTITY RB_PT_PCT_SWC_GAC_CompuMethods_ident 4 -50. 200. FORMAT "%10.5" DEPOSIT ABSOLUTE /end AXIS_DESCR
/end CHARACTERISTIC
/begin CHARACTERISTIC GAC_CALIB.GAC_GracD.GAC_DtntCtrl.GAC_PRESSDTNTCTRLMEDGRPOS "" MAP 0x806130DA RB_PT_PCT_SWC_GAC_RecordLayouts_RL_Map_sint16_12_uint16_3_sint16_4 64.0 RB_PT_PCT_SWC_GAC_CompuMethods_ratio_0p001 -32. 32. FORMAT "%10.5"
 /begin ANNOTATION ANNOTATION_LABEL "Description (coming from AUTOSAR DESC field)"
  /begin ANNOTATION_TEXT "Detent pressure offset for positive gear engagements - medium aggression\r\n" /end ANNOTATION_TEXT
 /end ANNOTATION
 /begin AXIS_DESCR STD_AXIS NO_INPUT_QUANTITY RB_PT_PCT_SWC_GAC_CompuMethods_ratio_0p001 3 0.0 40. FORMAT "%10.5" DEPOSIT ABSOLUTE /end AXIS_DESCR
 /begin AXIS_DESCR STD_AXIS NO_INPUT_QUANTITY RB_PT_PCT_SWC_GAC_CompuMethods_ident 4 -50. 200. FORMAT "%10.5" DEPOSIT ABSOLUTE /end AXIS_DESCR
/end CHARACTERISTIC
/begin CHARACTERISTIC GAC_CALIB.GAC_GracD.GAC_DtntCtrl.GAC_PRESSDTNTCTRLSTATICGRNEG "" MAP 0x80613104 RB_PT_PCT_SWC_GAC_RecordLayouts_RL_Map_sint16_12_uint16_3_sint16_4 64.0 RB_PT_PCT_SWC_GAC_CompuMethods_ratio_0p001 -32. 32. FORMAT "%10.5"
 /begin ANNOTATION ANNOTATION_LABEL "Description (coming from AUTOSAR DESC field)"
  /begin ANNOTATION_TEXT "Detent pressure offset for negative gear engagements - static aggression\r\n" /end ANNOTATION_TEXT
 /end ANNOTATION
 /begin AXIS_DESCR STD_AXIS NO_INPUT_QUANTITY RB_PT_PCT_SWC_GAC_CompuMethods_ratio_0p001 3 0.0 40. FORMAT "%10.5" DEPOSIT ABSOLUTE /end AXIS_DESCR
 /begin AXIS_DESCR STD_AXIS NO_INPUT_QUANTITY RB_PT_PCT_SWC_GAC_CompuMethods_ident 4 -50. 200. FORMAT "%10.5" DEPOSIT ABSOLUTE /end AXIS_DESCR
/end CHARACTERISTIC
/begin CHARACTERISTIC GAC_CALIB.GAC_GracD.GAC_DtntCtrl.GAC_PRESSDTNTCTRLSTATICGRPOS "" MAP 0x8061312E RB_PT_PCT_SWC_GAC_RecordLayouts_RL_Map_sint16_12_uint16_3_sint16_4 64.0 RB_PT_PCT_SWC_GAC_CompuMethods_ratio_0p001 -32. 32. FORMAT "%10.5"
 /begin ANNOTATION ANNOTATION_LABEL "Description (coming from AUTOSAR DESC field)"
  /begin ANNOTATION_TEXT "Detent pressure offset for positive gear engagements - static aggression\r\n" /end ANNOTATION_TEXT
 /end ANNOTATION
 /begin AXIS_DESCR STD_AXIS NO_INPUT_QUANTITY RB_PT_PCT_SWC_GAC_CompuMethods_ratio_0p001 3 0.0 40. FORMAT "%10.5" DEPOSIT ABSOLUTE /end AXIS_DESCR
 /begin AXIS_DESCR STD_AXIS NO_INPUT_QUANTITY RB_PT_PCT_SWC_GAC_CompuMethods_ident 4 -50. 200. FORMAT "%10.5" DEPOSIT ABSOLUTE /end AXIS_DESCR
/end CHARACTERISTIC
/begin CHARACTERISTIC GAC_CALIB.GAC_GracD.GAC_DtntCtrl.GAC_PRESSDTNTCTRLVLOWGRNEG "" MAP 0x80613158 RB_PT_PCT_SWC_GAC_RecordLayouts_RL_Map_sint16_12_uint16_3_sint16_4 64.0 RB_PT_PCT_SWC_GAC_CompuMethods_ratio_0p001 -32. 32. FORMAT "%10.5"
 /begin ANNOTATION ANNOTATION_LABEL "Description (coming from AUTOSAR DESC field)"
  /begin ANNOTATION_TEXT "Detent pressure offset for negative gear engagements - very low aggression\r\n" /end ANNOTATION_TEXT
 /end ANNOTATION
 /begin AXIS_DESCR STD_AXIS NO_INPUT_QUANTITY RB_PT_PCT_SWC_GAC_CompuMethods_ratio_0p001 3 0.0 40. FORMAT "%10.5" DEPOSIT ABSOLUTE /end AXIS_DESCR
 /begin AXIS_DESCR STD_AXIS NO_INPUT_QUANTITY RB_PT_PCT_SWC_GAC_CompuMethods_ident 4 -50. 200. FORMAT "%10.5" DEPOSIT ABSOLUTE /end AXIS_DESCR
/end CHARACTERISTIC
/begin CHARACTERISTIC GAC_CALIB.GAC_GracD.GAC_DtntCtrl.GAC_PRESSDTNTCTRLVLOWGRPOS "" MAP 0x80613182 RB_PT_PCT_SWC_GAC_RecordLayouts_RL_Map_sint16_12_uint16_3_sint16_4 64.0 RB_PT_PCT_SWC_GAC_CompuMethods_ratio_0p001 -32. 32. FORMAT "%10.5"
 /begin ANNOTATION ANNOTATION_LABEL "Description (coming from AUTOSAR DESC field)"
  /begin ANNOTATION_TEXT "Detent pressure offset for positive gear engagements - very low aggression\r\n" /end ANNOTATION_TEXT
 /end ANNOTATION
 /begin AXIS_DESCR STD_AXIS NO_INPUT_QUANTITY RB_PT_PCT_SWC_GAC_CompuMethods_ratio_0p001 3 0.0 40. FORMAT "%10.5" DEPOSIT ABSOLUTE /end AXIS_DESCR
 /begin AXIS_DESCR STD_AXIS NO_INPUT_QUANTITY RB_PT_PCT_SWC_GAC_CompuMethods_ident 4 -50. 200. FORMAT "%10.5" DEPOSIT ABSOLUTE /end AXIS_DESCR
/end CHARACTERISTIC
/begin CHARACTERISTIC GAC_CALIB.GAC_GracD.GAC_DtntCtrl.GAC_VELSGRACDTNTCTRLLIM "" VAL_BLK 0x80612FA4 DefaultValueRecordLayout_AUTOSAR_Platform_BaseTypes_uint16 1.2 RB_PT_PCT_SWC_GAC_CompuMethods_ratio_0p001 0.0 1.2 FORMAT "%10.5"
 /begin ANNOTATION ANNOTATION_LABEL "Description (coming from AUTOSAR DESC field)"
  /begin ANNOTATION_TEXT "Array of gear actuator velocities for each actuation aggression, used for limiting of detent control.\r\n" /end ANNOTATION_TEXT
 /end ANNOTATION
 MATRIX_DIM 4 1 1 /end CHARACTERISTIC
/begin CHARACTERISTIC GAC_CALIB.GAC_GracD.GAC_FCTFLWRIGHT "" VALUE 0x80612EE8 DefaultValueRecordLayout_AUTOSAR_Platform_BaseTypes_uint16 1.5 RB_PT_PCT_SWC_GAC_CompuMethods_ratio_0p001 0.0 1.5 FORMAT "%10.5"
 /begin ANNOTATION ANNOTATION_LABEL "Description (coming from AUTOSAR DESC field)"
  /begin ANNOTATION_TEXT "Factor for upscaling the flow demand due to piston area difference.\r\n" /end ANNOTATION_TEXT
 /end ANNOTATION
/end CHARACTERISTIC
/begin CHARACTERISTIC GAC_CALIB.GAC_GracD.GAC_FCTPRESSRIGHT "" VALUE 0x80612EEA DefaultValueRecordLayout_AUTOSAR_Platform_BaseTypes_uint16 1.5 RB_PT_PCT_SWC_GAC_CompuMethods_ratio_0p001 0.0 1.5 FORMAT "%10.5"
 /begin ANNOTATION ANNOTATION_LABEL "Description (coming from AUTOSAR DESC field)"
  /begin ANNOTATION_TEXT "Factor for upscaling the flow demand due to piston area difference.\r\n" /end ANNOTATION_TEXT
 /end ANNOTATION
/end CHARACTERISTIC
/begin CHARACTERISTIC GAC_CALIB.GAC_GracD.GAC_FCTRONSYNCLRNDELTAADPT "" VALUE 0x80612F6F DefaultValueRecordLayout_AUTOSAR_Platform_BaseTypes_uint8 1.0 RB_PT_PCT_SWC_GAC_CompuMethods_ratio_0p01 0.0 1. FORMAT "%10.5"
 /begin ANNOTATION ANNOTATION_LABEL "Description (coming from AUTOSAR DESC field)" /begin ANNOTATION_TEXT "Factor to adapt the in gear position by\r\n" /end ANNOTATION_TEXT /end ANNOTATION
/end CHARACTERISTIC
/begin CHARACTERISTIC GAC_CALIB.GAC_GracD.GAC_FCTRRETRYINGRPOSMOD "" VALUE 0x80612EEC DefaultValueRecordLayout_AUTOSAR_Platform_BaseTypes_sint16 40.0 RB_PT_PCT_SWC_GAC_CompuMethods_ratio_0p001 -20. 20. FORMAT "%10.5"
 /begin ANNOTATION ANNOTATION_LABEL "Description (coming from AUTOSAR DESC field)"
  /begin ANNOTATION_TEXT "The modification factor to the in gear position on retries\r\n" /end ANNOTATION_TEXT
 /end ANNOTATION
/end CHARACTERISTIC
/begin CHARACTERISTIC GAC_CALIB.GAC_GracD.GAC_FLGAGGEVENBL "" VALUE 0x80612F70 DefaultValueRecordLayout_AUTOSAR_Platform_BaseTypes_uint8 255.0 DefaultIdenticalCompu 0.0 255. FORMAT "%10.5"
 /begin ANNOTATION ANNOTATION_LABEL "Description (coming from AUTOSAR DESC field)"
  /begin ANNOTATION_TEXT "Flag to indicate if the EV mode aggression can be used\r\n" /end ANNOTATION_TEXT
 /end ANNOTATION
/end CHARACTERISTIC
/begin CHARACTERISTIC GAC_CALIB.GAC_GracD.GAC_FLGBOBADAPTPONEVERYSHIFT "" VALUE 0x80612F71 DefaultValueRecordLayout_AUTOSAR_Platform_BaseTypes_uint8 255.0 DefaultIdenticalCompu 0.0 255. FORMAT "%10.5"
 /begin ANNOTATION ANNOTATION_LABEL "Description (coming from AUTOSAR DESC field)"
  /begin ANNOTATION_TEXT "Trigger the logic to clear the adaptions and relearn them on every shift\r\n" /end ANNOTATION_TEXT
 /end ANNOTATION
/end CHARACTERISTIC
/begin CHARACTERISTIC GAC_CALIB.GAC_GracD.GAC_FLGDISABLEGBLK2ITERM "" VALUE 0x80612F72 DefaultValueRecordLayout_AUTOSAR_Platform_BaseTypes_uint8 255.0 DefaultIdenticalCompu 0.0 255. FORMAT "%10.5"
 /begin ANNOTATION ANNOTATION_LABEL "Description (coming from AUTOSAR DESC field)" /begin ANNOTATION_TEXT "Flag to disable the i term during gear blocking 2\r\n" /end ANNOTATION_TEXT /end ANNOTATION
/end CHARACTERISTIC
/begin CHARACTERISTIC GAC_CALIB.GAC_GracD.GAC_FLGDISABLENEGDETECTION "" VALUE 0x80612F73 DefaultValueRecordLayout_AUTOSAR_Platform_BaseTypes_uint8 255.0 DefaultIdenticalCompu 0.0 255. FORMAT "%10.5"
 /begin ANNOTATION ANNOTATION_LABEL "Description (coming from AUTOSAR DESC field)" /begin ANNOTATION_TEXT "Flag to disable negative gear detection\r\n" /end ANNOTATION_TEXT /end ANNOTATION
/end CHARACTERISTIC
/begin CHARACTERISTIC GAC_CALIB.GAC_GracD.GAC_FLGDISABLEPOSDETECTION "" VALUE 0x80612F74 DefaultValueRecordLayout_AUTOSAR_Platform_BaseTypes_uint8 255.0 DefaultIdenticalCompu 0.0 255. FORMAT "%10.5"
 /begin ANNOTATION ANNOTATION_LABEL "Description (coming from AUTOSAR DESC field)" /begin ANNOTATION_TEXT "Flag to disable positive gear detection\r\n" /end ANNOTATION_TEXT /end ANNOTATION
/end CHARACTERISTIC
/begin CHARACTERISTIC GAC_CALIB.GAC_GracD.GAC_FLGDISABLESLIPCHECK "" VALUE 0x80612F75 DefaultValueRecordLayout_AUTOSAR_Platform_BaseTypes_uint8 255.0 DefaultIdenticalCompu 0.0 255. FORMAT "%10.5"
 /begin ANNOTATION ANNOTATION_LABEL "Description (coming from AUTOSAR DESC field)"
  /begin ANNOTATION_TEXT "Flag to disable slip checking for the end of synchronisation\r\n" /end ANNOTATION_TEXT
 /end ANNOTATION
/end CHARACTERISTIC
/begin CHARACTERISTIC GAC_CALIB.GAC_GracD.GAC_FLGENBLBENDCOMPSYNCPOS "" VALUE 0x80612F76 DefaultValueRecordLayout_AUTOSAR_Platform_BaseTypes_uint8 255.0 DefaultIdenticalCompu 0.0 255. FORMAT "%10.5"
 /begin ANNOTATION ANNOTATION_LABEL "Description (coming from AUTOSAR DESC field)" /begin ANNOTATION_TEXT "flag to enable synchroniser bending compensation\r\n" /end ANNOTATION_TEXT /end ANNOTATION
/end CHARACTERISTIC
/begin CHARACTERISTIC GAC_CALIB.GAC_GracD.GAC_FLGENBLCALCFLWTGT "" VALUE 0x80612F77 DefaultValueRecordLayout_AUTOSAR_Platform_BaseTypes_uint8 255.0 DefaultIdenticalCompu 0.0 255. FORMAT "%10.5"
 /begin ANNOTATION ANNOTATION_LABEL "Description (coming from AUTOSAR DESC field)" /begin ANNOTATION_TEXT "Flag to activate calculated flow target\r\n" /end ANNOTATION_TEXT /end ANNOTATION
/end CHARACTERISTIC
/begin CHARACTERISTIC GAC_CALIB.GAC_GracD.GAC_FLGENBLNBANDMODIFY "" VALUE 0x80612F78 DefaultValueRecordLayout_AUTOSAR_Platform_BaseTypes_uint8 255.0 DefaultIdenticalCompu 0.0 255. FORMAT "%10.5"
 /begin ANNOTATION ANNOTATION_LABEL "Description (coming from AUTOSAR DESC field)"
  /begin ANNOTATION_TEXT "Flag to allow the neutral window to be modified for gear floating cases\r\n" /end ANNOTATION_TEXT
 /end ANNOTATION
/end CHARACTERISTIC
/begin CHARACTERISTIC GAC_CALIB.GAC_GracD.GAC_FLGENBLNEUTRALCLOSEOUT "" VALUE 0x80612F79 DefaultValueRecordLayout_AUTOSAR_Platform_BaseTypes_uint8 255.0 DefaultIdenticalCompu 0.0 255. FORMAT "%10.5"
 /begin ANNOTATION ANNOTATION_LABEL "Description (coming from AUTOSAR DESC field)"
  /begin ANNOTATION_TEXT "Flag to enable I term to close out small errors in neutral\r\n" /end ANNOTATION_TEXT
 /end ANNOTATION
/end CHARACTERISTIC
/begin CHARACTERISTIC GAC_CALIB.GAC_GracD.GAC_FLGENBLPRESSANDHOLD "" VALUE 0x80612F7A DefaultValueRecordLayout_AUTOSAR_Platform_BaseTypes_uint8 255.0 DefaultIdenticalCompu 0.0 255. FORMAT "%10.5"
 /begin ANNOTATION ANNOTATION_LABEL "Description (coming from AUTOSAR DESC field)" /begin ANNOTATION_TEXT "Flag to enable press and hold functionality\r\n" /end ANNOTATION_TEXT /end ANNOTATION
/end CHARACTERISTIC
/begin CHARACTERISTIC GAC_CALIB.GAC_GracD.GAC_FLGENBLPRESSCONTROLDISABLE "" VALUE 0x80612F7B DefaultValueRecordLayout_AUTOSAR_Platform_BaseTypes_uint8 255.0 DefaultIdenticalCompu 0.0 255. FORMAT "%10.5"
 /begin ANNOTATION ANNOTATION_LABEL "Description (coming from AUTOSAR DESC field)"
  /begin ANNOTATION_TEXT "Flag to disable the pressure control terms (pressure i, p, and velocity i) terms from impacting the EOL position learn\r\n" /end ANNOTATION_TEXT
 /end ANNOTATION
/end CHARACTERISTIC
/begin CHARACTERISTIC GAC_CALIB.GAC_GracD.GAC_FLGENBLPRESSINTONEUTRAL "" VALUE 0x80612F7C DefaultValueRecordLayout_AUTOSAR_Platform_BaseTypes_uint8 255.0 DefaultIdenticalCompu 0.0 255. FORMAT "%10.5"
 /begin ANNOTATION ANNOTATION_LABEL "Description (coming from AUTOSAR DESC field)" /begin ANNOTATION_TEXT "Flag to enable press and hold functionality\r\n" /end ANNOTATION_TEXT /end ANNOTATION
/end CHARACTERISTIC
/begin CHARACTERISTIC GAC_CALIB.GAC_GracD.GAC_FLGENBLVLOWAGG "" VALUE 0x80612F7D DefaultValueRecordLayout_AUTOSAR_Platform_BaseTypes_uint8 255.0 DefaultIdenticalCompu 0.0 255. FORMAT "%10.5"
 /begin ANNOTATION ANNOTATION_LABEL "Description (coming from AUTOSAR DESC field)" /begin ANNOTATION_TEXT "Flag to enable very low aggression\r\n" /end ANNOTATION_TEXT /end ANNOTATION
/end CHARACTERISTIC
/begin CHARACTERISTIC GAC_CALIB.GAC_GracD.GAC_FLGEVMODEAGGVERYLOW "" VALUE 0x80612F7E DefaultValueRecordLayout_AUTOSAR_Platform_BaseTypes_uint8 255.0 DefaultIdenticalCompu 0.0 255. FORMAT "%10.5"
 /begin ANNOTATION ANNOTATION_LABEL "Description (coming from AUTOSAR DESC field)" /begin ANNOTATION_TEXT "flag to allow the very low aggression for EV mode\r\n" /end ANNOTATION_TEXT /end ANNOTATION
/end CHARACTERISTIC
/begin CHARACTERISTIC GAC_CALIB.GAC_GracD.GAC_FLGEVSYNCAGAINSTDRAGENBL "" VALUE 0x80612F7F DefaultValueRecordLayout_AUTOSAR_Platform_BaseTypes_uint8 255.0 DefaultIdenticalCompu 0.0 255. FORMAT "%10.5"
 /begin ANNOTATION ANNOTATION_LABEL "Description (coming from AUTOSAR DESC field)"
  /begin ANNOTATION_TEXT "Flag to enable the strategy to only synchronise against the drag\r\n" /end ANNOTATION_TEXT
 /end ANNOTATION
/end CHARACTERISTIC
/begin CHARACTERISTIC GAC_CALIB.GAC_GracD.GAC_FLGGBLK0MINTGTSYNC "" VALUE 0x80612F80 DefaultValueRecordLayout_AUTOSAR_Platform_BaseTypes_uint8 255.0 DefaultIdenticalCompu 0.0 255. FORMAT "%10.5"
 /begin ANNOTATION ANNOTATION_LABEL "Description (coming from AUTOSAR DESC field)"
  /begin ANNOTATION_TEXT "flag to enable the strategy to have the gblk 0 time at least as large as the target time to synchronise the shaft\r\n" /end ANNOTATION_TEXT
 /end ANNOTATION
/end CHARACTERISTIC
/begin CHARACTERISTIC GAC_CALIB.GAC_GracD.GAC_FLGLIMITENDPRESSTOSYNCPRESS "" VALUE 0x80612F81 DefaultValueRecordLayout_AUTOSAR_Platform_BaseTypes_uint8 255.0 DefaultIdenticalCompu 0.0 255. FORMAT "%10.5"
 /begin ANNOTATION ANNOTATION_LABEL "Description (coming from AUTOSAR DESC field)"
  /begin ANNOTATION_TEXT "limit the minimum pressure in the free flight phase to the max pressure during the synchronisation phase\r\n" /end ANNOTATION_TEXT
 /end ANNOTATION
/end CHARACTERISTIC
/begin CHARACTERISTIC GAC_CALIB.GAC_GracD.GAC_FLGMOVINGMUSTBEINRANGE "" VALUE 0x80612F82 DefaultValueRecordLayout_AUTOSAR_Platform_BaseTypes_uint8 255.0 DefaultIdenticalCompu 0.0 255. FORMAT "%10.5"
 /begin ANNOTATION ANNOTATION_LABEL "Description (coming from AUTOSAR DESC field)" /begin ANNOTATION_TEXT "Moving detected must be in position range\r\n" /end ANNOTATION_TEXT /end ANNOTATION
/end CHARACTERISTIC
/begin CHARACTERISTIC GAC_CALIB.GAC_GracD.GAC_FLGNOPOSPOSNFROMN "" VALUE 0x80612F83 DefaultValueRecordLayout_AUTOSAR_Platform_BaseTypes_boolean 255.0 AUTOSAR_Platform_CompuMethods_boolean 0.0 255. FORMAT "%10.5"
 /begin ANNOTATION ANNOTATION_LABEL "Description (coming from AUTOSAR DESC field)"
  /begin ANNOTATION_TEXT "Flag inhibiting entry to positive position states, once in Neutral.\r\n" /end ANNOTATION_TEXT
 /end ANNOTATION
/end CHARACTERISTIC
/begin CHARACTERISTIC GAC_CALIB.GAC_GracD.GAC_FLGNOTMPCONDUPDATE "" VALUE 0x80612F84 DefaultValueRecordLayout_AUTOSAR_Platform_BaseTypes_boolean 255.0 AUTOSAR_Platform_CompuMethods_boolean 0.0 255. FORMAT "%10.5"
 /begin ANNOTATION ANNOTATION_LABEL "Description (coming from AUTOSAR DESC field)"
  /begin ANNOTATION_TEXT "Flag enabling continuous update of slow tasks without depending on temperature change condition.\r\n" /end ANNOTATION_TEXT
 /end ANNOTATION
/end CHARACTERISTIC
/begin CHARACTERISTIC GAC_CALIB.GAC_GracD.GAC_FLGNSTOPITERMRESETMAXTMR "" VALUE 0x80612F85 DefaultValueRecordLayout_AUTOSAR_Platform_BaseTypes_uint8 255.0 DefaultIdenticalCompu 0.0 255. FORMAT "%10.5"
 /begin ANNOTATION ANNOTATION_LABEL "Description (coming from AUTOSAR DESC field)"
  /begin ANNOTATION_TEXT "Flag to activate a maximum timer for the N stop I term reset\r\n" /end ANNOTATION_TEXT
 /end ANNOTATION
/end CHARACTERISTIC
/begin CHARACTERISTIC GAC_CALIB.GAC_GracD.GAC_FLGPVSCONFIG "" VALUE 0x80612F86 DefaultValueRecordLayout_AUTOSAR_Platform_BaseTypes_uint8 255.0 DefaultIdenticalCompu 0.0 255. FORMAT "%10.5"
 /begin ANNOTATION ANNOTATION_LABEL "Description (coming from AUTOSAR DESC field)"
  /begin ANNOTATION_TEXT "Flag to indicate whether or not the transmission is a PVS transmission\r\n" /end ANNOTATION_TEXT
 /end ANNOTATION
/end CHARACTERISTIC
/begin CHARACTERISTIC GAC_CALIB.GAC_GracD.GAC_FLGRESETGBLCKPRESSWHENMOVING "" VALUE 0x80612F87 DefaultValueRecordLayout_AUTOSAR_Platform_BaseTypes_uint8 255.0 DefaultIdenticalCompu 0.0 255. FORMAT "%10.5"
 /begin ANNOTATION ANNOTATION_LABEL "Description (coming from AUTOSAR DESC field)"
  /begin ANNOTATION_TEXT "Flag to reset the additional pressure from the gear block 3 pressure ramp once the synchro is moving\r\n" /end ANNOTATION_TEXT
 /end ANNOTATION
/end CHARACTERISTIC
/begin CHARACTERISTIC GAC_CALIB.GAC_GracD.GAC_FLGRESETITERMONSYNC "" VALUE 0x80612F88 DefaultValueRecordLayout_AUTOSAR_Platform_BaseTypes_uint8 255.0 DefaultIdenticalCompu 0.0 255. FORMAT "%10.5"
 /begin ANNOTATION ANNOTATION_LABEL "Description (coming from AUTOSAR DESC field)" /begin ANNOTATION_TEXT "Flag to reset the I term when on the synchro cone\r\n" /end ANNOTATION_TEXT /end ANNOTATION
/end CHARACTERISTIC
/begin CHARACTERISTIC GAC_CALIB.GAC_GracD.GAC_FLGSTATICADAPTENBL "" VALUE 0x80612F89 DefaultValueRecordLayout_AUTOSAR_Platform_BaseTypes_uint8 255.0 DefaultIdenticalCompu 0.0 255. FORMAT "%10.5"
 /begin ANNOTATION ANNOTATION_LABEL "Description (coming from AUTOSAR DESC field)" /begin ANNOTATION_TEXT "Allow static adaptions\r\n" /end ANNOTATION_TEXT /end ANNOTATION
/end CHARACTERISTIC
/begin CHARACTERISTIC GAC_CALIB.GAC_GracD.GAC_FLGUSELEARNEDSYNCPOS "" VALUE 0x80612F8A DefaultValueRecordLayout_AUTOSAR_Platform_BaseTypes_uint8 255.0 DefaultIdenticalCompu 0.0 255. FORMAT "%10.5"
 /begin ANNOTATION ANNOTATION_LABEL "Description (coming from AUTOSAR DESC field)"
  /begin ANNOTATION_TEXT "Flag to indicate the use of the learned on synchro position when determining synchronisation end\r\n" /end ANNOTATION_TEXT
 /end ANNOTATION
/end CHARACTERISTIC
/begin CHARACTERISTIC GAC_CALIB.GAC_GracD.GAC_FLGUSENSTOPERROR "" VALUE 0x80612F8B DefaultValueRecordLayout_AUTOSAR_Platform_BaseTypes_uint8 255.0 DefaultIdenticalCompu 0.0 255. FORMAT "%10.5"
 /begin ANNOTATION ANNOTATION_LABEL "Description (coming from AUTOSAR DESC field)" /begin ANNOTATION_TEXT "Flag to use N stop error instead of main error term\r\n" /end ANNOTATION_TEXT /end ANNOTATION
/end CHARACTERISTIC
/begin CHARACTERISTIC GAC_CALIB.GAC_GracD.GAC_FLOWMINITERMCLOSEOUT "" VALUE 0x80612EEE DefaultValueRecordLayout_AUTOSAR_Platform_BaseTypes_sint16 64.0 RB_PT_PCT_SWC_GAC_CompuMethods_ratio_0p001 -32. 32. FORMAT "%10.5"
 /begin ANNOTATION ANNOTATION_LABEL "Description (coming from AUTOSAR DESC field)" /begin ANNOTATION_TEXT "minimum synchro flow to enable neutral close out\r\n" /end ANNOTATION_TEXT /end ANNOTATION
/end CHARACTERISTIC
/begin CHARACTERISTIC GAC_CALIB.GAC_GracD.GAC_FLWGHOLDBCKLIM "" VALUE 0x80612EF0 DefaultValueRecordLayout_AUTOSAR_Platform_BaseTypes_sint16 64.0 RB_PT_PCT_SWC_GAC_CompuMethods_ratio_0p001 -32. 32. FORMAT "%10.5"
 /begin ANNOTATION ANNOTATION_LABEL "Description (coming from AUTOSAR DESC field)" /begin ANNOTATION_TEXT "Flow limit used for GHold active.\r\n" /end ANNOTATION_TEXT /end ANNOTATION
/end CHARACTERISTIC
/begin CHARACTERISTIC GAC_CALIB.GAC_GracD.GAC_FLWMINGBLCK3 "" VALUE 0x80612EF2 DefaultValueRecordLayout_AUTOSAR_Platform_BaseTypes_sint16 64.0 RB_PT_PCT_SWC_GAC_CompuMethods_ratio_0p001 -32. 32. FORMAT "%10.5"
 /begin ANNOTATION ANNOTATION_LABEL "Description (coming from AUTOSAR DESC field)" /begin ANNOTATION_TEXT "minimum flow to allow gear block 3 strategy\r\n" /end ANNOTATION_TEXT /end ANNOTATION
/end CHARACTERISTIC
/begin CHARACTERISTIC GAC_CALIB.GAC_GracD.GAC_FLWSFFVELCTRLNOSYNCABS "" CURVE 0x80613336 RB_PT_PCT_SWC_GAC_RecordLayouts_RL_Curve_uint16_4_uint16_4 32.0 RB_PT_PCT_SWC_GAC_CompuMethods_ratio_0p001 0.0 32. FORMAT "%10.5"
 /begin ANNOTATION ANNOTATION_LABEL "Description (coming from AUTOSAR DESC field)"
  /begin ANNOTATION_TEXT "Unsigned feedforward flow gains for velocity control before the synchro phase or Neutral actuation.\r\n" /end ANNOTATION_TEXT
 /end ANNOTATION
 /begin AXIS_DESCR STD_AXIS NO_INPUT_QUANTITY RB_PT_PCT_SWC_GAC_CompuMethods_ratio_0p001 4 0.0 1.2 FORMAT "%10.5" DEPOSIT ABSOLUTE /end AXIS_DESCR
/end CHARACTERISTIC
/begin CHARACTERISTIC GAC_CALIB.GAC_GracD.GAC_FLWSFFVELCTRLSYNCABS "" CURVE 0x80613348 RB_PT_PCT_SWC_GAC_RecordLayouts_RL_Curve_uint16_4_uint16_4 32.0 RB_PT_PCT_SWC_GAC_CompuMethods_ratio_0p001 0.0 32. FORMAT "%10.5"
 /begin ANNOTATION ANNOTATION_LABEL "Description (coming from AUTOSAR DESC field)"
  /begin ANNOTATION_TEXT "Unsigned feedforward flow gains for velocity control after the synchro phase.\r\n" /end ANNOTATION_TEXT
 /end ANNOTATION
 /begin AXIS_DESCR STD_AXIS NO_INPUT_QUANTITY RB_PT_PCT_SWC_GAC_CompuMethods_ratio_0p001 4 0.0 1.2 FORMAT "%10.5" DEPOSIT ABSOLUTE /end AXIS_DESCR
/end CHARACTERISTIC
/begin CHARACTERISTIC GAC_CALIB.GAC_GracD.GAC_FLWSIVELCTRLNOSYNC "" CURVE 0x8061335A RB_PT_PCT_SWC_GAC_RecordLayouts_RL_Curve_sint16_7_sint16_7 64.0 RB_PT_PCT_SWC_GAC_CompuMethods_ratio_0p001 -32. 32. FORMAT "%10.5"
 /begin ANNOTATION ANNOTATION_LABEL "Description (coming from AUTOSAR DESC field)"
  /begin ANNOTATION_TEXT "Integral flow gains for velocity control before the synchro phase.\r\n" /end ANNOTATION_TEXT
 /end ANNOTATION
 /begin AXIS_DESCR STD_AXIS NO_INPUT_QUANTITY RB_PT_PCT_SWC_GAC_CompuMethods_ratio_0p001 7 -1.2 1.2 FORMAT "%10.5" DEPOSIT ABSOLUTE /end AXIS_DESCR
/end CHARACTERISTIC
/begin CHARACTERISTIC GAC_CALIB.GAC_GracD.GAC_FLWSIVELCTRLSYNC "" CURVE 0x80613378 RB_PT_PCT_SWC_GAC_RecordLayouts_RL_Curve_sint16_7_sint16_7 64.0 RB_PT_PCT_SWC_GAC_CompuMethods_ratio_0p001 -32. 32. FORMAT "%10.5"
 /begin ANNOTATION ANNOTATION_LABEL "Description (coming from AUTOSAR DESC field)"
  /begin ANNOTATION_TEXT "Integral flow gains for velocity control after the synchro phase.\r\n" /end ANNOTATION_TEXT
 /end ANNOTATION
 /begin AXIS_DESCR STD_AXIS NO_INPUT_QUANTITY RB_PT_PCT_SWC_GAC_CompuMethods_ratio_0p001 7 -1.2 1.2 FORMAT "%10.5" DEPOSIT ABSOLUTE /end AXIS_DESCR
/end CHARACTERISTIC
/begin CHARACTERISTIC GAC_CALIB.GAC_GracD.GAC_FLWSNHOLD "" CURVE 0x80613396 RB_PT_PCT_SWC_GAC_RecordLayouts_RL_Curve_sint16_4_uint16_4 64.0 RB_PT_PCT_SWC_GAC_CompuMethods_ratio_0p001 -32. 32. FORMAT "%10.5"
 /begin ANNOTATION ANNOTATION_LABEL "Description (coming from AUTOSAR DESC field)"
  /begin ANNOTATION_TEXT "Proportional flow gains for velocity (position) control in NHold or drain phase after actuation to Neutral.\r\n" /end ANNOTATION_TEXT
 /end ANNOTATION
 /begin AXIS_DESCR STD_AXIS NO_INPUT_QUANTITY RB_PT_PCT_SWC_GAC_CompuMethods_ratio_0p001 4 0.0 20. FORMAT "%10.5" DEPOSIT ABSOLUTE /end AXIS_DESCR
/end CHARACTERISTIC
/begin CHARACTERISTIC GAC_CALIB.GAC_GracD.GAC_FLWSPVELCTRLGHOLD "" CURVE 0x806133A8 RB_PT_PCT_SWC_GAC_RecordLayouts_RL_Curve_sint16_7_sint16_7 64.0 RB_PT_PCT_SWC_GAC_CompuMethods_ratio_0p001 -32. 32. FORMAT "%10.5"
 /begin ANNOTATION ANNOTATION_LABEL "Description (coming from AUTOSAR DESC field)"
  /begin ANNOTATION_TEXT "Proportional flow gains for velocity (position) control in the GHold phase.\r\n" /end ANNOTATION_TEXT
 /end ANNOTATION
 /begin AXIS_DESCR STD_AXIS NO_INPUT_QUANTITY RB_PT_PCT_SWC_GAC_CompuMethods_ratio_0p001 7 -2. 2. FORMAT "%10.5" DEPOSIT ABSOLUTE /end AXIS_DESCR
/end CHARACTERISTIC
/begin CHARACTERISTIC GAC_CALIB.GAC_GracD.GAC_FLWSPVELCTRLGHOLDRULE26 "" CURVE 0x806133C6 RB_PT_PCT_SWC_GAC_RecordLayouts_RL_Curve_sint16_7_sint16_7 64.0 RB_PT_PCT_SWC_GAC_CompuMethods_ratio_0p001 -32. 32. FORMAT "%10.5"
 /begin ANNOTATION ANNOTATION_LABEL "Description (coming from AUTOSAR DESC field)"
  /begin ANNOTATION_TEXT "Proportional flow gains for velocity (position) control in the GHold phase.\r\n" /end ANNOTATION_TEXT
 /end ANNOTATION
 /begin AXIS_DESCR STD_AXIS NO_INPUT_QUANTITY RB_PT_PCT_SWC_GAC_CompuMethods_ratio_0p001 7 -2. 2. FORMAT "%10.5" DEPOSIT ABSOLUTE /end AXIS_DESCR
/end CHARACTERISTIC
/begin CHARACTERISTIC GAC_CALIB.GAC_GracD.GAC_FLWSPVELCTRLNSTOP "" MAP 0x806133E4 RB_PT_PCT_SWC_GAC_RecordLayouts_RL_Map_sint16_27_sint16_9_sint16_3 64.0 RB_PT_PCT_SWC_GAC_CompuMethods_ratio_0p001 -32. 32. FORMAT "%10.5"
 /begin ANNOTATION ANNOTATION_LABEL "Description (coming from AUTOSAR DESC field)"
  /begin ANNOTATION_TEXT "Proportional flow gains for velocity control in the NStop phase.\r\n" /end ANNOTATION_TEXT
 /end ANNOTATION
 /begin AXIS_DESCR STD_AXIS NO_INPUT_QUANTITY RB_PT_PCT_SWC_GAC_CompuMethods_ratio_0p001 9 -1.2 1.2 FORMAT "%10.5" DEPOSIT ABSOLUTE /end AXIS_DESCR
 /begin AXIS_DESCR STD_AXIS NO_INPUT_QUANTITY RB_PT_PCT_SWC_GAC_CompuMethods_ident 3 -50. 200. FORMAT "%10.5" DEPOSIT ABSOLUTE /end AXIS_DESCR
/end CHARACTERISTIC
/begin CHARACTERISTIC GAC_CALIB.GAC_GracD.GAC_FLWSVLVSTUCKDEM "" VAL_BLK 0x80612ECC DefaultValueRecordLayout_AUTOSAR_Platform_BaseTypes_sint16 64.0 RB_PT_PCT_SWC_GAC_CompuMethods_ratio_0p001 -32. 32. FORMAT "%10.5"
 /begin ANNOTATION ANNOTATION_LABEL "Description (coming from AUTOSAR DESC field)"
  /begin ANNOTATION_TEXT "Flow demands requested by the valve stuck diagnostic and failure handling..\r\n" /end ANNOTATION_TEXT
 /end ANNOTATION
 MATRIX_DIM 3 1 1 /end CHARACTERISTIC
/begin CHARACTERISTIC GAC_CALIB.GAC_GracD.GAC_GracPosnInitTmr.LIB_DT "" VALUE 0x806131AC DefaultValueRecordLayout_AUTOSAR_Platform_BaseTypes_uint16 65.535 RB_PT_PCT_SWC_GAC_CompuMethods_ratio_0p001 0.0 65.535 FORMAT "%10.5"
 /begin ANNOTATION ANNOTATION_LABEL "Description (coming from AUTOSAR DESC field)" /begin ANNOTATION_TEXT "Timer decrement value.\r\n" /end ANNOTATION_TEXT /end ANNOTATION
/end CHARACTERISTIC
/begin CHARACTERISTIC GAC_CALIB.GAC_GracD.GAC_IDDIAGENBLSHIFT "" VALUE 0x80612ED4 DefaultValueRecordLayout_AUTOSAR_Platform_BaseTypes_uint32 4194304.0 RB_PT_PCT_SWC_GAC_CompuMethods_ident 0.0 4194304. FORMAT "%10.5"
 /begin ANNOTATION ANNOTATION_LABEL "Description (coming from AUTOSAR DESC field)"
  /begin ANNOTATION_TEXT "multiplication factor to shift the bits for each actuator\r\n" /end ANNOTATION_TEXT
 /end ANNOTATION
/end CHARACTERISTIC
/begin CHARACTERISTIC GAC_CALIB.GAC_GracD.GAC_InGearLearn.GAC_FCTRINGEARLRNDELTAADPT "" VALUE 0x806131B6 DefaultValueRecordLayout_AUTOSAR_Platform_BaseTypes_uint8 1.0 RB_PT_PCT_SWC_GAC_CompuMethods_ratio_0p01 0.0 1. FORMAT "%10.5"
 /begin ANNOTATION ANNOTATION_LABEL "Description (coming from AUTOSAR DESC field)"
  /begin ANNOTATION_TEXT "percentage factor of the delta that is added to the learned in gear position\r\n" /end ANNOTATION_TEXT
 /end ANNOTATION
/end CHARACTERISTIC
/begin CHARACTERISTIC GAC_CALIB.GAC_GracD.GAC_InGearLearn.GAC_FCTRINGEARLRNDELTAADPTNOSTORE "" VALUE 0x806131B7 DefaultValueRecordLayout_AUTOSAR_Platform_BaseTypes_uint8 1.0 RB_PT_PCT_SWC_GAC_CompuMethods_ratio_0p01 0.0 1. FORMAT "%10.5"
 /begin ANNOTATION ANNOTATION_LABEL "Description (coming from AUTOSAR DESC field)"
  /begin ANNOTATION_TEXT "percentage factor of the delta that is added to the learned in gear position\r\n" /end ANNOTATION_TEXT
 /end ANNOTATION
/end CHARACTERISTIC
/begin CHARACTERISTIC GAC_CALIB.GAC_GracD.GAC_InGearLearn.GAC_FLGCHECKNOFSTDURINGINGRLEARN "" VALUE 0x806131B8 DefaultValueRecordLayout_AUTOSAR_Platform_BaseTypes_uint8 255.0 DefaultIdenticalCompu 0.0 255. FORMAT "%10.5"
 /begin ANNOTATION ANNOTATION_LABEL "Description (coming from AUTOSAR DESC field)"
  /begin ANNOTATION_TEXT "Flag to enable/disable checking neutral offset during in gear learn\r\n" /end ANNOTATION_TEXT
 /end ANNOTATION
/end CHARACTERISTIC
/begin CHARACTERISTIC GAC_CALIB.GAC_GracD.GAC_InGearLearn.GAC_FLGCHECKNOFSTDURINGUDSEXPORT "" VALUE 0x806131B9 DefaultValueRecordLayout_AUTOSAR_Platform_BaseTypes_uint8 255.0 DefaultIdenticalCompu 0.0 255. FORMAT "%10.5"
 /begin ANNOTATION ANNOTATION_LABEL "Description (coming from AUTOSAR DESC field)"
  /begin ANNOTATION_TEXT "Flag to enable/disable checking neutral offset during in gear learn - UDS version\r\n" /end ANNOTATION_TEXT
 /end ANNOTATION
/end CHARACTERISTIC
/begin CHARACTERISTIC GAC_CALIB.GAC_GracD.GAC_InGearLearn.GAC_FLGFORCEINGRLEARNCHECK "" VALUE 0x806131BA DefaultValueRecordLayout_AUTOSAR_Platform_BaseTypes_uint8 255.0 DefaultIdenticalCompu 0.0 255. FORMAT "%10.5"
 /begin ANNOTATION ANNOTATION_LABEL "Description (coming from AUTOSAR DESC field)"
  /begin ANNOTATION_TEXT "Flag to force the in gear position learn check and write to NV\r\n" /end ANNOTATION_TEXT
 /end ANNOTATION
/end CHARACTERISTIC
/begin CHARACTERISTIC GAC_CALIB.GAC_GracD.GAC_InGearLearn.GAC_FLGRESETINGEARPOSIFADAPTBAD "" VALUE 0x806131BB DefaultValueRecordLayout_AUTOSAR_Platform_BaseTypes_uint8 255.0 DefaultIdenticalCompu 0.0 255. FORMAT "%10.5"
 /begin ANNOTATION ANNOTATION_LABEL "Description (coming from AUTOSAR DESC field)"
  /begin ANNOTATION_TEXT "Flag to enable value reset if the adaption if the in gear learned position is bad\r\n" /end ANNOTATION_TEXT
 /end ANNOTATION
/end CHARACTERISTIC
/begin CHARACTERISTIC GAC_CALIB.GAC_GracD.GAC_InGearLearn.GAC_FLGRESETINVALIDLEARN "" VALUE 0x806131BC DefaultValueRecordLayout_AUTOSAR_Platform_BaseTypes_uint8 255.0 DefaultIdenticalCompu 0.0 255. FORMAT "%10.5"
 /begin ANNOTATION ANNOTATION_LABEL "Description (coming from AUTOSAR DESC field)"
  /begin ANNOTATION_TEXT "Flag to enable value reset if any learn if the in gear learned position is bad\r\n" /end ANNOTATION_TEXT
 /end ANNOTATION
/end CHARACTERISTIC
/begin CHARACTERISTIC GAC_CALIB.GAC_GracD.GAC_InGearLearn.GAC_FLGUSEORIGINGRLEARN "" VALUE 0x806131BD DefaultValueRecordLayout_AUTOSAR_Platform_BaseTypes_uint8 255.0 DefaultIdenticalCompu 0.0 255. FORMAT "%10.5"
 /begin ANNOTATION ANNOTATION_LABEL "Description (coming from AUTOSAR DESC field)" /begin ANNOTATION_TEXT "Flag to enable/ disable old in gear learn method\r\n" /end ANNOTATION_TEXT /end ANNOTATION
/end CHARACTERISTIC
/begin CHARACTERISTIC GAC_CALIB.GAC_GracD.GAC_InGearLearn.GAC_IDINGEARLEARNUDSVALUE "" VALUE 0x806131BE DefaultValueRecordLayout_AUTOSAR_Platform_BaseTypes_uint8 255.0 RB_PT_PCT_SWC_GAC_CompuMethods_ident 0.0 255. FORMAT "%10.5"
 /begin ANNOTATION ANNOTATION_LABEL "Description (coming from AUTOSAR DESC field)"
  /begin ANNOTATION_TEXT "Switch case input to switch learned value sent out over UDS\r\n" /end ANNOTATION_TEXT
 /end ANNOTATION
/end CHARACTERISTIC
/begin CHARACTERISTIC GAC_CALIB.GAC_GracD.GAC_InGearLearn.GAC_IDSYNCHRODIRNOTPOSSIBLE "" VALUE 0x806131BF DefaultValueRecordLayout_AUTOSAR_Platform_BaseTypes_uint8 255.0 RB_PT_PCT_SWC_GAC_CompuMethods_ident 0.0 255. FORMAT "%10.5"
 /begin ANNOTATION ANNOTATION_LABEL "Description (coming from AUTOSAR DESC field)"
  /begin ANNOTATION_TEXT "ID to indicate that the synchroniser position direction is not possible (1=left not possible, 2=right not possible)\r\n" /end ANNOTATION_TEXT
 /end ANNOTATION
/end CHARACTERISTIC
/begin CHARACTERISTIC GAC_CALIB.GAC_GracD.GAC_InGearLearn.GAC_POSNLESSINGRLRNNEG "" VALUE 0x806131AE DefaultValueRecordLayout_AUTOSAR_Platform_BaseTypes_uint16 2.0 RB_PT_PCT_SWC_GAC_CompuMethods_ratio_0p001 0.0 2. FORMAT "%10.5"
 /begin ANNOTATION ANNOTATION_LABEL "Description (coming from AUTOSAR DESC field)"
  /begin ANNOTATION_TEXT "Position margin removed for calculation of the learnt in negative gear position.\r\n" /end ANNOTATION_TEXT
 /end ANNOTATION
/end CHARACTERISTIC
/begin CHARACTERISTIC GAC_CALIB.GAC_GracD.GAC_InGearLearn.GAC_POSNLESSINGRLRNPOS "" VALUE 0x806131B0 DefaultValueRecordLayout_AUTOSAR_Platform_BaseTypes_uint16 2.0 RB_PT_PCT_SWC_GAC_CompuMethods_ratio_0p001 0.0 2. FORMAT "%10.5"
 /begin ANNOTATION ANNOTATION_LABEL "Description (coming from AUTOSAR DESC field)"
  /begin ANNOTATION_TEXT "Position margin removed for calculation of the learnt in positive gear position.\r\n" /end ANNOTATION_TEXT
 /end ANNOTATION
/end CHARACTERISTIC
/begin CHARACTERISTIC GAC_CALIB.GAC_GracD.GAC_InGearLearn.GAC_POSNMAXINGRLRN "" VALUE 0x806131B2 DefaultValueRecordLayout_AUTOSAR_Platform_BaseTypes_sint16 40.0 RB_PT_PCT_SWC_GAC_CompuMethods_ratio_0p001 -20. 20. FORMAT "%10.5"
 /begin ANNOTATION ANNOTATION_LABEL "Description (coming from AUTOSAR DESC field)" /begin ANNOTATION_TEXT "Maximum allowed position for in gear learn.\r\n" /end ANNOTATION_TEXT /end ANNOTATION
/end CHARACTERISTIC
/begin CHARACTERISTIC GAC_CALIB.GAC_GracD.GAC_InGearLearn.GAC_POSNMININGRLRN "" VALUE 0x806131B4 DefaultValueRecordLayout_AUTOSAR_Platform_BaseTypes_sint16 40.0 RB_PT_PCT_SWC_GAC_CompuMethods_ratio_0p001 -20. 20. FORMAT "%10.5"
 /begin ANNOTATION ANNOTATION_LABEL "Description (coming from AUTOSAR DESC field)" /begin ANNOTATION_TEXT "Minimum allowed position for in gear learn.\r\n" /end ANNOTATION_TEXT /end ANNOTATION
/end CHARACTERISTIC
/begin CHARACTERISTIC GAC_CALIB.GAC_GracD.GAC_InGearLearnTrig.GAC_BOBFLGFORCEINGEARLEARN "" VALUE 0x806131C8 DefaultValueRecordLayout_AUTOSAR_Platform_BaseTypes_uint8 255.0 DefaultIdenticalCompu 0.0 255. FORMAT "%10.5"
 /begin ANNOTATION ANNOTATION_LABEL "Description (coming from AUTOSAR DESC field)" /begin ANNOTATION_TEXT "Flag to force in gear position learn\r\n" /end ANNOTATION_TEXT /end ANNOTATION
/end CHARACTERISTIC
/begin CHARACTERISTIC GAC_CALIB.GAC_GracD.GAC_InGearLearnTrig.GAC_CNTTRIGADPINGRPOS "" VALUE 0x806131C9 DefaultValueRecordLayout_AUTOSAR_Platform_BaseTypes_uint8 10.0 RB_PT_PCT_SWC_GAC_CompuMethods_ident 0.0 10. FORMAT "%10.5"
 /begin ANNOTATION ANNOTATION_LABEL "Description (coming from AUTOSAR DESC field)"
  /begin ANNOTATION_TEXT "Counter value used to trigger the request for in positive gear learn.\r\n" /end ANNOTATION_TEXT
 /end ANNOTATION
/end CHARACTERISTIC
/begin CHARACTERISTIC GAC_CALIB.GAC_GracD.GAC_InGearLearnTrig.GAC_CNTTRIGAPPINGRNEG "" VALUE 0x806131CA DefaultValueRecordLayout_AUTOSAR_Platform_BaseTypes_uint8 10.0 RB_PT_PCT_SWC_GAC_CompuMethods_ident 0.0 10. FORMAT "%10.5"
 /begin ANNOTATION ANNOTATION_LABEL "Description (coming from AUTOSAR DESC field)"
  /begin ANNOTATION_TEXT "Counter value used to trigger the request for in negative gear learn.\r\n" /end ANNOTATION_TEXT
 /end ANNOTATION
/end CHARACTERISTIC
/begin CHARACTERISTIC GAC_CALIB.GAC_GracD.GAC_InGearLearnTrig.GAC_FLGSADPINGRNEGAGGOK "" VAL_BLK 0x806131C0 DefaultValueRecordLayout_AUTOSAR_Platform_BaseTypes_boolean 255.0 AUTOSAR_Platform_CompuMethods_boolean 0.0 255. FORMAT "%10.5"
 /begin ANNOTATION ANNOTATION_LABEL "Description (coming from AUTOSAR DESC field)"
  /begin ANNOTATION_TEXT "Array of flags indicating in negative gear learn allowed, for each actuation aggression.\r\n" /end ANNOTATION_TEXT
 /end ANNOTATION
 MATRIX_DIM 4 1 1 /end CHARACTERISTIC
/begin CHARACTERISTIC GAC_CALIB.GAC_GracD.GAC_InGearLearnTrig.GAC_FLGSADPINGRPOSAGGOK "" VAL_BLK 0x806131C4 DefaultValueRecordLayout_AUTOSAR_Platform_BaseTypes_boolean 255.0 AUTOSAR_Platform_CompuMethods_boolean 0.0 255. FORMAT "%10.5"
 /begin ANNOTATION ANNOTATION_LABEL "Description (coming from AUTOSAR DESC field)"
  /begin ANNOTATION_TEXT "Array of flags indicating in positive gear learn allowed, for each actuation aggression.\r\n" /end ANNOTATION_TEXT
 /end ANNOTATION
 MATRIX_DIM 4 1 1 /end CHARACTERISTIC
/begin CHARACTERISTIC GAC_CALIB.GAC_GracD.GAC_InGrDebTmr.LIB_DT "" VALUE 0x806131CC DefaultValueRecordLayout_AUTOSAR_Platform_BaseTypes_uint16 65.535 RB_PT_PCT_SWC_GAC_CompuMethods_ratio_0p001 0.0 65.535 FORMAT "%10.5"
 /begin ANNOTATION ANNOTATION_LABEL "Description (coming from AUTOSAR DESC field)" /begin ANNOTATION_TEXT "Timer decrement value.\r\n" /end ANNOTATION_TEXT /end ANNOTATION
/end CHARACTERISTIC
/begin CHARACTERISTIC GAC_CALIB.GAC_GracD.GAC_InGrPressToEndStopTmr.LIB_DT "" VALUE 0x806131CE DefaultValueRecordLayout_AUTOSAR_Platform_BaseTypes_uint16 65.535 RB_PT_PCT_SWC_GAC_CompuMethods_ratio_0p001 0.0 65.535 FORMAT "%10.5"
 /begin ANNOTATION ANNOTATION_LABEL "Description (coming from AUTOSAR DESC field)" /begin ANNOTATION_TEXT "Timer decrement value.\r\n" /end ANNOTATION_TEXT /end ANNOTATION
/end CHARACTERISTIC
/begin CHARACTERISTIC GAC_CALIB.GAC_GracD.GAC_InNDebTmr.LIB_DT "" VALUE 0x806131D0 DefaultValueRecordLayout_AUTOSAR_Platform_BaseTypes_uint16 65.535 RB_PT_PCT_SWC_GAC_CompuMethods_ratio_0p001 0.0 65.535 FORMAT "%10.5"
 /begin ANNOTATION ANNOTATION_LABEL "Description (coming from AUTOSAR DESC field)" /begin ANNOTATION_TEXT "Timer decrement value.\r\n" /end ANNOTATION_TEXT /end ANNOTATION
/end CHARACTERISTIC
/begin CHARACTERISTIC GAC_CALIB.GAC_GracD.GAC_POSNADPPUSHINGR "" VALUE 0x80612EF4 DefaultValueRecordLayout_AUTOSAR_Platform_BaseTypes_uint16 100.0 RB_PT_PCT_SWC_GAC_CompuMethods_ident 0.0 100. FORMAT "%10.5"
 /begin ANNOTATION ANNOTATION_LABEL "Description (coming from AUTOSAR DESC field)"
  /begin ANNOTATION_TEXT "Gear actuator position used for adaptation 'push in gear'.\r\n" /end ANNOTATION_TEXT
 /end ANNOTATION
/end CHARACTERISTIC
/begin CHARACTERISTIC GAC_CALIB.GAC_GracD.GAC_POSNGRACCLOSEOUTTHRESH "" VALUE 0x80612EF6 DefaultValueRecordLayout_AUTOSAR_Platform_BaseTypes_uint16 20.0 RB_PT_PCT_SWC_GAC_CompuMethods_ratio_0p001 0.0 20. FORMAT "%10.5"
 /begin ANNOTATION ANNOTATION_LABEL "Description (coming from AUTOSAR DESC field)"
  /begin ANNOTATION_TEXT "Maximum absolute synchroniser position for the neutral close out to activate\r\n" /end ANNOTATION_TEXT
 /end ANNOTATION
/end CHARACTERISTIC
/begin CHARACTERISTIC GAC_CALIB.GAC_GracD.GAC_POSNGRACFAILPUSHINGR "" VALUE 0x80612EF8 DefaultValueRecordLayout_AUTOSAR_Platform_BaseTypes_uint16 100.0 RB_PT_PCT_SWC_GAC_CompuMethods_ident 0.0 100. FORMAT "%10.5"
 /begin ANNOTATION ANNOTATION_LABEL "Description (coming from AUTOSAR DESC field)"
  /begin ANNOTATION_TEXT "Gear actuator position used for 'fail push in gear' active.\r\n" /end ANNOTATION_TEXT
 /end ANNOTATION
/end CHARACTERISTIC
/begin CHARACTERISTIC GAC_CALIB.GAC_GracD.GAC_POSNGRACNSTOPRESETI "" VALUE 0x80612EFA DefaultValueRecordLayout_AUTOSAR_Platform_BaseTypes_uint16 20.0 RB_PT_PCT_SWC_GAC_CompuMethods_ratio_0p001 0.0 20. FORMAT "%10.5"
 /begin ANNOTATION ANNOTATION_LABEL "Description (coming from AUTOSAR DESC field)"
  /begin ANNOTATION_TEXT "Gear actuator position used for resetting the I term during NStop phase.\r\n" /end ANNOTATION_TEXT
 /end ANNOTATION
/end CHARACTERISTIC
/begin CHARACTERISTIC GAC_CALIB.GAC_GracD.GAC_POSNGRACSYNCDEFAULT "" VALUE 0x80612EFC DefaultValueRecordLayout_AUTOSAR_Platform_BaseTypes_sint16 40.0 RB_PT_PCT_SWC_GAC_CompuMethods_ratio_0p001 -20. 20. FORMAT "%10.5"
 /begin ANNOTATION ANNOTATION_LABEL "Description (coming from AUTOSAR DESC field)"
  /begin ANNOTATION_TEXT "Gear actuator limit position used for synchronisation end detection.\r\n" /end ANNOTATION_TEXT
 /end ANNOTATION
/end CHARACTERISTIC
/begin CHARACTERISTIC GAC_CALIB.GAC_GracD.GAC_POSNGRACSYNCEXITMIN "" VALUE 0x80612EFE DefaultValueRecordLayout_AUTOSAR_Platform_BaseTypes_sint16 40.0 RB_PT_PCT_SWC_GAC_CompuMethods_ratio_0p001 -20. 20. FORMAT "%10.5"
 /begin ANNOTATION ANNOTATION_LABEL "Description (coming from AUTOSAR DESC field)"
  /begin ANNOTATION_TEXT "Gear actuator low position used for synchronisation start detection on the positive gear.\r\n" /end ANNOTATION_TEXT
 /end ANNOTATION
/end CHARACTERISTIC
/begin CHARACTERISTIC GAC_CALIB.GAC_GracD.GAC_POSNGRACSYNCHIGR "" VALUE 0x80612F00 DefaultValueRecordLayout_AUTOSAR_Platform_BaseTypes_sint16 40.0 RB_PT_PCT_SWC_GAC_CompuMethods_ratio_0p001 -20. 20. FORMAT "%10.5"
 /begin ANNOTATION ANNOTATION_LABEL "Description (coming from AUTOSAR DESC field)"
  /begin ANNOTATION_TEXT "Gear actuator high position used for synchronisation start detection on the positive gear.\r\n" /end ANNOTATION_TEXT
 /end ANNOTATION
/end CHARACTERISTIC
/begin CHARACTERISTIC GAC_CALIB.GAC_GracD.GAC_POSNGRACSYNCLOWGR "" VALUE 0x80612F02 DefaultValueRecordLayout_AUTOSAR_Platform_BaseTypes_sint16 40.0 RB_PT_PCT_SWC_GAC_CompuMethods_ratio_0p001 -20. 20. FORMAT "%10.5"
 /begin ANNOTATION ANNOTATION_LABEL "Description (coming from AUTOSAR DESC field)"
  /begin ANNOTATION_TEXT "Gear actuator low position used for synchronisation start detection on the positive gear.\r\n" /end ANNOTATION_TEXT
 /end ANNOTATION
/end CHARACTERISTIC
/begin CHARACTERISTIC GAC_CALIB.GAC_GracD.GAC_POSNMAXINGRLRN "" VALUE 0x80612F04 DefaultValueRecordLayout_AUTOSAR_Platform_BaseTypes_sint16 40.0 RB_PT_PCT_SWC_GAC_CompuMethods_ratio_0p001 -20. 20. FORMAT "%10.5"
 /begin ANNOTATION ANNOTATION_LABEL "Description (coming from AUTOSAR DESC field)" /begin ANNOTATION_TEXT "Maximum allowed position for in negative gear learn.\r\n" /end ANNOTATION_TEXT /end ANNOTATION
/end CHARACTERISTIC
/begin CHARACTERISTIC GAC_CALIB.GAC_GracD.GAC_POSNMAXMODNBAND "" VALUE 0x80612F06 DefaultValueRecordLayout_AUTOSAR_Platform_BaseTypes_sint16 40.0 RB_PT_PCT_SWC_GAC_CompuMethods_ratio_0p001 -20. 20. FORMAT "%10.5"
 /begin ANNOTATION ANNOTATION_LABEL "Description (coming from AUTOSAR DESC field)"
  /begin ANNOTATION_TEXT "Maximum allowed position that GAC can modify the neutral offset band for drifting actuators\r\n" /end ANNOTATION_TEXT
 /end ANNOTATION
/end CHARACTERISTIC
/begin CHARACTERISTIC GAC_CALIB.GAC_GracD.GAC_POSNNMODIFY "" VALUE 0x80612F08 DefaultValueRecordLayout_AUTOSAR_Platform_BaseTypes_sint16 40.0 RB_PT_PCT_SWC_GAC_CompuMethods_ratio_0p001 -20. 20. FORMAT "%10.5"
 /begin ANNOTATION ANNOTATION_LABEL "Description (coming from AUTOSAR DESC field)" /begin ANNOTATION_TEXT "Position offset for the neutral window detection\r\n" /end ANNOTATION_TEXT /end ANNOTATION
/end CHARACTERISTIC
/begin CHARACTERISTIC GAC_CALIB.GAC_GracD.GAC_POSNOFFSETGHOLD "" VALUE 0x80612F0A DefaultValueRecordLayout_AUTOSAR_Platform_BaseTypes_sint16 40.0 RB_PT_PCT_SWC_GAC_CompuMethods_ratio_0p001 -20. 20. FORMAT "%10.5"
 /begin ANNOTATION ANNOTATION_LABEL "Description (coming from AUTOSAR DESC field)"
  /begin ANNOTATION_TEXT "Position tolerance used for gear hold phase target position.\r\n" /end ANNOTATION_TEXT
 /end ANNOTATION
/end CHARACTERISTIC
/begin CHARACTERISTIC GAC_CALIB.GAC_GracD.GAC_POSNSFRKBENDGRNEG "" CURVE 0x80613436 RB_PT_PCT_SWC_GAC_RecordLayouts_RL_Curve_sint16_6_uint16_6 4.0 RB_PT_PCT_SWC_GAC_CompuMethods_ratio_0p001 -2. 2. FORMAT "%10.5"
 /begin ANNOTATION ANNOTATION_LABEL "Description (coming from AUTOSAR DESC field)"
  /begin ANNOTATION_TEXT "map for pressure to fork bend in the negative direction\r\n" /end ANNOTATION_TEXT
 /end ANNOTATION
 /begin AXIS_DESCR STD_AXIS NO_INPUT_QUANTITY RB_PT_PCT_SWC_GAC_CompuMethods_ratio_0p001 6 0.0 32. FORMAT "%10.5" DEPOSIT ABSOLUTE /end AXIS_DESCR
/end CHARACTERISTIC
/begin CHARACTERISTIC GAC_CALIB.GAC_GracD.GAC_POSNSFRKBENDGRPOS "" CURVE 0x80613450 RB_PT_PCT_SWC_GAC_RecordLayouts_RL_Curve_sint16_6_uint16_6 4.0 RB_PT_PCT_SWC_GAC_CompuMethods_ratio_0p001 -2. 2. FORMAT "%10.5"
 /begin ANNOTATION ANNOTATION_LABEL "Description (coming from AUTOSAR DESC field)"
  /begin ANNOTATION_TEXT "map for pressure to fork bend in the positive direction\r\n" /end ANNOTATION_TEXT
 /end ANNOTATION
 /begin AXIS_DESCR STD_AXIS NO_INPUT_QUANTITY RB_PT_PCT_SWC_GAC_CompuMethods_ratio_0p001 6 0.0 32. FORMAT "%10.5" DEPOSIT ABSOLUTE /end AXIS_DESCR
/end CHARACTERISTIC
/begin CHARACTERISTIC GAC_CALIB.GAC_GracD.GAC_POSNSTRIGNSTOPGRNEG "" CURVE 0x8061346A RB_PT_PCT_SWC_GAC_RecordLayouts_RL_Curve_sint16_4_sint16_4 40.0 RB_PT_PCT_SWC_GAC_CompuMethods_ratio_0p001 -20. 20. FORMAT "%10.5"
 /begin ANNOTATION ANNOTATION_LABEL "Description (coming from AUTOSAR DESC field)"
  /begin ANNOTATION_TEXT "Actuator position which NStop phase is activated - negative gear case.\r\n" /end ANNOTATION_TEXT
 /end ANNOTATION
 /begin AXIS_DESCR STD_AXIS NO_INPUT_QUANTITY RB_PT_PCT_SWC_GAC_CompuMethods_ident 4 -50. 200. FORMAT "%10.5" DEPOSIT ABSOLUTE /end AXIS_DESCR
/end CHARACTERISTIC
/begin CHARACTERISTIC GAC_CALIB.GAC_GracD.GAC_POSNSTRIGNSTOPGRPOS "" CURVE 0x8061347C RB_PT_PCT_SWC_GAC_RecordLayouts_RL_Curve_sint16_4_sint16_4 40.0 RB_PT_PCT_SWC_GAC_CompuMethods_ratio_0p001 -20. 20. FORMAT "%10.5"
 /begin ANNOTATION ANNOTATION_LABEL "Description (coming from AUTOSAR DESC field)"
  /begin ANNOTATION_TEXT "Actuator position which NStop phase is activated - positive gear case.\r\n" /end ANNOTATION_TEXT
 /end ANNOTATION
 /begin AXIS_DESCR STD_AXIS NO_INPUT_QUANTITY RB_PT_PCT_SWC_GAC_CompuMethods_ident 4 -50. 200. FORMAT "%10.5" DEPOSIT ABSOLUTE /end AXIS_DESCR
/end CHARACTERISTIC
/begin CHARACTERISTIC GAC_CALIB.GAC_GracD.GAC_POSNSYNCFORCEEND "" VALUE 0x80612F0C DefaultValueRecordLayout_AUTOSAR_Platform_BaseTypes_uint16 20.0 RB_PT_PCT_SWC_GAC_CompuMethods_ratio_0p001 0.0 20. FORMAT "%10.5"
 /begin ANNOTATION ANNOTATION_LABEL "Description (coming from AUTOSAR DESC field)"
  /begin ANNOTATION_TEXT "Position that the synchronisation phase is forced to end\r\n" /end ANNOTATION_TEXT
 /end ANNOTATION
/end CHARACTERISTIC
/begin CHARACTERISTIC GAC_CALIB.GAC_GracD.GAC_POSNTOLEXITNEOLDONE "" VALUE 0x80612F0E DefaultValueRecordLayout_AUTOSAR_Platform_BaseTypes_sint16 40.0 RB_PT_PCT_SWC_GAC_CompuMethods_ratio_0p001 -20. 20. FORMAT "%10.5"
 /begin ANNOTATION ANNOTATION_LABEL "Description (coming from AUTOSAR DESC field)"
  /begin ANNOTATION_TEXT "Neutral position tolerance when EOL Neutral learn has completed.\r\n" /end ANNOTATION_TEXT
 /end ANNOTATION
/end CHARACTERISTIC
/begin CHARACTERISTIC GAC_CALIB.GAC_GracD.GAC_POSNTOLGHOLD "" VALUE 0x80612F10 DefaultValueRecordLayout_AUTOSAR_Platform_BaseTypes_uint16 5.0 RB_PT_PCT_SWC_GAC_CompuMethods_ratio_0p001 0.0 5. FORMAT "%10.5"
 /begin ANNOTATION ANNOTATION_LABEL "Description (coming from AUTOSAR DESC field)"
  /begin ANNOTATION_TEXT "Position tolerance used for gear hold phase target position.\r\n" /end ANNOTATION_TEXT
 /end ANNOTATION
/end CHARACTERISTIC
/begin CHARACTERISTIC GAC_CALIB.GAC_GracD.GAC_POSNTOLINNEOLDONE "" VALUE 0x80612F12 DefaultValueRecordLayout_AUTOSAR_Platform_BaseTypes_sint16 40.0 RB_PT_PCT_SWC_GAC_CompuMethods_ratio_0p001 -20. 20. FORMAT "%10.5"
 /begin ANNOTATION ANNOTATION_LABEL "Description (coming from AUTOSAR DESC field)"
  /begin ANNOTATION_TEXT "Neutral position tolerance when EOL Neutral learn has completed.\r\n" /end ANNOTATION_TEXT
 /end ANNOTATION
/end CHARACTERISTIC
/begin CHARACTERISTIC GAC_CALIB.GAC_GracD.GAC_POSNTRIGNSTOPDFLT "" VALUE 0x80612F14 DefaultValueRecordLayout_AUTOSAR_Platform_BaseTypes_sint16 40.0 RB_PT_PCT_SWC_GAC_CompuMethods_ratio_0p001 -20. 20. FORMAT "%10.5"
 /begin ANNOTATION ANNOTATION_LABEL "Description (coming from AUTOSAR DESC field)"
  /begin ANNOTATION_TEXT "Actuator position which NStop phase is activated - default value.\r\n" /end ANNOTATION_TEXT
 /end ANNOTATION
/end CHARACTERISTIC
/begin CHARACTERISTIC GAC_CALIB.GAC_GracD.GAC_PPPULSETMC "" VALUE 0x80612F16 DefaultValueRecordLayout_AUTOSAR_Platform_BaseTypes_sint16 200.0 RB_PT_PCT_SWC_GAC_CompuMethods_ident -100. 100. FORMAT "%10.5"
 /begin ANNOTATION ANNOTATION_LABEL "Description (coming from AUTOSAR DESC field)"
  /begin ANNOTATION_TEXT "pP valve pressure pulse time linear function - intercept value.\r\n" /end ANNOTATION_TEXT
 /end ANNOTATION
/end CHARACTERISTIC
/begin CHARACTERISTIC GAC_CALIB.GAC_GracD.GAC_PPPULSETMM "" VALUE 0x80612F18 DefaultValueRecordLayout_AUTOSAR_Platform_BaseTypes_sint16 2.0 RB_PT_PCT_SWC_GAC_CompuMethods_ratio_0p01 -1. 1. FORMAT "%10.5"
 /begin ANNOTATION ANNOTATION_LABEL "Description (coming from AUTOSAR DESC field)"
  /begin ANNOTATION_TEXT "pP valve pressure pulse time linear function - gradient value.\r\n" /end ANNOTATION_TEXT
 /end ANNOTATION
/end CHARACTERISTIC
/begin CHARACTERISTIC GAC_CALIB.GAC_GracD.GAC_PRESSADDGBLKTMOUT "" VALUE 0x80612F1A DefaultValueRecordLayout_AUTOSAR_Platform_BaseTypes_uint16 32.0 RB_PT_PCT_SWC_GAC_CompuMethods_ratio_0p001 0.0 32. FORMAT "%10.5"
 /begin ANNOTATION ANNOTATION_LABEL "Description (coming from AUTOSAR DESC field)" /begin ANNOTATION_TEXT "Pressure step added for gear block timeout.\r\n" /end ANNOTATION_TEXT /end ANNOTATION
/end CHARACTERISTIC
/begin CHARACTERISTIC GAC_CALIB.GAC_GracD.GAC_PRESSFFVELCTRLNOSYNC "" MAP 0x8061348E RB_PT_PCT_SWC_GAC_RecordLayouts_RL_Map_uint16_12_uint16_6_sint16_2 32.0 RB_PT_PCT_SWC_GAC_CompuMethods_ratio_0p001 0.0 32. FORMAT "%10.5"
 /begin ANNOTATION ANNOTATION_LABEL "Description (coming from AUTOSAR DESC field)"
  /begin ANNOTATION_TEXT "Feedforward pressure gains for velocity control before the synchro phase or Neutral actuation.\r\n" /end ANNOTATION_TEXT
 /end ANNOTATION
 /begin AXIS_DESCR STD_AXIS NO_INPUT_QUANTITY RB_PT_PCT_SWC_GAC_CompuMethods_ratio_0p001 6 0.0 1.2 FORMAT "%10.5" DEPOSIT ABSOLUTE /end AXIS_DESCR
 /begin AXIS_DESCR STD_AXIS NO_INPUT_QUANTITY RB_PT_PCT_SWC_GAC_CompuMethods_ident 2 -50. 200. FORMAT "%10.5" DEPOSIT ABSOLUTE /end AXIS_DESCR
/end CHARACTERISTIC
/begin CHARACTERISTIC GAC_CALIB.GAC_GracD.GAC_PRESSFFVELCTRLNOSYNC2 "" CURVE 0x806134BA RB_PT_PCT_SWC_GAC_RecordLayouts_RL_Curve_uint16_5_uint16_5 32.0 RB_PT_PCT_SWC_GAC_CompuMethods_ratio_0p001 0.0 32. FORMAT "%10.5"
 /begin ANNOTATION ANNOTATION_LABEL "Description (coming from AUTOSAR DESC field)"
  /begin ANNOTATION_TEXT "Feedforward pressure gains for velocity control before the synchro phase or Neutral actuation.\r\n" /end ANNOTATION_TEXT
 /end ANNOTATION
 /begin AXIS_DESCR STD_AXIS NO_INPUT_QUANTITY RB_PT_PCT_SWC_GAC_CompuMethods_ratio_0p001 5 0.0 1.2 FORMAT "%10.5" DEPOSIT ABSOLUTE /end AXIS_DESCR
/end CHARACTERISTIC
/begin CHARACTERISTIC GAC_CALIB.GAC_GracD.GAC_PRESSFFVELCTRLSYNC "" MAP 0x806134D0 RB_PT_PCT_SWC_GAC_RecordLayouts_RL_Map_uint16_10_uint16_5_sint16_2 32.0 RB_PT_PCT_SWC_GAC_CompuMethods_ratio_0p001 0.0 32. FORMAT "%10.5"
 /begin ANNOTATION ANNOTATION_LABEL "Description (coming from AUTOSAR DESC field)"
  /begin ANNOTATION_TEXT "Feedforward pressure gains for velocity control after the synchro phase.\r\n" /end ANNOTATION_TEXT
 /end ANNOTATION
 /begin AXIS_DESCR STD_AXIS NO_INPUT_QUANTITY RB_PT_PCT_SWC_GAC_CompuMethods_ratio_0p001 5 0.0 1.2 FORMAT "%10.5" DEPOSIT ABSOLUTE /end AXIS_DESCR
 /begin AXIS_DESCR STD_AXIS NO_INPUT_QUANTITY RB_PT_PCT_SWC_GAC_CompuMethods_ident 2 -50. 200. FORMAT "%10.5" DEPOSIT ABSOLUTE /end AXIS_DESCR
/end CHARACTERISTIC
/begin CHARACTERISTIC GAC_CALIB.GAC_GracD.GAC_PRESSFFVELCTRLSYNC2 "" CURVE 0x806134F6 RB_PT_PCT_SWC_GAC_RecordLayouts_RL_Curve_uint16_4_uint16_4 32.0 RB_PT_PCT_SWC_GAC_CompuMethods_ratio_0p001 0.0 32. FORMAT "%10.5"
 /begin ANNOTATION ANNOTATION_LABEL "Description (coming from AUTOSAR DESC field)"
  /begin ANNOTATION_TEXT "Feedforward pressure gains for velocity control after the synchro phase.\r\n" /end ANNOTATION_TEXT
 /end ANNOTATION
 /begin AXIS_DESCR STD_AXIS NO_INPUT_QUANTITY RB_PT_PCT_SWC_GAC_CompuMethods_ratio_0p001 4 0.0 1.2 FORMAT "%10.5" DEPOSIT ABSOLUTE /end AXIS_DESCR
/end CHARACTERISTIC
/begin CHARACTERISTIC GAC_CALIB.GAC_GracD.GAC_PRESSGHOLDACTV "" VALUE 0x80612F1C DefaultValueRecordLayout_AUTOSAR_Platform_BaseTypes_uint16 32.0 RB_PT_PCT_SWC_GAC_CompuMethods_ratio_0p001 0.0 32. FORMAT "%10.5"
 /begin ANNOTATION ANNOTATION_LABEL "Description (coming from AUTOSAR DESC field)" /begin ANNOTATION_TEXT "Pressure request for GHold active.\r\n" /end ANNOTATION_TEXT /end ANNOTATION
/end CHARACTERISTIC
/begin CHARACTERISTIC GAC_CALIB.GAC_GracD.GAC_PRESSGHOLDACTVNOADAPTION "" VALUE 0x80612F1E DefaultValueRecordLayout_AUTOSAR_Platform_BaseTypes_uint16 32.0 RB_PT_PCT_SWC_GAC_CompuMethods_ratio_0p001 0.0 32. FORMAT "%10.5"
 /begin ANNOTATION ANNOTATION_LABEL "Description (coming from AUTOSAR DESC field)" /begin ANNOTATION_TEXT "Pressure request for GHold active.\r\n" /end ANNOTATION_TEXT /end ANNOTATION
/end CHARACTERISTIC
/begin CHARACTERISTIC GAC_CALIB.GAC_GracD.GAC_PRESSGHOLDACTVNOOTHERSHIFT "" VALUE 0x80612F20 DefaultValueRecordLayout_AUTOSAR_Platform_BaseTypes_uint16 32.0 RB_PT_PCT_SWC_GAC_CompuMethods_ratio_0p001 0.0 32. FORMAT "%10.5"
 /begin ANNOTATION ANNOTATION_LABEL "Description (coming from AUTOSAR DESC field)" /begin ANNOTATION_TEXT "Pressure request for GHold active.\r\n" /end ANNOTATION_TEXT /end ANNOTATION
/end CHARACTERISTIC
/begin CHARACTERISTIC GAC_CALIB.GAC_GracD.GAC_PRESSGHOLDACTVRULE26 "" VALUE 0x80612F22 DefaultValueRecordLayout_AUTOSAR_Platform_BaseTypes_uint16 32.0 RB_PT_PCT_SWC_GAC_CompuMethods_ratio_0p001 0.0 32. FORMAT "%10.5"
 /begin ANNOTATION ANNOTATION_LABEL "Description (coming from AUTOSAR DESC field)" /begin ANNOTATION_TEXT "Pressure request for GHold active.\r\n" /end ANNOTATION_TEXT /end ANNOTATION
/end CHARACTERISTIC
/begin CHARACTERISTIC GAC_CALIB.GAC_GracD.GAC_PRESSGHOLDACTVSTATIC "" VALUE 0x80612F24 DefaultValueRecordLayout_AUTOSAR_Platform_BaseTypes_uint16 32.0 RB_PT_PCT_SWC_GAC_CompuMethods_ratio_0p001 0.0 32. FORMAT "%10.5"
 /begin ANNOTATION ANNOTATION_LABEL "Description (coming from AUTOSAR DESC field)" /begin ANNOTATION_TEXT "Pressure request for GHold active static cases\r\n" /end ANNOTATION_TEXT /end ANNOTATION
/end CHARACTERISTIC
/begin CHARACTERISTIC GAC_CALIB.GAC_GracD.GAC_PRESSIVELCTRL "" CURVE 0x80613508 RB_PT_PCT_SWC_GAC_RecordLayouts_RL_Curve_sint16_7_sint16_7 64.0 RB_PT_PCT_SWC_GAC_CompuMethods_ratio_0p001 -32. 32. FORMAT "%10.5"
 /begin ANNOTATION ANNOTATION_LABEL "Description (coming from AUTOSAR DESC field)" /begin ANNOTATION_TEXT "Integral pressure gains for velocity control.\r\n" /end ANNOTATION_TEXT /end ANNOTATION
 /begin AXIS_DESCR STD_AXIS NO_INPUT_QUANTITY RB_PT_PCT_SWC_GAC_CompuMethods_ratio_0p001 7 -1.2 1.2 FORMAT "%10.5" DEPOSIT ABSOLUTE /end AXIS_DESCR
/end CHARACTERISTIC
/begin CHARACTERISTIC GAC_CALIB.GAC_GracD.GAC_PRESSIVELCTRLGBLOCK2 "" CURVE 0x80613526 RB_PT_PCT_SWC_GAC_RecordLayouts_RL_Curve_sint16_7_sint16_7 64.0 RB_PT_PCT_SWC_GAC_CompuMethods_ratio_0p001 -32. 32. FORMAT "%10.5"
 /begin ANNOTATION ANNOTATION_LABEL "Description (coming from AUTOSAR DESC field)" /begin ANNOTATION_TEXT "Integral pressure gains for velocity control.\r\n" /end ANNOTATION_TEXT /end ANNOTATION
 /begin AXIS_DESCR STD_AXIS NO_INPUT_QUANTITY RB_PT_PCT_SWC_GAC_CompuMethods_ratio_0p001 7 -1.2 1.2 FORMAT "%10.5" DEPOSIT ABSOLUTE /end AXIS_DESCR
/end CHARACTERISTIC
/begin CHARACTERISTIC GAC_CALIB.GAC_GracD.GAC_PRESSIVELCTRLGBLOCK3 "" CURVE 0x80613544 RB_PT_PCT_SWC_GAC_RecordLayouts_RL_Curve_sint16_4_sint16_4 64.0 RB_PT_PCT_SWC_GAC_CompuMethods_ratio_0p001 -32. 32. FORMAT "%10.5"
 /begin ANNOTATION ANNOTATION_LABEL "Description (coming from AUTOSAR DESC field)" /begin ANNOTATION_TEXT "Integral pressure gains for velocity control.\r\n" /end ANNOTATION_TEXT /end ANNOTATION
 /begin AXIS_DESCR STD_AXIS NO_INPUT_QUANTITY RB_PT_PCT_SWC_GAC_CompuMethods_ratio_0p001 4 -1.2 1.2 FORMAT "%10.5" DEPOSIT ABSOLUTE /end AXIS_DESCR
/end CHARACTERISTIC
/begin CHARACTERISTIC GAC_CALIB.GAC_GracD.GAC_PRESSMINEVPOSTSYNC "" VALUE 0x80612F26 DefaultValueRecordLayout_AUTOSAR_Platform_BaseTypes_uint16 32.0 RB_PT_PCT_SWC_GAC_CompuMethods_ratio_0p001 0.0 32. FORMAT "%10.5"
 /begin ANNOTATION ANNOTATION_LABEL "Description (coming from AUTOSAR DESC field)" /begin ANNOTATION_TEXT "Minimum pressure demand during velocity control.\r\n" /end ANNOTATION_TEXT /end ANNOTATION
/end CHARACTERISTIC
/begin CHARACTERISTIC GAC_CALIB.GAC_GracD.GAC_PRESSMINVELCTRLDEM "" VALUE 0x80612F28 DefaultValueRecordLayout_AUTOSAR_Platform_BaseTypes_uint16 32.0 RB_PT_PCT_SWC_GAC_CompuMethods_ratio_0p001 0.0 32. FORMAT "%10.5"
 /begin ANNOTATION ANNOTATION_LABEL "Description (coming from AUTOSAR DESC field)" /begin ANNOTATION_TEXT "Minimum pressure demand during velocity control.\r\n" /end ANNOTATION_TEXT /end ANNOTATION
/end CHARACTERISTIC
/begin CHARACTERISTIC GAC_CALIB.GAC_GracD.GAC_PRESSMINVELCTRLDEMMAP "" CURVE 0x80613556 RB_PT_PCT_SWC_GAC_RecordLayouts_RL_Curve_uint16_4_sint16_4 32.0 RB_PT_PCT_SWC_GAC_CompuMethods_ratio_0p001 0.0 32. FORMAT "%10.5"
 /begin ANNOTATION ANNOTATION_LABEL "Description (coming from AUTOSAR DESC field)"
  /begin ANNOTATION_TEXT "Minimum pressure demand during velocity control based on temperature\r\n" /end ANNOTATION_TEXT
 /end ANNOTATION
 /begin AXIS_DESCR STD_AXIS NO_INPUT_QUANTITY RB_PT_PCT_SWC_GAC_CompuMethods_ident 4 -50. 200. FORMAT "%10.5" DEPOSIT ABSOLUTE /end AXIS_DESCR
/end CHARACTERISTIC
/begin CHARACTERISTIC GAC_CALIB.GAC_GracD.GAC_PRESSONFLWVELCTRLNOSYNC "" MAP 0x80613568 RB_PT_PCT_SWC_GAC_RecordLayouts_RL_Map_uint16_10_uint16_5_sint16_2 32.0 RB_PT_PCT_SWC_GAC_CompuMethods_ratio_0p001 0.0 32. FORMAT "%10.5"
 /begin ANNOTATION ANNOTATION_LABEL "Description (coming from AUTOSAR DESC field)"
  /begin ANNOTATION_TEXT "Flow based pressure gains for velocity control before the synchro phase.\r\n" /end ANNOTATION_TEXT
 /end ANNOTATION
 /begin AXIS_DESCR STD_AXIS NO_INPUT_QUANTITY RB_PT_PCT_SWC_GAC_CompuMethods_ratio_0p001 5 0.0 32. FORMAT "%10.5" DEPOSIT ABSOLUTE /end AXIS_DESCR
 /begin AXIS_DESCR STD_AXIS NO_INPUT_QUANTITY RB_PT_PCT_SWC_GAC_CompuMethods_ident 2 -50. 200. FORMAT "%10.5" DEPOSIT ABSOLUTE /end AXIS_DESCR
/end CHARACTERISTIC
/begin CHARACTERISTIC GAC_CALIB.GAC_GracD.GAC_PRESSONFLWVELCTRLNOSYNC2 "" CURVE 0x8061358E RB_PT_PCT_SWC_GAC_RecordLayouts_RL_Curve_uint16_3_uint16_3 32.0 RB_PT_PCT_SWC_GAC_CompuMethods_ratio_0p001 0.0 32. FORMAT "%10.5"
 /begin ANNOTATION ANNOTATION_LABEL "Description (coming from AUTOSAR DESC field)"
  /begin ANNOTATION_TEXT "Flow based pressure gains for velocity control before the synchro phase.\r\n" /end ANNOTATION_TEXT
 /end ANNOTATION
 /begin AXIS_DESCR STD_AXIS NO_INPUT_QUANTITY RB_PT_PCT_SWC_GAC_CompuMethods_ratio_0p001 3 0.0 32. FORMAT "%10.5" DEPOSIT ABSOLUTE /end AXIS_DESCR
/end CHARACTERISTIC
/begin CHARACTERISTIC GAC_CALIB.GAC_GracD.GAC_PRESSONFLWVELCTRLSYNC "" CURVE 0x8061359C RB_PT_PCT_SWC_GAC_RecordLayouts_RL_Curve_uint16_5_uint16_5 32.0 RB_PT_PCT_SWC_GAC_CompuMethods_ratio_0p001 0.0 32. FORMAT "%10.5"
 /begin ANNOTATION ANNOTATION_LABEL "Description (coming from AUTOSAR DESC field)"
  /begin ANNOTATION_TEXT "Flow based pressure gains for velocity control after the synchro phase.\r\n" /end ANNOTATION_TEXT
 /end ANNOTATION
 /begin AXIS_DESCR STD_AXIS NO_INPUT_QUANTITY RB_PT_PCT_SWC_GAC_CompuMethods_ratio_0p001 5 0.0 32. FORMAT "%10.5" DEPOSIT ABSOLUTE /end AXIS_DESCR
/end CHARACTERISTIC
/begin CHARACTERISTIC GAC_CALIB.GAC_GracD.GAC_PRESSPVLVPULSE "" VALUE 0x80612F2A DefaultValueRecordLayout_AUTOSAR_Platform_BaseTypes_uint16 32.0 RB_PT_PCT_SWC_GAC_CompuMethods_ratio_0p001 0.0 32. FORMAT "%10.5"
 /begin ANNOTATION ANNOTATION_LABEL "Description (coming from AUTOSAR DESC field)" /begin ANNOTATION_TEXT "Pressure request for pressure valve pulse phase.\r\n" /end ANNOTATION_TEXT /end ANNOTATION
/end CHARACTERISTIC
/begin CHARACTERISTIC GAC_CALIB.GAC_GracD.GAC_PRESSPVLVPULSEDRAIN "" VALUE 0x80612F2C DefaultValueRecordLayout_AUTOSAR_Platform_BaseTypes_uint16 32.0 RB_PT_PCT_SWC_GAC_CompuMethods_ratio_0p001 0.0 32. FORMAT "%10.5"
 /begin ANNOTATION ANNOTATION_LABEL "Description (coming from AUTOSAR DESC field)"
  /begin ANNOTATION_TEXT "Pressure request for pressure valve pulse if drain phase not yet completed.\r\n" /end ANNOTATION_TEXT
 /end ANNOTATION
/end CHARACTERISTIC
/begin CHARACTERISTIC GAC_CALIB.GAC_GracD.GAC_PRESSSYNCENDEVMAX "" VALUE 0x80612F2E DefaultValueRecordLayout_AUTOSAR_Platform_BaseTypes_uint16 32.0 RB_PT_PCT_SWC_GAC_CompuMethods_ratio_0p001 0.0 32. FORMAT "%10.5"
 /begin ANNOTATION ANNOTATION_LABEL "Description (coming from AUTOSAR DESC field)"
  /begin ANNOTATION_TEXT "Max pressure to hand over into the sync end phase in EV mode\r\n" /end ANNOTATION_TEXT
 /end ANNOTATION
/end CHARACTERISTIC
/begin CHARACTERISTIC GAC_CALIB.GAC_GracD.GAC_PVlvPulseTmr.LIB_DT "" VALUE 0x806131D2 DefaultValueRecordLayout_AUTOSAR_Platform_BaseTypes_uint16 65.535 RB_PT_PCT_SWC_GAC_CompuMethods_ratio_0p001 0.0 65.535 FORMAT "%10.5"
 /begin ANNOTATION ANNOTATION_LABEL "Description (coming from AUTOSAR DESC field)" /begin ANNOTATION_TEXT "Timer decrement value.\r\n" /end ANNOTATION_TEXT /end ANNOTATION
/end CHARACTERISTIC
/begin CHARACTERISTIC GAC_CALIB.GAC_GracD.GAC_ROCSPDSYNCSLIPTGTMAX "" VALUE 0x80612ED8 DefaultValueRecordLayout_AUTOSAR_Platform_BaseTypes_uint32 100000.0 RB_PT_PCT_SWC_GAC_CompuMethods_ratio_10p0 0.0 100000. FORMAT "%10.5"
 /begin ANNOTATION ANNOTATION_LABEL "Description (coming from AUTOSAR DESC field)"
  /begin ANNOTATION_TEXT "Maximum limit for target rate of change of synchro slip.\r\n" /end ANNOTATION_TEXT
 /end ANNOTATION
/end CHARACTERISTIC
/begin CHARACTERISTIC GAC_CALIB.GAC_GracD.GAC_ROCSPDSYNCSLIPTGTMIN "" VALUE 0x80612EDC DefaultValueRecordLayout_AUTOSAR_Platform_BaseTypes_uint32 100000.0 RB_PT_PCT_SWC_GAC_CompuMethods_ratio_10p0 0.0 100000. FORMAT "%10.5"
 /begin ANNOTATION ANNOTATION_LABEL "Description (coming from AUTOSAR DESC field)"
  /begin ANNOTATION_TEXT "Minimum limit for target rate of change of synchro slip.\r\n" /end ANNOTATION_TEXT
 /end ANNOTATION
/end CHARACTERISTIC
/begin CHARACTERISTIC GAC_CALIB.GAC_GracD.GAC_ROCSYNCSLIPGRPOS "" VALUE 0x80612F30 DefaultValueRecordLayout_AUTOSAR_Platform_BaseTypes_sint16 655350.0 RB_PT_PCT_SWC_GAC_CompuMethods_ratio_10p0 -327680. 327670. FORMAT "%10.5"
 /begin ANNOTATION ANNOTATION_LABEL "Description (coming from AUTOSAR DESC field)"
  /begin ANNOTATION_TEXT "Rate of change of synchro slip used for synchro start detection on the positive gear.\r\n" /end ANNOTATION_TEXT
 /end ANNOTATION
/end CHARACTERISTIC
/begin CHARACTERISTIC GAC_CALIB.GAC_GracD.GAC_SPDSLIPSYNCFORGBLK0 "" VALUE 0x80612F32 DefaultValueRecordLayout_AUTOSAR_Platform_BaseTypes_sint16 40000.0 RB_PT_PCT_SWC_GAC_CompuMethods_ident -20000. 20000. FORMAT "%10.5"
 /begin ANNOTATION ANNOTATION_LABEL "Description (coming from AUTOSAR DESC field)"
  /begin ANNOTATION_TEXT "Initial synchroniser slip used for allowing synchoniser start detection.\r\n" /end ANNOTATION_TEXT
 /end ANNOTATION
/end CHARACTERISTIC
/begin CHARACTERISTIC GAC_CALIB.GAC_GracD.GAC_SPDSLIPSYNCFORONSYNC "" VALUE 0x80612F34 DefaultValueRecordLayout_AUTOSAR_Platform_BaseTypes_sint16 40000.0 RB_PT_PCT_SWC_GAC_CompuMethods_ident -20000. 20000. FORMAT "%10.5"
 /begin ANNOTATION ANNOTATION_LABEL "Description (coming from AUTOSAR DESC field)"
  /begin ANNOTATION_TEXT "Initial synchroniser slip used for allowing synchoniser start detection.\r\n" /end ANNOTATION_TEXT
 /end ANNOTATION
/end CHARACTERISTIC
/begin CHARACTERISTIC GAC_CALIB.GAC_GracD.GAC_SPDSSLIPSYNCEND "" CURVE 0x806135B2 RB_PT_PCT_SWC_GAC_RecordLayouts_RL_Curve_uint16_5_sint16_5 20000.0 RB_PT_PCT_SWC_GAC_CompuMethods_ident 0.0 20000. FORMAT "%10.5"
 /begin ANNOTATION ANNOTATION_LABEL "Description (coming from AUTOSAR DESC field)"
  /begin ANNOTATION_TEXT "Synchro slip speed thresholds for detection of synchronisation end, based on transmission output speed.\r\n" /end ANNOTATION_TEXT
 /end ANNOTATION
 /begin AXIS_DESCR STD_AXIS NO_INPUT_QUANTITY RB_PT_PCT_SWC_GAC_CompuMethods_ident 5 -20000. 20000. FORMAT "%10.5" DEPOSIT ABSOLUTE /end AXIS_DESCR
/end CHARACTERISTIC
/begin CHARACTERISTIC GAC_CALIB.GAC_GracD.GAC_SPEEDSLIPTHRESHAGAINSTDRAG "" VALUE 0x80612F36 DefaultValueRecordLayout_AUTOSAR_Platform_BaseTypes_sint16 40000.0 RB_PT_PCT_SWC_GAC_CompuMethods_ident -20000. 20000. FORMAT "%10.5"
 /begin ANNOTATION ANNOTATION_LABEL "Description (coming from AUTOSAR DESC field)"
  /begin ANNOTATION_TEXT "slip speed required to complete synchronise against drag strategy\r\n" /end ANNOTATION_TEXT
 /end ANNOTATION
/end CHARACTERISTIC
/begin CHARACTERISTIC GAC_CALIB.GAC_GracD.GAC_SyncAgainstDragTmr.LIB_DT "" VALUE 0x806131D4 DefaultValueRecordLayout_AUTOSAR_Platform_BaseTypes_uint16 65.535 RB_PT_PCT_SWC_GAC_CompuMethods_ratio_0p001 0.0 65.535 FORMAT "%10.5"
 /begin ANNOTATION ANNOTATION_LABEL "Description (coming from AUTOSAR DESC field)" /begin ANNOTATION_TEXT "Timer decrement value.\r\n" /end ANNOTATION_TEXT /end ANNOTATION
/end CHARACTERISTIC
/begin CHARACTERISTIC GAC_CALIB.GAC_GracD.GAC_SyncCtrl.GAC_FCTSYNCPRESSBLEND "" CURVE 0x80613234 RB_PT_PCT_SWC_GAC_RecordLayouts_RL_Curve_uint8_6_uint8_6 1.0 RB_PT_PCT_SWC_GAC_CompuMethods_ratio_0p01 0.0 1. FORMAT "%10.5"
 /begin ANNOTATION ANNOTATION_LABEL "Description (coming from AUTOSAR DESC field)"
  /begin ANNOTATION_TEXT "Pressure blending multiplication factor as a function of synchronisation progression\r\n" /end ANNOTATION_TEXT
 /end ANNOTATION
 /begin AXIS_DESCR STD_AXIS NO_INPUT_QUANTITY RB_PT_PCT_SWC_GAC_CompuMethods_ratio_0p01 6 0.0 1. FORMAT "%10.5" DEPOSIT ABSOLUTE /end AXIS_DESCR
/end CHARACTERISTIC
/begin CHARACTERISTIC GAC_CALIB.GAC_GracD.GAC_SyncCtrl.GAC_FLGENBLBLK0HIRAMP "" VALUE 0x8061322A DefaultValueRecordLayout_AUTOSAR_Platform_BaseTypes_uint8 255.0 DefaultIdenticalCompu 0.0 255. FORMAT "%10.5"
 /begin ANNOTATION ANNOTATION_LABEL "Description (coming from AUTOSAR DESC field)"
  /begin ANNOTATION_TEXT "enable/disable flag for ramping the pressure aggressively when gear blocking type 0 occurs\r\n" /end ANNOTATION_TEXT
 /end ANNOTATION
/end CHARACTERISTIC
/begin CHARACTERISTIC GAC_CALIB.GAC_GracD.GAC_SyncCtrl.GAC_FLGENBLCALCSYNCPRESSTGT "" VALUE 0x8061322B DefaultValueRecordLayout_AUTOSAR_Platform_BaseTypes_uint8 255.0 DefaultIdenticalCompu 0.0 255. FORMAT "%10.5"
 /begin ANNOTATION ANNOTATION_LABEL "Description (coming from AUTOSAR DESC field)" /begin ANNOTATION_TEXT "flag to enable calculated pressure target\r\n" /end ANNOTATION_TEXT /end ANNOTATION
/end CHARACTERISTIC
/begin CHARACTERISTIC GAC_CALIB.GAC_GracD.GAC_SyncCtrl.GAC_FLGENBLPRESSURESHUNT "" VALUE 0x8061322C DefaultValueRecordLayout_AUTOSAR_Platform_BaseTypes_uint8 255.0 DefaultIdenticalCompu 0.0 255. FORMAT "%10.5"
 /begin ANNOTATION ANNOTATION_LABEL "Description (coming from AUTOSAR DESC field)" /begin ANNOTATION_TEXT "flag to enable pressure shunt feature\r\n" /end ANNOTATION_TEXT /end ANNOTATION
/end CHARACTERISTIC
/begin CHARACTERISTIC GAC_CALIB.GAC_GracD.GAC_SyncCtrl.GAC_FLGENBLPRESSURESHUNT1STATTEMPT "" VALUE 0x8061322D DefaultValueRecordLayout_AUTOSAR_Platform_BaseTypes_uint8 255.0 DefaultIdenticalCompu 0.0 255. FORMAT "%10.5"
 /begin ANNOTATION ANNOTATION_LABEL "Description (coming from AUTOSAR DESC field)"
  /begin ANNOTATION_TEXT "flag to enable pressure shunt feature at the first engagement attempt\r\n" /end ANNOTATION_TEXT
 /end ANNOTATION
/end CHARACTERISTIC
/begin CHARACTERISTIC GAC_CALIB.GAC_GracD.GAC_SyncCtrl.GAC_FLGEVMODEGBLK0ENBL "" VALUE 0x8061322E DefaultValueRecordLayout_AUTOSAR_Platform_BaseTypes_uint8 255.0 DefaultIdenticalCompu 0.0 255. FORMAT "%10.5"
 /begin ANNOTATION ANNOTATION_LABEL "Description (coming from AUTOSAR DESC field)" /begin ANNOTATION_TEXT "Flag to enable EV mode gblock 0 pressure spike\r\n" /end ANNOTATION_TEXT /end ANNOTATION
/end CHARACTERISTIC
/begin CHARACTERISTIC GAC_CALIB.GAC_GracD.GAC_SyncCtrl.GAC_FLGLATCHSYNCBLENDUNTILEND "" VALUE 0x8061322F DefaultValueRecordLayout_AUTOSAR_Platform_BaseTypes_uint8 255.0 DefaultIdenticalCompu 0.0 255. FORMAT "%10.5"
 /begin ANNOTATION ANNOTATION_LABEL "Description (coming from AUTOSAR DESC field)" /begin ANNOTATION_TEXT "latch the synchronisation blend until end\r\n" /end ANNOTATION_TEXT /end ANNOTATION
/end CHARACTERISTIC
/begin CHARACTERISTIC GAC_CALIB.GAC_GracD.GAC_SyncCtrl.GAC_FLGSSTEPTOMAXFRKPEAK1STATTEMPT "" VAL_BLK 0x80613206 DefaultValueRecordLayout_AUTOSAR_Platform_BaseTypes_uint8 255.0 DefaultIdenticalCompu 0.0 255. FORMAT "%10.5"
 /begin ANNOTATION ANNOTATION_LABEL "Description (coming from AUTOSAR DESC field)"
  /begin ANNOTATION_TEXT "allow the pressure command to go from the lower to the higher pressure limit based on aggression command\r\n" /end ANNOTATION_TEXT
 /end ANNOTATION
 MATRIX_DIM 5 1 1 /end CHARACTERISTIC
/begin CHARACTERISTIC GAC_CALIB.GAC_GracD.GAC_SyncCtrl.GAC_FLWSSYNCCTRLTGT "" VAL_BLK 0x806131D6 DefaultValueRecordLayout_AUTOSAR_Platform_BaseTypes_sint16 64.0 RB_PT_PCT_SWC_GAC_CompuMethods_ratio_0p001 -32. 32. FORMAT "%10.5"
 /begin ANNOTATION ANNOTATION_LABEL "Description (coming from AUTOSAR DESC field)"
  /begin ANNOTATION_TEXT "Flow targets for synchro control for each actuation aggression.\r\n" /end ANNOTATION_TEXT
 /end ANNOTATION
 MATRIX_DIM 4 1 1 /end CHARACTERISTIC
/begin CHARACTERISTIC GAC_CALIB.GAC_GracD.GAC_SyncCtrl.GAC_FLWSYNCCTRLVLOWTGT "" VALUE 0x8061320C DefaultValueRecordLayout_AUTOSAR_Platform_BaseTypes_sint16 64.0 RB_PT_PCT_SWC_GAC_CompuMethods_ratio_0p001 -32. 32. FORMAT "%10.5"
 /begin ANNOTATION ANNOTATION_LABEL "Description (coming from AUTOSAR DESC field)"
  /begin ANNOTATION_TEXT "Flow target for synchro control for very low aggression actuation.\r\n" /end ANNOTATION_TEXT
 /end ANNOTATION
/end CHARACTERISTIC
/begin CHARACTERISTIC GAC_CALIB.GAC_GracD.GAC_SyncCtrl.GAC_PRESSIADDGBLOCK "" VALUE 0x8061320E DefaultValueRecordLayout_AUTOSAR_Platform_BaseTypes_sint16 64.0 RB_PT_PCT_SWC_GAC_CompuMethods_ratio_0p001 -32. 32. FORMAT "%10.5"
 /begin ANNOTATION ANNOTATION_LABEL "Description (coming from AUTOSAR DESC field)"
  /begin ANNOTATION_TEXT "Additive integral pressure term for synchro control when gear blocking type 0 occurs\r\n" /end ANNOTATION_TEXT
 /end ANNOTATION
/end CHARACTERISTIC
/begin CHARACTERISTIC GAC_CALIB.GAC_GracD.GAC_SyncCtrl.GAC_PRESSIADDNOSLIP "" VALUE 0x80613210 DefaultValueRecordLayout_AUTOSAR_Platform_BaseTypes_sint16 64.0 RB_PT_PCT_SWC_GAC_CompuMethods_ratio_0p001 -32. 32. FORMAT "%10.5"
 /begin ANNOTATION ANNOTATION_LABEL "Description (coming from AUTOSAR DESC field)"
  /begin ANNOTATION_TEXT "Additive integral pressure term for synchro control when syncrhro slip is negligible\r\n" /end ANNOTATION_TEXT
 /end ANNOTATION
/end CHARACTERISTIC
/begin CHARACTERISTIC GAC_CALIB.GAC_GracD.GAC_SyncCtrl.GAC_PRESSIADDSYNCHIGRNEG "" CURVE 0x80613242 RB_PT_PCT_SWC_GAC_RecordLayouts_RL_Curve_sint16_5_uint16_5 64.0 RB_PT_PCT_SWC_GAC_CompuMethods_ratio_0p001 -32. 32. FORMAT "%10.5"
 /begin ANNOTATION ANNOTATION_LABEL "Description (coming from AUTOSAR DESC field)"
  /begin ANNOTATION_TEXT "Additive integral pressure term for synchro control engaging to negative gear with high aggression actuation.\r\n" /end ANNOTATION_TEXT
 /end ANNOTATION
 /begin AXIS_DESCR STD_AXIS NO_INPUT_QUANTITY RB_PT_PCT_SWC_GAC_CompuMethods_ratio_10p0 5 0.0 100000. FORMAT "%10.5" DEPOSIT ABSOLUTE /end AXIS_DESCR
/end CHARACTERISTIC
/begin CHARACTERISTIC GAC_CALIB.GAC_GracD.GAC_SyncCtrl.GAC_PRESSIADDSYNCHIGRPOS "" CURVE 0x80613258 RB_PT_PCT_SWC_GAC_RecordLayouts_RL_Curve_sint16_5_uint16_5 64.0 RB_PT_PCT_SWC_GAC_CompuMethods_ratio_0p001 -32. 32. FORMAT "%10.5"
 /begin ANNOTATION ANNOTATION_LABEL "Description (coming from AUTOSAR DESC field)"
  /begin ANNOTATION_TEXT "Additive integral pressure term for synchro control engaging to positive gear with high aggression actuation.\r\n" /end ANNOTATION_TEXT
 /end ANNOTATION
 /begin AXIS_DESCR STD_AXIS NO_INPUT_QUANTITY RB_PT_PCT_SWC_GAC_CompuMethods_ratio_10p0 5 0.0 100000. FORMAT "%10.5" DEPOSIT ABSOLUTE /end AXIS_DESCR
/end CHARACTERISTIC
/begin CHARACTERISTIC GAC_CALIB.GAC_GracD.GAC_SyncCtrl.GAC_PRESSIADDSYNCLIM "" VALUE 0x80613212 DefaultValueRecordLayout_AUTOSAR_Platform_BaseTypes_sint16 64.0 RB_PT_PCT_SWC_GAC_CompuMethods_ratio_0p001 -32. 32. FORMAT "%10.5"
 /begin ANNOTATION ANNOTATION_LABEL "Description (coming from AUTOSAR DESC field)"
  /begin ANNOTATION_TEXT "Limited additive integral pressure term when rate of change of sync slip not ok for sync control.\r\n" /end ANNOTATION_TEXT
 /end ANNOTATION
/end CHARACTERISTIC
/begin CHARACTERISTIC GAC_CALIB.GAC_GracD.GAC_SyncCtrl.GAC_PRESSIADDSYNCLOWGRNEG "" CURVE 0x8061326E RB_PT_PCT_SWC_GAC_RecordLayouts_RL_Curve_sint16_5_uint16_5 64.0 RB_PT_PCT_SWC_GAC_CompuMethods_ratio_0p001 -32. 32. FORMAT "%10.5"
 /begin ANNOTATION ANNOTATION_LABEL "Description (coming from AUTOSAR DESC field)"
  /begin ANNOTATION_TEXT "Additive integral pressure term for synchro control engaging to negative gear with low aggression actuation.\r\n" /end ANNOTATION_TEXT
 /end ANNOTATION
 /begin AXIS_DESCR STD_AXIS NO_INPUT_QUANTITY RB_PT_PCT_SWC_GAC_CompuMethods_ratio_10p0 5 0.0 100000. FORMAT "%10.5" DEPOSIT ABSOLUTE /end AXIS_DESCR
/end CHARACTERISTIC
/begin CHARACTERISTIC GAC_CALIB.GAC_GracD.GAC_SyncCtrl.GAC_PRESSIADDSYNCLOWGRPOS "" CURVE 0x80613284 RB_PT_PCT_SWC_GAC_RecordLayouts_RL_Curve_sint16_5_uint16_5 64.0 RB_PT_PCT_SWC_GAC_CompuMethods_ratio_0p001 -32. 32. FORMAT "%10.5"
 /begin ANNOTATION ANNOTATION_LABEL "Description (coming from AUTOSAR DESC field)"
  /begin ANNOTATION_TEXT "Additive integral pressure term for synchro control engaging to positive gear with low aggression actuation.\r\n" /end ANNOTATION_TEXT
 /end ANNOTATION
 /begin AXIS_DESCR STD_AXIS NO_INPUT_QUANTITY RB_PT_PCT_SWC_GAC_CompuMethods_ratio_10p0 5 0.0 100000. FORMAT "%10.5" DEPOSIT ABSOLUTE /end AXIS_DESCR
/end CHARACTERISTIC
/begin CHARACTERISTIC GAC_CALIB.GAC_GracD.GAC_SyncCtrl.GAC_PRESSIADDSYNCMEDGRNEG "" CURVE 0x8061329A RB_PT_PCT_SWC_GAC_RecordLayouts_RL_Curve_sint16_5_uint16_5 64.0 RB_PT_PCT_SWC_GAC_CompuMethods_ratio_0p001 -32. 32. FORMAT "%10.5"
 /begin ANNOTATION ANNOTATION_LABEL "Description (coming from AUTOSAR DESC field)"
  /begin ANNOTATION_TEXT "Additive integral pressure term for synchro control engaging to negative gear with medium aggression actuation.\r\n" /end ANNOTATION_TEXT
 /end ANNOTATION
 /begin AXIS_DESCR STD_AXIS NO_INPUT_QUANTITY RB_PT_PCT_SWC_GAC_CompuMethods_ratio_10p0 5 0.0 100000. FORMAT "%10.5" DEPOSIT ABSOLUTE /end AXIS_DESCR
/end CHARACTERISTIC
/begin CHARACTERISTIC GAC_CALIB.GAC_GracD.GAC_SyncCtrl.GAC_PRESSIADDSYNCMEDGRPOS "" CURVE 0x806132B0 RB_PT_PCT_SWC_GAC_RecordLayouts_RL_Curve_sint16_5_uint16_5 64.0 RB_PT_PCT_SWC_GAC_CompuMethods_ratio_0p001 -32. 32. FORMAT "%10.5"
 /begin ANNOTATION ANNOTATION_LABEL "Description (coming from AUTOSAR DESC field)"
  /begin ANNOTATION_TEXT "Additive integral pressure term for synchro control engaging to positive gear with mediium aggression actuation.\r\n" /end ANNOTATION_TEXT
 /end ANNOTATION
 /begin AXIS_DESCR STD_AXIS NO_INPUT_QUANTITY RB_PT_PCT_SWC_GAC_CompuMethods_ratio_10p0 5 0.0 100000. FORMAT "%10.5" DEPOSIT ABSOLUTE /end AXIS_DESCR
/end CHARACTERISTIC
/begin CHARACTERISTIC GAC_CALIB.GAC_GracD.GAC_SyncCtrl.GAC_PRESSIADDSYNCSLIPUDEF "" VALUE 0x80613214 DefaultValueRecordLayout_AUTOSAR_Platform_BaseTypes_sint16 64.0 RB_PT_PCT_SWC_GAC_CompuMethods_ratio_0p001 -32. 32. FORMAT "%10.5"
 /begin ANNOTATION ANNOTATION_LABEL "Description (coming from AUTOSAR DESC field)"
  /begin ANNOTATION_TEXT "Additive integral pressure term for synchro control when syncrhro slip is unknown.\r\n" /end ANNOTATION_TEXT
 /end ANNOTATION
/end CHARACTERISTIC
/begin CHARACTERISTIC GAC_CALIB.GAC_GracD.GAC_SyncCtrl.GAC_PRESSLIMSSYNCIGRNEG "" VAL_BLK 0x806131DE DefaultValueRecordLayout_AUTOSAR_Platform_BaseTypes_sint16 64.0 RB_PT_PCT_SWC_GAC_CompuMethods_ratio_0p001 -32. 32. FORMAT "%10.5"
 /begin ANNOTATION ANNOTATION_LABEL "Description (coming from AUTOSAR DESC field)"
  /begin ANNOTATION_TEXT "Integral pressure addition limit for synchro control engaging negative gear, for each actuation aggression.\r\n" /end ANNOTATION_TEXT
 /end ANNOTATION
 MATRIX_DIM 4 1 1 /end CHARACTERISTIC
/begin CHARACTERISTIC GAC_CALIB.GAC_GracD.GAC_SyncCtrl.GAC_PRESSLIMSSYNCIGRPOS "" VAL_BLK 0x806131E6 DefaultValueRecordLayout_AUTOSAR_Platform_BaseTypes_sint16 64.0 RB_PT_PCT_SWC_GAC_CompuMethods_ratio_0p001 -32. 32. FORMAT "%10.5"
 /begin ANNOTATION ANNOTATION_LABEL "Description (coming from AUTOSAR DESC field)"
  /begin ANNOTATION_TEXT "Integral pressure addition limit for synchro control engaging positive gear, for each actuation aggression.\r\n" /end ANNOTATION_TEXT
 /end ANNOTATION
 MATRIX_DIM 4 1 1 /end CHARACTERISTIC
/begin CHARACTERISTIC GAC_CALIB.GAC_GracD.GAC_SyncCtrl.GAC_PRESSLIMSYNCHIMAP "" CURVE 0x806132C6 RB_PT_PCT_SWC_GAC_RecordLayouts_RL_Curve_uint16_4_sint16_4 32.0 RB_PT_PCT_SWC_GAC_CompuMethods_ratio_0p001 0.0 32. FORMAT "%10.5"
 /begin ANNOTATION ANNOTATION_LABEL "Description (coming from AUTOSAR DESC field)"
  /begin ANNOTATION_TEXT "Limit for the static pressure engagements based on temperature - high aggression\r\n" /end ANNOTATION_TEXT
 /end ANNOTATION
 /begin AXIS_DESCR STD_AXIS NO_INPUT_QUANTITY RB_PT_PCT_SWC_GAC_CompuMethods_ident 4 -50. 200. FORMAT "%10.5" DEPOSIT ABSOLUTE /end AXIS_DESCR
/end CHARACTERISTIC
/begin CHARACTERISTIC GAC_CALIB.GAC_GracD.GAC_SyncCtrl.GAC_PRESSLIMSYNCLOWMAP "" CURVE 0x806132D8 RB_PT_PCT_SWC_GAC_RecordLayouts_RL_Curve_uint16_4_sint16_4 32.0 RB_PT_PCT_SWC_GAC_CompuMethods_ratio_0p001 0.0 32. FORMAT "%10.5"
 /begin ANNOTATION ANNOTATION_LABEL "Description (coming from AUTOSAR DESC field)"
  /begin ANNOTATION_TEXT "Limit for the static pressure engagements based on temperature- low aggression\r\n" /end ANNOTATION_TEXT
 /end ANNOTATION
 /begin AXIS_DESCR STD_AXIS NO_INPUT_QUANTITY RB_PT_PCT_SWC_GAC_CompuMethods_ident 4 -50. 200. FORMAT "%10.5" DEPOSIT ABSOLUTE /end AXIS_DESCR
/end CHARACTERISTIC
/begin CHARACTERISTIC GAC_CALIB.GAC_GracD.GAC_SyncCtrl.GAC_PRESSLIMSYNCMEDMAP "" CURVE 0x806132EA RB_PT_PCT_SWC_GAC_RecordLayouts_RL_Curve_uint16_4_sint16_4 32.0 RB_PT_PCT_SWC_GAC_CompuMethods_ratio_0p001 0.0 32. FORMAT "%10.5"
 /begin ANNOTATION ANNOTATION_LABEL "Description (coming from AUTOSAR DESC field)"
  /begin ANNOTATION_TEXT "Limit for the static pressure engagements based on temperature - medium aggression\r\n" /end ANNOTATION_TEXT
 /end ANNOTATION
 /begin AXIS_DESCR STD_AXIS NO_INPUT_QUANTITY RB_PT_PCT_SWC_GAC_CompuMethods_ident 4 -50. 200. FORMAT "%10.5" DEPOSIT ABSOLUTE /end AXIS_DESCR
/end CHARACTERISTIC
/begin CHARACTERISTIC GAC_CALIB.GAC_GracD.GAC_SyncCtrl.GAC_PRESSLIMSYNCSTATICMAP "" CURVE 0x806132FC RB_PT_PCT_SWC_GAC_RecordLayouts_RL_Curve_uint16_4_sint16_4 32.0 RB_PT_PCT_SWC_GAC_CompuMethods_ratio_0p001 0.0 32. FORMAT "%10.5"
 /begin ANNOTATION ANNOTATION_LABEL "Description (coming from AUTOSAR DESC field)"
  /begin ANNOTATION_TEXT "Limit for the static pressure engagements based on temperature - static aggression\r\n" /end ANNOTATION_TEXT
 /end ANNOTATION
 /begin AXIS_DESCR STD_AXIS NO_INPUT_QUAN /end AXIS_DESCR
/end CHARACTERISTIC
/end MODULE
/end PROJECT
