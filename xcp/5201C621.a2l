ASAP2_VERSION 1 60
/begin PROJECT LB74x_TCU "5201C621"
/begin HEADER "" VERSION "5201C621" PROJECT_NO LB74x_TCU /end HEADER
/begin MODULE DIM ""
/begin MOD_COMMON "" BYTE_ORDER MSB_LAST ALIGNMENT_BYTE 1 ALIGNMENT_WORD 2 ALIGNMENT_LONG 4 ALIGNMENT_INT64 4 ALIGNMENT_FLOAT32_IEEE 4 ALIGNMENT_FLOAT64_IEEE 4 DATA_SIZE 32 /end MOD_COMMON
/begin CHARACTERISTIC DWC_CALIB.DWC_K2DeviceControl.DWC_ValveClean.DWC_PCTVALVERINSEEARLYCOMPLETE "" VALUE 0x8060EFB0 DefaultValueRecordLayout_AUTOSAR_Platform_BaseTypes_uint8 1.0 RB_PT_PCT_SWC_DWC_CompuMethods_ratio_0p01 0.0 1. FORMAT "%10.5"
 /begin ANNOTATION ANNOTATION_LABEL "Description (coming from AUTOSAR DESC field)"
  /begin ANNOTATION_TEXT "Percentage of full rinse time where an early abortion still leads to a timeout condition\r\n" /end ANNOTATION_TEXT
 /end ANNOTATION
/end CHARACTERISTIC
/begin CHARACTERISTIC DWC_CALIB.DWC_K2DeviceControl.DWC_ValveClean.DWC_PRESSURECLOSEDCLEANMAX "" CURVE 0x8060EFB2 RB_PT_PCT_SWC_DWC_RecordLayouts_RL_Curve_sint16_5_sint16_5 34.0 RB_PT_PCT_SWC_DWC_CompuMethods_ratio_0p001__2 -2. 32. FORMAT "%10.5"
 /begin ANNOTATION ANNOTATION_LABEL "Description (coming from AUTOSAR DESC field)" /begin ANNOTATION_TEXT "Lower limit lookup\r\n" /end ANNOTATION_TEXT /end ANNOTATION
 /begin AXIS_DESCR STD_AXIS NO_INPUT_QUANTITY RB_PT_PCT_SWC_DWC_CompuMethods_ratio_0p001__2 5 -2. 32. FORMAT "%10.5" DEPOSIT ABSOLUTE /end AXIS_DESCR
/end CHARACTERISTIC
/begin CHARACTERISTIC DWC_CALIB.DWC_K2DeviceControl.DWC_ValveClean.DWC_PRESSUREOPENCLEANMAX "" CURVE 0x8060EFC8 RB_PT_PCT_SWC_DWC_RecordLayouts_RL_Curve_sint16_5_sint16_5 34.0 RB_PT_PCT_SWC_DWC_CompuMethods_ratio_0p001__2 -2. 32. FORMAT "%10.5"
 /begin ANNOTATION ANNOTATION_LABEL "Description (coming from AUTOSAR DESC field)" /begin ANNOTATION_TEXT "Lower limit lookup\r\n" /end ANNOTATION_TEXT /end ANNOTATION
 /begin AXIS_DESCR STD_AXIS NO_INPUT_QUANTITY RB_PT_PCT_SWC_DWC_CompuMethods_ratio_0p001__2 5 -2. 32. FORMAT "%10.5" DEPOSIT ABSOLUTE /end AXIS_DESCR
/end CHARACTERISTIC
/begin CHARACTERISTIC DWC_CALIB.DWC_K2DeviceControl.DWC_ValveClean.DWC_PRESSUREOVERHEADMAX "" CURVE 0x8060EFDE RB_PT_PCT_SWC_DWC_RecordLayouts_RL_Curve_sint16_5_sint16_5 34.0 RB_PT_PCT_SWC_DWC_CompuMethods_ratio_0p001__2 -2. 32. FORMAT "%10.5"
 /begin ANNOTATION ANNOTATION_LABEL "Description (coming from AUTOSAR DESC field)" /begin ANNOTATION_TEXT "Lower limit lookup\r\n" /end ANNOTATION_TEXT /end ANNOTATION
 /begin AXIS_DESCR STD_AXIS NO_INPUT_QUANTITY RB_PT_PCT_SWC_DWC_CompuMethods_ratio_0p001__2 5 -2. 32. FORMAT "%10.5" DEPOSIT ABSOLUTE /end AXIS_DESCR
/end CHARACTERISTIC
/begin CHARACTERISTIC DWC_CALIB.DWC_K2DeviceControl.DWC_ValveClean.DWC_PRESSUREOVERHEADMIN "" CURVE 0x8060EFF4 RB_PT_PCT_SWC_DWC_RecordLayouts_RL_Curve_sint16_5_sint16_5 34.0 RB_PT_PCT_SWC_DWC_CompuMethods_ratio_0p001__2 -2. 32. FORMAT "%10.5"
 /begin ANNOTATION ANNOTATION_LABEL "Description (coming from AUTOSAR DESC field)" /begin ANNOTATION_TEXT "Lower limit lookup\r\n" /end ANNOTATION_TEXT /end ANNOTATION
 /begin AXIS_DESCR STD_AXIS NO_INPUT_QUANTITY RB_PT_PCT_SWC_DWC_CompuMethods_ratio_0p001__2 5 -2. 32. FORMAT "%10.5" DEPOSIT ABSOLUTE /end AXIS_DESCR
/end CHARACTERISTIC
/begin CHARACTERISTIC DWC_CALIB.DWC_K2DeviceControl.DWC_ValveClean.DWC_TF_FCTROPENCLEANCURRENT "" CURVE 0x8060F00A RB_PT_PCT_SWC_DWC_RecordLayouts_RL_Curve_uint16_11_uint16_11 1.0 RB_PT_PCT_SWC_DWC_CompuMethods_Ratio_0p001 0.0 1. FORMAT "%10.5"
 /begin ANNOTATION ANNOTATION_LABEL "Description (coming from AUTOSAR DESC field)" /begin ANNOTATION_TEXT "Depressure fctr\r\n" /end ANNOTATION_TEXT /end ANNOTATION
 /begin AXIS_DESCR STD_AXIS NO_INPUT_QUANTITY RB_PT_PCT_SWC_DWC_CompuMethods_DST_Time 11 0.0 655.35 FORMAT "%10.5" DEPOSIT ABSOLUTE /end AXIS_DESCR
/end CHARACTERISTIC
/begin CHARACTERISTIC DWC_CALIB.DWC_K2DeviceControl.DWC_ValveClean.DWC_TF_FCTRROUTINECLEANCURRENT "" CURVE 0x8060F038 RB_PT_PCT_SWC_DWC_RecordLayouts_RL_Curve_uint16_11_uint16_11 1.0 RB_PT_PCT_SWC_DWC_CompuMethods_Ratio_0p001 0.0 1. FORMAT "%10.5"
 /begin ANNOTATION ANNOTATION_LABEL "Description (coming from AUTOSAR DESC field)" /begin ANNOTATION_TEXT "Depressure fctr\r\n" /end ANNOTATION_TEXT /end ANNOTATION
 /begin AXIS_DESCR STD_AXIS NO_INPUT_QUANTITY RB_PT_PCT_SWC_DWC_CompuMethods_DST_Time 11 0.0 655.35 FORMAT "%10.5" DEPOSIT ABSOLUTE /end AXIS_DESCR
/end CHARACTERISTIC
/begin CHARACTERISTIC DWC_CALIB.DWC_K2DeviceControl.DWC_ValveClean.DWC_TIMEROUTINECLEAN "" VALUE 0x8060EFA0 DefaultValueRecordLayout_AUTOSAR_Platform_BaseTypes_uint16 65.535 RB_PT_PCT_SWC_DWC_CompuMethods_ratio_0p001__2 0.0 65.535 FORMAT "%10.5"
 /begin ANNOTATION ANNOTATION_LABEL "Description (coming from AUTOSAR DESC field)" /begin ANNOTATION_TEXT "Maximum time before valve clean timeout\r\n" /end ANNOTATION_TEXT /end ANNOTATION
/end CHARACTERISTIC
/begin CHARACTERISTIC DWC_CALIB.DWC_K2DeviceControl.DWC_ValveClean.DWC_TIMEVALVECLEANHALFCYCLE "" VALUE 0x8060EFB1 DefaultValueRecordLayout_AUTOSAR_Platform_BaseTypes_uint8 1.275 RB_PT_PCT_SWC_DWC_CompuMethods_ratio_0p005 0.0 1.275 FORMAT "%10.5"
 /begin ANNOTATION ANNOTATION_LABEL "Description (coming from AUTOSAR DESC field)" /begin ANNOTATION_TEXT "Half period of valve cycle\r\n" /end ANNOTATION_TEXT /end ANNOTATION
/end CHARACTERISTIC
/begin CHARACTERISTIC DWC_CALIB.DWC_K2DeviceControl.DWC_ValveClean.DWC_TIMEVALVECLOSEDCLEAN "" VALUE 0x8060EFA2 DefaultValueRecordLayout_AUTOSAR_Platform_BaseTypes_uint16 65.535 RB_PT_PCT_SWC_DWC_CompuMethods_ratio_0p001__2 0.0 65.535 FORMAT "%10.5"
 /begin ANNOTATION ANNOTATION_LABEL "Description (coming from AUTOSAR DESC field)" /begin ANNOTATION_TEXT "Maximum time before valve clean timeout\r\n" /end ANNOTATION_TEXT /end ANNOTATION
/end CHARACTERISTIC
/begin CHARACTERISTIC DWC_CALIB.DWC_K2DeviceControl.DWC_ValveClean.DWC_TIMEVALVECLOSEDCLEANRESET "" VALUE 0x8060EF94 DefaultValueRecordLayout_AUTOSAR_Platform_BaseTypes_uint32 4294967.295 RB_PT_PCT_SWC_DWC_CompuMethods_ratio_0p001__2 0.0 4294967.295 FORMAT "%10.5"
 /begin ANNOTATION ANNOTATION_LABEL "Description (coming from AUTOSAR DESC field)" /begin ANNOTATION_TEXT "Maximum time before valve rinse timeout\r\n" /end ANNOTATION_TEXT /end ANNOTATION
/end CHARACTERISTIC
/begin CHARACTERISTIC DWC_CALIB.DWC_K2DeviceControl.DWC_ValveClean.DWC_TIMEVALVEOPENCLEAN "" VALUE 0x8060EFA4 DefaultValueRecordLayout_AUTOSAR_Platform_BaseTypes_uint16 65.535 RB_PT_PCT_SWC_DWC_CompuMethods_ratio_0p001__2 0.0 65.535 FORMAT "%10.5"
 /begin ANNOTATION ANNOTATION_LABEL "Description (coming from AUTOSAR DESC field)" /begin ANNOTATION_TEXT "Maximum time before valve clean timeout\r\n" /end ANNOTATION_TEXT /end ANNOTATION
/end CHARACTERISTIC
/begin CHARACTERISTIC DWC_CALIB.DWC_K2DeviceControl.DWC_ValveClean.DWC_TIMEVALVEOPENCLEANRESET "" VALUE 0x8060EF98 DefaultValueRecordLayout_AUTOSAR_Platform_BaseTypes_uint32 4294967.295 RB_PT_PCT_SWC_DWC_CompuMethods_ratio_0p001__2 0.0 4294967.295 FORMAT "%10.5"
 /begin ANNOTATION ANNOTATION_LABEL "Description (coming from AUTOSAR DESC field)" /begin ANNOTATION_TEXT "Maximum time before valve rinse timeout\r\n" /end ANNOTATION_TEXT /end ANNOTATION
/end CHARACTERISTIC
/begin CHARACTERISTIC DWC_CALIB.DWC_K2DeviceControl.DWC_ValveClean.DWC_TIMEVALVEPRECLOSEDCLEAN "" VALUE 0x8060EFA6 DefaultValueRecordLayout_AUTOSAR_Platform_BaseTypes_uint16 65.535 RB_PT_PCT_SWC_DWC_CompuMethods_ratio_0p001__2 0.0 65.535 FORMAT "%10.5"
 /begin ANNOTATION ANNOTATION_LABEL "Description (coming from AUTOSAR DESC field)" /begin ANNOTATION_TEXT "Maximum time before valve clean timeout\r\n" /end ANNOTATION_TEXT /end ANNOTATION
/end CHARACTERISTIC
/begin CHARACTERISTIC DWC_CALIB.DWC_K2DeviceControl.DWC_ValveClean.DWC_TIMEVALVEPREOPENCLEAN "" VALUE 0x8060EFA8 DefaultValueRecordLayout_AUTOSAR_Platform_BaseTypes_uint16 65.535 RB_PT_PCT_SWC_DWC_CompuMethods_ratio_0p001__2 0.0 65.535 FORMAT "%10.5"
 /begin ANNOTATION ANNOTATION_LABEL "Description (coming from AUTOSAR DESC field)" /begin ANNOTATION_TEXT "Maximum time before valve clean timeout\r\n" /end ANNOTATION_TEXT /end ANNOTATION
/end CHARACTERISTIC
/begin CHARACTERISTIC DWC_CALIB.DWC_K2DeviceControl.DWC_ValveClean.DWC_TIMEVALVEPRERINSE "" VALUE 0x8060EFAA DefaultValueRecordLayout_AUTOSAR_Platform_BaseTypes_uint16 65.535 RB_PT_PCT_SWC_DWC_CompuMethods_ratio_0p001__2 0.0 65.535 FORMAT "%10.5"
 /begin ANNOTATION ANNOTATION_LABEL "Description (coming from AUTOSAR DESC field)" /begin ANNOTATION_TEXT "Maximum time before valve clean timeout\r\n" /end ANNOTATION_TEXT /end ANNOTATION
/end CHARACTERISTIC
/begin CHARACTERISTIC DWC_CALIB.DWC_K2DeviceControl.DWC_ValveClean.DWC_TIMEVALVERINSE "" VALUE 0x8060EFAC DefaultValueRecordLayout_AUTOSAR_Platform_BaseTypes_uint16 65.535 RB_PT_PCT_SWC_DWC_CompuMethods_ratio_0p001__2 0.0 65.535 FORMAT "%10.5"
 /begin ANNOTATION ANNOTATION_LABEL "Description (coming from AUTOSAR DESC field)" /begin ANNOTATION_TEXT "Maximum time before valve clean timeout\r\n" /end ANNOTATION_TEXT /end ANNOTATION
/end CHARACTERISTIC
/begin CHARACTERISTIC DWC_CALIB.DWC_K2DeviceControl.DWC_ValveClean.DWC_TIMEVALVERINSERESET "" VALUE 0x8060EF9C DefaultValueRecordLayout_AUTOSAR_Platform_BaseTypes_uint32 4294967.295 RB_PT_PCT_SWC_DWC_CompuMethods_ratio_0p001__2 0.0 4294967.295 FORMAT "%10.5"
 /begin ANNOTATION ANNOTATION_LABEL "Description (coming from AUTOSAR DESC field)" /begin ANNOTATION_TEXT "Maximum time before valve rinse timeout\r\n" /end ANNOTATION_TEXT /end ANNOTATION
/end CHARACTERISTIC
/begin CHARACTERISTIC DWC_CALIB.DWC_L2DBLCLUTCH "" VALUE 0x8060E70A DefaultValueRecordLayout_AUTOSAR_Platform_BaseTypes_uint16 65535.0 RB_PT_PCT_SWC_DWC_CompuMethods_ident 0.0 65535. FORMAT "%10.5"
 /begin ANNOTATION ANNOTATION_LABEL "Description (coming from AUTOSAR DESC field)"
  /begin ANNOTATION_TEXT "Used to trigger double clutch engage use with caution\r\n" /end ANNOTATION_TEXT
 /end ANNOTATION
/end CHARACTERISTIC
/begin CHARACTERISTIC DWC_CALIB.DWC_MaxPaTrqEPBEngaged "" VALUE 0x8060E70E DefaultValueRecordLayout_AUTOSAR_Platform_BaseTypes_sint16 4000.0 RB_PT_PCT_SWC_DWC_CompuMethods_ratio_0p1 -2000. 2000. FORMAT "%10.5"
 /begin ANNOTATION ANNOTATION_LABEL "Description (coming from AUTOSAR DESC field)" /begin ANNOTATION_TEXT "max final pullaway torque when EPB engaged.\r\n" /end ANNOTATION_TEXT /end ANNOTATION
/end CHARACTERISTIC
/begin CHARACTERISTIC DWC_CALIB.DWC_MINCOOLINGREV "" VALUE 0x8060E70C DefaultValueRecordLayout_AUTOSAR_Platform_BaseTypes_uint16 127.5 RB_PT_PCT_SWC_DWC_CompuMethods_flow_0p01 0.0 127.5 FORMAT "%10.5"
 /begin ANNOTATION ANNOTATION_LABEL "Description (coming from AUTOSAR DESC field)" /begin ANNOTATION_TEXT "Min cooling in reverse\r\n" /end ANNOTATION_TEXT /end ANNOTATION
/end CHARACTERISTIC
/begin CHARACTERISTIC DWC_CALIB.DWC_OVERRIDECURRENTFBCHECK "" VALUE 0x8060E735 DefaultValueRecordLayout_AUTOSAR_Platform_BaseTypes_uint8 255.0 DefaultIdenticalCompu 0.0 255. FORMAT "%10.5"
 /begin ANNOTATION ANNOTATION_LABEL "Description (coming from AUTOSAR DESC field)"
  /begin ANNOTATION_TEXT "Flag to override the current feedback checks in thermal model.\r\n" /end ANNOTATION_TEXT
 /end ANNOTATION
/end CHARACTERISTIC
/begin CHARACTERISTIC DWC_CALIB.DWC_P2TORQUEHYST "" VALUE 0x8060E710 DefaultValueRecordLayout_AUTOSAR_Platform_BaseTypes_uint16 2000.0 RB_PT_PCT_SWC_DWC_CompuMethods_ratio_0p1 0.0 2000. FORMAT "%10.5"
 /begin ANNOTATION ANNOTATION_LABEL "Description (coming from AUTOSAR DESC field)" /begin ANNOTATION_TEXT "Torque hysteresis for P2 engine start\r\n" /end ANNOTATION_TEXT /end ANNOTATION
/end CHARACTERISTIC
/begin CHARACTERISTIC DWC_CALIB.DWC_P2TORQUEOFFSET "" VALUE 0x8060E712 DefaultValueRecordLayout_AUTOSAR_Platform_BaseTypes_uint16 2000.0 RB_PT_PCT_SWC_DWC_CompuMethods_ratio_0p1 0.0 2000. FORMAT "%10.5"
 /begin ANNOTATION ANNOTATION_LABEL "Description (coming from AUTOSAR DESC field)"
  /begin ANNOTATION_TEXT "Torque offset to target torque for declaring clutch torque is OK for P2 engine start\r\n" /end ANNOTATION_TEXT
 /end ANNOTATION
/end CHARACTERISTIC
/begin CHARACTERISTIC DWC_CALIB.DWC_SpeedPhaseControl.DWC_GradientProfiler.DWC_ENDBLENDMAPSELECT "" VAL_BLK 0x8060F2F4 DefaultValueRecordLayout_AUTOSAR_Platform_BaseTypes_uint8 3.0 RB_PT_PCT_SWC_DWC_CompuMethods_ident 0.0 3. FORMAT "%10.5"
 /begin ANNOTATION ANNOTATION_LABEL "Description (coming from AUTOSAR DESC field)"
  /begin ANNOTATION_TEXT "Transfer function to map shiftmodeudisc to end blend map.\r\n" /end ANNOTATION_TEXT
 /end ANNOTATION
 MATRIX_DIM 8 1 1 /end CHARACTERISTIC
/begin CHARACTERISTIC DWC_CALIB.DWC_SpeedPhaseControl.DWC_MaxGradient.DWC_CURTGTFORDWNGRAD "" VALUE 0x8060F2FC DefaultValueRecordLayout_AUTOSAR_Platform_BaseTypes_boolean 255.0 AUTOSAR_Platform_CompuMethods_boolean 0.0 255. FORMAT "%10.5"
 /begin ANNOTATION ANNOTATION_LABEL "Description (coming from AUTOSAR DESC field)"
  /begin ANNOTATION_TEXT "Flag to use the current gear target for gradient calculation of power on down.\r\n" /end ANNOTATION_TEXT
 /end ANNOTATION
/end CHARACTERISTIC
/begin CHARACTERISTIC DWC_CALIB.DWC_SpeedPhaseControl.DWC_MaxGradient.DWC_DISABLEKICKDOWNMAPS "" VALUE 0x8060F2FD DefaultValueRecordLayout_AUTOSAR_Platform_BaseTypes_boolean 255.0 AUTOSAR_Platform_CompuMethods_boolean 0.0 255. FORMAT "%10.5"
 /begin ANNOTATION ANNOTATION_LABEL "Description (coming from AUTOSAR DESC field)" /begin ANNOTATION_TEXT "Flag to disable the kickdown specific gradient maps.\r\n" /end ANNOTATION_TEXT /end ANNOTATION
/end CHARACTERISTIC
/begin CHARACTERISTIC DWC_CALIB.DWC_TEMPMAXVALVECLEAN "" VALUE 0x8060E714 DefaultValueRecordLayout_AUTOSAR_Platform_BaseTypes_sint16 250.0 RB_PT_PCT_SWC_DWC_CompuMethods_ident -50. 200. FORMAT "%10.5"
 /begin ANNOTATION ANNOTATION_LABEL "Description (coming from AUTOSAR DESC field)" /begin ANNOTATION_TEXT "Maximum temperature to allow valve clean\r\n" /end ANNOTATION_TEXT /end ANNOTATION
/end CHARACTERISTIC
/begin CHARACTERISTIC DWC_CALIB.DWC_TEMPMAXVALVERINSE "" VALUE 0x8060E716 DefaultValueRecordLayout_AUTOSAR_Platform_BaseTypes_sint16 250.0 RB_PT_PCT_SWC_DWC_CompuMethods_ident -50. 200. FORMAT "%10.5"
 /begin ANNOTATION ANNOTATION_LABEL "Description (coming from AUTOSAR DESC field)" /begin ANNOTATION_TEXT "Maximum temperature to allow valve rinse\r\n" /end ANNOTATION_TEXT /end ANNOTATION
/end CHARACTERISTIC
/begin CHARACTERISTIC DWC_CALIB.DWC_TEMPMINVALVECLEAN "" VALUE 0x8060E718 DefaultValueRecordLayout_AUTOSAR_Platform_BaseTypes_sint16 250.0 RB_PT_PCT_SWC_DWC_CompuMethods_ident -50. 200. FORMAT "%10.5"
 /begin ANNOTATION ANNOTATION_LABEL "Description (coming from AUTOSAR DESC field)" /begin ANNOTATION_TEXT "Minimum temperature to allow valve clean\r\n" /end ANNOTATION_TEXT /end ANNOTATION
/end CHARACTERISTIC
/begin CHARACTERISTIC DWC_CALIB.DWC_TEMPMINVALVERINSE "" VALUE 0x8060E71A DefaultValueRecordLayout_AUTOSAR_Platform_BaseTypes_sint16 250.0 RB_PT_PCT_SWC_DWC_CompuMethods_ident -50. 200. FORMAT "%10.5"
 /begin ANNOTATION ANNOTATION_LABEL "Description (coming from AUTOSAR DESC field)" /begin ANNOTATION_TEXT "Minimum temperature to allow valve rinse\r\n" /end ANNOTATION_TEXT /end ANNOTATION
/end CHARACTERISTIC
/begin CHARACTERISTIC DWC_CALIB.DWC_TF_TEMPWARNINGOFFSET "" CURVE 0x8061001E RB_PT_PCT_SWC_DWC_RecordLayouts_RL_Curve_sint16_5_sint16_5 250.0 RB_PT_PCT_SWC_DWC_CompuMethods_ratio_0p05 -50. 200. FORMAT "%10.5"
 /begin ANNOTATION ANNOTATION_LABEL "Description (coming from AUTOSAR DESC field)"
  /begin ANNOTATION_TEXT "Temperature offset from max clutch temperature where driver is warned\r\n" /end ANNOTATION_TEXT
 /end ANNOTATION
 /begin AXIS_DESCR STD_AXIS NO_INPUT_QUANTITY RB_PT_PCT_SWC_DWC_CompuMethods_ratio_0p1 5 -1000. 2000. FORMAT "%10.5" DEPOSIT ABSOLUTE /end AXIS_DESCR
/end CHARACTERISTIC
/begin CHARACTERISTIC DWC_CALIB.DWC_TorqueControl.DWC_ALTARBUSEABSSLIP "" VALUE 0x8060F35C DefaultValueRecordLayout_AUTOSAR_Platform_BaseTypes_boolean 255.0 AUTOSAR_Platform_CompuMethods_boolean 0.0 255. FORMAT "%10.5"
 /begin ANNOTATION ANNOTATION_LABEL "Description (coming from AUTOSAR DESC field)" /begin ANNOTATION_TEXT "Flag to use absolute slip for alt arb trigger.\r\n" /end ANNOTATION_TEXT /end ANNOTATION
/end CHARACTERISTIC
/begin CHARACTERISTIC DWC_CALIB.DWC_TorqueControl.DWC_CLAMPTEENGTQROLLOFF "" VALUE 0x8060F35D DefaultValueRecordLayout_AUTOSAR_Platform_BaseTypes_boolean 255.0 AUTOSAR_Platform_CompuMethods_boolean 0.0 255. FORMAT "%10.5"
 /begin ANNOTATION ANNOTATION_LABEL "Description (coming from AUTOSAR DESC field)"
  /begin ANNOTATION_TEXT "Flag to clamp the TEEngine Torque estimate during roll off.\r\n" /end ANNOTATION_TEXT
 /end ANNOTATION
/end CHARACTERISTIC
/begin CHARACTERISTIC DWC_CALIB.DWC_TorqueControl.DWC_CLUTCHTORQUEP2MODE "" VALUE 0x8060F33C DefaultValueRecordLayout_AUTOSAR_Platform_BaseTypes_sint16 4000.0 RB_PT_PCT_SWC_DWC_CompuMethods_ratio_0p1 -2000. 2000. FORMAT "%10.5"
 /begin ANNOTATION ANNOTATION_LABEL "Description (coming from AUTOSAR DESC field)"
  /begin ANNOTATION_TEXT "Clutch torque capacity to request when in P2 mode with clutch closed\r\n" /end ANNOTATION_TEXT
 /end ANNOTATION
/end CHARACTERISTIC
/begin CHARACTERISTIC DWC_CALIB.DWC_TorqueControl.DWC_CLUTCHTORQUEP2MODERAMP "" CURVE 0x8060F3F6 RB_PT_PCT_SWC_DWC_RecordLayouts_RL_Curve_sint16_4_uint16_4 4000.0 RB_PT_PCT_SWC_DWC_CompuMethods_ratio_0p1 -2000. 2000. FORMAT "%10.5"
 /begin ANNOTATION ANNOTATION_LABEL "Description (coming from AUTOSAR DESC field)" /begin ANNOTATION_TEXT "Map of ramp rate vs slip\r\n" /end ANNOTATION_TEXT /end ANNOTATION
 /begin AXIS_DESCR STD_AXIS NO_INPUT_QUANTITY RB_PT_PCT_SWC_DWC_CompuMethods_ident 4 0.0 20000. FORMAT "%10.5" DEPOSIT ABSOLUTE /end AXIS_DESCR
/end CHARACTERISTIC
/begin CHARACTERISTIC DWC_CALIB.DWC_TorqueControl.DWC_DISABLEOFFGOINGTQINCASGASSIST "" VALUE 0x8060F35E DefaultValueRecordLayout_AUTOSAR_Platform_BaseTypes_boolean 255.0 AUTOSAR_Platform_CompuMethods_boolean 0.0 255. FORMAT "%10.5"
 /begin ANNOTATION ANNOTATION_LABEL "Description (coming from AUTOSAR DESC field)"
  /begin ANNOTATION_TEXT "Flag to disable offgoing torque increase when ASG assist shift is triggered.\r\n" /end ANNOTATION_TEXT
 /end ANNOTATION
/end CHARACTERISTIC
/begin CHARACTERISTIC DWC_CALIB.DWC_TorqueControl.DWC_DRIVEMODETOPULLAWAYTYPE "" VAL_BLK 0x8060F318 DefaultValueRecordLayout_AUTOSAR_Platform_BaseTypes_uint8 2.0 RB_PT_PCT_SWC_DWC_CompuMethods_ident 0.0 2. FORMAT "%10.5"
 /begin ANNOTATION ANNOTATION_LABEL "Description (coming from AUTOSAR DESC field)"
  /begin ANNOTATION_TEXT "Array to arbitrate between drive mode type and pullaway maps.\r\n" /end ANNOTATION_TEXT
 /end ANNOTATION
 MATRIX_DIM 15 1 1 /end CHARACTERISTIC
/begin CHARACTERISTIC DWC_CALIB.DWC_TorqueControl.DWC_ENABLECHECKFROMSLIPTOSPEED "" VALUE 0x8060F35F DefaultValueRecordLayout_AUTOSAR_Platform_BaseTypes_boolean 255.0 AUTOSAR_Platform_CompuMethods_boolean 0.0 255. FORMAT "%10.5"
 /begin ANNOTATION ANNOTATION_LABEL "Description (coming from AUTOSAR DESC field)"
  /begin ANNOTATION_TEXT "Flag to enable check when moving from slip to speed control, for bumpless transfer.\r\n" /end ANNOTATION_TEXT
 /end ANNOTATION
/end CHARACTERISTIC
/begin CHARACTERISTIC DWC_CALIB.DWC_TorqueControl.DWC_ENABLEGTSHIFTS "" VAL_BLK 0x8060F328 DefaultValueRecordLayout_AUTOSAR_Platform_BaseTypes_uint16 20000.0 RB_PT_PCT_SWC_DWC_CompuMethods_ident 0.0 20000. FORMAT "%10.5"
 /begin ANNOTATION ANNOTATION_LABEL "Description (coming from AUTOSAR DESC field)"
  /begin ANNOTATION_TEXT "Enable GT shifts above engine speed for each shift mode.\r\n" /end ANNOTATION_TEXT
 /end ANNOTATION
 MATRIX_DIM 8 1 1 /end CHARACTERISTIC
/begin CHARACTERISTIC DWC_CALIB.DWC_TorqueControl.DWC_ENABLESPCARBALT "" VALUE 0x8060F360 DefaultValueRecordLayout_AUTOSAR_Platform_BaseTypes_uint8 255.0 RB_PT_PCT_SWC_DWC_CompuMethods_ident 0.0 255. FORMAT "%10.5"
 /begin ANNOTATION ANNOTATION_LABEL "Description (coming from AUTOSAR DESC field)" /begin ANNOTATION_TEXT "Enable the SPC arbitrator in tip out or slip closed.\r\n" /end ANNOTATION_TEXT /end ANNOTATION
/end CHARACTERISTIC
/begin CHARACTERISTIC DWC_CALIB.DWC_TorqueControl.DWC_ENABLESPCARBPAAC "" VALUE 0x8060F361 DefaultValueRecordLayout_AUTOSAR_Platform_BaseTypes_uint8 255.0 RB_PT_PCT_SWC_DWC_CompuMethods_ident 0.0 255. FORMAT "%10.5"
 /begin ANNOTATION ANNOTATION_LABEL "Description (coming from AUTOSAR DESC field)"
  /begin ANNOTATION_TEXT "Enable the SPC arbitrator when in auto close condition.\r\n" /end ANNOTATION_TEXT
 /end ANNOTATION
/end CHARACTERISTIC
/begin CHARACTERISTIC DWC_CALIB.DWC_TorqueControl.DWC_ENGINESPEEDDELAYCYCLES "" VALUE 0x8060F362 DefaultValueRecordLayout_AUTOSAR_Platform_BaseTypes_uint8 28.0 RB_PT_PCT_SWC_DWC_CompuMethods_ident 0.0 28. FORMAT "%10.5"
 /begin ANNOTATION ANNOTATION_LABEL "Description (coming from AUTOSAR DESC field)" /begin ANNOTATION_TEXT "Number of cycles to delay input 1 speed.\r\n" /end ANNOTATION_TEXT /end ANNOTATION
/end CHARACTERISTIC
/begin CHARACTERISTIC DWC_CALIB.DWC_TorqueControl.DWC_FLGDISABLEASGCHECK4CURTQINPUT "" VALUE 0x8060F363 DefaultValueRecordLayout_AUTOSAR_Platform_BaseTypes_boolean 255.0 AUTOSAR_Platform_CompuMethods_boolean 0.0 255. FORMAT "%10.5"
 /begin ANNOTATION ANNOTATION_LABEL "Description (coming from AUTOSAR DESC field)"
  /begin ANNOTATION_TEXT "Flag to disable check on ASG Shift for current torque input.\r\n" /end ANNOTATION_TEXT
 /end ANNOTATION
/end CHARACTERISTIC
/begin CHARACTERISTIC DWC_CALIB.DWC_TorqueControl.DWC_FLGDONTUSEPATRGTRST "" VALUE 0x8060F364 DefaultValueRecordLayout_AUTOSAR_Platform_BaseTypes_boolean 255.0 AUTOSAR_Platform_CompuMethods_boolean 0.0 255. FORMAT "%10.5"
 /begin ANNOTATION ANNOTATION_LABEL "Description (coming from AUTOSAR DESC field)"
  /begin ANNOTATION_TEXT "Flag to block use of PaTargetSpeedRawP in speed reset.\r\n" /end ANNOTATION_TEXT
 /end ANNOTATION
/end CHARACTERISTIC
/begin CHARACTERISTIC DWC_CALIB.DWC_TorqueControl.DWC_FLGENABLEPAALTMAPS "" VALUE 0x8060F365 DefaultValueRecordLayout_AUTOSAR_Platform_BaseTypes_boolean 255.0 AUTOSAR_Platform_CompuMethods_boolean 0.0 255. FORMAT "%10.5"
 /begin ANNOTATION ANNOTATION_LABEL "Description (coming from AUTOSAR DESC field)" /begin ANNOTATION_TEXT "Set true to enable PA alternative mode maps\r\n" /end ANNOTATION_TEXT /end ANNOTATION
/end CHARACTERISTIC
/begin CHARACTERISTIC DWC_CALIB.DWC_TorqueControl.DWC_FLGENABLEPAZEROMAPS "" VALUE 0x8060F366 DefaultValueRecordLayout_AUTOSAR_Platform_BaseTypes_boolean 255.0 AUTOSAR_Platform_CompuMethods_boolean 0.0 255. FORMAT "%10.5"
 /begin ANNOTATION ANNOTATION_LABEL "Description (coming from AUTOSAR DESC field)" /begin ANNOTATION_TEXT "Set true to enable PA zero mode maps\r\n" /end ANNOTATION_TEXT /end ANNOTATION
/end CHARACTERISTIC
/begin CHARACTERISTIC DWC_CALIB.DWC_TorqueControl.DWC_FLGENABLETQ2PRESADAPTION "" VALUE 0x8060F367 DefaultValueRecordLayout_AUTOSAR_Platform_BaseTypes_boolean 255.0 AUTOSAR_Platform_CompuMethods_boolean 0.0 255. FORMAT "%10.5"
 /begin ANNOTATION ANNOTATION_LABEL "Description (coming from AUTOSAR DESC field)" /begin ANNOTATION_TEXT "Set true to enable torque to pressure adaption\r\n" /end ANNOTATION_TEXT /end ANNOTATION
/end CHARACTERISTIC
/begin CHARACTERISTIC DWC_CALIB.DWC_TorqueControl.DWC_FLGRESETITERMCRP "" VALUE 0x8060F368 DefaultValueRecordLayout_AUTOSAR_Platform_BaseTypes_boolean 255.0 AUTOSAR_Platform_CompuMethods_boolean 0.0 255. FORMAT "%10.5"
 /begin ANNOTATION ANNOTATION_LABEL "Description (coming from AUTOSAR DESC field)" /begin ANNOTATION_TEXT "Reset I term based on CRP reset.\r\n" /end ANNOTATION_TEXT /end ANNOTATION
/end CHARACTERISTIC
/begin CHARACTERISTIC DWC_CALIB.DWC_TorqueControl.DWC_MAXPEDALFORSPCENABLE "" VALUE 0x8060F369 DefaultValueRecordLayout_AUTOSAR_Platform_BaseTypes_uint8 102.0 RB_PT_PCT_SWC_DWC_CompuMethods_ratio_0p4 0.0 102. FORMAT "%10.5"
 /begin ANNOTATION ANNOTATION_LABEL "Description (coming from AUTOSAR DESC field)"
  /begin ANNOTATION_TEXT "Maximum throttle pedal that SPC arbitrator can be enabled early.\r\n" /end ANNOTATION_TEXT
 /end ANNOTATION
/end CHARACTERISTIC
/begin CHARACTERISTIC DWC_CALIB.DWC_TorqueControl.DWC_MINGEARLOWSPDFASTFILLPWRDOWN "" VALUE 0x8060F36A DefaultValueRecordLayout_AUTOSAR_Platform_BaseTypes_uint8 11.0 RB_PT_PCT_SWC_DWC_CompuMethods_ident 0.0 11. FORMAT "%10.5"
 /begin ANNOTATION ANNOTATION_LABEL "Description (coming from AUTOSAR DESC field)"
  /begin ANNOTATION_TEXT "Minimum gear to allow a fast fill below setpoint speed during a power on down.\r\n" /end ANNOTATION_TEXT
 /end ANNOTATION
/end CHARACTERISTIC
/begin CHARACTERISTIC DWC_CALIB.DWC_TorqueControl.DWC_MINSPEEDFORASGBYPASS "" VALUE 0x8060F33E DefaultValueRecordLayout_AUTOSAR_Platform_BaseTypes_sint16 40000.0 RB_PT_PCT_SWC_DWC_CompuMethods_ident -20000. 20000. FORMAT "%10.5"
 /begin ANNOTATION ANNOTATION_LABEL "Description (coming from AUTOSAR DESC field)" /begin ANNOTATION_TEXT "Minimum output speed to allow fast fill.\r\n" /end ANNOTATION_TEXT /end ANNOTATION
/end CHARACTERISTIC
/begin CHARACTERISTIC DWC_CALIB.DWC_TorqueControl.DWC_MINTEMPPWRDWNFASTFILLBELOWSETPOINT "" VALUE 0x8060F340 DefaultValueRecordLayout_AUTOSAR_Platform_BaseTypes_sint16 250.0 RB_PT_PCT_SWC_DWC_CompuMethods_ident -50. 200. FORMAT "%10.5"
 /begin ANNOTATION ANNOTATION_LABEL "Description (coming from AUTOSAR DESC field)"
  /begin ANNOTATION_TEXT "Minimum temperature to allow the fast fill for power on down below pa set point.\r\n" /end ANNOTATION_TEXT
 /end ANNOTATION
/end CHARACTERISTIC
/begin CHARACTERISTIC DWC_CALIB.DWC_TorqueControl.DWC_OFFSETITERMLIMTHRESHFORPAAC "" VALUE 0x8060F36B DefaultValueRecordLayout_AUTOSAR_Platform_BaseTypes_boolean 255.0 AUTOSAR_Platform_CompuMethods_boolean 0.0 255. FORMAT "%10.5"
 /begin ANNOTATION ANNOTATION_LABEL "Description (coming from AUTOSAR DESC field)" /begin ANNOTATION_TEXT "Offset the threshold for iterm limit for PAAC.\r\n" /end ANNOTATION_TEXT /end ANNOTATION
/end CHARACTERISTIC
/begin CHARACTERISTIC DWC_CALIB.DWC_TorqueControl.DWC_PAAARBITRATORGEAROFFSET "" VAL_BLK 0x8060F300 DefaultValueRecordLayout_AUTOSAR_Platform_BaseTypes_sint16 40000.0 RB_PT_PCT_SWC_DWC_CompuMethods_ident -20000. 20000. FORMAT "%10.5"
 /begin ANNOTATION ANNOTATION_LABEL "Description (coming from AUTOSAR DESC field)" /begin ANNOTATION_TEXT "Offset to apply to DWC_PAClutchMustOpen vs Gear\r\n" /end ANNOTATION_TEXT /end ANNOTATION
 MATRIX_DIM 12 1 1 /end CHARACTERISTIC
/begin CHARACTERISTIC DWC_CALIB.DWC_TorqueControl.DWC_PAACARBITERMLIM "" VALUE 0x8060F338 DefaultValueRecordLayout_AUTOSAR_Platform_BaseTypes_sint32 4000.0 RB_PT_PCT_SWC_DWC_CompuMethods_ratio_0p0001 -2000. 2000. FORMAT "%10.5"
 /begin ANNOTATION ANNOTATION_LABEL "Description (coming from AUTOSAR DESC field)" /begin ANNOTATION_TEXT "Iterm limit to enable SLC ARB check\r\n" /end ANNOTATION_TEXT /end ANNOTATION
/end CHARACTERISTIC
/begin CHARACTERISTIC DWC_CALIB.DWC_TorqueControl.DWC_PAACARBUPPEROFFSET "" VALUE 0x8060F342 DefaultValueRecordLayout_AUTOSAR_Platform_BaseTypes_sint16 40000.0 RB_PT_PCT_SWC_DWC_CompuMethods_ident -20000. 20000. FORMAT "%10.5"
 /begin ANNOTATION ANNOTATION_LABEL "Description (coming from AUTOSAR DESC field)"
  /begin ANNOTATION_TEXT "Offset to PA arbitration upper to reenable SPC arb in PAAC.\r\n" /end ANNOTATION_TEXT
 /end ANNOTATION
/end CHARACTERISTIC
/begin CHARACTERISTIC DWC_CALIB.DWC_TorqueControl.DWC_PAACDRVLNGRDENABLE "" VALUE 0x8060F344 DefaultValueRecordLayout_AUTOSAR_Platform_BaseTypes_sint16 2000.0 RB_PT_PCT_SWC_DWC_CompuMethods_ident -1000. 1000. FORMAT "%10.5"
 /begin ANNOTATION ANNOTATION_LABEL "Description (coming from AUTOSAR DESC field)"
  /begin ANNOTATION_TEXT "Driveline gradient threshold for paac. To prevent enabling on rollout.\r\n" /end ANNOTATION_TEXT
 /end ANNOTATION
/end CHARACTERISTIC
/begin CHARACTERISTIC DWC_CALIB.DWC_TorqueControl.DWC_PAACITERMLIMOFFSET "" VALUE 0x8060F346 DefaultValueRecordLayout_AUTOSAR_Platform_BaseTypes_sint16 40000.0 RB_PT_PCT_SWC_DWC_CompuMethods_ident -20000. 20000. FORMAT "%10.5"
 /begin ANNOTATION ANNOTATION_LABEL "Description (coming from AUTOSAR DESC field)" /begin ANNOTATION_TEXT "Offset i term limit threshold to idle for PAAC\r\n" /end ANNOTATION_TEXT /end ANNOTATION
/end CHARACTERISTIC
/begin CHARACTERISTIC DWC_CALIB.DWC_TorqueControl.DWC_PAACUSEMINOFENGandACTIVEINPUT "" VALUE 0x8060F36C DefaultValueRecordLayout_AUTOSAR_Platform_BaseTypes_boolean 255.0 AUTOSAR_Platform_CompuMethods_boolean 0.0 255. FORMAT "%10.5" /end CHARACTERISTIC
/begin CHARACTERISTIC DWC_CALIB.DWC_TorqueControl.DWC_PAACUSEMINOFENGandCURTQINP "" VALUE 0x8060F36D DefaultValueRecordLayout_AUTOSAR_Platform_BaseTypes_boolean 255.0 AUTOSAR_Platform_CompuMethods_boolean 0.0 255. FORMAT "%10.5" /end CHARACTERISTIC
/begin CHARACTERISTIC DWC_CALIB.DWC_TorqueControl.DWC_PAEARLYARBFNLTGTSPDOFFSET "" VALUE 0x8060F348 DefaultValueRecordLayout_AUTOSAR_Platform_BaseTypes_uint16 20000.0 RB_PT_PCT_SWC_DWC_CompuMethods_ident 0.0 20000. FORMAT "%10.5"
 /begin ANNOTATION ANNOTATION_LABEL "Description (coming from AUTOSAR DESC field)" /begin ANNOTATION_TEXT "Offset for final target speed to early arb check.\r\n" /end ANNOTATION_TEXT /end ANNOTATION
/end CHARACTERISTIC
/begin CHARACTERISTIC DWC_CALIB.DWC_TorqueControl.DWC_PAEARLYARBSLIPTHRESH "" VALUE 0x8060F36E DefaultValueRecordLayout_AUTOSAR_Platform_BaseTypes_uint8 255.0 RB_PT_PCT_SWC_DWC_CompuMethods_ident 0.0 255. FORMAT "%10.5"
 /begin ANNOTATION ANNOTATION_LABEL "Description (coming from AUTOSAR DESC field)" /begin ANNOTATION_TEXT "Slip threshold for early ARB enable.\r\n" /end ANNOTATION_TEXT /end ANNOTATION
/end CHARACTERISTIC
/begin CHARACTERISTIC DWC_CALIB.DWC_TorqueControl.DWC_PALAUNCHMAXOFFSET "" MAP 0x8060F408 RB_PT_PCT_SWC_DWC_RecordLayouts_RL_Map_sint16_100_sint16_10_sint16_10 4000.0 RB_PT_PCT_SWC_DWC_CompuMethods_ratio_0p1 -2000. 2000. FORMAT "%10.5"
 /begin ANNOTATION ANNOTATION_LABEL "Description (coming from AUTOSAR DESC field)"
  /begin ANNOTATION_TEXT "Instant torque offset for launch x- rate of change of engine speed y- engine speed error ref setpoint pullaway speed.\r\n" /end ANNOTATION_TEXT
 /end ANNOTATION
 /begin AXIS_DESCR STD_AXIS NO_INPUT_QUANTITY RB_PT_PCT_SWC_DWC_CompuMethods_ident 10 -32000. 32000. FORMAT "%10.5" DEPOSIT ABSOLUTE /end AXIS_DESCR
 /begin AXIS_DESCR STD_AXIS NO_INPUT_QUANTITY RB_PT_PCT_SWC_DWC_CompuMethods_ident 10 -20000. 20000. FORMAT "%10.5" DEPOSIT ABSOLUTE /end AXIS_DESCR
/end CHARACTERISTIC
/begin CHARACTERISTIC DWC_CALIB.DWC_TorqueControl.DWC_PAOFFBRAKETHRESH "" VALUE 0x8060F34A DefaultValueRecordLayout_AUTOSAR_Platform_BaseTypes_uint16 409.5 RB_PT_PCT_SWC_DWC_CompuMethods_ratio_0p1 0.0 409.5 FORMAT "%10.5"
 /begin ANNOTATION ANNOTATION_LABEL "Description (coming from AUTOSAR DESC field)"
  /begin ANNOTATION_TEXT "brake pressure to detemine if the driver is OFF the brake.\r\n" /end ANNOTATION_TEXT
 /end ANNOTATION
/end CHARACTERISTIC
/begin CHARACTERISTIC DWC_CALIB.DWC_TorqueControl.DWC_PAPullawaySequencer.DWC_ALWAYSLOWERTQSYNCFLAG "" VALUE 0x8060F372 DefaultValueRecordLayout_AUTOSAR_Platform_BaseTypes_boolean 255.0 AUTOSAR_Platform_CompuMethods_boolean 0.0 255. FORMAT "%10.5"
 /begin ANNOTATION ANNOTATION_LABEL "Description (coming from AUTOSAR DESC field)" /begin ANNOTATION_TEXT "Flag to lower torque sync after one cycle.\r\n" /end ANNOTATION_TEXT /end ANNOTATION
/end CHARACTERISTIC
/begin CHARACTERISTIC DWC_CALIB.DWC_TorqueControl.DWC_PAPullawaySequencer.DWC_ENTERPASACTIVEwSEQCURTQGR "" VALUE 0x8060F373 DefaultValueRecordLayout_AUTOSAR_Platform_BaseTypes_boolean 255.0 AUTOSAR_Platform_CompuMethods_boolean 0.0 255. FORMAT "%10.5"
 /begin ANNOTATION ANNOTATION_LABEL "Description (coming from AUTOSAR DESC field)"
  /begin ANNOTATION_TEXT "Flag to enter pullaway active based on current torque gear.\r\n" /end ANNOTATION_TEXT
 /end ANNOTATION
/end CHARACTERISTIC
/begin CHARACTERISTIC DWC_CALIB.DWC_TorqueControl.DWC_PAPullawaySequencer.DWC_FLGBYPASSACCPEDPLW2PWTSYNC "" VALUE 0x8060F374 DefaultValueRecordLayout_AUTOSAR_Platform_BaseTypes_boolean 255.0 AUTOSAR_Platform_CompuMethods_boolean 0.0 255. FORMAT "%10.5"
 /begin ANNOTATION ANNOTATION_LABEL "Description (coming from AUTOSAR DESC field)"
  /begin ANNOTATION_TEXT "Flag to bypass accelerator pedal pressed check from pullaway sync to powertrain sync transition\r\n" /end ANNOTATION_TEXT
 /end ANNOTATION
/end CHARACTERISTIC
/begin CHARACTERISTIC DWC_CALIB.DWC_TorqueControl.DWC_PASPERROR4MAXTQOFFSET "" VALUE 0x8060F34C DefaultValueRecordLayout_AUTOSAR_Platform_BaseTypes_sint16 40000.0 RB_PT_PCT_SWC_DWC_CompuMethods_ident -20000. 20000. FORMAT "%10.5"
 /begin ANNOTATION ANNOTATION_LABEL "Description (coming from AUTOSAR DESC field)"
  /begin ANNOTATION_TEXT "Time the driver has to be off the brake to allow max torque offset applied during launch\r\n" /end ANNOTATION_TEXT
 /end ANNOTATION
/end CHARACTERISTIC
/begin CHARACTERISTIC DWC_CALIB.DWC_TorqueControl.DWC_PASTATE2NOTENABLEPAACTIVE "" VALUE 0x8060F36F DefaultValueRecordLayout_AUTOSAR_Platform_BaseTypes_uint8 8.0 RB_PT_PCT_SWC_DWC_CompuMethods_Enumerations_DWC_PAStates 0.0 8. FORMAT "%10.5"
 /begin ANNOTATION ANNOTATION_LABEL "Description (coming from AUTOSAR DESC field)" /begin ANNOTATION_TEXT "pullaway state not to force pullaway flag\r\n" /end ANNOTATION_TEXT /end ANNOTATION
/end CHARACTERISTIC
/begin CHARACTERISTIC DWC_CALIB.DWC_TorqueControl.DWC_PATMOFFBRK4MAXTQOFFSET "" VALUE 0x8060F34E DefaultValueRecordLayout_AUTOSAR_Platform_BaseTypes_uint16 10.0 RB_PT_PCT_SWC_DWC_CompuMethods_ratio_0p001__2 0.0 10. FORMAT "%10.5"
 /begin ANNOTATION ANNOTATION_LABEL "Description (coming from AUTOSAR DESC field)"
  /begin ANNOTATION_TEXT "Time the driver has to be off the brake to allow max torque offset applied during launch\r\n" /end ANNOTATION_TEXT
 /end ANNOTATION
/end CHARACTERISTIC
/begin CHARACTERISTIC DWC_CALIB.DWC_TorqueControl.DWC_PRESWENGSPDCATHEAT "" VALUE 0x8060F350 DefaultValueRecordLayout_AUTOSAR_Platform_BaseTypes_uint16 20000.0 RB_PT_PCT_SWC_DWC_CompuMethods_ident 0.0 20000. FORMAT "%10.5"
 /begin ANNOTATION ANNOTATION_LABEL "Description (coming from AUTOSAR DESC field)"
  /begin ANNOTATION_TEXT "Max engine speed to trigger start of slipping wheels.\r\n" /end ANNOTATION_TEXT
 /end ANNOTATION
/end CHARACTERISTIC
/begin CHARACTERISTIC DWC_CALIB.DWC_TorqueControl.DWC_PWRONDOWNACTIVEINPUTTEMPTHRESH "" VALUE 0x8060F352 DefaultValueRecordLayout_AUTOSAR_Platform_BaseTypes_sint16 250.0 RB_PT_PCT_SWC_DWC_CompuMethods_ident -50. 200. FORMAT "%10.5"
 /begin ANNOTATION ANNOTATION_LABEL "Description (coming from AUTOSAR DESC field)"
  /begin ANNOTATION_TEXT "Temperature below which to use active input if gear is not engaged.\r\n" /end ANNOTATION_TEXT
 /end ANNOTATION
/end CHARACTERISTIC
/begin CHARACTERISTIC DWC_CALIB.DWC_TorqueControl.DWC_SLCMinTorqueManager.DWC_SLCLATACC4LOCKUP "" VALUE 0x8060F376 DefaultValueRecordLayout_AUTOSAR_Platform_BaseTypes_sint8 2.54 RB_PT_PCT_SWC_DWC_CompuMethods_ratio_0p01 -1.27 1.27 FORMAT "%10.5"
 /begin ANNOTATION ANNOTATION_LABEL "Description (coming from AUTOSAR DESC field)" /begin ANNOTATION_TEXT "min latt acc to force clutch lockup\r\n" /end ANNOTATION_TEXT /end ANNOTATION
/end CHARACTERISTIC
/begin CHARACTERISTIC DWC_CALIB.DWC_TorqueControl.DWC_SLIPTARGETFORCRANKPULSE "" VALUE 0x8060F354 DefaultValueRecordLayout_AUTOSAR_Platform_BaseTypes_sint16 40000.0 RB_PT_PCT_SWC_DWC_CompuMethods_ident -20000. 20000. FORMAT "%10.5"
 /begin ANNOTATION ANNOTATION_LABEL "Description (coming from AUTOSAR DESC field)"
  /begin ANNOTATION_TEXT "Slip threshold to allow bypass pulse during cranking.\r\n" /end ANNOTATION_TEXT
 /end ANNOTATION
/end CHARACTERISTIC
/begin CHARACTERISTIC DWC_CALIB.DWC_TorqueControl.DWC_SSDISABLEASTIME "" VALUE 0x8060F356 DefaultValueRecordLayout_AUTOSAR_Platform_BaseTypes_uint16 10.0 RB_PT_PCT_SWC_DWC_CompuMethods_ratio_0p001__2 0.0 10. FORMAT "%10.5"
 /begin ANNOTATION ANNOTATION_LABEL "Description (coming from AUTOSAR DESC field)" /begin ANNOTATION_TEXT "Time of engine stop to disable antistall\r\n" /end ANNOTATION_TEXT /end ANNOTATION
/end CHARACTERISTIC
/begin CHARACTERISTIC DWC_CALIB.DWC_TorqueControl.DWC_TIMENGRUNFORPOSTCRANKPULSE "" VALUE 0x8060F358 DefaultValueRecordLayout_AUTOSAR_Platform_BaseTypes_uint16 10.0 RB_PT_PCT_SWC_DWC_CompuMethods_ratio_0p001__2 0.0 10. FORMAT "%10.5"
 /begin ANNOTATION ANNOTATION_LABEL "Description (coming from AUTOSAR DESC field)"
  /begin ANNOTATION_TEXT "Time engine running to allow normal ASG bypass logic.\r\n" /end ANNOTATION_TEXT
 /end ANNOTATION
/end CHARACTERISTIC
/begin CHARACTERISTIC DWC_CALIB.DWC_TorqueControl.DWC_TorquePhaseTorque.DWC_FLGINTERPCOMINGFACTORFORMANEST "" VALUE 0x8060F378 DefaultValueRecordLayout_AUTOSAR_Platform_BaseTypes_boolean 255.0 AUTOSAR_Platform_CompuMethods_boolean 0.0 255. FORMAT "%10.5"
 /begin ANNOTATION ANNOTATION_LABEL "Description (coming from AUTOSAR DESC field)"
  /begin ANNOTATION_TEXT "Flag to enable the interpolation of the high and low coming factor tables for correcting the max fill torque input to bypass pulse map.\r\n" /end ANNOTATION_TEXT
 /end ANNOTATION
/end CHARACTERISTIC
/begin CHARACTERISTIC DWC_CALIB.DWC_TorqueControl.DWC_TorquePhaseTorque.DWC_TPGOINGDELAYTRQMAP "" MAP 0x8060F37A RB_PT_PCT_SWC_DWC_RecordLayouts_RL_Map_sint16_49_uint16_7_sint8_7 3.0 RB_PT_PCT_SWC_DWC_CompuMethods_ratio_0p001__2 -1. 2. FORMAT "%10.5"
 /begin ANNOTATION ANNOTATION_LABEL "Description (coming from AUTOSAR DESC field)"
  /begin ANNOTATION_TEXT "Hold torque level for going clutch during GT style shift\r\n" /end ANNOTATION_TEXT
 /end ANNOTATION
 /begin AXIS_DESCR STD_AXIS NO_INPUT_QUANTITY RB_PT_PCT_SWC_DWC_CompuMethods_ratio_0p1 7 0.0 2000. FORMAT "%10.5" DEPOSIT ABSOLUTE /end AXIS_DESCR
 /begin AXIS_DESCR STD_AXIS NO_INPUT_QUANTITY RB_PT_PCT_SWC_DWC_CompuMethods_ratio_0p01 7 -1. 1. FORMAT "%10.5" DEPOSIT ABSOLUTE /end AXIS_DESCR
/end CHARACTERISTIC
/begin CHARACTERISTIC DWC_CALIB.DWC_TorqueControl.DWC_UPSHIFTTYPETQCHECKID "" VALUE 0x8060F370 DefaultValueRecordLayout_AUTOSAR_Platform_BaseTypes_uint8 2.0 RB_PT_PCT_SWC_DWC_CompuMethods_ident 0.0 2. FORMAT "%10.5"
 /begin ANNOTATION ANNOTATION_LABEL "Description (coming from AUTOSAR DESC field)"
  /begin ANNOTATION_TEXT "ID to configure which torque check to use for power on/off decision.\r\n" /end ANNOTATION_TEXT
 /end ANNOTATION
/end CHARACTERISTIC
/begin CHARACTERISTIC DWC_CALIB.DWC_TorqueControl.DWC_USETQFB4POWERCALC "" VALUE 0x8060F371 DefaultValueRecordLayout_AUTOSAR_Platform_BaseTypes_uint8 255.0 DefaultIdenticalCompu 0.0 255. FORMAT "%10.5"
 /begin ANNOTATION ANNOTATION_LABEL "Description (coming from AUTOSAR DESC field)"
  /begin ANNOTATION_TEXT "Flag to enable max of torque demand and torque FB into slip power calculation.\r\n" /end ANNOTATION_TEXT
 /end ANNOTATION
/end CHARACTERISTIC
/begin CHARACTERISTIC DWC_CALIB.DWC_TorqueControl.DWC_WSCSetTorque "" VALUE 0x8060F35A DefaultValueRecordLayout_AUTOSAR_Platform_BaseTypes_sint16 4000.0 RB_PT_PCT_SWC_DWC_CompuMethods_ratio_0p1 -2000. 2000. FORMAT "%10.5"
 /begin ANNOTATION ANNOTATION_LABEL "Description (coming from AUTOSAR DESC field)"
  /begin ANNOTATION_TEXT "Set reference torque used for the WSC, above this torque provides the window in which the WSC p term can operate.\r\n" /end ANNOTATION_TEXT
 /end ANNOTATION
/end CHARACTERISTIC
/begin CHARACTERISTIC DWC_CALIB.DWC_TorqueDragLossRateLimit.DWC_TF_TORQUERATELIMITDOWN "" CURVE 0x8060F4FC RB_PT_PCT_SWC_DWC_RecordLayouts_RL_Curve_uint16_6_sint16_6 655.34 RB_PT_PCT_SWC_DWC_CompuMethods_ratio_0p01 0.01 655.35 FORMAT "%10.5"
 /begin ANNOTATION ANNOTATION_LABEL "Description (coming from AUTOSAR DESC field)" /begin ANNOTATION_TEXT "Rate of change limit for output\r\n" /end ANNOTATION_TEXT /end ANNOTATION
 /begin AXIS_DESCR STD_AXIS NO_INPUT_QUANTITY RB_PT_PCT_SWC_DWC_CompuMethods_ident 6 -50. 200. FORMAT "%10.5" DEPOSIT ABSOLUTE /end AXIS_DESCR
/end CHARACTERISTIC
/begin CHARACTERISTIC DWC_CALIB.DWC_TorqueDragLossRateLimit.DWC_TF_TORQUERATELIMITUP "" CURVE 0x8060F516 RB_PT_PCT_SWC_DWC_RecordLayouts_RL_Curve_uint16_6_sint16_6 655.34 RB_PT_PCT_SWC_DWC_CompuMethods_ratio_0p01 0.01 655.35 FORMAT "%10.5"
 /begin ANNOTATION ANNOTATION_LABEL "Description (coming from AUTOSAR DESC field)" /begin ANNOTATION_TEXT "Rate of change limit for output\r\n" /end ANNOTATION_TEXT /end ANNOTATION
 /begin AXIS_DESCR STD_AXIS NO_INPUT_QUANTITY RB_PT_PCT_SWC_DWC_CompuMethods_ident 6 -50. 200. FORMAT "%10.5" DEPOSIT ABSOLUTE /end AXIS_DESCR
/end CHARACTERISTIC
/begin CHARACTERISTIC DWC_CALIB.DWC_TorqueParasiticLossRateLimit.DWC_TF_TORQUERATELIMITDOWN "" CURVE 0x8060F530 RB_PT_PCT_SWC_DWC_RecordLayouts_RL_Curve_uint16_6_sint16_6 655.34 RB_PT_PCT_SWC_DWC_CompuMethods_ratio_0p01 0.01 655.35 FORMAT "%10.5"
 /begin ANNOTATION ANNOTATION_LABEL "Description (coming from AUTOSAR DESC field)" /begin ANNOTATION_TEXT "Rate of change limit for output\r\n" /end ANNOTATION_TEXT /end ANNOTATION
 /begin AXIS_DESCR STD_AXIS NO_INPUT_QUANTITY RB_PT_PCT_SWC_DWC_CompuMethods_ident 6 -50. 200. FORMAT "%10.5" DEPOSIT ABSOLUTE /end AXIS_DESCR
/end CHARACTERISTIC
/begin CHARACTERISTIC DWC_CALIB.DWC_TorqueParasiticLossRateLimit.DWC_TF_TORQUERATELIMITUP "" CURVE 0x8060F54A RB_PT_PCT_SWC_DWC_RecordLayouts_RL_Curve_uint16_6_sint16_6 655.34 RB_PT_PCT_SWC_DWC_CompuMethods_ratio_0p01 0.01 655.35 FORMAT "%10.5"
 /begin ANNOTATION ANNOTATION_LABEL "Description (coming from AUTOSAR DESC field)" /begin ANNOTATION_TEXT "Rate of change limit for output\r\n" /end ANNOTATION_TEXT /end ANNOTATION
 /begin AXIS_DESCR STD_AXIS NO_INPUT_QUANTITY RB_PT_PCT_SWC_DWC_CompuMethods_ident 6 -50. 200. FORMAT "%10.5" DEPOSIT ABSOLUTE /end AXIS_DESCR
/end CHARACTERISTIC
/begin CHARACTERISTIC DWC_CALIB.DWC_TransmissionLosses.DWC_CURRENTINGEARLOSSES "" CURVE 0x8060F568 RB_PT_PCT_SWC_DWC_RecordLayouts_RL_Curve_uint16_10_uint8_10 5.0 RB_PT_PCT_SWC_DWC_CompuMethods_Ratio_0p001 0.0 5. FORMAT "%10.5"
 /begin ANNOTATION ANNOTATION_LABEL "Description (coming from AUTOSAR DESC field)" /begin ANNOTATION_TEXT "Factor for different losses in each gear selected\r\n" /end ANNOTATION_TEXT /end ANNOTATION
 /begin AXIS_DESCR STD_AXIS NO_INPUT_QUANTITY RB_PT_PCT_SWC_DWC_CompuMethods_ident 10 0.0 254. FORMAT "%10.5" DEPOSIT ABSOLUTE /end AXIS_DESCR
/end CHARACTERISTIC
/begin CHARACTERISTIC DWC_CALIB.DWC_TransmissionLosses.DWC_DRAGLOSSVLVCLSD "" MAP 0x8060F588 RB_PT_PCT_SWC_DWC_RecordLayouts_RL_Map_sint16_70_uint16_10_sint16_7 4000.0 RB_PT_PCT_SWC_DWC_CompuMethods_ratio_0p1 -2000. 2000. FORMAT "%10.5"
 /begin ANNOTATION ANNOTATION_LABEL "Description (coming from AUTOSAR DESC field)"
  /begin ANNOTATION_TEXT "Transmission loss as a function of engine speed and temperature when the flow valves are closed\r\n" /end ANNOTATION_TEXT
 /end ANNOTATION
 /begin AXIS_DESCR STD_AXIS NO_INPUT_QUANTITY RB_PT_PCT_SWC_DWC_CompuMethods_ident 10 0.0 20000. FORMAT "%10.5" DEPOSIT ABSOLUTE /end AXIS_DESCR
 /begin AXIS_DESCR STD_AXIS NO_INPUT_QUANTITY RB_PT_PCT_SWC_DWC_CompuMethods_ident 7 -50. 200. FORMAT "%10.5" DEPOSIT ABSOLUTE /end AXIS_DESCR
/end CHARACTERISTIC
/begin CHARACTERISTIC DWC_CALIB.DWC_TransmissionLosses.DWC_DRAGLOSSVLVOPEN "" MAP 0x8060F63A RB_PT_PCT_SWC_DWC_RecordLayouts_RL_Map_sint16_70_uint16_10_sint16_7 4000.0 RB_PT_PCT_SWC_DWC_CompuMethods_ratio_0p1 -2000. 2000. FORMAT "%10.5"
 /begin ANNOTATION ANNOTATION_LABEL "Description (coming from AUTOSAR DESC field)"
  /begin ANNOTATION_TEXT "Transmission loss as a function of engine speed and temperature when the flow valves are Open\r\n" /end ANNOTATION_TEXT
 /end ANNOTATION
 /begin AXIS_DESCR STD_AXIS NO_INPUT_QUANTITY RB_PT_PCT_SWC_DWC_CompuMethods_ident 10 0.0 20000. FORMAT "%10.5" DEPOSIT ABSOLUTE /end AXIS_DESCR
 /begin AXIS_DESCR STD_AXIS NO_INPUT_QUANTITY RB_PT_PCT_SWC_DWC_CompuMethods_ident 7 -50. 200. FORMAT "%10.5" DEPOSIT ABSOLUTE /end AXIS_DESCR
/end CHARACTERISTIC
/begin CHARACTERISTIC DWC_CALIB.DWC_TransmissionLosses.DWC_FLGADDPUMPDRAGTOPARASITICLOSS "" VALUE 0x8060F564 DefaultValueRecordLayout_AUTOSAR_Platform_BaseTypes_uint8 255.0 DefaultIdenticalCompu 0.0 255. FORMAT "%10.5"
 /begin ANNOTATION ANNOTATION_LABEL "Description (coming from AUTOSAR DESC field)" /begin ANNOTATION_TEXT "remove pump loss from parastitic loss calculations\r\n" /end ANNOTATION_TEXT /end ANNOTATION
/end CHARACTERISTIC
/begin CHARACTERISTIC DWC_CALIB.DWC_TransmissionLosses.DWC_FLGREMOVEPUMPDRAGFROMPARASITICLOSS "" VALUE 0x8060F565 DefaultValueRecordLayout_AUTOSAR_Platform_BaseTypes_uint8 255.0 DefaultIdenticalCompu 0.0 255. FORMAT "%10.5"
 /begin ANNOTATION ANNOTATION_LABEL "Description (coming from AUTOSAR DESC field)" /begin ANNOTATION_TEXT "remove pump loss from parastitic loss calculations\r\n" /end ANNOTATION_TEXT /end ANNOTATION
/end CHARACTERISTIC
/begin CHARACTERISTIC DWC_CALIB.DWC_TransmissionLosses.DWC_FLGUSENEGTORQUEPARASITICLOSS "" VALUE 0x8060F566 DefaultValueRecordLayout_AUTOSAR_Platform_BaseTypes_uint8 255.0 DefaultIdenticalCompu 0.0 255. FORMAT "%10.5"
 /begin ANNOTATION ANNOTATION_LABEL "Description (coming from AUTOSAR DESC field)" /begin ANNOTATION_TEXT "Use negative torque in parastitic loss calculations\r\n" /end ANNOTATION_TEXT /end ANNOTATION
/end CHARACTERISTIC
/begin CHARACTERISTIC DWC_CALIB.DWC_TransmissionLosses.DWC_FLGUSETORQUEDEADBANDPARASITIC "" VALUE 0x8060F567 DefaultValueRecordLayout_AUTOSAR_Platform_BaseTypes_uint8 255.0 DefaultIdenticalCompu 0.0 255. FORMAT "%10.5"
 /begin ANNOTATION ANNOTATION_LABEL "Description (coming from AUTOSAR DESC field)" /begin ANNOTATION_TEXT "Use negative torque in parastitic loss calculations\r\n" /end ANNOTATION_TEXT /end ANNOTATION
/end CHARACTERISTIC
/begin CHARACTERISTIC DWC_CALIB.DWC_TransmissionLosses.DWC_PRESSUREDELTACORRECTIONK1 "" MAP 0x8060F6EC RB_PT_PCT_SWC_DWC_RecordLayouts_RL_Map_uint16_18_sint16_6_sint16_3 1.0 RB_PT_PCT_SWC_DWC_CompuMethods_ratio_0p001__2 0.0 1. FORMAT "%10.5"
 /begin ANNOTATION ANNOTATION_LABEL "Description (coming from AUTOSAR DESC field)" /begin ANNOTATION_TEXT "Correction for temperature and pressure delta to KP\r\n" /end ANNOTATION_TEXT /end ANNOTATION
 /begin AXIS_DESCR STD_AXIS NO_INPUT_QUANTITY RB_PT_PCT_SWC_DWC_CompuMethods_ident 6 -50. 200. FORMAT "%10.5" DEPOSIT ABSOLUTE /end AXIS_DESCR
 /begin AXIS_DESCR STD_AXIS NO_INPUT_QUANTITY RB_PT_PCT_SWC_DWC_CompuMethods_ratio_0p001__2 3 -2. 32. FORMAT "%10.5" DEPOSIT ABSOLUTE /end AXIS_DESCR
/end CHARACTERISTIC
/begin CHARACTERISTIC DWC_CALIB.DWC_TransmissionLosses.DWC_PRESSUREDELTACORRECTIONK2 "" MAP 0x8060F726 RB_PT_PCT_SWC_DWC_RecordLayouts_RL_Map_uint16_18_sint16_6_sint16_3 1.0 RB_PT_PCT_SWC_DWC_CompuMethods_ratio_0p001__2 0.0 1. FORMAT "%10.5"
 /begin ANNOTATION ANNOTATION_LABEL "Description (coming from AUTOSAR DESC field)" /begin ANNOTATION_TEXT "Correction for temperature and pressure delta to KP\r\n" /end ANNOTATION_TEXT /end ANNOTATION
 /begin AXIS_DESCR STD_AXIS NO_INPUT_QUANTITY RB_PT_PCT_SWC_DWC_CompuMethods_ident 6 -50. 200. FORMAT "%10.5" DEPOSIT ABSOLUTE /end AXIS_DESCR
 /begin AXIS_DESCR STD_AXIS NO_INPUT_QUANTITY RB_PT_PCT_SWC_DWC_CompuMethods_ratio_0p001__2 3 -2. 32. FORMAT "%10.5" DEPOSIT ABSOLUTE /end AXIS_DESCR
/end CHARACTERISTIC
/begin CHARACTERISTIC DWC_CALIB.DWC_TransmissionLosses.DWC_PUMPLOSSVLVCLSD "" MAP 0x8060F760 RB_PT_PCT_SWC_DWC_RecordLayouts_RL_Map_sint16_70_uint16_10_sint16_7 4000.0 RB_PT_PCT_SWC_DWC_CompuMethods_ratio_0p1 -2000. 2000. FORMAT "%10.5"
 /begin ANNOTATION ANNOTATION_LABEL "Description (coming from AUTOSAR DESC field)"
  /begin ANNOTATION_TEXT "Transmission loss as a function of engine speed and temperature when the flow valves are closed\r\n" /end ANNOTATION_TEXT
 /end ANNOTATION
 /begin AXIS_DESCR STD_AXIS NO_INPUT_QUANTITY RB_PT_PCT_SWC_DWC_CompuMethods_ident 10 0.0 20000. FORMAT "%10.5" DEPOSIT ABSOLUTE /end AXIS_DESCR
 /begin AXIS_DESCR STD_AXIS NO_INPUT_QUANTITY RB_PT_PCT_SWC_DWC_CompuMethods_ident 7 -50. 200. FORMAT "%10.5" DEPOSIT ABSOLUTE /end AXIS_DESCR
/end CHARACTERISTIC
/begin CHARACTERISTIC DWC_CALIB.DWC_TransmissionLosses.DWC_PUMPLOSSVLVOPEN "" MAP 0x8060F812 RB_PT_PCT_SWC_DWC_RecordLayouts_RL_Map_sint16_70_uint16_10_sint16_7 4000.0 RB_PT_PCT_SWC_DWC_CompuMethods_ratio_0p1 -2000. 2000. FORMAT "%10.5"
 /begin ANNOTATION ANNOTATION_LABEL "Description (coming from AUTOSAR DESC field)"
  /begin ANNOTATION_TEXT "Transmission loss as a function of engine speed and temperature when the flow valves are Open\r\n" /end ANNOTATION_TEXT
 /end ANNOTATION
 /begin AXIS_DESCR STD_AXIS NO_INPUT_QUANTITY RB_PT_PCT_SWC_DWC_CompuMethods_ident 10 0.0 20000. FORMAT "%10.5" DEPOSIT ABSOLUTE /end AXIS_DESCR
 /begin AXIS_DESCR STD_AXIS NO_INPUT_QUANTITY RB_PT_PCT_SWC_DWC_CompuMethods_ident 7 -50. 200. FORMAT "%10.5" DEPOSIT ABSOLUTE /end AXIS_DESCR
/end CHARACTERISTIC
/begin CHARACTERISTIC DWC_CALIB.DWC_TransmissionLosses.DWC_TORQUEPARASITICLOSSHIGHTEMP "" MAP 0x8060F8C4 RB_PT_PCT_SWC_DWC_RecordLayouts_RL_Map_uint16_42_uint16_6_sint16_7 2000.0 RB_PT_PCT_SWC_DWC_CompuMethods_ratio_0p1 0.0 2000. FORMAT "%10.5"
 /begin ANNOTATION ANNOTATION_LABEL "Description (coming from AUTOSAR DESC field)"
  /begin ANNOTATION_TEXT "Transmission loss as a function of engine speed and temperature when the flow valves are closed\r\n" /end ANNOTATION_TEXT
 /end ANNOTATION
 /begin AXIS_DESCR STD_AXIS NO_INPUT_QUANTITY RB_PT_PCT_SWC_DWC_CompuMethods_ident 6 0.0 20000. FORMAT "%10.5" DEPOSIT ABSOLUTE /end AXIS_DESCR
 /begin AXIS_DESCR STD_AXIS NO_INPUT_QUANTITY RB_PT_PCT_SWC_DWC_CompuMethods_ratio_0p1 7 -2000. 2000. FORMAT "%10.5" DEPOSIT ABSOLUTE /end AXIS_DESCR
/end CHARACTERISTIC
/begin CHARACTERISTIC DWC_CALIB.DWC_TransmissionLosses.DWC_TORQUEPARASITICLOSSLOWTEMP "" MAP 0x8060F936 RB_PT_PCT_SWC_DWC_RecordLayouts_RL_Map_uint16_42_uint16_6_sint16_7 2000.0 RB_PT_PCT_SWC_DWC_CompuMethods_ratio_0p1 0.0 2000. FORMAT "%10.5"
 /begin ANNOTATION ANNOTATION_LABEL "Description (coming from AUTOSAR DESC field)"
  /begin ANNOTATION_TEXT "Transmission loss as a function of engine speed and temperature when the flow valves are closed\r\n" /end ANNOTATION_TEXT
 /end ANNOTATION
 /begin AXIS_DESCR STD_AXIS NO_INPUT_QUANTITY RB_PT_PCT_SWC_DWC_CompuMethods_ident 6 0.0 20000. FORMAT "%10.5" DEPOSIT ABSOLUTE /end AXIS_DESCR
 /begin AXIS_DESCR STD_AXIS NO_INPUT_QUANTITY RB_PT_PCT_SWC_DWC_CompuMethods_ratio_0p1 7 -2000. 2000. FORMAT "%10.5" DEPOSIT ABSOLUTE /end AXIS_DESCR
/end CHARACTERISTIC
/begin CHARACTERISTIC DWC_CALIB.DWC_TransmissionLosses.DWC_TORQUEPARASITICLOSSMEDTEMP "" MAP 0x8060F9A8 RB_PT_PCT_SWC_DWC_RecordLayouts_RL_Map_uint16_42_uint16_6_sint16_7 2000.0 RB_PT_PCT_SWC_DWC_CompuMethods_ratio_0p1 0.0 2000. FORMAT "%10.5"
 /begin ANNOTATION ANNOTATION_LABEL "Description (coming from AUTOSAR DESC field)"
  /begin ANNOTATION_TEXT "Transmission loss as a function of engine speed and temperature when the flow valves are closed\r\n" /end ANNOTATION_TEXT
 /end ANNOTATION
 /begin AXIS_DESCR STD_AXIS NO_INPUT_QUANTITY RB_PT_PCT_SWC_DWC_CompuMethods_ident 6 0.0 20000. FORMAT "%10.5" DEPOSIT ABSOLUTE /end AXIS_DESCR
 /begin AXIS_DESCR STD_AXIS NO_INPUT_QUANTITY RB_PT_PCT_SWC_DWC_CompuMethods_ratio_0p1 7 -2000. 2000. FORMAT "%10.5" DEPOSIT ABSOLUTE /end AXIS_DESCR
/end CHARACTERISTIC
/begin CHARACTERISTIC DWC_CALIB.DWC_TransmissionLosses.DWC_VISCOUSSPEEDCORRECTIONK1 "" MAP 0x8060FA1A RB_PT_PCT_SWC_DWC_RecordLayouts_RL_Map_uint16_18_uint16_3_sint16_6 10.0 RB_PT_PCT_SWC_DWC_CompuMethods_ratio_0p001__2 0.0 10. FORMAT "%10.5"
 /begin ANNOTATION ANNOTATION_LABEL "Description (coming from AUTOSAR DESC field)" /begin ANNOTATION_TEXT "Correction for temperature and input speed\r\n" /end ANNOTATION_TEXT /end ANNOTATION
 /begin AXIS_DESCR STD_AXIS NO_INPUT_QUANTITY RB_PT_PCT_SWC_DWC_CompuMethods_ident 3 0.0 20000. FORMAT "%10.5" DEPOSIT ABSOLUTE /end AXIS_DESCR
 /begin AXIS_DESCR STD_AXIS NO_INPUT_QUANTITY RB_PT_PCT_SWC_DWC_CompuMethods_ident 6 -50. 200. FORMAT "%10.5" DEPOSIT ABSOLUTE /end AXIS_DESCR
/end CHARACTERISTIC
/begin CHARACTERISTIC DWC_CALIB.DWC_TransmissionLosses.DWC_VISCOUSSPEEDCORRECTIONK2 "" MAP 0x8060FA54 RB_PT_PCT_SWC_DWC_RecordLayouts_RL_Map_uint16_18_uint16_3_sint16_6 10.0 RB_PT_PCT_SWC_DWC_CompuMethods_ratio_0p001__2 0.0 10. FORMAT "%10.5"
 /begin ANNOTATION ANNOTATION_LABEL "Description (coming from AUTOSAR DESC field)" /begin ANNOTATION_TEXT "Correction for temperature and input speed\r\n" /end ANNOTATION_TEXT /end ANNOTATION
 /begin AXIS_DESCR STD_AXIS NO_INPUT_QUANTITY RB_PT_PCT_SWC_DWC_CompuMethods_ident 3 0.0 20000. FORMAT "%10.5" DEPOSIT ABSOLUTE /end AXIS_DESCR
 /begin AXIS_DESCR STD_AXIS NO_INPUT_QUANTITY RB_PT_PCT_SWC_DWC_CompuMethods_ident 6 -50. 200. FORMAT "%10.5" DEPOSIT ABSOLUTE /end AXIS_DESCR
/end CHARACTERISTIC
/begin CHARACTERISTIC DWC_CALIB.DWC_USEFLGIONOTREADY "" VALUE 0x8060E736 DefaultValueRecordLayout_AUTOSAR_Platform_BaseTypes_boolean 255.0 AUTOSAR_Platform_CompuMethods_boolean 0.0 255. FORMAT "%10.5"
 /begin ANNOTATION ANNOTATION_LABEL "Description (coming from AUTOSAR DESC field)" /begin ANNOTATION_TEXT "Flag to enable IO not ready check\r\n" /end ANNOTATION_TEXT /end ANNOTATION
/end CHARACTERISTIC
/begin CHARACTERISTIC DWC_CALIB.DWC_ValveCleanLite.DWC_MAXCLEANCURRENT "" VALUE 0x8060FA8E DefaultValueRecordLayout_AUTOSAR_Platform_BaseTypes_uint16 5000.0 RB_PT_PCT_SWC_DWC_CompuMethods_ident 0.0 5000. FORMAT "%10.5"
 /begin ANNOTATION ANNOTATION_LABEL "Description (coming from AUTOSAR DESC field)" /begin ANNOTATION_TEXT "Maximum current during clean\r\n" /end ANNOTATION_TEXT /end ANNOTATION
/end CHARACTERISTIC
/begin CHARACTERISTIC DWC_CALIB.DWC_ValveCleanLite.DWC_MINCLEANCURRENT "" VALUE 0x8060FA90 DefaultValueRecordLayout_AUTOSAR_Platform_BaseTypes_uint16 5000.0 RB_PT_PCT_SWC_DWC_CompuMethods_ident 0.0 5000. FORMAT "%10.5"
 /begin ANNOTATION ANNOTATION_LABEL "Description (coming from AUTOSAR DESC field)" /begin ANNOTATION_TEXT "Minimum current during clean\r\n" /end ANNOTATION_TEXT /end ANNOTATION
/end CHARACTERISTIC
/begin CHARACTERISTIC DWC_CALIB.DWC_ValveCleanLite.DWC_TF_FCTRROUTINECLEANCURRENT "" CURVE 0x8060FA96 RB_PT_PCT_SWC_DWC_RecordLayouts_RL_Curve_uint16_11_uint16_11 1.0 RB_PT_PCT_SWC_DWC_CompuMethods_Ratio_0p001 0.0 1. FORMAT "%10.5"
 /begin ANNOTATION ANNOTATION_LABEL "Description (coming from AUTOSAR DESC field)" /begin ANNOTATION_TEXT "Depressure current as a function of time\r\n" /end ANNOTATION_TEXT /end ANNOTATION
 /begin AXIS_DESCR STD_AXIS NO_INPUT_QUANTITY RB_PT_PCT_SWC_DWC_CompuMethods_DST_Time 11 0.0 655.35 FORMAT "%10.5" DEPOSIT ABSOLUTE /end AXIS_DESCR
/end CHARACTERISTIC
/begin CHARACTERISTIC DWC_CALIB.DWC_ValveCleanLite.DWC_TIMEVALVEROUTINECLEAN "" VALUE 0x8060FA92 DefaultValueRecordLayout_AUTOSAR_Platform_BaseTypes_uint16 327.675 RB_PT_PCT_SWC_DWC_CompuMethods_time_0p005 0.0 327.675 FORMAT "%10.5"
 /begin ANNOTATION ANNOTATION_LABEL "Description (coming from AUTOSAR DESC field)" /begin ANNOTATION_TEXT "Maximum time before valve clean timeout\r\n" /end ANNOTATION_TEXT /end ANNOTATION
/end CHARACTERISTIC
/begin CHARACTERISTIC DWC_CALIB.DWC_ValveCleanLite.DWC_TIMEWAITFORDECOUPLE "" VALUE 0x8060FA94 DefaultValueRecordLayout_AUTOSAR_Platform_BaseTypes_uint16 327.675 RB_PT_PCT_SWC_DWC_CompuMethods_time_0p005 0.0 327.675 FORMAT "%10.5"
 /begin ANNOTATION ANNOTATION_LABEL "Description (coming from AUTOSAR DESC field)" /begin ANNOTATION_TEXT "Maximum time to wait for decouple\r\n" /end ANNOTATION_TEXT /end ANNOTATION
/end CHARACTERISTIC
/begin CHARACTERISTIC DWC_CALIB.DWC_ValveRinse.DWC_PCTVALVERINSEEARLYCOMPLETE "" VALUE 0x8060FACC DefaultValueRecordLayout_AUTOSAR_Platform_BaseTypes_uint8 1.0 RB_PT_PCT_SWC_DWC_CompuMethods_ratio_0p01 0.0 1. FORMAT "%10.5"
 /begin ANNOTATION ANNOTATION_LABEL "Description (coming from AUTOSAR DESC field)"
  /begin ANNOTATION_TEXT "Percentage of full rinse time where an early abortion still leads to a timeout condition\r\n" /end ANNOTATION_TEXT
 /end ANNOTATION
/end CHARACTERISTIC
/begin CHARACTERISTIC DWC_CALIB.DWC_ValveRinse.DWC_TIMEVALVEPRERINSE "" VALUE 0x8060FAC8 DefaultValueRecordLayout_AUTOSAR_Platform_BaseTypes_uint16 65.535 RB_PT_PCT_SWC_DWC_CompuMethods_ratio_0p001__2 0.0 65.535 FORMAT "%10.5"
 /begin ANNOTATION ANNOTATION_LABEL "Description (coming from AUTOSAR DESC field)" /begin ANNOTATION_TEXT "Maximum time before valve clean timeout\r\n" /end ANNOTATION_TEXT /end ANNOTATION
/end CHARACTERISTIC
/begin CHARACTERISTIC DWC_CALIB.DWC_ValveRinse.DWC_TIMEVALVERINSE "" VALUE 0x8060FACA DefaultValueRecordLayout_AUTOSAR_Platform_BaseTypes_uint16 65.535 RB_PT_PCT_SWC_DWC_CompuMethods_ratio_0p001__2 0.0 65.535 FORMAT "%10.5"
 /begin ANNOTATION ANNOTATION_LABEL "Description (coming from AUTOSAR DESC field)" /begin ANNOTATION_TEXT "Maximum time before valve clean timeout\r\n" /end ANNOTATION_TEXT /end ANNOTATION
/end CHARACTERISTIC
/begin CHARACTERISTIC DWC_CALIB.DWC_ValveRinse.DWC_TIMEVALVERINSERESET "" VALUE 0x8060FAC4 DefaultValueRecordLayout_AUTOSAR_Platform_BaseTypes_uint32 36000.0 RB_PT_PCT_SWC_DWC_CompuMethods_ratio_0p001__2 0.0 36000. FORMAT "%10.5"
 /begin ANNOTATION ANNOTATION_LABEL "Description (coming from AUTOSAR DESC field)" /begin ANNOTATION_TEXT "Maximum time before valve rinse timeout\r\n" /end ANNOTATION_TEXT /end ANNOTATION
/end CHARACTERISTIC
/begin CHARACTERISTIC DWC_CALIB.DWM_ThermalModel_BW.DWC_BOBCOOLINGFLOW "" VALUE 0x8060FAD8 DefaultValueRecordLayout_AUTOSAR_Platform_BaseTypes_uint16 127.5 RB_PT_PCT_SWC_DWC_CompuMethods_flow_0p01 0.0 127.5 FORMAT "%10.5"
 /begin ANNOTATION ANNOTATION_LABEL "Description (coming from AUTOSAR DESC field)" /begin ANNOTATION_TEXT "Cooling flow manual override value.\r\n" /end ANNOTATION_TEXT /end ANNOTATION
/end CHARACTERISTIC
/begin CHARACTERISTIC DWC_CALIB.DWM_ThermalModel_BW.DWC_BOBCOOLINGTEMP "" VALUE 0x8060FADA DefaultValueRecordLayout_AUTOSAR_Platform_BaseTypes_sint16 250.0 RB_PT_PCT_SWC_DWC_CompuMethods_ident -50. 200. FORMAT "%10.5"
 /begin ANNOTATION ANNOTATION_LABEL "Description (coming from AUTOSAR DESC field)" /begin ANNOTATION_TEXT "Cooling temp manual override value.\r\n" /end ANNOTATION_TEXT /end ANNOTATION
/end CHARACTERISTIC
/begin CHARACTERISTIC DWC_CALIB.DWM_ThermalModel_BW.DWC_BOBCOOLINGTEMPSTATUS "" VALUE 0x8060FAEA DefaultValueRecordLayout_AUTOSAR_Platform_BaseTypes_boolean 255.0 AUTOSAR_Platform_CompuMethods_boolean 0.0 255. FORMAT "%10.5"
 /begin ANNOTATION ANNOTATION_LABEL "Description (coming from AUTOSAR DESC field)" /begin ANNOTATION_TEXT "Cooling temp status manual override value.\r\n" /end ANNOTATION_TEXT /end ANNOTATION
/end CHARACTERISTIC
/begin CHARACTERISTIC DWC_CALIB.DWM_ThermalModel_BW.DWC_BOBCUTCOOLING "" VALUE 0x8060FAEB DefaultValueRecordLayout_AUTOSAR_Platform_BaseTypes_uint8 255.0 DefaultIdenticalCompu 0.0 255. FORMAT "%10.5"
 /begin ANNOTATION ANNOTATION_LABEL "Description (coming from AUTOSAR DESC field)" /begin ANNOTATION_TEXT "GAC cut manual override value.\r\n" /end ANNOTATION_TEXT /end ANNOTATION
/end CHARACTERISTIC
/begin CHARACTERISTIC DWC_CALIB.DWM_ThermalModel_BW.DWC_BOBENGINESPEED "" VALUE 0x8060FADC DefaultValueRecordLayout_AUTOSAR_Platform_BaseTypes_uint16 20000.0 RB_PT_PCT_SWC_DWC_CompuMethods_ident 0.0 20000. FORMAT "%10.5"
 /begin ANNOTATION ANNOTATION_LABEL "Description (coming from AUTOSAR DESC field)" /begin ANNOTATION_TEXT "Engine speed manual override value.\r\n" /end ANNOTATION_TEXT /end ANNOTATION
/end CHARACTERISTIC
/begin CHARACTERISTIC DWC_CALIB.DWM_ThermalModel_BW.DWC_BOBGEAR "" VALUE 0x8060FAEC DefaultValueRecordLayout_AUTOSAR_Platform_BaseTypes_uint8 11.0 RB_PT_PCT_SWC_DWC_CompuMethods_ident 0.0 11. FORMAT "%10.5"
 /begin ANNOTATION ANNOTATION_LABEL "Description (coming from AUTOSAR DESC field)" /begin ANNOTATION_TEXT "Engaged gear manual override value.\r\n" /end ANNOTATION_TEXT /end ANNOTATION
/end CHARACTERISTIC
/begin CHARACTERISTIC DWC_CALIB.DWM_ThermalModel_BW.DWC_BOBK1TORQUEFB "" VALUE 0x8060FADE DefaultValueRecordLayout_AUTOSAR_Platform_BaseTypes_sint16 4000.0 RB_PT_PCT_SWC_DWC_CompuMethods_ratio_0p1 -2000. 2000. FORMAT "%10.5"
 /begin ANNOTATION ANNOTATION_LABEL "Description (coming from AUTOSAR DESC field)" /begin ANNOTATION_TEXT "K1 torque capacity estimate bob\r\n" /end ANNOTATION_TEXT /end ANNOTATION
/end CHARACTERISTIC
/begin CHARACTERISTIC DWC_CALIB.DWM_ThermalModel_BW.DWC_BOBK2TORQUEFB "" VALUE 0x8060FAE0 DefaultValueRecordLayout_AUTOSAR_Platform_BaseTypes_sint16 4000.0 RB_PT_PCT_SWC_DWC_CompuMethods_ratio_0p1 -2000. 2000. FORMAT "%10.5"
 /begin ANNOTATION ANNOTATION_LABEL "Description (coming from AUTOSAR DESC field)" /begin ANNOTATION_TEXT "K2 torque capacity estimate bob\r\n" /end ANNOTATION_TEXT /end ANNOTATION
/end CHARACTERISTIC
/begin CHARACTERISTIC DWC_CALIB.DWM_ThermalModel_BW.DWC_BOBKL15 "" VALUE 0x8060FAED DefaultValueRecordLayout_AUTOSAR_Platform_BaseTypes_uint8 255.0 DefaultIdenticalCompu 0.0 255. FORMAT "%10.5"
 /begin ANNOTATION ANNOTATION_LABEL "Description (coming from AUTOSAR DESC field)" /begin ANNOTATION_TEXT "KL15 manual override value.\r\n" /end ANNOTATION_TEXT /end ANNOTATION
/end CHARACTERISTIC
/begin CHARACTERISTIC DWC_CALIB.DWM_ThermalModel_BW.DWC_BOBPASTATE "" VALUE 0x8060FAEE DefaultValueRecordLayout_AUTOSAR_Platform_BaseTypes_uint8 8.0 RB_PT_PCT_SWC_DWC_CompuMethods_Enumerations_DWC_PAStates 0.0 8. FORMAT "%10.5"
 /begin ANNOTATION ANNOTATION_LABEL "Description (coming from AUTOSAR DESC field)" /begin ANNOTATION_TEXT "Pullaway state manual override value.\r\n" /end ANNOTATION_TEXT /end ANNOTATION
/end CHARACTERISTIC
/begin CHARACTERISTIC DWC_CALIB.DWM_ThermalModel_BW.DWC_BOBSHIFTACTIVE "" VALUE 0x8060FAEF DefaultValueRecordLayout_AUTOSAR_Platform_BaseTypes_uint8 255.0 DefaultIdenticalCompu 0.0 255. FORMAT "%10.5"
 /begin ANNOTATION ANNOTATION_LABEL "Description (coming from AUTOSAR DESC field)" /begin ANNOTATION_TEXT "Shift active manual override value.\r\n" /end ANNOTATION_TEXT /end ANNOTATION
/end CHARACTERISTIC
/begin CHARACTERISTIC DWC_CALIB.DWM_ThermalModel_BW.DWC_BOBSLIPPOWERK1 "" VALUE 0x8060FAD0 DefaultValueRecordLayout_AUTOSAR_Platform_BaseTypes_uint32 1000000.0 RB_PT_PCT_SWC_DWC_CompuMethods_ident 0.0 1000000. FORMAT "%10.5"
 /begin ANNOTATION ANNOTATION_LABEL "Description (coming from AUTOSAR DESC field)" /begin ANNOTATION_TEXT "Slip power manual override value.\r\n" /end ANNOTATION_TEXT /end ANNOTATION
/end CHARACTERISTIC
/begin CHARACTERISTIC DWC_CALIB.DWM_ThermalModel_BW.DWC_BOBSLIPPOWERK2 "" VALUE 0x8060FAD4 DefaultValueRecordLayout_AUTOSAR_Platform_BaseTypes_uint32 1000000.0 RB_PT_PCT_SWC_DWC_CompuMethods_ident 0.0 1000000. FORMAT "%10.5"
 /begin ANNOTATION ANNOTATION_LABEL "Description (coming from AUTOSAR DESC field)" /begin ANNOTATION_TEXT "Slip power manual override value.\r\n" /end ANNOTATION_TEXT /end ANNOTATION
/end CHARACTERISTIC
/begin CHARACTERISTIC DWC_CALIB.DWM_ThermalModel_BW.DWC_BOBSUMPTEMP "" VALUE 0x8060FAE2 DefaultValueRecordLayout_AUTOSAR_Platform_BaseTypes_sint16 250.0 RB_PT_PCT_SWC_DWC_CompuMethods_ident -50. 200. FORMAT "%10.5"
 /begin ANNOTATION ANNOTATION_LABEL "Description (coming from AUTOSAR DESC field)" /begin ANNOTATION_TEXT "Sump temp manual override value.\r\n" /end ANNOTATION_TEXT /end ANNOTATION
/end CHARACTERISTIC
/begin CHARACTERISTIC DWC_CALIB.DWM_ThermalModel_BW.DWC_BOBSUMPTEMPSTATUS "" VALUE 0x8060FAF0 DefaultValueRecordLayout_AUTOSAR_Platform_BaseTypes_boolean 255.0 AUTOSAR_Platform_CompuMethods_boolean 0.0 255. FORMAT "%10.5"
 /begin ANNOTATION ANNOTATION_LABEL "Description (coming from AUTOSAR DESC field)" /begin ANNOTATION_TEXT "Sump temp status manual override value.\r\n" /end ANNOTATION_TEXT /end ANNOTATION
/end CHARACTERISTIC
/begin CHARACTERISTIC DWC_CALIB.DWM_ThermalModel_BW.DWC_ClutchCoolingDemand_K1.DWC_BOBCOOLINGTEMP "" VALUE 0x8060FB04 DefaultValueRecordLayout_AUTOSAR_Platform_BaseTypes_sint16 450.0 RB_PT_PCT_SWC_DWC_CompuMethods_temperature_0p1 -50. 400. FORMAT "%10.5"
 /begin ANNOTATION ANNOTATION_LABEL "Description (coming from AUTOSAR DESC field)" /begin ANNOTATION_TEXT "Cooling temp manual override value.\r\n" /end ANNOTATION_TEXT /end ANNOTATION
/end CHARACTERISTIC
/begin CHARACTERISTIC DWC_CALIB.DWM_ThermalModel_BW.DWC_ClutchCoolingDemand_K1.DWC_BOBCUTCOOLING "" VALUE 0x8060FB1A DefaultValueRecordLayout_AUTOSAR_Platform_BaseTypes_boolean 255.0 AUTOSAR_Platform_CompuMethods_boolean 0.0 255. FORMAT "%10.5"
 /begin ANNOTATION ANNOTATION_LABEL "Description (coming from AUTOSAR DESC field)" /begin ANNOTATION_TEXT "GAC cut manual override value.\r\n" /end ANNOTATION_TEXT /end ANNOTATION
/end CHARACTERISTIC
/begin CHARACTERISTIC DWC_CALIB.DWM_ThermalModel_BW.DWC_ClutchCoolingDemand_K1.DWC_BOBENGSPEED "" VALUE 0x8060FB06 DefaultValueRecordLayout_AUTOSAR_Platform_BaseTypes_uint16 20000.0 RB_PT_PCT_SWC_DWC_CompuMethods_ident 0.0 20000. FORMAT "%10.5"
 /begin ANNOTATION ANNOTATION_LABEL "Description (coming from AUTOSAR DESC field)" /begin ANNOTATION_TEXT "Engine speed manual override value.\r\n" /end ANNOTATION_TEXT /end ANNOTATION
/end CHARACTERISTIC
/begin CHARACTERISTIC DWC_CALIB.DWM_ThermalModel_BW.DWC_ClutchCoolingDemand_K1.DWC_BOBGEAR "" VALUE 0x8060FB1B DefaultValueRecordLayout_AUTOSAR_Platform_BaseTypes_uint8 11.0 RB_PT_PCT_SWC_DWC_CompuMethods_ident 0.0 11. FORMAT "%10.5"
 /begin ANNOTATION ANNOTATION_LABEL "Description (coming from AUTOSAR DESC field)" /begin ANNOTATION_TEXT "Gear manual override value.\r\n" /end ANNOTATION_TEXT /end ANNOTATION
/end CHARACTERISTIC
/begin CHARACTERISTIC DWC_CALIB.DWM_ThermalModel_BW.DWC_ClutchCoolingDemand_K1.DWC_BOBINTTEMP "" VALUE 0x8060FB08 DefaultValueRecordLayout_AUTOSAR_Platform_BaseTypes_sint16 450.0 RB_PT_PCT_SWC_DWC_CompuMethods_temperature_0p1 -50. 400. FORMAT "%10.5"
 /begin ANNOTATION ANNOTATION_LABEL "Description (coming from AUTOSAR DESC field)" /begin ANNOTATION_TEXT "Plate temp manual override value.\r\n" /end ANNOTATION_TEXT /end ANNOTATION
/end CHARACTERISTIC
/begin CHARACTERISTIC DWC_CALIB.DWM_ThermalModel_BW.DWC_ClutchCoolingDemand_K1.DWC_BOBPAACTIVE "" VALUE 0x8060FB1C DefaultValueRecordLayout_AUTOSAR_Platform_BaseTypes_boolean 255.0 AUTOSAR_Platform_CompuMethods_boolean 0.0 255. FORMAT "%10.5"
 /begin ANNOTATION ANNOTATION_LABEL "Description (coming from AUTOSAR DESC field)" /begin ANNOTATION_TEXT "Pullaway active flag manual override value.\r\n" /end ANNOTATION_TEXT /end ANNOTATION
/end CHARACTERISTIC
/begin CHARACTERISTIC DWC_CALIB.DWM_ThermalModel_BW.DWC_ClutchCoolingDemand_K1.DWC_BOBSLIPPOWER "" VALUE 0x8060FAFC DefaultValueRecordLayout_AUTOSAR_Platform_BaseTypes_uint32 1000000.0 RB_PT_PCT_SWC_DWC_CompuMethods_ident 0.0 1000000. FORMAT "%10.5"
 /begin ANNOTATION ANNOTATION_LABEL "Description (coming from AUTOSAR DESC field)" /begin ANNOTATION_TEXT "Slip power manual override value.\r\n" /end ANNOTATION_TEXT /end ANNOTATION
/end CHARACTERISTIC
/begin CHARACTERISTIC DWC_CALIB.DWM_ThermalModel_BW.DWC_ClutchCoolingDemand_K1.DWC_CutCoolingMaxTimer.LIB_DT "" VALUE 0x8060FB20 DefaultValueRecordLayout_AUTOSAR_Platform_BaseTypes_uint16 65.535 RB_PT_PCT_SWC_DWC_CompuMethods_ratio_0p001__2 0.0 65.535 FORMAT "%10.5"
 /begin ANNOTATION ANNOTATION_LABEL "Description (coming from AUTOSAR DESC field)" /begin ANNOTATION_TEXT "Timer decrement value.\r\n" /end ANNOTATION_TEXT /end ANNOTATION
/end CHARACTERISTIC
/begin CHARACTERISTIC DWC_CALIB.DWM_ThermalModel_BW.DWC_ClutchCoolingDemand_K1.DWC_FLGBLOCKGACCUTWITHTEMP "" VALUE 0x8060FB1D DefaultValueRecordLayout_AUTOSAR_Platform_BaseTypes_boolean 255.0 AUTOSAR_Platform_CompuMethods_boolean 0.0 255. FORMAT "%10.5"
 /begin ANNOTATION ANNOTATION_LABEL "Description (coming from AUTOSAR DESC field)"
  /begin ANNOTATION_TEXT "Enable logic to block GAC cut based on interface temp or slip power.\r\n" /end ANNOTATION_TEXT
 /end ANNOTATION
/end CHARACTERISTIC
/begin CHARACTERISTIC DWC_CALIB.DWM_ThermalModel_BW.DWC_ClutchCoolingDemand_K1.DWC_FLGBOB "" VALUE 0x8060FB1E DefaultValueRecordLayout_AUTOSAR_Platform_BaseTypes_boolean 255.0 AUTOSAR_Platform_CompuMethods_boolean 0.0 255. FORMAT "%10.5"
 /begin ANNOTATION ANNOTATION_LABEL "Description (coming from AUTOSAR DESC field)" /begin ANNOTATION_TEXT "Bob enable.\r\n" /end ANNOTATION_TEXT /end ANNOTATION
/end CHARACTERISTIC
/begin CHARACTERISTIC DWC_CALIB.DWM_ThermalModel_BW.DWC_ClutchCoolingDemand_K1.DWC_FLGENABNEUTRALCOOLING "" VALUE 0x8060FB1F DefaultValueRecordLayout_AUTOSAR_Platform_BaseTypes_uint8 255.0 DefaultIdenticalCompu 0.0 255. FORMAT "%10.5"
 /begin ANNOTATION ANNOTATION_LABEL "Description (coming from AUTOSAR DESC field)" /begin ANNOTATION_TEXT "Flag to implement neutral cooling fix.\r\n" /end ANNOTATION_TEXT /end ANNOTATION
/end CHARACTERISTIC
/begin CHARACTERISTIC DWC_CALIB.DWM_ThermalModel_BW.DWC_ClutchCoolingDemand_K1.DWC_FLOWPULSEHEIGHT "" VALUE 0x8060FB0A DefaultValueRecordLayout_AUTOSAR_Platform_BaseTypes_uint16 127.5 RB_PT_PCT_SWC_DWC_CompuMethods_flow_0p01 0.0 127.5 FORMAT "%10.5"
 /begin ANNOTATION ANNOTATION_LABEL "Description (coming from AUTOSAR DESC field)"
  /begin ANNOTATION_TEXT "Pulse height to be applied to continuous flow from map\r\n" /end ANNOTATION_TEXT
 /end ANNOTATION
/end CHARACTERISTIC
/begin CHARACTERISTIC DWC_CALIB.DWM_ThermalModel_BW.DWC_ClutchCoolingDemand_K1.DWC_MAXINTERFACETEMPFORGACCUT "" VALUE 0x8060FB0C DefaultValueRecordLayout_AUTOSAR_Platform_BaseTypes_sint16 450.0 RB_PT_PCT_SWC_DWC_CompuMethods_temperature_0p1 -50. 400. FORMAT "%10.5"
 /begin ANNOTATION ANNOTATION_LABEL "Description (coming from AUTOSAR DESC field)"
  /begin ANNOTATION_TEXT "Maximum allowable interface temperature to allow a GAC cut.\r\n" /end ANNOTATION_TEXT
 /end ANNOTATION
/end CHARACTERISTIC
/begin CHARACTERISTIC DWC_CALIB.DWM_ThermalModel_BW.DWC_ClutchCoolingDemand_K1.DWC_MAXSLIPPOWERFORGACCUT "" VALUE 0x8060FB00 DefaultValueRecordLayout_AUTOSAR_Platform_BaseTypes_uint32 1000000.0 RB_PT_PCT_SWC_DWC_CompuMethods_ident 0.0 1000000. FORMAT "%10.5"
 /begin ANNOTATION ANNOTATION_LABEL "Description (coming from AUTOSAR DESC field)"
  /begin ANNOTATION_TEXT "MAximum allowable slip power to allow for a GAC cut request.\r\n" /end ANNOTATION_TEXT
 /end ANNOTATION
/end CHARACTERISTIC
/begin CHARACTERISTIC DWC_CALIB.DWM_ThermalModel_BW.DWC_ClutchCoolingDemand_K1.DWC_MAXSPDFORPNCOOLING "" VALUE 0x8060FB0E DefaultValueRecordLayout_AUTOSAR_Platform_BaseTypes_uint16 500.0 RB_PT_PCT_SWC_DWC_CompuMethods_ratio_0p01 0.0 500. FORMAT "%10.5"
 /begin ANNOTATION ANNOTATION_LABEL "Description (coming from AUTOSAR DESC field)"
  /begin ANNOTATION_TEXT "Maximum vehicle speed for park/neutral cooling request\r\n" /end ANNOTATION_TEXT
 /end ANNOTATION
/end CHARACTERISTIC
/begin CHARACTERISTIC DWC_CALIB.DWM_ThermalModel_BW.DWC_ClutchCoolingDemand_K1.DWC_TEMPHYSTLOWTEMP "" VALUE 0x8060FB10 DefaultValueRecordLayout_AUTOSAR_Platform_BaseTypes_sint16 450.0 RB_PT_PCT_SWC_DWC_CompuMethods_temperature_0p1 -50. 400. FORMAT "%10.5"
 /begin ANNOTATION ANNOTATION_LABEL "Description (coming from AUTOSAR DESC field)"
  /begin ANNOTATION_TEXT "Temperature hysteresis for low temperature identification in N/P\r\n" /end ANNOTATION_TEXT
 /end ANNOTATION
/end CHARACTERISTIC
/begin CHARACTERISTIC DWC_CALIB.DWM_ThermalModel_BW.DWC_ClutchCoolingDemand_K1.DWC_TEMPTHRESHOLDN "" VALUE 0x8060FB12 DefaultValueRecordLayout_AUTOSAR_Platform_BaseTypes_sint16 450.0 RB_PT_PCT_SWC_DWC_CompuMethods_temperature_0p1 -50. 400. FORMAT "%10.5"
 /begin ANNOTATION ANNOTATION_LABEL "Description (coming from AUTOSAR DESC field)" /begin ANNOTATION_TEXT "Temperature threshold for cooling in N\r\n" /end ANNOTATION_TEXT /end ANNOTATION
/end CHARACTERISTIC
/begin CHARACTERISTIC DWC_CALIB.DWM_ThermalModel_BW.DWC_ClutchCoolingDemand_K1.DWC_TF_CONTINUOUSPOWER "" CURVE 0x8060FB22 RB_PT_PCT_SWC_DWC_RecordLayouts_RL_Curve_uint16_3_sint16_3 1000000.0 RB_PT_PCT_SWC_DWC_CompuMethods_ratio_20p0 0.0 1000000. FORMAT "%10.5"
 /begin ANNOTATION ANNOTATION_LABEL "Description (coming from AUTOSAR DESC field)"
  /begin ANNOTATION_TEXT "Continuous power limit based upon cooling oil temperature\r\n" /end ANNOTATION_TEXT
 /end ANNOTATION
 /begin AXIS_DESCR STD_AXIS NO_INPUT_QUANTITY RB_PT_PCT_SWC_DWC_CompuMethods_temperature_0p1 3 -50. 400. FORMAT "%10.5" DEPOSIT ABSOLUTE /end AXIS_DESCR
/end CHARACTERISTIC
/begin CHARACTERISTIC DWC_CALIB.DWM_ThermalModel_BW.DWC_ClutchCoolingDemand_K1.DWC_TF_COOLINGFLOW_CONTINUOUS "" MAP 0x8060FB30 RB_PT_PCT_SWC_DWC_RecordLayouts_RL_Map_uint16_18_uint16_6_sint16_3 127.5 RB_PT_PCT_SWC_DWC_CompuMethods_flow_0p01 0.0 127.5 FORMAT "%10.5"
 /begin ANNOTATION ANNOTATION_LABEL "Description (coming from AUTOSAR DESC field)"
  /begin ANNOTATION_TEXT "Cooling flow as a function of clutch slip power and oil temperature\r\n" /end ANNOTATION_TEXT
 /end ANNOTATION
 /begin AXIS_DESCR STD_AXIS NO_INPUT_QUANTITY RB_PT_PCT_SWC_DWC_CompuMethods_ratio_20p0 6 0.0 1000000. FORMAT "%10.5" DEPOSIT ABSOLUTE /end AXIS_DESCR
 /begin AXIS_DESCR STD_AXIS NO_INPUT_QUANTITY RB_PT_PCT_SWC_DWC_CompuMethods_temperature_0p1 3 -50. 400. FORMAT "%10.5" DEPOSIT ABSOLUTE /end AXIS_DESCR
/end CHARACTERISTIC
/begin CHARACTERISTIC DWC_CALIB.DWM_ThermalModel_BW.DWC_ClutchCoolingDemand_K1.DWC_TF_COOLINGFLOW_HPE "" MAP 0x8060FB6A RB_PT_PCT_SWC_DWC_RecordLayouts_RL_Map_uint16_18_uint16_6_sint16_3 127.5 RB_PT_PCT_SWC_DWC_CompuMethods_flow_0p01 0.0 127.5 FORMAT "%10.5"
 /begin ANNOTATION ANNOTATION_LABEL "Description (coming from AUTOSAR DESC field)"
  /begin ANNOTATION_TEXT "Cooling flow as a function of clutch slip power and oil temperature\r\n" /end ANNOTATION_TEXT
 /end ANNOTATION
 /begin AXIS_DESCR STD_AXIS NO_INPUT_QUANTITY RB_PT_PCT_SWC_DWC_CompuMethods_ratio_20p0 6 0.0 1000000. FORMAT "%10.5" DEPOSIT ABSOLUTE /end AXIS_DESCR
 /begin AXIS_DESCR STD_AXIS NO_INPUT_QUANTITY RB_PT_PCT_SWC_DWC_CompuMethods_temperature_0p1 3 -50. 400. FORMAT "%10.5" DEPOSIT ABSOLUTE /end AXIS_DESCR
/end CHARACTERISTIC
/begin CHARACTERISTIC DWC_CALIB.DWM_ThermalModel_BW.DWC_ClutchCoolingDemand_K1.DWC_TF_COOLINGPULSEPROFILE "" CURVE 0x8060FBA4 RB_PT_PCT_SWC_DWC_RecordLayouts_RL_Curve_sint16_5_uint16_5 2.0 RB_PT_PCT_SWC_DWC_CompuMethods_ratio_0p0001 -1. 1. FORMAT "%10.5"
 /begin ANNOTATION ANNOTATION_LABEL "Description (coming from AUTOSAR DESC field)" /begin ANNOTATION_TEXT "Cooling pulse profile\r\n" /end ANNOTATION_TEXT /end ANNOTATION
 /begin AXIS_DESCR STD_AXIS NO_INPUT_QUANTITY RB_PT_PCT_SWC_DWC_CompuMethods_ratio_0p001__2 5 0.0 1. FORMAT "%10.5" DEPOSIT ABSOLUTE /end AXIS_DESCR
/end CHARACTERISTIC
/begin CHARACTERISTIC DWC_CALIB.DWM_ThermalModel_BW.DWC_ClutchCoolingDemand_K1.DWC_TF_COOLINGVSPOWER "" CURVE 0x8060FBBC RB_PT_PCT_SWC_DWC_RecordLayouts_RL_Curve_uint16_4_uint32_4 127.5 RB_PT_PCT_SWC_DWC_CompuMethods_flow_0p01 0.0 127.5 FORMAT "%10.5"
 /begin ANNOTATION ANNOTATION_LABEL "Description (coming from AUTOSAR DESC field)"
  /begin ANNOTATION_TEXT "Cooling flow as a function of slip power during the high power event\r\n" /end ANNOTATION_TEXT
 /end ANNOTATION
 /begin AXIS_DESCR STD_AXIS NO_INPUT_QUANTITY RB_PT_PCT_SWC_DWC_CompuMethods_ident 4 0.0 1000000. FORMAT "%10.5" DEPOSIT ABSOLUTE /end AXIS_DESCR
/end CHARACTERISTIC
/begin CHARACTERISTIC DWC_CALIB.DWM_ThermalModel_BW.DWC_ClutchCoolingDemand_K1.DWC_TF_FCTPOSTCOOLING "" CURVE 0x8060FBD8 RB_PT_PCT_SWC_DWC_RecordLayouts_RL_Curve_uint16_5_uint16_5 1.0 RB_PT_PCT_SWC_DWC_CompuMethods_ratio_0p001__2 0.0 1. FORMAT "%10.5"
 /begin ANNOTATION ANNOTATION_LABEL "Description (coming from AUTOSAR DESC field)"
  /begin ANNOTATION_TEXT "Post cooling factor to be applied to latched flow demand\r\n" /end ANNOTATION_TEXT
 /end ANNOTATION
 /begin AXIS_DESCR STD_AXIS NO_INPUT_QUANTITY RB_PT_PCT_SWC_DWC_CompuMethods_ratio_0p001__2 5 0.0 1. FORMAT "%10.5" DEPOSIT ABSOLUTE /end AXIS_DESCR
/end CHARACTERISTIC
/begin CHARACTERISTIC DWC_CALIB.DWM_ThermalModel_BW.DWC_ClutchCoolingDemand_K1.DWC_TF_FLOWMAXCUTCOOLING "" CURVE 0x8060FBEE RB_PT_PCT_SWC_DWC_RecordLayouts_RL_Curve_uint16_5_sint16_5 127.5 RB_PT_PCT_SWC_DWC_CompuMethods_flow_0p01 0.0 127.5 FORMAT "%10.5"
 /begin ANNOTATION ANNOTATION_LABEL "Description (coming from AUTOSAR DESC field)"
  /begin ANNOTATION_TEXT "Maximum flow demand when cooling is cut based on oil temperature\r\n" /end ANNOTATION_TEXT
 /end ANNOTATION
 /begin AXIS_DESCR STD_AXIS NO_INPUT_QUANTITY RB_PT_PCT_SWC_DWC_CompuMethods_temperature_0p1 5 -50. 400. FORMAT "%10.5" DEPOSIT ABSOLUTE /end AXIS_DESCR
/end CHARACTERISTIC
/begin CHARACTERISTIC DWC_CALIB.DWM_ThermalModel_BW.DWC_ClutchCoolingDemand_K1.DWC_TF_FLOWNHIGHTEMP "" CURVE 0x8060FC04 RB_PT_PCT_SWC_DWC_RecordLayouts_RL_Curve_uint16_4_uint16_4 127.5 RB_PT_PCT_SWC_DWC_CompuMethods_flow_0p01 0.0 127.5 FORMAT "%10.5"
 /begin ANNOTATION ANNOTATION_LABEL "Description (coming from AUTOSAR DESC field)" /begin ANNOTATION_TEXT "Flow request in N at low temperatures\r\n" /end ANNOTATION_TEXT /end ANNOTATION
 /begin AXIS_DESCR STD_AXIS NO_INPUT_QUANTITY RB_PT_PCT_SWC_DWC_CompuMethods_ident 4 0.0 20000. FORMAT "%10.5" DEPOSIT ABSOLUTE /end AXIS_DESCR
/end CHARACTERISTIC
/begin CHARACTERISTIC DWC_CALIB.DWM_ThermalModel_BW.DWC_ClutchCoolingDemand_K1.DWC_TF_FLOWNLOWTEMP "" CURVE 0x8060FC16 RB_PT_PCT_SWC_DWC_RecordLayouts_RL_Curve_uint16_4_uint16_4 127.5 RB_PT_PCT_SWC_DWC_CompuMethods_flow_0p01 0.0 127.5 FORMAT "%10.5"
 /begin ANNOTATION ANNOTATION_LABEL "Description (coming from AUTOSAR DESC field)" /begin ANNOTATION_TEXT "Flow request in N at low temperatures\r\n" /end ANNOTATION_TEXT /end ANNOTATION
 /begin AXIS_DESCR STD_AXIS NO_INPUT_QUANTITY RB_PT_PCT_SWC_DWC_CompuMethods_ident 4 0.0 20000. FORMAT "%10.5" DEPOSIT ABSOLUTE /end AXIS_DESCR
/end CHARACTERISTIC
/begin CHARACTERISTIC DWC_CALIB.DWM_ThermalModel_BW.DWC_ClutchCoolingDemand_K1.DWC_TF_INTERFACEFLOW "" CURVE 0x8060FC28 RB_PT_PCT_SWC_DWC_RecordLayouts_RL_Curve_uint16_8_sint16_8 127.5 RB_PT_PCT_SWC_DWC_CompuMethods_flow_0p01 0.0 127.5 FORMAT "%10.5"
 /begin ANNOTATION ANNOTATION_LABEL "Description (coming from AUTOSAR DESC field)" /begin ANNOTATION_TEXT "Flow as a funciton of interface temperature\r\n" /end ANNOTATION_TEXT /end ANNOTATION
 /begin AXIS_DESCR STD_AXIS NO_INPUT_QUANTITY RB_PT_PCT_SWC_DWC_CompuMethods_temperature_0p1 8 -50. 400. FORMAT "%10.5" DEPOSIT ABSOLUTE /end AXIS_DESCR
/end CHARACTERISTIC
/begin CHARACTERISTIC DWC_CALIB.DWM_ThermalModel_BW.DWC_ClutchCoolingDemand_K1.DWC_TF_MAXCOOLING "" CURVE 0x8060FC4A RB_PT_PCT_SWC_DWC_RecordLayouts_RL_Curve_uint16_5_sint16_5 127.5 RB_PT_PCT_SWC_DWC_CompuMethods_flow_0p01 0.0 127.5 FORMAT "%10.5"
 /begin ANNOTATION ANNOTATION_LABEL "Description (coming from AUTOSAR DESC field)"
  /begin ANNOTATION_TEXT "Maximum cooling flow demand as a function of temperature\r\n" /end ANNOTATION_TEXT
 /end ANNOTATION
 /begin AXIS_DESCR STD_AXIS NO_INPUT_QUANTITY RB_PT_PCT_SWC_DWC_CompuMethods_temperature_0p1 5 -50. 400. FORMAT "%10.5" DEPOSIT ABSOLUTE /end AXIS_DESCR
/end CHARACTERISTIC
/begin CHARACTERISTIC DWC_CALIB.DWM_ThermalModel_BW.DWC_ClutchCoolingDemand_K1.DWC_TF_MINFLOW "" CURVE 0x8060FC60 RB_PT_PCT_SWC_DWC_RecordLayouts_RL_Curve_uint16_5_sint16_5 127.5 RB_PT_PCT_SWC_DWC_CompuMethods_flow_0p01 0.0 127.5 FORMAT "%10.5"
 /begin ANNOTATION ANNOTATION_LABEL "Description (coming from AUTOSAR DESC field)" /begin ANNOTATION_TEXT "Minimum flow as a function of temperature\r\n" /end ANNOTATION_TEXT /end ANNOTATION
 /begin AXIS_DESCR STD_AXIS NO_INPUT_QUANTITY RB_PT_PCT_SWC_DWC_CompuMethods_temperature_0p1 5 -50. 400. FORMAT "%10.5" DEPOSIT ABSOLUTE /end AXIS_DESCR
/end CHARACTERISTIC
/begin CHARACTERISTIC DWC_CALIB.DWM_ThermalModel_BW.DWC_ClutchCoolingDemand_K1.DWC_TF_POSTCOOLINGTIME "" CURVE 0x8060FC76 RB_PT_PCT_SWC_DWC_RecordLayouts_RL_Curve_uint16_3_uint16_3 65.535 RB_PT_PCT_SWC_DWC_CompuMethods_ratio_0p001__2 0.0 65.535 FORMAT "%10.5"
 /begin ANNOTATION ANNOTATION_LABEL "Description (coming from AUTOSAR DESC field)"
  /begin ANNOTATION_TEXT "Post cooling time as a function of maximum slip power seen during high power event\r\n" /end ANNOTATION_TEXT
 /end ANNOTATION
 /begin AXIS_DESCR STD_AXIS NO_INPUT_QUANTITY RB_PT_PCT_SWC_DWC_CompuMethods_ratio_20p0 3 0.0 1000000. FORMAT "%10.5" DEPOSIT ABSOLUTE /end AXIS_DESCR
/end CHARACTERISTIC
/begin CHARACTERISTIC DWC_CALIB.DWM_ThermalModel_BW.DWC_ClutchCoolingDemand_K1.DWC_TIMECOOLINGCUTMAX "" VALUE 0x8060FB14 DefaultValueRecordLayout_AUTOSAR_Platform_BaseTypes_uint16 65.535 RB_PT_PCT_SWC_DWC_CompuMethods_ratio_0p001__2 0.0 65.535 FORMAT "%10.5"
 /begin ANNOTATION ANNOTATION_LABEL "Description (coming from AUTOSAR DESC field)" /begin ANNOTATION_TEXT "Maximum time for cutting cooling\r\n" /end ANNOTATION_TEXT /end ANNOTATION
/end CHARACTERISTIC
/begin CHARACTERISTIC DWC_CALIB.DWM_ThermalModel_BW.DWC_ClutchCoolingDemand_K1.DWC_TIMECOOLINGCUTMAXMAP "" CURVE 0x8060FC84 RB_PT_PCT_SWC_DWC_RecordLayouts_RL_Curve_uint16_4_sint16_4 65.535 RB_PT_PCT_SWC_DWC_CompuMethods_ratio_0p001__2 0.0 65.535 FORMAT "%10.5"
 /begin ANNOTATION ANNOTATION_LABEL "Description (coming from AUTOSAR DESC field)" /begin ANNOTATION_TEXT "Maximum time for cutting cooling.\r\n" /end ANNOTATION_TEXT /end ANNOTATION
 /begin AXIS_DESCR STD_AXIS NO_INPUT_QUANTITY RB_PT_PCT_SWC_DWC_CompuMethods_temperature_0p1 4 -50. 400. FORMAT "%10.5" DEPOSIT ABSOLUTE /end AXIS_DESCR
/end CHARACTERISTIC
/begin CHARACTERISTIC DWC_CALIB.DWM_ThermalModel_BW.DWC_ClutchCoolingDemand_K1.DWC_TIMEMAXCOOLINGCUT "" VALUE 0x8060FB16 DefaultValueRecordLayout_AUTOSAR_Platform_BaseTypes_uint16 65.535 RB_PT_PCT_SWC_DWC_CompuMethods_ratio_0p001__2 0.0 65.535 FORMAT "%10.5"
 /begin ANNOTATION ANNOTATION_LABEL "Description (coming from AUTOSAR DESC field)" /begin ANNOTATION_TEXT "Maximum time that cooling can be cut\r\n" /end ANNOTATION_TEXT /end ANNOTATION
/end CHARACTERISTIC
/begin CHARACTERISTIC DWC_CALIB.DWM_ThermalModel_BW.DWC_ClutchCoolingDemand_K1.DWC_TIMEPULSE "" VALUE 0x8060FB18 DefaultValueRecordLayout_AUTOSAR_Platform_BaseTypes_uint16 65.535 RB_PT_PCT_SWC_DWC_CompuMethods_ratio_0p001__2 0.0 65.535 FORMAT "%10.5"
 /begin ANNOTATION ANNOTATION_LABEL "Description (coming from AUTOSAR DESC field)" /begin ANNOTATION_TEXT "Pulse time\r\n" /end ANNOTATION_TEXT /end ANNOTATION
/end CHARACTERISTIC
/begin CHARACTERISTIC DWC_CALIB.DWM_ThermalModel_BW.DWC_ClutchCoolingDemand_K2.DWC_BOBCOOLINGTEMP "" VALUE 0x8060FCA0 DefaultValueRecordLayout_AUTOSAR_Platform_BaseTypes_sint16 450.0 RB_PT_PCT_SWC_DWC_CompuMethods_temperature_0p1 -50. 400. FORMAT "%10.5"
 /begin ANNOTATION ANNOTATION_LABEL "Description (coming from AUTOSAR DESC field)" /begin ANNOTATION_TEXT "Cooling temp manual override value.\r\n" /end ANNOTATION_TEXT /end ANNOTATION
/end CHARACTERISTIC
/begin CHARACTERISTIC DWC_CALIB.DWM_ThermalModel_BW.DWC_ClutchCoolingDemand_K2.DWC_BOBCUTCOOLING "" VALUE 0x8060FCB6 DefaultValueRecordLayout_AUTOSAR_Platform_BaseTypes_boolean 255.0 AUTOSAR_Platform_CompuMethods_boolean 0.0 255. FORMAT "%10.5"
 /begin ANNOTATION ANNOTATION_LABEL "Description (coming from AUTOSAR DESC field)" /begin ANNOTATION_TEXT "GAC cut manual override value.\r\n" /end ANNOTATION_TEXT /end ANNOTATION
/end CHARACTERISTIC
/begin CHARACTERISTIC DWC_CALIB.DWM_ThermalModel_BW.DWC_ClutchCoolingDemand_K2.DWC_BOBENGSPEED "" VALUE 0x8060FCA2 DefaultValueRecordLayout_AUTOSAR_Platform_BaseTypes_uint16 20000.0 RB_PT_PCT_SWC_DWC_CompuMethods_ident 0.0 20000. FORMAT "%10.5"
 /begin ANNOTATION ANNOTATION_LABEL "Description (coming from AUTOSAR DESC field)" /begin ANNOTATION_TEXT "Engine speed manual override value.\r\n" /end ANNOTATION_TEXT /end ANNOTATION
/end CHARACTERISTIC
/begin CHARACTERISTIC DWC_CALIB.DWM_ThermalModel_BW.DWC_ClutchCoolingDemand_K2.DWC_BOBGEAR "" VALUE 0x8060FCB7 DefaultValueRecordLayout_AUTOSAR_Platform_BaseTypes_uint8 11.0 RB_PT_PCT_SWC_DWC_CompuMethods_ident 0.0 11. FORMAT "%10.5"
 /begin ANNOTATION ANNOTATION_LABEL "Description (coming from AUTOSAR DESC field)" /begin ANNOTATION_TEXT "Gear manual override value.\r\n" /end ANNOTATION_TEXT /end ANNOTATION
/end CHARACTERISTIC
/begin CHARACTERISTIC DWC_CALIB.DWM_ThermalModel_BW.DWC_ClutchCoolingDemand_K2.DWC_BOBINTTEMP "" VALUE 0x8060FCA4 DefaultValueRecordLayout_AUTOSAR_Platform_BaseTypes_sint16 450.0 RB_PT_PCT_SWC_DWC_CompuMethods_temperature_0p1 -50. 400. FORMAT "%10.5"
 /begin ANNOTATION ANNOTATION_LABEL "Description (coming from AUTOSAR DESC field)" /begin ANNOTATION_TEXT "Plate temp manual override value.\r\n" /end ANNOTATION_TEXT /end ANNOTATION
/end CHARACTERISTIC
/begin CHARACTERISTIC DWC_CALIB.DWM_ThermalModel_BW.DWC_ClutchCoolingDemand_K2.DWC_BOBPAACTIVE "" VALUE 0x8060FCB8 DefaultValueRecordLayout_AUTOSAR_Platform_BaseTypes_boolean 255.0 AUTOSAR_Platform_CompuMethods_boolean 0.0 255. FORMAT "%10.5"
 /begin ANNOTATION ANNOTATION_LABEL "Description (coming from AUTOSAR DESC field)" /begin ANNOTATION_TEXT "Pullaway active flag manual override value.\r\n" /end ANNOTATION_TEXT /end ANNOTATION
/end CHARACTERISTIC
/begin CHARACTERISTIC DWC_CALIB.DWM_ThermalModel_BW.DWC_ClutchCoolingDemand_K2.DWC_BOBSLIPPOWER "" VALUE 0x8060FC98 DefaultValueRecordLayout_AUTOSAR_Platform_BaseTypes_uint32 1000000.0 RB_PT_PCT_SWC_DWC_CompuMethods_ident 0.0 1000000. FORMAT "%10.5"
 /begin ANNOTATION ANNOTATION_LABEL "Description (coming from AUTOSAR DESC field)" /begin ANNOTATION_TEXT "Slip power manual override value.\r\n" /end ANNOTATION_TEXT /end ANNOTATION
/end CHARACTERISTIC
/begin CHARACTERISTIC DWC_CALIB.DWM_ThermalModel_BW.DWC_ClutchCoolingDemand_K2.DWC_CutCoolingMaxTimer.LIB_DT "" VALUE 0x8060FCBC DefaultValueRecordLayout_AUTOSAR_Platform_BaseTypes_uint16 65.535 RB_PT_PCT_SWC_DWC_CompuMethods_ratio_0p001__2 0.0 65.535 FORMAT "%10.5"
 /begin ANNOTATION ANNOTATION_LABEL "Description (coming from AUTOSAR DESC field)" /begin ANNOTATION_TEXT "Timer decrement value.\r\n" /end ANNOTATION_TEXT /end ANNOTATION
/end CHARACTERISTIC
/begin CHARACTERISTIC DWC_CALIB.DWM_ThermalModel_BW.DWC_ClutchCoolingDemand_K2.DWC_FLGBLOCKGACCUTWITHTEMP "" VALUE 0x8060FCB9 DefaultValueRecordLayout_AUTOSAR_Platform_BaseTypes_boolean 255.0 AUTOSAR_Platform_CompuMethods_boolean 0.0 255. FORMAT "%10.5"
 /begin ANNOTATION ANNOTATION_LABEL "Description (coming from AUTOSAR DESC field)"
  /begin ANNOTATION_TEXT "Enable logic to block GAC cut based on interface temp or slip power.\r\n" /end ANNOTATION_TEXT
 /end ANNOTATION
/end CHARACTERISTIC
/begin CHARACTERISTIC DWC_CALIB.DWM_ThermalModel_BW.DWC_ClutchCoolingDemand_K2.DWC_FLGBOB "" VALUE 0x8060FCBA DefaultValueRecordLayout_AUTOSAR_Platform_BaseTypes_boolean 255.0 AUTOSAR_Platform_CompuMethods_boolean 0.0 255. FORMAT "%10.5"
 /begin ANNOTATION ANNOTATION_LABEL "Description (coming from AUTOSAR DESC field)" /begin ANNOTATION_TEXT "Bob enable.\r\n" /end ANNOTATION_TEXT /end ANNOTATION
/end CHARACTERISTIC
/begin CHARACTERISTIC DWC_CALIB.DWM_ThermalModel_BW.DWC_ClutchCoolingDemand_K2.DWC_FLGENABNEUTRALCOOLING "" VALUE 0x8060FCBB DefaultValueRecordLayout_AUTOSAR_Platform_BaseTypes_uint8 255.0 DefaultIdenticalCompu 0.0 255. FORMAT "%10.5"
 /begin ANNOTATION ANNOTATION_LABEL "Description (coming from AUTOSAR DESC field)" /begin ANNOTATION_TEXT "Flag to implement neutral cooling fix.\r\n" /end ANNOTATION_TEXT /end ANNOTATION
/end CHARACTERISTIC
/begin CHARACTERISTIC DWC_CALIB.DWM_ThermalModel_BW.DWC_ClutchCoolingDemand_K2.DWC_FLOWPULSEHEIGHT "" VALUE 0x8060FCA6 DefaultValueRecordLayout_AUTOSAR_Platform_BaseTypes_uint16 127.5 RB_PT_PCT_SWC_DWC_CompuMethods_flow_0p01 0.0 127.5 FORMAT "%10.5"
 /begin ANNOTATION ANNOTATION_LABEL "Description (coming from AUTOSAR DESC field)"
  /begin ANNOTATION_TEXT "Pulse height to be applied to continuous flow from map\r\n" /end ANNOTATION_TEXT
 /end ANNOTATION
/end CHARACTERISTIC
/begin CHARACTERISTIC DWC_CALIB.DWM_ThermalModel_BW.DWC_ClutchCoolingDemand_K2.DWC_MAXINTERFACETEMPFORGACCUT "" VALUE 0x8060FCA8 DefaultValueRecordLayout_AUTOSAR_Platform_BaseTypes_sint16 450.0 RB_PT_PCT_SWC_DWC_CompuMethods_temperature_0p1 -50. 400. FORMAT "%10.5"
 /begin ANNOTATION ANNOTATION_LABEL "Description (coming from AUTOSAR DESC field)"
  /begin ANNOTATION_TEXT "Maximum allowable interface temperature to allow a GAC cut.\r\n" /end ANNOTATION_TEXT
 /end ANNOTATION
/end CHARACTERISTIC
/begin CHARACTERISTIC DWC_CALIB.DWM_ThermalModel_BW.DWC_ClutchCoolingDemand_K2.DWC_MAXSLIPPOWERFORGACCUT "" VALUE 0x8060FC9C DefaultValueRecordLayout_AUTOSAR_Platform_BaseTypes_uint32 1000000.0 RB_PT_PCT_SWC_DWC_CompuMethods_ident 0.0 1000000. FORMAT "%10.5"
 /begin ANNOTATION ANNOTATION_LABEL "Description (coming from AUTOSAR DESC field)"
  /begin ANNOTATION_TEXT "MAximum allowable slip power to allow for a GAC cut request.\r\n" /end ANNOTATION_TEXT
 /end ANNOTATION
/end CHARACTERISTIC
/begin CHARACTERISTIC DWC_CALIB.DWM_ThermalModel_BW.DWC_ClutchCoolingDemand_K2.DWC_MAXSPDFORPNCOOLING "" VALUE 0x8060FCAA DefaultValueRecordLayout_AUTOSAR_Platform_BaseTypes_uint16 500.0 RB_PT_PCT_SWC_DWC_CompuMethods_ratio_0p01 0.0 500. FORMAT "%10.5"
 /begin ANNOTATION ANNOTATION_LABEL "Description (coming from AUTOSAR DESC field)"
  /begin ANNOTATION_TEXT "Maximum vehicle speed for park/neutral cooling request\r\n" /end ANNOTATION_TEXT
 /end ANNOTATION
/end CHARACTERISTIC
/begin CHARACTERISTIC DWC_CALIB.DWM_ThermalModel_BW.DWC_ClutchCoolingDemand_K2.DWC_TEMPHYSTLOWTEMP "" VALUE 0x8060FCAC DefaultValueRecordLayout_AUTOSAR_Platform_BaseTypes_sint16 450.0 RB_PT_PCT_SWC_DWC_CompuMethods_temperature_0p1 -50. 400. FORMAT "%10.5"
 /begin ANNOTATION ANNOTATION_LABEL "Description (coming from AUTOSAR DESC field)"
  /begin ANNOTATION_TEXT "Temperature hysteresis for low temperature identification in N/P\r\n" /end ANNOTATION_TEXT
 /end ANNOTATION
/end CHARACTERISTIC
/begin CHARACTERISTIC DWC_CALIB.DWM_ThermalModel_BW.DWC_ClutchCoolingDemand_K2.DWC_TEMPTHRESHOLDN "" VALUE 0x8060FCAE DefaultValueRecordLayout_AUTOSAR_Platform_BaseTypes_sint16 450.0 RB_PT_PCT_SWC_DWC_CompuMethods_temperature_0p1 -50. 400. FORMAT "%10.5"
 /begin ANNOTATION ANNOTATION_LABEL "Description (coming from AUTOSAR DESC field)" /begin ANNOTATION_TEXT "Temperature threshold for cooling in N\r\n" /end ANNOTATION_TEXT /end ANNOTATION
/end CHARACTERISTIC
/begin CHARACTERISTIC DWC_CALIB.DWM_ThermalModel_BW.DWC_ClutchCoolingDemand_K2.DWC_TF_CONTINUOUSPOWER "" CURVE 0x8060FCBE RB_PT_PCT_SWC_DWC_RecordLayouts_RL_Curve_uint16_3_sint16_3 1000000.0 RB_PT_PCT_SWC_DWC_CompuMethods_ratio_20p0 0.0 1000000. FORMAT "%10.5"
 /begin ANNOTATION ANNOTATION_LABEL "Description (coming from AUTOSAR DESC field)"
  /begin ANNOTATION_TEXT "Continuous power limit based upon cooling oil temperature\r\n" /end ANNOTATION_TEXT
 /end ANNOTATION
 /begin AXIS_DESCR STD_AXIS NO_INPUT_QUANTITY RB_PT_PCT_SWC_DWC_CompuMethods_temperature_0p1 3 -50. 400. FORMAT "%10.5" DEPOSIT ABSOLUTE /end AXIS_DESCR
/end CHARACTERISTIC
/begin CHARACTERISTIC DWC_CALIB.DWM_ThermalModel_BW.DWC_ClutchCoolingDemand_K2.DWC_TF_COOLINGFLOW_CONTINUOUS "" MAP 0x8060FCCC RB_PT_PCT_SWC_DWC_RecordLayouts_RL_Map_uint16_18_uint16_6_sint16_3 127.5 RB_PT_PCT_SWC_DWC_CompuMethods_flow_0p01 0.0 127.5 FORMAT "%10.5"
 /begin ANNOTATION ANNOTATION_LABEL "Description (coming from AUTOSAR DESC field)"
  /begin ANNOTATION_TEXT "Cooling flow as a function of clutch slip power and oil temperature\r\n" /end ANNOTATION_TEXT
 /end ANNOTATION
 /begin AXIS_DESCR STD_AXIS NO_INPUT_QUANTITY RB_PT_PCT_SWC_DWC_CompuMethods_ratio_20p0 6 0.0 1000000. FORMAT "%10.5" DEPOSIT ABSOLUTE /end AXIS_DESCR
 /begin AXIS_DESCR STD_AXIS NO_INPUT_QUANTITY RB_PT_PCT_SWC_DWC_CompuMethods_temperature_0p1 3 -50. 400. FORMAT "%10.5" DEPOSIT ABSOLUTE /end AXIS_DESCR
/end CHARACTERISTIC
/begin CHARACTERISTIC DWC_CALIB.DWM_ThermalModel_BW.DWC_ClutchCoolingDemand_K2.DWC_TF_COOLINGFLOW_HPE "" MAP 0x8060FD06 RB_PT_PCT_SWC_DWC_RecordLayouts_RL_Map_uint16_18_uint16_6_sint16_3 127.5 RB_PT_PCT_SWC_DWC_CompuMethods_flow_0p01 0.0 127.5 FORMAT "%10.5"
 /begin ANNOTATION ANNOTATION_LABEL "Description (coming from AUTOSAR DESC field)"
  /begin ANNOTATION_TEXT "Cooling flow as a function of clutch slip power and oil temperature\r\n" /end ANNOTATION_TEXT
 /end ANNOTATION
 /begin AXIS_DESCR STD_AXIS NO_INPUT_QUANTITY RB_PT_PCT_SWC_DWC_CompuMethods_ratio_20p0 6 0.0 1000000. FORMAT "%10.5" DEPOSIT ABSOLUTE /end AXIS_DESCR
 /begin AXIS_DESCR STD_AXIS NO_INPUT_QUANTITY RB_PT_PCT_SWC_DWC_CompuMethods_temperature_0p1 3 -50. 400. FORMAT "%10.5" DEPOSIT ABSOLUTE /end AXIS_DESCR
/end CHARACTERISTIC
/begin CHARACTERISTIC DWC_CALIB.DWM_ThermalModel_BW.DWC_ClutchCoolingDemand_K2.DWC_TF_COOLINGPULSEPROFILE "" CURVE 0x8060FD40 RB_PT_PCT_SWC_DWC_RecordLayouts_RL_Curve_sint16_5_uint16_5 2.0 RB_PT_PCT_SWC_DWC_CompuMethods_ratio_0p0001 -1. 1. FORMAT "%10.5"
 /begin ANNOTATION ANNOTATION_LABEL "Description (coming from AUTOSAR DESC field)" /begin ANNOTATION_TEXT "Cooling pulse profile\r\n" /end ANNOTATION_TEXT /end ANNOTATION
 /begin AXIS_DESCR STD_AXIS NO_INPUT_QUANTITY RB_PT_PCT_SWC_DWC_CompuMethods_ratio_0p001__2 5 0.0 1. FORMAT "%10.5" DEPOSIT ABSOLUTE /end AXIS_DESCR
/end CHARACTERISTIC
/begin CHARACTERISTIC DWC_CALIB.DWM_ThermalModel_BW.DWC_ClutchCoolingDemand_K2.DWC_TF_COOLINGVSPOWER "" CURVE 0x8060FD58 RB_PT_PCT_SWC_DWC_RecordLayouts_RL_Curve_uint16_4_uint32_4 127.5 RB_PT_PCT_SWC_DWC_CompuMethods_flow_0p01 0.0 127.5 FORMAT "%10.5"
 /begin ANNOTATION ANNOTATION_LABEL "Description (coming from AUTOSAR DESC field)"
  /begin ANNOTATION_TEXT "Cooling flow as a function of slip power during the high power event\r\n" /end ANNOTATION_TEXT
 /end ANNOTATION
 /begin AXIS_DESCR STD_AXIS NO_INPUT_QUANTITY RB_PT_PCT_SWC_DWC_CompuMethods_ident 4 0.0 1000000. FORMAT "%10.5" DEPOSIT ABSOLUTE /end AXIS_DESCR
/end CHARACTERISTIC
/begin CHARACTERISTIC DWC_CALIB.DWM_ThermalModel_BW.DWC_ClutchCoolingDemand_K2.DWC_TF_FCTPOSTCOOLING "" CURVE 0x8060FD74 RB_PT_PCT_SWC_DWC_RecordLayouts_RL_Curve_uint16_5_uint16_5 1.0 RB_PT_PCT_SWC_DWC_CompuMethods_ratio_0p001__2 0.0 1. FORMAT "%10.5"
 /begin ANNOTATION ANNOTATION_LABEL "Description (coming from AUTOSAR DESC field)"
  /begin ANNOTATION_TEXT "Post cooling factor to be applied to latched flow demand\r\n" /end ANNOTATION_TEXT
 /end ANNOTATION
 /begin AXIS_DESCR STD_AXIS NO_INPUT_QUANTITY RB_PT_PCT_SWC_DWC_CompuMethods_ratio_0p001__2 5 0.0 1. FORMAT "%10.5" DEPOSIT ABSOLUTE /end AXIS_DESCR
/end CHARACTERISTIC
/begin CHARACTERISTIC DWC_CALIB.DWM_ThermalModel_BW.DWC_ClutchCoolingDemand_K2.DWC_TF_FLOWMAXCUTCOOLING "" CURVE 0x8060FD8A RB_PT_PCT_SWC_DWC_RecordLayouts_RL_Curve_uint16_5_sint16_5 127.5 RB_PT_PCT_SWC_DWC_CompuMethods_flow_0p01 0.0 127.5 FORMAT "%10.5"
 /begin ANNOTATION ANNOTATION_LABEL "Description (coming from AUTOSAR DESC field)"
  /begin ANNOTATION_TEXT "Maximum flow demand when cooling is cut based on oil temperature\r\n" /end ANNOTATION_TEXT
 /end ANNOTATION
 /begin AXIS_DESCR STD_AXIS NO_INPUT_QUANTITY RB_PT_PCT_SWC_DWC_CompuMethods_temperature_0p1 5 -50. 400. FORMAT "%10.5" DEPOSIT ABSOLUTE /end AXIS_DESCR
/end CHARACTERISTIC
/begin CHARACTERISTIC DWC_CALIB.DWM_ThermalModel_BW.DWC_ClutchCoolingDemand_K2.DWC_TF_FLOWNHIGHTEMP "" CURVE 0x8060FDA0 RB_PT_PCT_SWC_DWC_RecordLayouts_RL_Curve_uint16_4_uint16_4 127.5 RB_PT_PCT_SWC_DWC_CompuMethods_flow_0p01 0.0 127.5 FORMAT "%10.5"
 /begin ANNOTATION ANNOTATION_LABEL "Description (coming from AUTOSAR DESC field)" /begin ANNOTATION_TEXT "Flow request in N at low temperatures\r\n" /end ANNOTATION_TEXT /end ANNOTATION
 /begin AXIS_DESCR STD_AXIS NO_INPUT_QUANTITY RB_PT_PCT_SWC_DWC_CompuMethods_ident 4 0.0 20000. FORMAT "%10.5" DEPOSIT ABSOLUTE /end AXIS_DESCR
/end CHARACTERISTIC
/begin CHARACTERISTIC DWC_CALIB.DWM_ThermalModel_BW.DWC_ClutchCoolingDemand_K2.DWC_TF_FLOWNLOWTEMP "" CURVE 0x8060FDB2 RB_PT_PCT_SWC_DWC_RecordLayouts_RL_Curve_uint16_4_uint16_4 127.5 RB_PT_PCT_SWC_DWC_CompuMethods_flow_0p01 0.0 127.5 FORMAT "%10.5"
 /begin ANNOTATION ANNOTATION_LABEL "Description (coming from AUTOSAR DESC field)" /begin ANNOTATION_TEXT "Flow request in N at low temperatures\r\n" /end ANNOTATION_TEXT /end ANNOTATION
 /begin AXIS_DESCR STD_AXIS NO_INPUT_QUANTITY RB_PT_PCT_SWC_DWC_CompuMethods_ident 4 0.0 20000. FORMAT "%10.5" DEPOSIT ABSOLUTE /end AXIS_DESCR
/end CHARACTERISTIC
/begin CHARACTERISTIC DWC_CALIB.DWM_ThermalModel_BW.DWC_ClutchCoolingDemand_K2.DWC_TF_INTERFACEFLOW "" CURVE 0x8060FDC4 RB_PT_PCT_SWC_DWC_RecordLayouts_RL_Curve_uint16_8_sint16_8 127.5 RB_PT_PCT_SWC_DWC_CompuMethods_flow_0p01 0.0 127.5 FORMAT "%10.5"
 /begin ANNOTATION ANNOTATION_LABEL "Description (coming from AUTOSAR DESC field)" /begin ANNOTATION_TEXT "Flow as a funciton of interface temperature\r\n" /end ANNOTATION_TEXT /end ANNOTATION
 /begin AXIS_DESCR STD_AXIS NO_INPUT_QUANTITY RB_PT_PCT_SWC_DWC_CompuMethods_temperature_0p1 8 -50. 400. FORMAT "%10.5" DEPOSIT ABSOLUTE /end AXIS_DESCR
/end CHARACTERISTIC
/begin CHARACTERISTIC DWC_CALIB.DWM_ThermalModel_BW.DWC_ClutchCoolingDemand_K2.DWC_TF_MAXCOOLING "" CURVE 0x8060FDE6 RB_PT_PCT_SWC_DWC_RecordLayouts_RL_Curve_uint16_5_sint16_5 127.5 RB_PT_PCT_SWC_DWC_CompuMethods_flow_0p01 0.0 127.5 FORMAT "%10.5"
 /begin ANNOTATION ANNOTATION_LABEL "Description (coming from AUTOSAR DESC field)"
  /begin ANNOTATION_TEXT "Maximum cooling flow demand as a function of temperature\r\n" /end ANNOTATION_TEXT
 /end ANNOTATION
 /begin AXIS_DESCR STD_AXIS NO_INPUT_QUANTITY RB_PT_PCT_SWC_DWC_CompuMethods_temperature_0p1 5 -50. 400. FORMAT "%10.5" DEPOSIT ABSOLUTE /end AXIS_DESCR
/end CHARACTERISTIC
/begin CHARACTERISTIC DWC_CALIB.DWM_ThermalModel_BW.DWC_ClutchCoolingDemand_K2.DWC_TF_MINFLOW "" CURVE 0x8060FDFC RB_PT_PCT_SWC_DWC_RecordLayouts_RL_Curve_uint16_5_sint16_5 127.5 RB_PT_PCT_SWC_DWC_CompuMethods_flow_0p01 0.0 127.5 FORMAT "%10.5"
 /begin ANNOTATION ANNOTATION_LABEL "Description (coming from AUTOSAR DESC field)" /begin ANNOTATION_TEXT "Minimum flow as a function of temperature\r\n" /end ANNOTATION_TEXT /end ANNOTATION
 /begin AXIS_DESCR STD_AXIS NO_INPUT_QUANTITY RB_PT_PCT_SWC_DWC_CompuMethods_temperature_0p1 5 -50. 400. FORMAT "%10.5" DEPOSIT ABSOLUTE /end AXIS_DESCR
/end CHARACTERISTIC
/begin CHARACTERISTIC DWC_CALIB.DWM_ThermalModel_BW.DWC_ClutchCoolingDemand_K2.DWC_TF_POSTCOOLINGTIME "" CURVE 0x8060FE12 RB_PT_PCT_SWC_DWC_RecordLayouts_RL_Curve_uint16_3_uint16_3 65.535 RB_PT_PCT_SWC_DWC_CompuMethods_ratio_0p001__2 0.0 65.535 FORMAT "%10.5"
 /begin ANNOTATION ANNOTATION_LABEL "Description (coming from AUTOSAR DESC field)"
  /begin ANNOTATION_TEXT "Post cooling time as a function of maximum slip power seen during high power event\r\n" /end ANNOTATION_TEXT
 /end ANNOTATION
 /begin AXIS_DESCR STD_AXIS NO_INPUT_QUANTITY RB_PT_PCT_SWC_DWC_CompuMethods_ratio_20p0 3 0.0 1000000. FORMAT "%10.5" DEPOSIT ABSOLUTE /end AXIS_DESCR
/end CHARACTERISTIC
/begin CHARACTERISTIC DWC_CALIB.DWM_ThermalModel_BW.DWC_ClutchCoolingDemand_K2.DWC_TIMECOOLINGCUTMAX "" VALUE 0x8060FCB0 DefaultValueRecordLayout_AUTOSAR_Platform_BaseTypes_uint16 65.535 RB_PT_PCT_SWC_DWC_CompuMethods_ratio_0p001__2 0.0 65.535 FORMAT "%10.5"
 /begin ANNOTATION ANNOTATION_LABEL "Description (coming from AUTOSAR DESC field)" /begin ANNOTATION_TEXT "Maximum time for cutting cooling\r\n" /end ANNOTATION_TEXT /end ANNOTATION
/end CHARACTERISTIC
/begin CHARACTERISTIC DWC_CALIB.DWM_ThermalModel_BW.DWC_ClutchCoolingDemand_K2.DWC_TIMECOOLINGCUTMAXMAP "" CURVE 0x8060FE20 RB_PT_PCT_SWC_DWC_RecordLayouts_RL_Curve_uint16_4_sint16_4 65.535 RB_PT_PCT_SWC_DWC_CompuMethods_ratio_0p001__2 0.0 65.535 FORMAT "%10.5"
 /begin ANNOTATION ANNOTATION_LABEL "Description (coming from AUTOSAR DESC field)" /begin ANNOTATION_TEXT "Maximum time for cutting cooling.\r\n" /end ANNOTATION_TEXT /end ANNOTATION
 /begin AXIS_DESCR STD_AXIS NO_INPUT_QUANTITY RB_PT_PCT_SWC_DWC_CompuMethods_temperature_0p1 4 -50. 400. FORMAT "%10.5" DEPOSIT ABSOLUTE /end AXIS_DESCR
/end CHARACTERISTIC
/begin CHARACTERISTIC DWC_CALIB.DWM_ThermalModel_BW.DWC_ClutchCoolingDemand_K2.DWC_TIMEMAXCOOLINGCUT "" VALUE 0x8060FCB2 DefaultValueRecordLayout_AUTOSAR_Platform_BaseTypes_uint16 65.535 RB_PT_PCT_SWC_DWC_CompuMethods_ratio_0p001__2 0.0 65.535 FORMAT "%10.5"
 /begin ANNOTATION ANNOTATION_LABEL "Description (coming from AUTOSAR DESC field)" /begin ANNOTATION_TEXT "Maximum time that cooling can be cut\r\n" /end ANNOTATION_TEXT /end ANNOTATION
/end CHARACTERISTIC
/begin CHARACTERISTIC DWC_CALIB.DWM_ThermalModel_BW.DWC_ClutchCoolingDemand_K2.DWC_TIMEPULSE "" VALUE 0x8060FCB4 DefaultValueRecordLayout_AUTOSAR_Platform_BaseTypes_uint16 65.535 RB_PT_PCT_SWC_DWC_CompuMethods_ratio_0p001__2 0.0 65.535 FORMAT "%10.5"
 /begin ANNOTATION ANNOTATION_LABEL "Description (coming from AUTOSAR DESC field)" /begin ANNOTATION_TEXT "Pulse time\r\n" /end ANNOTATION_TEXT /end ANNOTATION
/end CHARACTERISTIC
/begin CHARACTERISTIC DWC_CALIB.DWM_ThermalModel_BW.DWC_FLGBOB "" VALUE 0x8060FAF1 DefaultValueRecordLayout_AUTOSAR_Platform_BaseTypes_uint8 255.0 DefaultIdenticalCompu 0.0 255. FORMAT "%10.5"
 /begin ANNOTATION ANNOTATION_LABEL "Description (coming from AUTOSAR DESC field)" /begin ANNOTATION_TEXT "Bob enable.\r\n" /end ANNOTATION_TEXT /end ANNOTATION
/end CHARACTERISTIC
/begin CHARACTERISTIC DWC_CALIB.DWM_ThermalModel_BW.DWC_FLGCHECKFBTORQUEFAULT "" VALUE 0x8060FAF2 DefaultValueRecordLayout_AUTOSAR_Platform_BaseTypes_boolean 255.0 AUTOSAR_Platform_CompuMethods_boolean 0.0 255. FORMAT "%10.5"
 /begin ANNOTATION ANNOTATION_LABEL "Description (coming from AUTOSAR DESC field)" /begin ANNOTATION_TEXT "Flag to check torqueFB if there is a speed fault.\r\n" /end ANNOTATION_TEXT /end ANNOTATION
/end CHARACTERISTIC
/begin CHARACTERISTIC DWC_CALIB.DWM_ThermalModel_BW.DWC_FLGCRCTCOOLINGDRCTN "" VALUE 0x8060FAF3 DefaultValueRecordLayout_AUTOSAR_Platform_BaseTypes_boolean 255.0 AUTOSAR_Platform_CompuMethods_boolean 0.0 255. FORMAT "%10.5"
 /begin ANNOTATION ANNOTATION_LABEL "Description (coming from AUTOSAR DESC field)"
  /begin ANNOTATION_TEXT "Flag to swap the target cooling oil inputs to align with flow direction.\r\n" /end ANNOTATION_TEXT
 /end ANNOTATION
/end CHARACTERISTIC
/begin CHARACTERISTIC DWC_CALIB.DWM_ThermalModel_BW.DWC_FLGENABLESIM "" VALUE 0x8060FAF4 DefaultValueRecordLayout_AUTOSAR_Platform_BaseTypes_uint8 255.0 DefaultIdenticalCompu 0.0 255. FORMAT "%10.5"
 /begin ANNOTATION ANNOTATION_LABEL "Description (coming from AUTOSAR DESC field)" /begin ANNOTATION_TEXT "Set true to enter simulation mode\r\n" /end ANNOTATION_TEXT /end ANNOTATION
/end CHARACTERISTIC
/begin CHARACTERISTIC DWC_CALIB.DWM_ThermalModel_BW.DWC_FLGFORCETEMPINIT "" VALUE 0x8060FAF5 DefaultValueRecordLayout_AUTOSAR_Platform_BaseTypes_uint8 255.0 DefaultIdenticalCompu 0.0 255. FORMAT "%10.5"
 /begin ANNOTATION ANNOTATION_LABEL "Description (coming from AUTOSAR DESC field)"
  /begin ANNOTATION_TEXT "Set true to force thermal model temperatures to initialise\r\n" /end ANNOTATION_TEXT
 /end ANNOTATION
/end CHARACTERISTIC
/begin CHARACTERISTIC DWC_CALIB.DWM_ThermalModel_BW.DWC_FLGINITSUMPOIL "" VALUE 0x8060FAF6 DefaultValueRecordLayout_AUTOSAR_Platform_BaseTypes_uint8 255.0 DefaultIdenticalCompu 0.0 255. FORMAT "%10.5"
 /begin ANNOTATION ANNOTATION_LABEL "Description (coming from AUTOSAR DESC field)"
  /begin ANNOTATION_TEXT "Set true to force init of clutch thermal model to sump oil temp, false to clutch cooling oil temp\r\n" /end ANNOTATION_TEXT
 /end ANNOTATION
/end CHARACTERISTIC
/begin CHARACTERISTIC DWC_CALIB.DWM_ThermalModel_BW.DWC_FLGRUNSIMTIMER "" VALUE 0x8060FAF7 DefaultValueRecordLayout_AUTOSAR_Platform_BaseTypes_uint8 255.0 DefaultIdenticalCompu 0.0 255. FORMAT "%10.5"
 /begin ANNOTATION ANNOTATION_LABEL "Description (coming from AUTOSAR DESC field)" /begin ANNOTATION_TEXT "Set true to run simulation timer\r\n" /end ANNOTATION_TEXT /end ANNOTATION
/end CHARACTERISTIC
/begin CHARACTERISTIC DWC_CALIB.DWM_ThermalModel_BW.DWC_FLGUSETARGETCOOLFLOW "" VALUE 0x8060FAF8 DefaultValueRecordLayout_AUTOSAR_Platform_BaseTypes_uint8 255.0 DefaultIdenticalCompu 0.0 255. FORMAT "%10.5"
 /begin ANNOTATION ANNOTATION_LABEL "Description (coming from AUTOSAR DESC field)" /begin ANNOTATION_TEXT "Use target cooling for thermal model.\r\n" /end ANNOTATION_TEXT /end ANNOTATION
/end CHARACTERISTIC
/begin CHARACTERISTIC DWC_CALIB.DWM_ThermalModel_BW.DWC_FLOWTHRESHHYST "" VALUE 0x8060FAE4 DefaultValueRecordLayout_AUTOSAR_Platform_BaseTypes_uint16 127.5 RB_PT_PCT_SWC_DWC_CompuMethods_flow_0p01 0.0 127.5 FORMAT "%10.5"
 /begin ANNOTATION ANNOTATION_LABEL "Description (coming from AUTOSAR DESC field)" /begin ANNOTATION_TEXT "Flow hysteresis for cooling grade\r\n" /end ANNOTATION_TEXT /end ANNOTATION
/end CHARACTERISTIC
/begin CHARACTERISTIC DWC_CALIB.DWM_ThermalModel_BW.DWC_FLOWTHRESHLOW2NORMAL "" VALUE 0x8060FAE6 DefaultValueRecordLayout_AUTOSAR_Platform_BaseTypes_uint16 127.5 RB_PT_PCT_SWC_DWC_CompuMethods_flow_0p01 0.0 127.5 FORMAT "%10.5"
 /begin ANNOTATION ANNOTATION_LABEL "Description (coming from AUTOSAR DESC field)"
  /begin ANNOTATION_TEXT "Norminal flow threshold - maximum for \"very low\".  No hysteresis applied\r\n" /end ANNOTATION_TEXT
 /end ANNOTATION
/end CHARACTERISTIC
/begin CHARACTERISTIC DWC_CALIB.DWM_ThermalModel_BW.DWC_FLOWTHRESHNORMAL2HIGH "" VALUE 0x8060FAE8 DefaultValueRecordLayout_AUTOSAR_Platform_BaseTypes_uint16 127.5 RB_PT_PCT_SWC_DWC_CompuMethods_flow_0p01 0.0 127.5 FORMAT "%10.5"
 /begin ANNOTATION ANNOTATION_LABEL "Description (coming from AUTOSAR DESC field)"
  /begin ANNOTATION_TEXT "Norminal flow threshold - maximum for \"normal\".  No hysteresis applied\r\n" /end ANNOTATION_TEXT
 /end ANNOTATION
/end CHARACTERISTIC
/begin CHARACTERISTIC DWC_CALIB.DWM_ThermalModel_BW.DWC_TF_SIM_COOLINGFLOW "" CURVE 0x8060FE56 RB_PT_PCT_SWC_DWC_RecordLayouts_RL_Curve_uint16_20_uint16_20 127.5 RB_PT_PCT_SWC_DWC_CompuMethods_flow_0p01 0.0 127.5 FORMAT "%10.5"
 /begin ANNOTATION ANNOTATION_LABEL "Description (coming from AUTOSAR DESC field)" /begin ANNOTATION_TEXT "Simulation looup table\r\n" /end ANNOTATION_TEXT /end ANNOTATION
 /begin AXIS_DESCR STD_AXIS NO_INPUT_QUANTITY RB_PT_PCT_SWC_DWC_CompuMethods_ratio_0p001__2 20 0.0 65.535 FORMAT "%10.5" DEPOSIT ABSOLUTE /end AXIS_DESCR
/end CHARACTERISTIC
/begin CHARACTERISTIC DWC_CALIB.DWM_ThermalModel_BW.DWC_TF_SIM_INLETTEMP "" CURVE 0x8060FEA8 RB_PT_PCT_SWC_DWC_RecordLayouts_RL_Curve_sint16_20_uint16_20 450.0 RB_PT_PCT_SWC_DWC_CompuMethods_temperature_0p1 -50. 400. FORMAT "%10.5"
 /begin ANNOTATION ANNOTATION_LABEL "Description (coming from AUTOSAR DESC field)" /begin ANNOTATION_TEXT "Simulation looup table\r\n" /end ANNOTATION_TEXT /end ANNOTATION
 /begin AXIS_DESCR STD_AXIS NO_INPUT_QUANTITY RB_PT_PCT_SWC_DWC_CompuMethods_ratio_0p001__2 20 0.0 65.535 FORMAT "%10.5" DEPOSIT ABSOLUTE /end AXIS_DESCR
/end CHARACTERISTIC
/begin CHARACTERISTIC DWC_CALIB.DWM_ThermalModel_BW.DWC_TF_SIM_K1POWER "" CURVE 0x8060FEFA RB_PT_PCT_SWC_DWC_RecordLayouts_RL_Curve_uint16_20_uint16_20 1000000.0 RB_PT_PCT_SWC_DWC_CompuMethods_ratio_20p0 0.0 1000000. FORMAT "%10.5"
 /begin ANNOTATION ANNOTATION_LABEL "Description (coming from AUTOSAR DESC field)" /begin ANNOTATION_TEXT "Simulation looup table\r\n" /end ANNOTATION_TEXT /end ANNOTATION
 /begin AXIS_DESCR STD_AXIS NO_INPUT_QUANTITY RB_PT_PCT_SWC_DWC_CompuMethods_ratio_0p001__2 20 0.0 65.535 FORMAT "%10.5" DEPOSIT ABSOLUTE /end AXIS_DESCR
/end CHARACTERISTIC
/begin CHARACTERISTIC DWC_CALIB.DWM_ThermalModel_BW.DWC_TF_SIM_K2POWER "" CURVE 0x8060FF4C RB_PT_PCT_SWC_DWC_RecordLayouts_RL_Curve_uint16_20_uint16_20 1000000.0 RB_PT_PCT_SWC_DWC_CompuMethods_ratio_20p0 0.0 1000000. FORMAT "%10.5"
 /begin ANNOTATION ANNOTATION_LABEL "Description (coming from AUTOSAR DESC field)" /begin ANNOTATION_TEXT "Simulation looup table\r\n" /end ANNOTATION_TEXT /end ANNOTATION
 /begin AXIS_DESCR STD_AXIS NO_INPUT_QUANTITY RB_PT_PCT_SWC_DWC_CompuMethods_ratio_0p001__2 20 0.0 65.535 FORMAT "%10.5" DEPOSIT ABSOLUTE /end AXIS_DESCR
/end CHARACTERISTIC
/begin CHARACTERISTIC DWC_CALIB.DWM_ThermalModel_BW.DWC_ThermalModel_K1.DWC_ENABLECLUTCHOILRISEWITHINLET "" VALUE 0x8060FE3A DefaultValueRecordLayout_AUTOSAR_Platform_BaseTypes_boolean 255.0 AUTOSAR_Platform_CompuMethods_boolean 0.0 255. FORMAT "%10.5"
 /begin ANNOTATION ANNOTATION_LABEL "Description (coming from AUTOSAR DESC field)"
  /begin ANNOTATION_TEXT "Flag to enable clutch oil temp to rise with inlet oil temp.\r\n" /end ANNOTATION_TEXT
 /end ANNOTATION
/end CHARACTERISTIC
/begin CHARACTERISTIC DWC_CALIB.DWM_ThermalModel_BW.DWC_ThermalModel_K1.DWC_FCTCOOL "" VALUE 0x8060FE34 DefaultValueRecordLayout_AUTOSAR_Platform_BaseTypes_uint16 0.5 RB_PT_PCT_SWC_DWC_CompuMethods_ratio_0p00001 0.0 0.5 FORMAT "%10.5"
 /begin ANNOTATION ANNOTATION_LABEL "Description (coming from AUTOSAR DESC field)" /begin ANNOTATION_TEXT "Cooling factor\r\n" /end ANNOTATION_TEXT /end ANNOTATION
/end CHARACTERISTIC
/begin CHARACTERISTIC DWC_CALIB.DWM_ThermalModel_BW.DWC_ThermalModel_K1.DWC_FCTHEAT "" VALUE 0x8060FE36 DefaultValueRecordLayout_AUTOSAR_Platform_BaseTypes_uint16 0.1 RB_PT_PCT_SWC_DWC_CompuMethods_ratio_0p00001 0.0 0.1 FORMAT "%10.5"
 /begin ANNOTATION ANNOTATION_LABEL "Description (coming from AUTOSAR DESC field)" /begin ANNOTATION_TEXT "Heat factor with power conversion ( x 9.549)\r\n" /end ANNOTATION_TEXT /end ANNOTATION
/end CHARACTERISTIC
/begin CHARACTERISTIC DWC_CALIB.DWM_ThermalModel_BW.DWC_ThermalModel_K1.DWC_INLETTEMPRISEFACTOR "" VALUE 0x8060FE3B DefaultValueRecordLayout_AUTOSAR_Platform_BaseTypes_uint8 1.0 RB_PT_PCT_SWC_DWC_CompuMethods_ratio_0p01 0.0 1. FORMAT "%10.5"
 /begin ANNOTATION ANNOTATION_LABEL "Description (coming from AUTOSAR DESC field)"
  /begin ANNOTATION_TEXT "Factor of inlet temp at which current temp should rise to.\r\n" /end ANNOTATION_TEXT
 /end ANNOTATION
/end CHARACTERISTIC
/begin CHARACTERISTIC DWC_CALIB.DWM_ThermalModel_BW.DWC_ThermalModel_K1.DWC_MINCOOLINGFLOW "" VALUE 0x8060FE38 DefaultValueRecordLayout_AUTOSAR_Platform_BaseTypes_uint16 0.1 RB_PT_PCT_SWC_DWC_CompuMethods_flow_0p01 0.0 0.1 FORMAT "%10.5"
 /begin ANNOTATION ANNOTATION_LABEL "Description (coming from AUTOSAR DESC field)"
  /begin ANNOTATION_TEXT "Minimum cooling flow to allow for temperature decay in no flow scenario.\r\n" /end ANNOTATION_TEXT
 /end ANNOTATION
/end CHARACTERISTIC
/begin CHARACTERISTIC DWC_CALIB.DWM_ThermalModel_BW.DWC_ThermalModel_K1OutletOil.DWC_ENABLECLUTCHOILRISEWITHINLET "" VALUE 0x8060FE42 DefaultValueRecordLayout_AUTOSAR_Platform_BaseTypes_boolean 255.0 AUTOSAR_Platform_CompuMethods_boolean 0.0 255. FORMAT "%10.5"
 /begin ANNOTATION ANNOTATION_LABEL "Description (coming from AUTOSAR DESC field)"
  /begin ANNOTATION_TEXT "Flag to enable clutch oil temp to rise with inlet oil temp.\r\n" /end ANNOTATION_TEXT
 /end ANNOTATION
/end CHARACTERISTIC
/begin CHARACTERISTIC DWC_CALIB.DWM_ThermalModel_BW.DWC_ThermalModel_K1OutletOil.DWC_FCTCOOL "" VALUE 0x8060FE3C DefaultValueRecordLayout_AUTOSAR_Platform_BaseTypes_uint16 0.5 RB_PT_PCT_SWC_DWC_CompuMethods_ratio_0p00001 0.0 0.5 FORMAT "%10.5"
 /begin ANNOTATION ANNOTATION_LABEL "Description (coming from AUTOSAR DESC field)" /begin ANNOTATION_TEXT "Cooling factor\r\n" /end ANNOTATION_TEXT /end ANNOTATION
/end CHARACTERISTIC
/begin CHARACTERISTIC DWC_CALIB.DWM_ThermalModel_BW.DWC_ThermalModel_K1OutletOil.DWC_FCTHEAT "" VALUE 0x8060FE3E DefaultValueRecordLayout_AUTOSAR_Platform_BaseTypes_uint16 0.1 RB_PT_PCT_SWC_DWC_CompuMethods_ratio_0p00001 0.0 0.1 FORMAT "%10.5"
 /begin ANNOTATION ANNOTATION_LABEL "Description (coming from AUTOSAR DESC field)" /begin ANNOTATION_TEXT "Heat factor with power conversion ( x 9.549)\r\n" /end ANNOTATION_TEXT /end ANNOTATION
/end CHARACTERISTIC
/begin CHARACTERISTIC DWC_CALIB.DWM_ThermalModel_BW.DWC_ThermalModel_K1OutletOil.DWC_INLETTEMPRISEFACTOR "" VALUE 0x8060FE43 DefaultValueRecordLayout_AUTOSAR_Platform_BaseTypes_uint8 1.0 RB_PT_PCT_SWC_DWC_CompuMethods_ratio_0p01 0.0 1. FORMAT "%10.5"
 /begin ANNOTATION ANNOTATION_LABEL "Description (coming from AUTOSAR DESC field)"
  /begin ANNOTATION_TEXT "Factor of inlet temp at which current temp should rise to.\r\n" /end ANNOTATION_TEXT
 /end ANNOTATION
/end CHARACTERISTIC
/begin CHARACTERISTIC DWC_CALIB.DWM_ThermalModel_BW.DWC_ThermalModel_K1OutletOil.DWC_MINCOOLINGFLOW "" VALUE 0x8060FE40 DefaultValueRecordLayout_AUTOSAR_Platform_BaseTypes_uint16 0.1 RB_PT_PCT_SWC_DWC_CompuMethods_flow_0p01 0.0 0.1 FORMAT "%10.5"
 /begin ANNOTATION ANNOTATION_LABEL "Description (coming from AUTOSAR DESC field)"
  /begin ANNOTATION_TEXT "Minimum cooling flow to allow for temperature decay in no flow scenario.\r\n" /end ANNOTATION_TEXT
 /end ANNOTATION
/end CHARACTERISTIC
/begin CHARACTERISTIC DWC_CALIB.DWM_ThermalModel_BW.DWC_ThermalModel_K2.DWC_ENABLECLUTCHOILRISEWITHINLET "" VALUE 0x8060FE4A DefaultValueRecordLayout_AUTOSAR_Platform_BaseTypes_boolean 255.0 AUTOSAR_Platform_CompuMethods_boolean 0.0 255. FORMAT "%10.5"
 /begin ANNOTATION ANNOTATION_LABEL "Description (coming from AUTOSAR DESC field)"
  /begin ANNOTATION_TEXT "Flag to enable clutch oil temp to rise with inlet oil temp.\r\n" /end ANNOTATION_TEXT
 /end ANNOTATION
/end CHARACTERISTIC
/begin CHARACTERISTIC DWC_CALIB.DWM_ThermalModel_BW.DWC_ThermalModel_K2.DWC_FCTCOOL "" VALUE 0x8060FE44 DefaultValueRecordLayout_AUTOSAR_Platform_BaseTypes_uint16 0.5 RB_PT_PCT_SWC_DWC_CompuMethods_ratio_0p00001 0.0 0.5 FORMAT "%10.5"
 /begin ANNOTATION ANNOTATION_LABEL "Description (coming from AUTOSAR DESC field)" /begin ANNOTATION_TEXT "Cooling factor\r\n" /end ANNOTATION_TEXT /end ANNOTATION
/end CHARACTERISTIC
/begin CHARACTERISTIC DWC_CALIB.DWM_ThermalModel_BW.DWC_ThermalModel_K2.DWC_FCTHEAT "" VALUE 0x8060FE46 DefaultValueRecordLayout_AUTOSAR_Platform_BaseTypes_uint16 0.1 RB_PT_PCT_SWC_DWC_CompuMethods_ratio_0p00001 0.0 0.1 FORMAT "%10.5"
 /begin ANNOTATION ANNOTATION_LABEL "Description (coming from AUTOSAR DESC field)" /begin ANNOTATION_TEXT "Heat factor with power conversion ( x 9.549)\r\n" /end ANNOTATION_TEXT /end ANNOTATION
/end CHARACTERISTIC
/begin CHARACTERISTIC DWC_CALIB.DWM_ThermalModel_BW.DWC_ThermalModel_K2.DWC_INLETTEMPRISEFACTOR "" VALUE 0x8060FE4B DefaultValueRecordLayout_AUTOSAR_Platform_BaseTypes_uint8 1.0 RB_PT_PCT_SWC_DWC_CompuMethods_ratio_0p01 0.0 1. FORMAT "%10.5"
 /begin ANNOTATION ANNOTATION_LABEL "Description (coming from AUTOSAR DESC field)"
  /begin ANNOTATION_TEXT "Factor of inlet temp at which current temp should rise to.\r\n" /end ANNOTATION_TEXT
 /end ANNOTATION
/end CHARACTERISTIC
/begin CHARACTERISTIC DWC_CALIB.DWM_ThermalModel_BW.DWC_ThermalModel_K2.DWC_MINCOOLINGFLOW "" VALUE 0x8060FE48 DefaultValueRecordLayout_AUTOSAR_Platform_BaseTypes_uint16 0.1 RB_PT_PCT_SWC_DWC_CompuMethods_flow_0p01 0.0 0.1 FORMAT "%10.5"
 /begin ANNOTATION ANNOTATION_LABEL "Description (coming from AUTOSAR DESC field)"
  /begin ANNOTATION_TEXT "Minimum cooling flow to allow for temperature decay in no flow scenario.\r\n" /end ANNOTATION_TEXT
 /end ANNOTATION
/end CHARACTERISTIC
/begin CHARACTERISTIC DWC_CALIB.DWM_ThermalModel_BW.DWC_ThermalModel_K2OutletOil.DWC_ENABLECLUTCHOILRISEWITHINLET "" VALUE 0x8060FE52 DefaultValueRecordLayout_AUTOSAR_Platform_BaseTypes_boolean 255.0 AUTOSAR_Platform_CompuMethods_boolean 0.0 255. FORMAT "%10.5"
 /begin ANNOTATION ANNOTATION_LABEL "Description (coming from AUTOSAR DESC field)"
  /begin ANNOTATION_TEXT "Flag to enable clutch oil temp to rise with inlet oil temp.\r\n" /end ANNOTATION_TEXT
 /end ANNOTATION
/end CHARACTERISTIC
/begin CHARACTERISTIC DWC_CALIB.DWM_ThermalModel_BW.DWC_ThermalModel_K2OutletOil.DWC_FCTCOOL "" VALUE 0x8060FE4C DefaultValueRecordLayout_AUTOSAR_Platform_BaseTypes_uint16 0.5 RB_PT_PCT_SWC_DWC_CompuMethods_ratio_0p00001 0.0 0.5 FORMAT "%10.5"
 /begin ANNOTATION ANNOTATION_LABEL "Description (coming from AUTOSAR DESC field)" /begin ANNOTATION_TEXT "Cooling factor\r\n" /end ANNOTATION_TEXT /end ANNOTATION
/end CHARACTERISTIC
/begin CHARACTERISTIC DWC_CALIB.DWM_ThermalModel_BW.DWC_ThermalModel_K2OutletOil.DWC_FCTHEAT "" VALUE 0x8060FE4E DefaultValueRecordLayout_AUTOSAR_Platform_BaseTypes_uint16 0.1 RB_PT_PCT_SWC_DWC_CompuMethods_ratio_0p00001 0.0 0.1 FORMAT "%10.5"
 /begin ANNOTATION ANNOTATION_LABEL "Description (coming from AUTOSAR DESC field)" /begin ANNOTATION_TEXT "Heat factor with power conversion ( x 9.549)\r\n" /end ANNOTATION_TEXT /end ANNOTATION
/end CHARACTERISTIC
/begin CHARACTERISTIC DWC_CALIB.DWM_ThermalModel_BW.DWC_ThermalModel_K2OutletOil.DWC_INLETTEMPRISEFACTOR "" VALUE 0x8060FE53 DefaultValueRecordLayout_AUTOSAR_Platform_BaseTypes_uint8 1.0 RB_PT_PCT_SWC_DWC_CompuMethods_ratio_0p01 0.0 1. FORMAT "%10.5"
 /begin ANNOTATION ANNOTATION_LABEL "Description (coming from AUTOSAR DESC field)"
  /begin ANNOTATION_TEXT "Factor of inlet temp at which current temp should rise to.\r\n" /end ANNOTATION_TEXT
 /end ANNOTATION
/end CHARACTERISTIC
/begin CHARACTERISTIC DWC_CALIB.DWM_ThermalModel_BW.DWC_ThermalModel_K2OutletOil.DWC_MINCOOLINGFLOW "" VALUE 0x8060FE50 DefaultValueRecordLayout_AUTOSAR_Platform_BaseTypes_uint16 0.1 RB_PT_PCT_SWC_DWC_CompuMethods_flow_0p01 0.0 0.1 FORMAT "%10.5"
 /begin ANNOTATION ANNOTATION_LABEL "Description (coming from AUTOSAR DESC field)"
  /begin ANNOTATION_TEXT "Minimum cooling flow to allow for temperature decay in no flow scenario.\r\n" /end ANNOTATION_TEXT
 /end ANNOTATION
/end CHARACTERISTIC
/begin CHARACTERISTIC DWC_CALIB.DWM_ThermalModel_BW.DWC_TimerThermalModelSimulate.LIB_DT "" VALUE 0x8060FE54 DefaultValueRecordLayout_AUTOSAR_Platform_BaseTypes_uint16 65.535 RB_PT_PCT_SWC_DWC_CompuMethods_ratio_0p001__2 0.0 65.535 FORMAT "%10.5"
 /begin ANNOTATION ANNOTATION_LABEL "Description (coming from AUTOSAR DESC field)" /begin ANNOTATION_TEXT "Timer decrement value.\r\n" /end ANNOTATION_TEXT /end ANNOTATION
/end CHARACTERISTIC
/begin CHARACTERISTIC DWC_CLEARADAPTIONS "Boolean" VALUE 0x806040A0 DefaultValueRecordLayout_AUTOSAR_Platform_BaseTypes_boolean 255.0 AUTOSAR_Platform_CompuMethods_boolean 0.0 255. FORMAT "%10.5"
 /begin ANNOTATION ANNOTATION_LABEL "Description (coming from AUTOSAR DESC field)" /begin ANNOTATION_TEXT "Flag to force clear of adaptions\r\n" /end ANNOTATION_TEXT /end ANNOTATION
/end CHARACTERISTIC
/begin CHARACTERISTIC DWC_EFLASHB.BOB_DWCINPUTS "" VALUE 0x80609874 DefaultValueRecordLayout_AUTOSAR_Platform_BaseTypes_uint16 65535.0 RB_PT_PCT_SWC_DWC_CompuMethods_ident 0.0 65535. FORMAT "%10.5"
 /begin ANNOTATION ANNOTATION_LABEL "Description (coming from AUTOSAR DESC field)"
  /begin ANNOTATION_TEXT "Break out box request to override the SEQ commands to DWC\r\n" /end ANNOTATION_TEXT
 /end ANNOTATION
/end CHARACTERISTIC
/begin CHARACTERISTIC DWC_EFLASHB.BOB_SEQCURRENTTORQUEGEAR "" VALUE 0x806098B8 DefaultValueRecordLayout_AUTOSAR_Platform_BaseTypes_uint8 11.0 RB_PT_PCT_SWC_DWC_CompuMethods_ident 0.0 11. FORMAT "%10.5"
 /begin ANNOTATION ANNOTATION_LABEL "Description (coming from AUTOSAR DESC field)" /begin ANNOTATION_TEXT "Break out box override for SEQ Current Torque Gear\r\n" /end ANNOTATION_TEXT /end ANNOTATION
/end CHARACTERISTIC
/begin CHARACTERISTIC DWC_EFLASHB.BOB_SEQFINALTARGETGEAR "" VALUE 0x806098B9 DefaultValueRecordLayout_AUTOSAR_Platform_BaseTypes_uint8 11.0 RB_PT_PCT_SWC_DWC_CompuMethods_ident 0.0 11. FORMAT "%10.5"
 /begin ANNOTATION ANNOTATION_LABEL "Description (coming from AUTOSAR DESC field)" /begin ANNOTATION_TEXT "Break out box override for SEQ Final Target Gear\r\n" /end ANNOTATION_TEXT /end ANNOTATION
/end CHARACTERISTIC
/begin CHARACTERISTIC DWC_EFLASHB.BOB_SEQK1REQUEST "" VALUE 0x806098BA DefaultValueRecordLayout_AUTOSAR_Platform_BaseTypes_uint8 7.0 RB_PT_PCT_SWC_DWC_CompuMethods_Enumerations_DWC_Command 0.0 7. FORMAT "%10.5"
 /begin ANNOTATION ANNOTATION_LABEL "Description (coming from AUTOSAR DESC field)" /begin ANNOTATION_TEXT "Enumerated request to clutch state machine\r\n" /end ANNOTATION_TEXT /end ANNOTATION
/end CHARACTERISTIC
/begin CHARACTERISTIC DWC_EFLASHB.BOB_SEQK2REQUEST "" VALUE 0x806098BB DefaultValueRecordLayout_AUTOSAR_Platform_BaseTypes_uint8 7.0 RB_PT_PCT_SWC_DWC_CompuMethods_Enumerations_DWC_Command 0.0 7. FORMAT "%10.5"
 /begin ANNOTATION ANNOTATION_LABEL "Description (coming from AUTOSAR DESC field)" /begin ANNOTATION_TEXT "Enumerated request to clutch state machine\r\n" /end ANNOTATION_TEXT /end ANNOTATION
/end CHARACTERISTIC
/begin CHARACTERISTIC DWC_EFLASHB.BOB_SEQSHIFTTYPE "" VALUE 0x806098BC DefaultValueRecordLayout_AUTOSAR_Platform_BaseTypes_uint8 7.0 RB_PT_PCT_SWC_DWC_CompuMethods_Enumerations_SEQ_ShiftDescription 0.0 7. FORMAT "%10.5"
 /begin ANNOTATION ANNOTATION_LABEL "Description (coming from AUTOSAR DESC field)"
  /begin ANNOTATION_TEXT "Enumerated shift type override for break out box mode\r\n" /end ANNOTATION_TEXT
 /end ANNOTATION
/end CHARACTERISTIC
/begin CHARACTERISTIC DWC_EFLASHB.BOB_SEQTARGETGEAR "" VALUE 0x806098BD DefaultValueRecordLayout_AUTOSAR_Platform_BaseTypes_uint8 11.0 RB_PT_PCT_SWC_DWC_CompuMethods_ident 0.0 11. FORMAT "%10.5"
 /begin ANNOTATION ANNOTATION_LABEL "Description (coming from AUTOSAR DESC field)" /begin ANNOTATION_TEXT "Break out box override for SEQ Target Gear\r\n" /end ANNOTATION_TEXT /end ANNOTATION
/end CHARACTERISTIC
/begin CHARACTERISTIC DWC_EFLASHB.DWC_AUTOTIMETOSHIFTFACTOR "" MAP 0x8060E41E RB_PT_PCT_SWC_DWC_RecordLayouts_RL_Map_uint8_25_uint16_5_sint16_5 1.0 RB_PT_PCT_SWC_DWC_CompuMethods_ratio_0p01 0.0 1. FORMAT "%10.5"
 /begin ANNOTATION ANNOTATION_LABEL "Description (coming from AUTOSAR DESC field)"
  /begin ANNOTATION_TEXT "Factor of time to shift to use in auto mode vs. RPM and torque\r\n" /end ANNOTATION_TEXT
 /end ANNOTATION
 /begin AXIS_DESCR STD_AXIS NO_INPUT_QUANTITY RB_PT_PCT_SWC_DWC_CompuMethods_ident 5 0.0 20000. FORMAT "%10.5" DEPOSIT ABSOLUTE /end AXIS_DESCR
 /begin AXIS_DESCR STD_AXIS NO_INPUT_QUANTITY RB_PT_PCT_SWC_DWC_CompuMethods_ratio_0p1 5 -2000. 2000. FORMAT "%10.5" DEPOSIT ABSOLUTE /end AXIS_DESCR
/end CHARACTERISTIC
/begin CHARACTERISTIC DWC_EFLASHB.DWC_AUTOTIMETOSHIFTFACTORLOWGEAR "" MAP 0x8060E450 RB_PT_PCT_SWC_DWC_RecordLayouts_RL_Map_uint8_25_uint16_5_sint16_5 1.0 RB_PT_PCT_SWC_DWC_CompuMethods_ratio_0p01 0.0 1. FORMAT "%10.5"
 /begin ANNOTATION ANNOTATION_LABEL "Description (coming from AUTOSAR DESC field)"
  /begin ANNOTATION_TEXT "Factor of time to shift to use in auto mode vs. RPM and torque\r\n" /end ANNOTATION_TEXT
 /end ANNOTATION
 /begin AXIS_DESCR STD_AXIS NO_INPUT_QUANTITY RB_PT_PCT_SWC_DWC_CompuMethods_ident 5 0.0 20000. FORMAT "%10.5" DEPOSIT ABSOLUTE /end AXIS_DESCR
 /begin AXIS_DESCR STD_AXIS NO_INPUT_QUANTITY RB_PT_PCT_SWC_DWC_CompuMethods_ratio_0p1 5 -2000. 2000. FORMAT "%10.5" DEPOSIT ABSOLUTE /end AXIS_DESCR
/end CHARACTERISTIC
/begin CHARACTERISTIC DWC_EFLASHB.DWC_BITIDTOBOTHCLUTCHDRAGALWAYS "" VALUE 0x806098BE DefaultValueRecordLayout_AUTOSAR_Platform_BaseTypes_uint8 255.0 RB_PT_PCT_SWC_DWC_CompuMethods_ident 0.0 255. FORMAT "%10.5"
 /begin ANNOTATION ANNOTATION_LABEL "Description (coming from AUTOSAR DESC field)" /begin ANNOTATION_TEXT "which loss ID to use both clutch drag components\r\n" /end ANNOTATION_TEXT /end ANNOTATION
/end CHARACTERISTIC
/begin CHARACTERISTIC DWC_EFLASHB.DWC_BITIDTOUSEPARASITICLOSS "" VALUE 0x806098BF DefaultValueRecordLayout_AUTOSAR_Platform_BaseTypes_uint8 255.0 RB_PT_PCT_SWC_DWC_CompuMethods_ident 0.0 255. FORMAT "%10.5"
 /begin ANNOTATION ANNOTATION_LABEL "Description (coming from AUTOSAR DESC field)" /begin ANNOTATION_TEXT "which loss ID to use parastitic loss\r\n" /end ANNOTATION_TEXT /end ANNOTATION
/end CHARACTERISTIC
/begin CHARACTERISTIC DWC_EFLASHB.DWC_BITIDTOUSEPUMPDRAGTORQUE "" VALUE 0x806098C0 DefaultValueRecordLayout_AUTOSAR_Platform_BaseTypes_uint8 255.0 RB_PT_PCT_SWC_DWC_CompuMethods_ident 0.0 255. FORMAT "%10.5"
 /begin ANNOTATION ANNOTATION_LABEL "Description (coming from AUTOSAR DESC field)"
  /begin ANNOTATION_TEXT "which loss ID to use pump drag loss instead of overall drag\r\n" /end ANNOTATION_TEXT
 /end ANNOTATION
/end CHARACTERISTIC
/begin CHARACTERISTIC DWC_EFLASHB.DWC_BOBCLUTCHOSCILLATEWARN "" VALUE 0x806098C1 DefaultValueRecordLayout_AUTOSAR_Platform_BaseTypes_boolean 255.0 AUTOSAR_Platform_CompuMethods_boolean 0.0 255. FORMAT "%10.5"
 /begin ANNOTATION ANNOTATION_LABEL "Description (coming from AUTOSAR DESC field)"
  /begin ANNOTATION_TEXT "Flag to force a request to warn the driver using clutch oscillation\r\n" /end ANNOTATION_TEXT
 /end ANNOTATION
/end CHARACTERISTIC
/begin CHARACTERISTIC DWC_EFLASHB.DWC_CLUTCHCOOLINGTEMPERATUREREENABLE "" VALUE 0x80609876 DefaultValueRecordLayout_AUTOSAR_Platform_BaseTypes_sint16 250.0 RB_PT_PCT_SWC_DWC_CompuMethods_ratio_0p01 -50. 200. FORMAT "%10.5"
 /begin ANNOTATION ANNOTATION_LABEL "Description (coming from AUTOSAR DESC field)"
  /begin ANNOTATION_TEXT "Clutch cooling temperature for clutch use to be re-allowed after overheat\r\n" /end ANNOTATION_TEXT
 /end ANNOTATION
/end CHARACTERISTIC
/begin CHARACTERISTIC DWC_EFLASHB.DWC_CLUTCHSUMPTEMPERATUREREENABLE "" VALUE 0x80609878 DefaultValueRecordLayout_AUTOSAR_Platform_BaseTypes_sint16 250.0 RB_PT_PCT_SWC_DWC_CompuMethods_ratio_0p01 -50. 200. FORMAT "%10.5"
 /begin ANNOTATION ANNOTATION_LABEL "Description (coming from AUTOSAR DESC field)"
  /begin ANNOTATION_TEXT "Clutch sump temperature for clutch use to be re-allowed after overheat\r\n" /end ANNOTATION_TEXT
 /end ANNOTATION
/end CHARACTERISTIC
/begin CHARACTERISTIC DWC_EFLASHB.DWC_CLUTCHWARNTEMPHYST "" VALUE 0x8060987A DefaultValueRecordLayout_AUTOSAR_Platform_BaseTypes_uint16 399.0 RB_PT_PCT_SWC_DWC_CompuMethods_ratio_0p01 1. 400. FORMAT "%10.5"
 /begin ANNOTATION ANNOTATION_LABEL "Description (coming from AUTOSAR DESC field)"
  /begin ANNOTATION_TEXT "Temperature hysteresis applied once a cluthc oscillation warning is requested\r\n" /end ANNOTATION_TEXT
 /end ANNOTATION
/end CHARACTERISTIC
/begin CHARACTERISTIC DWC_EFLASHB.DWC_CreepTorqueLossFilter.DWC_FIRSTORDERLPCOEFF "" VALUE 0x806098CD DefaultValueRecordLayout_AUTOSAR_Platform_BaseTypes_uint8 1.0 RB_PT_PCT_SWC_DWC_CompuMethods_ratio_0p01 0.0 1. FORMAT "%10.5"
 /begin ANNOTATION ANNOTATION_LABEL "Description (coming from AUTOSAR DESC field)" /begin ANNOTATION_TEXT "Coefficient for low pass IIR filter\r\n" /end ANNOTATION_TEXT /end ANNOTATION
/end CHARACTERISTIC
/begin CHARACTERISTIC DWC_EFLASHB.DWC_DragTorqueLossFilter.DWC_FIRSTORDERLPCOEFF "" VALUE 0x806098CE DefaultValueRecordLayout_AUTOSAR_Platform_BaseTypes_uint8 1.0 RB_PT_PCT_SWC_DWC_CompuMethods_ratio_0p01 0.0 1. FORMAT "%10.5"
 /begin ANNOTATION ANNOTATION_LABEL "Description (coming from AUTOSAR DESC field)" /begin ANNOTATION_TEXT "Coefficient for low pass IIR filter\r\n" /end ANNOTATION_TEXT /end ANNOTATION
/end CHARACTERISTIC
/begin CHARACTERISTIC DWC_EFLASHB.DWC_FLGENABLELOSSESRATELIMITER "" VALUE 0x806098C2 DefaultValueRecordLayout_AUTOSAR_Platform_BaseTypes_boolean 255.0 AUTOSAR_Platform_CompuMethods_boolean 0.0 255. FORMAT "%10.5"
 /begin ANNOTATION ANNOTATION_LABEL "Description (coming from AUTOSAR DESC field)"
  /begin ANNOTATION_TEXT "Flag to use new temperature dependent rate limiter for torque losses\r\n" /end ANNOTATION_TEXT
 /end ANNOTATION
/end CHARACTERISTIC
/begin CHARACTERISTIC DWC_EFLASHB.DWC_FLGREMOVEVISCOUSDRAGFROMPARASITICLOSS "" VALUE 0x806098C3 DefaultValueRecordLayout_AUTOSAR_Platform_BaseTypes_boolean 255.0 AUTOSAR_Platform_CompuMethods_boolean 0.0 255. FORMAT "%10.5"
 /begin ANNOTATION ANNOTATION_LABEL "Description (coming from AUTOSAR DESC field)"
  /begin ANNOTATION_TEXT "Flag to keep viscous drag component in parasitic loss estimate\r\n" /end ANNOTATION_TEXT
 /end ANNOTATION
/end CHARACTERISTIC
/begin CHARACTERISTIC DWC_EFLASHB.DWC_FORCEZEROTIMETOSHIFT "" VALUE 0x806098C4 DefaultValueRecordLayout_AUTOSAR_Platform_BaseTypes_boolean 255.0 AUTOSAR_Platform_CompuMethods_boolean 0.0 255. FORMAT "%10.5"
 /begin ANNOTATION ANNOTATION_LABEL "Description (coming from AUTOSAR DESC field)" /begin ANNOTATION_TEXT "Force time to shift to zero\r\n" /end ANNOTATION_TEXT /end ANNOTATION
/end CHARACTERISTIC
/begin CHARACTERISTIC DWC_EFLASHB.DWC_GEAROILTEMPLOWERMAXTIME "" VALUE 0x8060987C DefaultValueRecordLayout_AUTOSAR_Platform_BaseTypes_uint16 327.675 RB_PT_PCT_SWC_DWC_CompuMethods_time_0p005 0.0 327.675 FORMAT "%10.5"
 /begin ANNOTATION ANNOTATION_LABEL "Description (coming from AUTOSAR DESC field)"
  /begin ANNOTATION_TEXT "Maximum time allowed for gear oil to be above the lower threshold\r\n" /end ANNOTATION_TEXT
 /end ANNOTATION
/end CHARACTERISTIC
/begin CHARACTERISTIC DWC_EFLASHB.DWC_INCLUDEPUMPTORQUEINCREEPLOAD "" VALUE 0x806098C5 DefaultValueRecordLayout_AUTOSAR_Platform_BaseTypes_boolean 255.0 AUTOSAR_Platform_CompuMethods_boolean 0.0 255. FORMAT "%10.5"
 /begin ANNOTATION ANNOTATION_LABEL "Description (coming from AUTOSAR DESC field)" /begin ANNOTATION_TEXT "Flag to include the pump drag element in creep load\r\n" /end ANNOTATION_TEXT /end ANNOTATION
/end CHARACTERISTIC
/begin CHARACTERISTIC DWC_EFLASHB.DWC_INCLUDEPUMPTORQUEINDRAGTOEMS "" VALUE 0x806098C6 DefaultValueRecordLayout_AUTOSAR_Platform_BaseTypes_boolean 255.0 AUTOSAR_Platform_CompuMethods_boolean 0.0 255. FORMAT "%10.5"
 /begin ANNOTATION ANNOTATION_LABEL "Description (coming from AUTOSAR DESC field)"
  /begin ANNOTATION_TEXT "Flag to include the pump drag element in drag torque sent to EMS\r\n" /end ANNOTATION_TEXT
 /end ANNOTATION
/end CHARACTERISTIC
/begin CHARACTERISTIC DWC_EFLASHB.DWC_INCLUDESHAFTFRICTIONINPARASITICLOSSES "" VALUE 0x806098C7 DefaultValueRecordLayout_AUTOSAR_Platform_BaseTypes_boolean 255.0 AUTOSAR_Platform_CompuMethods_boolean 0.0 255. FORMAT "%10.5"
 /begin ANNOTATION ANNOTATION_LABEL "Description (coming from AUTOSAR DESC field)"
  /begin ANNOTATION_TEXT "Flag to include the pump drag element in parasitic losses\r\n" /end ANNOTATION_TEXT
 /end ANNOTATION
/end CHARACTERISTIC
/begin CHARACTERISTIC DWC_EFLASHB.DWC_INCLUDEVISCOUSDRAGINCREEPLOAD "" VALUE 0x806098C8 DefaultValueRecordLayout_AUTOSAR_Platform_BaseTypes_boolean 255.0 AUTOSAR_Platform_CompuMethods_boolean 0.0 255. FORMAT "%10.5"
 /begin ANNOTATION ANNOTATION_LABEL "Description (coming from AUTOSAR DESC field)"
  /begin ANNOTATION_TEXT "Flag to include the visocus drag element in creep load\r\n" /end ANNOTATION_TEXT
 /end ANNOTATION
/end CHARACTERISTIC
/begin CHARACTERISTIC DWC_EFLASHB.DWC_INCLUDEVISCOUSDRAGINDRAGTOEMS "" VALUE 0x806098C9 DefaultValueRecordLayout_AUTOSAR_Platform_BaseTypes_boolean 255.0 AUTOSAR_Platform_CompuMethods_boolean 0.0 255. FORMAT "%10.5"
 /begin ANNOTATION ANNOTATION_LABEL "Description (coming from AUTOSAR DESC field)"
  /begin ANNOTATION_TEXT "Flag to include the visocus drag element in drag torque sent to EMS\r\n" /end ANNOTATION_TEXT
 /end ANNOTATION
/end CHARACTERISTIC
/begin CHARACTERISTIC DWC_EFLASHB.DWC_InputProcessing.DWC_AggLPAccel.DWC_FIRSTORDERLPCOEFF "" VALUE 0x806098D7 DefaultValueRecordLayout_AUTOSAR_Platform_BaseTypes_uint8 1.0 RB_PT_PCT_SWC_DWC_CompuMethods_ratio_0p01 0.0 1. FORMAT "%10.5"
 /begin ANNOTATION ANNOTATION_LABEL "Description (coming from AUTOSAR DESC field)" /begin ANNOTATION_TEXT "Coefficient for low pass IIR filter\r\n" /end ANNOTATION_TEXT /end ANNOTATION
/end CHARACTERISTIC
/begin CHARACTERISTIC DWC_EFLASHB.DWC_InputProcessing.DWC_AntiOscillationFilter.DWC_ERRORMAX "" VALUE 0x806098D8 DefaultValueRecordLayout_AUTOSAR_Platform_BaseTypes_sint16 40000.0 RB_PT_PCT_SWC_DWC_CompuMethods_ident -20000. 20000. FORMAT "%10.5"
 /begin ANNOTATION ANNOTATION_LABEL "Description (coming from AUTOSAR DESC field)" /begin ANNOTATION_TEXT "Maximum raw error\r\n" /end ANNOTATION_TEXT /end ANNOTATION
/end CHARACTERISTIC
/begin CHARACTERISTIC DWC_EFLASHB.DWC_InputProcessing.DWC_AntiOscillationFilter.DWC_ERRORMIN "" VALUE 0x806098DA DefaultValueRecordLayout_AUTOSAR_Platform_BaseTypes_sint16 40000.0 RB_PT_PCT_SWC_DWC_CompuMethods_ident -20000. 20000. FORMAT "%10.5"
 /begin ANNOTATION ANNOTATION_LABEL "Description (coming from AUTOSAR DESC field)" /begin ANNOTATION_TEXT "Minimum raw error\r\n" /end ANNOTATION_TEXT /end ANNOTATION
/end CHARACTERISTIC
/begin CHARACTERISTIC DWC_EFLASHB.DWC_InputProcessing.DWC_AntiOscillationFilter.DWC_INTEGRATORGAIN "" VALUE 0x806098E0 DefaultValueRecordLayout_AUTOSAR_Platform_BaseTypes_uint8 1.0 RB_PT_PCT_SWC_DWC_CompuMethods_ratio_0p1 0.0 1. FORMAT "%10.5"
 /begin ANNOTATION ANNOTATION_LABEL "Description (coming from AUTOSAR DESC field)" /begin ANNOTATION_TEXT "Gain of integrator I term\r\n" /end ANNOTATION_TEXT /end ANNOTATION
/end CHARACTERISTIC
/begin CHARACTERISTIC DWC_EFLASHB.DWC_InputProcessing.DWC_AntiOscillationFilter.DWC_INTEGRATORMAX "" VALUE 0x806098DC DefaultValueRecordLayout_AUTOSAR_Platform_BaseTypes_sint16 40000.0 RB_PT_PCT_SWC_DWC_CompuMethods_ident -20000. 20000. FORMAT "%10.5"
 /begin ANNOTATION ANNOTATION_LABEL "Description (coming from AUTOSAR DESC field)" /begin ANNOTATION_TEXT "Maximum value for integrator\r\n" /end ANNOTATION_TEXT /end ANNOTATION
/end CHARACTERISTIC
/begin CHARACTERISTIC DWC_EFLASHB.DWC_InputProcessing.DWC_AntiOscillationFilter.DWC_INTEGRATORMIN "" VALUE 0x806098DE DefaultValueRecordLayout_AUTOSAR_Platform_BaseTypes_sint16 40000.0 RB_PT_PCT_SWC_DWC_CompuMethods_ident -20000. 20000. FORMAT "%10.5"
 /begin ANNOTATION ANNOTATION_LABEL "Description (coming from AUTOSAR DESC field)" /begin ANNOTATION_TEXT "Minimum value for integrator\r\n" /end ANNOTATION_TEXT /end ANNOTATION
/end CHARACTERISTIC
/begin CHARACTERISTIC DWC_EFLASHB.DWC_InputProcessing.DWC_AntiOscillationFilter.DWC_TIMECONSTDEC "" VALUE 0x806098E1 DefaultValueRecordLayout_AUTOSAR_Platform_BaseTypes_uint8 0.495 RB_PT_PCT_SWC_DWC_CompuMethods_ratio_0p005 0.005 0.5 FORMAT "%10.5"
 /begin ANNOTATION ANNOTATION_LABEL "Description (coming from AUTOSAR DESC field)" /begin ANNOTATION_TEXT "Deccrease rate of time constant\r\n" /end ANNOTATION_TEXT /end ANNOTATION
/end CHARACTERISTIC
/begin CHARACTERISTIC DWC_EFLASHB.DWC_InputProcessing.DWC_AntiOscillationFilter.DWC_TIMECONSTINC "" VALUE 0x806098E2 DefaultValueRecordLayout_AUTOSAR_Platform_BaseTypes_uint8 0.495 RB_PT_PCT_SWC_DWC_CompuMethods_ratio_0p005 0.005 0.5 FORMAT "%10.5"
 /begin ANNOTATION ANNOTATION_LABEL "Description (coming from AUTOSAR DESC field)" /begin ANNOTATION_TEXT "Increase rate of time constant\r\n" /end ANNOTATION_TEXT /end ANNOTATION
/end CHARACTERISTIC
/begin CHARACTERISTIC DWC_EFLASHB.DWC_InputProcessing.DWC_AntiOscillationFilter.DWC_TIMECONSTMAX "" VALUE 0x806098E3 DefaultValueRecordLayout_AUTOSAR_Platform_BaseTypes_uint8 0.495 RB_PT_PCT_SWC_DWC_CompuMethods_ratio_0p005 0.005 0.5 FORMAT "%10.5"
 /begin ANNOTATION ANNOTATION_LABEL "Description (coming from AUTOSAR DESC field)" /begin ANNOTATION_TEXT "Maximum for time constant\r\n" /end ANNOTATION_TEXT /end ANNOTATION
/end CHARACTERISTIC
/begin CHARACTERISTIC DWC_EFLASHB.DWC_InputProcessing.DWC_AntiOscillationFilter.DWC_TIMECONSTMIN "" VALUE 0x806098E4 DefaultValueRecordLayout_AUTOSAR_Platform_BaseTypes_uint8 0.495 RB_PT_PCT_SWC_DWC_CompuMethods_ratio_0p005 0.005 0.5 FORMAT "%10.5"
 /begin ANNOTATION ANNOTATION_LABEL "Description (coming from AUTOSAR DESC field)" /begin ANNOTATION_TEXT "Minimum for time constant\r\n" /end ANNOTATION_TEXT /end ANNOTATION
/end CHARACTERISTIC
/begin CHARACTERISTIC DWC_EFLASHB.DWC_InputProcessing.DWC_BOBLAUNCHSTATE "" VALUE 0x806098D2 DefaultValueRecordLayout_AUTOSAR_Platform_BaseTypes_uint8 3.0 RB_PT_PCT_SWC_DWC_CompuMethods_Enumerations_DWC_LaunchCommand 0.0 3. FORMAT "%10.5"
 /begin ANNOTATION ANNOTATION_LABEL "Description (coming from AUTOSAR DESC field)" /begin ANNOTATION_TEXT "Parameter to force higher launch states for testing\r\n" /end ANNOTATION_TEXT /end ANNOTATION
/end CHARACTERISTIC
/begin CHARACTERISTIC DWC_EFLASHB.DWC_InputProcessing.DWC_BRAKEPRESSAGGRESSIONFACTOR "" VALUE 0x806098D3 DefaultValueRecordLayout_AUTOSAR_Platform_BaseTypes_uint8 10.0 RB_PT_PCT_SWC_DWC_CompuMethods_ratio_0p1 0.0 10. FORMAT "%10.5"
 /begin ANNOTATION ANNOTATION_LABEL "Description (coming from AUTOSAR DESC field)" /begin ANNOTATION_TEXT "Multiplier on brake pressure to get aggression\r\n" /end ANNOTATION_TEXT /end ANNOTATION
/end CHARACTERISTIC
/begin CHARACTERISTIC DWC_EFLASHB.DWC_InputProcessing.DWC_DRIVERAGGFACTORLATACC "" CURVE 0x806099AE RB_PT_PCT_SWC_DWC_RecordLayouts_RL_Curve_uint8_7_sint8_7 1.0 RB_PT_PCT_SWC_DWC_CompuMethods_ratio_0p01 0.0 1. FORMAT "%10.5"
 /begin ANNOTATION ANNOTATION_LABEL "Description (coming from AUTOSAR DESC field)"
  /begin ANNOTATION_TEXT "Driver aggression multiplication factor based on lateral acceleration\r\n" /end ANNOTATION_TEXT
 /end ANNOTATION
 /begin AXIS_DESCR STD_AXIS NO_INPUT_QUANTITY RB_PT_PCT_SWC_DWC_CompuMethods_ratio_0p01 7 -1.28 1.27 FORMAT "%10.5" DEPOSIT ABSOLUTE /end AXIS_DESCR
/end CHARACTERISTIC
/begin CHARACTERISTIC DWC_EFLASHB.DWC_InputProcessing.DWC_K1PressureCorrect.DWC_MAXTEMPDELTAADAPT "" VALUE 0x806098EA DefaultValueRecordLayout_AUTOSAR_Platform_BaseTypes_uint8 150.0 RB_PT_PCT_SWC_DWC_CompuMethods_ident 0.0 150. FORMAT "%10.5"
 /begin ANNOTATION ANNOTATION_LABEL "Description (coming from AUTOSAR DESC field)"
  /begin ANNOTATION_TEXT "Maximum adaptation temperature delta for normal adaptations\r\n" /end ANNOTATION_TEXT
 /end ANNOTATION
/end CHARACTERISTIC
/begin CHARACTERISTIC DWC_EFLASHB.DWC_InputProcessing.DWC_K1PressureCorrect.DWC_MINTIMEPOINTSTABLE "" VALUE 0x806098E6 DefaultValueRecordLayout_AUTOSAR_Platform_BaseTypes_uint16 6553.5 RB_PT_PCT_SWC_DWC_CompuMethods_ratio_0p1 0.0 6553.5 FORMAT "%10.5"
 /begin ANNOTATION ANNOTATION_LABEL "Description (coming from AUTOSAR DESC field)"
  /begin ANNOTATION_TEXT "Minimum time of adaptation at a point before a stable result is accepted - below this proximity is ignored\r\n" /end ANNOTATION_TEXT
 /end ANNOTATION
/end CHARACTERISTIC
/begin CHARACTERISTIC DWC_EFLASHB.DWC_InputProcessing.DWC_K1PressureCorrect.DWC_TEMPERATUREFIXEDADAPT "" VALUE 0x806098E8 DefaultValueRecordLayout_AUTOSAR_Platform_BaseTypes_sint16 250.0 RB_PT_PCT_SWC_DWC_CompuMethods_ident -50. 200. FORMAT "%10.5"
 /begin ANNOTATION ANNOTATION_LABEL "Description (coming from AUTOSAR DESC field)"
  /begin ANNOTATION_TEXT "Temperature at which to fix all adaptations (forces single point adaptation +200C = off)\r\n" /end ANNOTATION_TEXT
 /end ANNOTATION
/end CHARACTERISTIC
/begin CHARACTERISTIC DWC_EFLASHB.DWC_InputProcessing.DWC_K2PressureCorrect.DWC_MAXTEMPDELTAADAPT "" VALUE 0x806098F0 DefaultValueRecordLayout_AUTOSAR_Platform_BaseTypes_uint8 150.0 RB_PT_PCT_SWC_DWC_CompuMethods_ident 0.0 150. FORMAT "%10.5"
 /begin ANNOTATION ANNOTATION_LABEL "Description (coming from AUTOSAR DESC field)"
  /begin ANNOTATION_TEXT "Maximum adaptation temperature delta for normal adaptations\r\n" /end ANNOTATION_TEXT
 /end ANNOTATION
/end CHARACTERISTIC
/begin CHARACTERISTIC DWC_EFLASHB.DWC_InputProcessing.DWC_K2PressureCorrect.DWC_MINTIMEPOINTSTABLE "" VALUE 0x806098EC DefaultValueRecordLayout_AUTOSAR_Platform_BaseTypes_uint16 6553.5 RB_PT_PCT_SWC_DWC_CompuMethods_ratio_0p1 0.0 6553.5 FORMAT "%10.5"
 /begin ANNOTATION ANNOTATION_LABEL "Description (coming from AUTOSAR DESC field)"
  /begin ANNOTATION_TEXT "Minimum time of adaptation at a point before a stable result is accepted - below this proximity is ignored\r\n" /end ANNOTATION_TEXT
 /end ANNOTATION
/end CHARACTERISTIC
/begin CHARACTERISTIC DWC_EFLASHB.DWC_InputProcessing.DWC_K2PressureCorrect.DWC_TEMPERATUREFIXEDADAPT "" VALUE 0x806098EE DefaultValueRecordLayout_AUTOSAR_Platform_BaseTypes_sint16 250.0 RB_PT_PCT_SWC_DWC_CompuMethods_ident -50. 200. FORMAT "%10.5"
 /begin ANNOTATION ANNOTATION_LABEL "Description (coming from AUTOSAR DESC field)"
  /begin ANNOTATION_TEXT "Temperature at which to fix all adaptations (forces single point adaptation +200C = off)\r\n" /end ANNOTATION_TEXT
 /end ANNOTATION
/end CHARACTERISTIC
/begin CHARACTERISTIC DWC_EFLASHB.DWC_InputProcessing.DWC_MODESELECTELECTRIC2 "" VALUE 0x806098D4 DefaultValueRecordLayout_AUTOSAR_Platform_BaseTypes_uint8 6.0 RB_PT_PCT_SWC_DWC_CompuMethods_Enumerations_DWC_ShiftMode_PCCU 0.0 6. FORMAT "%10.5"
 /begin ANNOTATION ANNOTATION_LABEL "Description (coming from AUTOSAR DESC field)" /begin ANNOTATION_TEXT "Mode to select when in IOP_ELECTRICMODE2\r\n" /end ANNOTATION_TEXT /end ANNOTATION
/end CHARACTERISTIC
/begin CHARACTERISTIC DWC_EFLASHB.DWC_InputProcessing.DWC_UPDATEPTMODEALWAYS "" VALUE 0x806098D5 DefaultValueRecordLayout_AUTOSAR_Platform_BaseTypes_boolean 255.0 AUTOSAR_Platform_CompuMethods_boolean 0.0 255. FORMAT "%10.5"
 /begin ANNOTATION ANNOTATION_LABEL "Description (coming from AUTOSAR DESC field)"
  /begin ANNOTATION_TEXT "Flag to force constant PT mode update (otherwise it will only be done when shift not active)\r\n" /end ANNOTATION_TEXT
 /end ANNOTATION
/end CHARACTERISTIC
/begin CHARACTERISTIC DWC_EFLASHB.DWC_InputProcessing.DWC_USEDRIVERTORQUEPOSITIVEAGG "" VALUE 0x806098D6 DefaultValueRecordLayout_AUTOSAR_Platform_BaseTypes_boolean 255.0 AUTOSAR_Platform_CompuMethods_boolean 0.0 255. FORMAT "%10.5"
 /begin ANNOTATION ANNOTATION_LABEL "Description (coming from AUTOSAR DESC field)"
  /begin ANNOTATION_TEXT "Flag to enable using driver wish torque for positive aggression data\r\n" /end ANNOTATION_TEXT
 /end ANNOTATION
/end CHARACTERISTIC
/begin CHARACTERISTIC DWC_EFLASHB.DWC_InputProcessing.DWC_USEDSTMANUALFORCEMODERPM "" VALUE 0x806098D0 DefaultValueRecordLayout_AUTOSAR_Platform_BaseTypes_uint16 20000.0 RB_PT_PCT_SWC_DWC_CompuMethods_ident 0.0 20000. FORMAT "%10.5"
 /begin ANNOTATION ANNOTATION_LABEL "Description (coming from AUTOSAR DESC field)"
  /begin ANNOTATION_TEXT "Engine speed, above which manual mode data from DST will be used in DWC shift mode\r\n" /end ANNOTATION_TEXT
 /end ANNOTATION
/end CHARACTERISTIC
/begin CHARACTERISTIC DWC_EFLASHB.DWC_InputProcessing.DWC_VirtualK1Pressure.DWC_CHAMBERPRESSVSVOLUME "" CURVE 0x806098F4 RB_PT_PCT_SWC_DWC_RecordLayouts_RL_Curve_sint16_11_uint16_11 34.0 RB_PT_PCT_SWC_DWC_CompuMethods_ratio_0p001__2 -2. 32. FORMAT "%10.5"
 /begin ANNOTATION ANNOTATION_LABEL "Description (coming from AUTOSAR DESC field)" /begin ANNOTATION_TEXT "Pressure in clutch chamber vs volume\r\n" /end ANNOTATION_TEXT /end ANNOTATION
 /begin AXIS_DESCR STD_AXIS NO_INPUT_QUANTITY RB_PT_PCT_SWC_DWC_CompuMethods_ratio_0p001__2 11 0.0 41. FORMAT "%10.5" DEPOSIT ABSOLUTE /end AXIS_DESCR
/end CHARACTERISTIC
/begin CHARACTERISTIC DWC_EFLASHB.DWC_InputProcessing.DWC_VirtualK1Pressure.DWC_ValveModel.DWC_FIRSTORDERLPCOEFF "" VALUE 0x806098F2 DefaultValueRecordLayout_AUTOSAR_Platform_BaseTypes_uint8 1.0 RB_PT_PCT_SWC_DWC_CompuMethods_ratio_0p01 0.0 1. FORMAT "%10.5"
 /begin ANNOTATION ANNOTATION_LABEL "Description (coming from AUTOSAR DESC field)" /begin ANNOTATION_TEXT "Coefficient for low pass IIR filter\r\n" /end ANNOTATION_TEXT /end ANNOTATION
/end CHARACTERISTIC
/begin CHARACTERISTIC DWC_EFLASHB.DWC_InputProcessing.DWC_VirtualK1Pressure.DWC_VOLUMECHANGEVSDELTAP "" CURVE 0x80609922 RB_PT_PCT_SWC_DWC_RecordLayouts_RL_Curve_sint16_11_sint16_11 3.0 RB_PT_PCT_SWC_DWC_CompuMethods_ratio_0p0001 -1. 2. FORMAT "%10.5"
 /begin ANNOTATION ANNOTATION_LABEL "Description (coming from AUTOSAR DESC field)" /begin ANNOTATION_TEXT "Clutch volume change vs delta pressure\r\n" /end ANNOTATION_TEXT /end ANNOTATION
 /begin AXIS_DESCR STD_AXIS NO_INPUT_QUANTITY RB_PT_PCT_SWC_DWC_CompuMethods_ratio_0p001__2 11 -32. 32. FORMAT "%10.5" DEPOSIT ABSOLUTE /end AXIS_DESCR
/end CHARACTERISTIC
/begin CHARACTERISTIC DWC_EFLASHB.DWC_InputProcessing.DWC_VirtualK2Pressure.DWC_CHAMBERPRESSVSVOLUME "" CURVE 0x80609952 RB_PT_PCT_SWC_DWC_RecordLayouts_RL_Curve_sint16_11_uint16_11 34.0 RB_PT_PCT_SWC_DWC_CompuMethods_ratio_0p001__2 -2. 32. FORMAT "%10.5"
 /begin ANNOTATION ANNOTATION_LABEL "Description (coming from AUTOSAR DESC field)" /begin ANNOTATION_TEXT "Pressure in clutch chamber vs volume\r\n" /end ANNOTATION_TEXT /end ANNOTATION
 /begin AXIS_DESCR STD_AXIS NO_INPUT_QUANTITY RB_PT_PCT_SWC_DWC_CompuMethods_ratio_0p001__2 11 0.0 41. FORMAT "%10.5" DEPOSIT ABSOLUTE /end AXIS_DESCR
/end CHARACTERISTIC
/begin CHARACTERISTIC DWC_EFLASHB.DWC_InputProcessing.DWC_VirtualK2Pressure.DWC_ValveModel.DWC_FIRSTORDERLPCOEFF "" VALUE 0x80609950 DefaultValueRecordLayout_AUTOSAR_Platform_BaseTypes_uint8 1.0 RB_PT_PCT_SWC_DWC_CompuMethods_ratio_0p01 0.0 1. FORMAT "%10.5"
 /begin ANNOTATION ANNOTATION_LABEL "Description (coming from AUTOSAR DESC field)" /begin ANNOTATION_TEXT "Coefficient for low pass IIR filter\r\n" /end ANNOTATION_TEXT /end ANNOTATION
/end CHARACTERISTIC
/begin CHARACTERISTIC DWC_EFLASHB.DWC_InputProcessing.DWC_VirtualK2Pressure.DWC_VOLUMECHANGEVSDELTAP "" CURVE 0x80609980 RB_PT_PCT_SWC_DWC_RecordLayouts_RL_Curve_sint16_11_sint16_11 3.0 RB_PT_PCT_SWC_DWC_CompuMethods_ratio_0p0001 -1. 2. FORMAT "%10.5"
 /begin ANNOTATION ANNOTATION_LABEL "Description (coming from AUTOSAR DESC field)" /begin ANNOTATION_TEXT "Clutch volume change vs delta pressure\r\n" /end ANNOTATION_TEXT /end ANNOTATION
 /begin AXIS_DESCR STD_AXIS NO_INPUT_QUANTITY RB_PT_PCT_SWC_DWC_CompuMethods_ratio_0p001__2 11 -32. 32. FORMAT "%10.5" DEPOSIT ABSOLUTE /end AXIS_DESCR
/end CHARACTERISTIC
/begin CHARACTERISTIC DWC_EFLASHB.DWC_K1DeviceControl.DWC_ASGENGAGETARGETFEEDBACK "" CURVE 0x80609FF0 RB_PT_PCT_SWC_DWC_RecordLayouts_RL_Curve_sint16_5_sint16_5 4000.0 RB_PT_PCT_SWC_DWC_CompuMethods_ratio_0p1 -2000. 2000. FORMAT "%10.5"
 /begin ANNOTATION ANNOTATION_LABEL "Description (coming from AUTOSAR DESC field)"
  /begin ANNOTATION_TEXT "Target torque feedback for ASG engagement based on actual torque demand\r\n" /end ANNOTATION_TEXT
 /end ANNOTATION
 /begin AXIS_DESCR STD_AXIS NO_INPUT_QUANTITY RB_PT_PCT_SWC_DWC_CompuMethods_ratio_0p1 5 -2000. 2000. FORMAT "%10.5" DEPOSIT ABSOLUTE /end AXIS_DESCR
/end CHARACTERISTIC
/begin CHARACTERISTIC DWC_EFLASHB.DWC_K1DeviceControl.DWC_ASGEngageTimeout.DWC_TIMERDT "" VALUE 0x80609A20 DefaultValueRecordLayout_AUTOSAR_Platform_BaseTypes_uint16 10.0 RB_PT_PCT_SWC_DWC_CompuMethods_ratio_0p001__2 0.0 10. FORMAT "%10.5"
 /begin ANNOTATION ANNOTATION_LABEL "Description (coming from AUTOSAR DESC field)"
  /begin ANNOTATION_TEXT "Count down rate of timer (call rate of timed out task)\r\n" /end ANNOTATION_TEXT
 /end ANNOTATION
/end CHARACTERISTIC
/begin CHARACTERISTIC DWC_EFLASHB.DWC_K1DeviceControl.DWC_ASGSlipConditions.DWC_ASGSLIPDEBOUNCE "" VALUE 0x80609A22 DefaultValueRecordLayout_AUTOSAR_Platform_BaseTypes_uint16 10.0 RB_PT_PCT_SWC_DWC_CompuMethods_ratio_0p001__2 0.0 10. FORMAT "%10.5"
 /begin ANNOTATION ANNOTATION_LABEL "Description (coming from AUTOSAR DESC field)"
  /begin ANNOTATION_TEXT "ASG Enagement - debounce timer for low slip condition\r\n" /end ANNOTATION_TEXT
 /end ANNOTATION
/end CHARACTERISTIC
/begin CHARACTERISTIC DWC_EFLASHB.DWC_K1DeviceControl.DWC_ASGSlipConditions.DWC_ASGSLIPFORCOMPLETE "" VALUE 0x80609A24 DefaultValueRecordLayout_AUTOSAR_Platform_BaseTypes_uint16 20000.0 RB_PT_PCT_SWC_DWC_CompuMethods_ident 0.0 20000. FORMAT "%10.5"
 /begin ANNOTATION ANNOTATION_LABEL "Description (coming from AUTOSAR DESC field)"
  /begin ANNOTATION_TEXT "Magnitude of clutch slip, below which complete debounce wihh be triggered\r\n" /end ANNOTATION_TEXT
 /end ANNOTATION
/end CHARACTERISTIC
/begin CHARACTERISTIC DWC_EFLASHB.DWC_K1DeviceControl.DWC_ASGTIMEOUT "" VALUE 0x806099D8 DefaultValueRecordLayout_AUTOSAR_Platform_BaseTypes_uint16 10.0 RB_PT_PCT_SWC_DWC_CompuMethods_ratio_0p001__2 0.0 10. FORMAT "%10.5"
 /begin ANNOTATION ANNOTATION_LABEL "Description (coming from AUTOSAR DESC field)" /begin ANNOTATION_TEXT "ASG Enagement timeout\r\n" /end ANNOTATION_TEXT /end ANNOTATION
/end CHARACTERISTIC
/begin CHARACTERISTIC DWC_EFLASHB.DWC_K1DeviceControl.DWC_BOBBYPASSPREPARE "" VALUE 0x80609A14 DefaultValueRecordLayout_AUTOSAR_Platform_BaseTypes_uint8 3.0 RB_PT_PCT_SWC_DWC_CompuMethods_Enumerations_DWC_BypassType 0.0 3. FORMAT "%10.5"
 /begin ANNOTATION ANNOTATION_LABEL "Description (coming from AUTOSAR DESC field)" /begin ANNOTATION_TEXT "Bypass prepare state when in BOB mode\r\n" /end ANNOTATION_TEXT /end ANNOTATION
/end CHARACTERISTIC
/begin CHARACTERISTIC DWC_EFLASHB.DWC_K1DeviceControl.DWC_BOBDCSTATECLOSED "" VALUE 0x80609A15 DefaultValueRecordLayout_AUTOSAR_Platform_BaseTypes_boolean 255.0 AUTOSAR_Platform_CompuMethods_boolean 0.0 255. FORMAT "%10.5"
 /begin ANNOTATION ANNOTATION_LABEL "Description (coming from AUTOSAR DESC field)" /begin ANNOTATION_TEXT "Flag to enable fill cal torque demand\r\n" /end ANNOTATION_TEXT /end ANNOTATION
/end CHARACTERISTIC
/begin CHARACTERISTIC DWC_EFLASHB.DWC_K1DeviceControl.DWC_BOBDEVICECONTROL "" VALUE 0x80609A16 DefaultValueRecordLayout_AUTOSAR_Platform_BaseTypes_boolean 255.0 AUTOSAR_Platform_CompuMethods_boolean 0.0 255. FORMAT "%10.5"
 /begin ANNOTATION ANNOTATION_LABEL "Description (coming from AUTOSAR DESC field)" /begin ANNOTATION_TEXT "Flag to enable fill cal torque demand\r\n" /end ANNOTATION_TEXT /end ANNOTATION
/end CHARACTERISTIC
/begin CHARACTERISTIC DWC_EFLASHB.DWC_K1DeviceControl.DWC_BOBFILLCAL "" VALUE 0x80609A17 DefaultValueRecordLayout_AUTOSAR_Platform_BaseTypes_boolean 255.0 AUTOSAR_Platform_CompuMethods_boolean 0.0 255. FORMAT "%10.5"
 /begin ANNOTATION ANNOTATION_LABEL "Description (coming from AUTOSAR DESC field)" /begin ANNOTATION_TEXT "Flag to enable fill cal torque demand\r\n" /end ANNOTATION_TEXT /end ANNOTATION
/end CHARACTERISTIC
/begin CHARACTERISTIC DWC_EFLASHB.DWC_K1DeviceControl.DWC_BOBFILLCALTORQUE "" VALUE 0x806099DA DefaultValueRecordLayout_AUTOSAR_Platform_BaseTypes_sint16 4000.0 RB_PT_PCT_SWC_DWC_CompuMethods_ratio_0p1 -2000. 2000. FORMAT "%10.5"
 /begin ANNOTATION ANNOTATION_LABEL "Description (coming from AUTOSAR DESC field)"
  /begin ANNOTATION_TEXT "Torque demand for fill controller and clutch controller\r\n" /end ANNOTATION_TEXT
 /end ANNOTATION
/end CHARACTERISTIC
/begin CHARACTERISTIC DWC_EFLASHB.DWC_K1DeviceControl.DWC_BOBRUNFILLSEQUENCE "" VALUE 0x80609A18 DefaultValueRecordLayout_AUTOSAR_Platform_BaseTypes_boolean 255.0 AUTOSAR_Platform_CompuMethods_boolean 0.0 255. FORMAT "%10.5"
 /begin ANNOTATION ANNOTATION_LABEL "Description (coming from AUTOSAR DESC field)" /begin ANNOTATION_TEXT "Flag to enable fill cal torque demand\r\n" /end ANNOTATION_TEXT /end ANNOTATION
/end CHARACTERISTIC
/begin CHARACTERISTIC DWC_EFLASHB.DWC_K1DeviceControl.DWC_BOBSEQUENCEMAXTORQUE "" VALUE 0x806099DC DefaultValueRecordLayout_AUTOSAR_Platform_BaseTypes_sint16 4000.0 RB_PT_PCT_SWC_DWC_CompuMethods_ratio_0p1 -2000. 2000. FORMAT "%10.5"
 /begin ANNOTATION ANNOTATION_LABEL "Description (coming from AUTOSAR DESC field)" /begin ANNOTATION_TEXT "Maximum torque for engagement simulation sequence\r\n" /end ANNOTATION_TEXT /end ANNOTATION
/end CHARACTERISTIC
/begin CHARACTERISTIC DWC_EFLASHB.DWC_K1DeviceControl.DWC_BOBSEQUENCESTEPTORQUE "" VALUE 0x806099DE DefaultValueRecordLayout_AUTOSAR_Platform_BaseTypes_sint16 4000.0 RB_PT_PCT_SWC_DWC_CompuMethods_ratio_0p1 -2000. 2000. FORMAT "%10.5"
 /begin ANNOTATION ANNOTATION_LABEL "Description (coming from AUTOSAR DESC field)"
  /begin ANNOTATION_TEXT "Torque increase for close part of engagement simulation\r\n" /end ANNOTATION_TEXT
 /end ANNOTATION
/end CHARACTERISTIC
/begin CHARACTERISTIC DWC_EFLASHB.DWC_K1DeviceControl.DWC_BypassPreparePulse.DWC_BYPASSTORQUECANCEL "" VALUE 0x80609A26 DefaultValueRecordLayout_AUTOSAR_Platform_BaseTypes_sint16 4000.0 RB_PT_PCT_SWC_DWC_CompuMethods_ratio_0p1 -2000. 2000. FORMAT "%10.5"
 /begin ANNOTATION ANNOTATION_LABEL "Description (coming from AUTOSAR DESC field)" /begin ANNOTATION_TEXT "Torque level for cancelling bypass prepare\r\n" /end ANNOTATION_TEXT /end ANNOTATION
/end CHARACTERISTIC
/begin CHARACTERISTIC DWC_EFLASHB.DWC_K1DeviceControl.DWC_BypassPreparePulse.DWC_BYPASSTORQUERELOAD "" VALUE 0x80609A28 DefaultValueRecordLayout_AUTOSAR_Platform_BaseTypes_sint16 4000.0 RB_PT_PCT_SWC_DWC_CompuMethods_ratio_0p1 -2000. 2000. FORMAT "%10.5"
 /begin ANNOTATION ANNOTATION_LABEL "Description (coming from AUTOSAR DESC field)" /begin ANNOTATION_TEXT "Torque level for re-enabling bypass torque\r\n" /end ANNOTATION_TEXT /end ANNOTATION
/end CHARACTERISTIC
/begin CHARACTERISTIC DWC_EFLASHB.DWC_K1DeviceControl.DWC_BypassPreparePulse.DWC_FILLADAPTINC "" CURVE 0x80609A2A RB_PT_PCT_SWC_DWC_RecordLayouts_RL_Curve_sint16_5_sint16_5 2.0 RB_PT_PCT_SWC_DWC_CompuMethods_ratio_0p001__2 -1. 1. FORMAT "%10.5"
 /begin ANNOTATION ANNOTATION_LABEL "Description (coming from AUTOSAR DESC field)"
  /begin ANNOTATION_TEXT "Factor applied to fill time based on current line pressure\r\n" /end ANNOTATION_TEXT
 /end ANNOTATION
 /begin AXIS_DESCR STD_AXIS NO_INPUT_QUANTITY RB_PT_PCT_SWC_DWC_CompuMethods_ratio_0p001__2 5 -2. 32. FORMAT "%10.5" DEPOSIT ABSOLUTE /end AXIS_DESCR
/end CHARACTERISTIC
/begin CHARACTERISTIC DWC_EFLASHB.DWC_K1DeviceControl.DWC_BypassPreparePulse.DWC_LINEPRESSUREFACTOR "" CURVE 0x80609A40 RB_PT_PCT_SWC_DWC_RecordLayouts_RL_Curve_uint16_5_sint16_5 2.0 RB_PT_PCT_SWC_DWC_CompuMethods_ratio_0p001__2 0.0 2. FORMAT "%10.5"
 /begin ANNOTATION ANNOTATION_LABEL "Description (coming from AUTOSAR DESC field)"
  /begin ANNOTATION_TEXT "Factor applied to fill time based on current line pressure\r\n" /end ANNOTATION_TEXT
 /end ANNOTATION
 /begin AXIS_DESCR STD_AXIS NO_INPUT_QUANTITY RB_PT_PCT_SWC_DWC_CompuMethods_ratio_0p005 5 -5. 100. FORMAT "%10.5" DEPOSIT ABSOLUTE /end AXIS_DESCR
/end CHARACTERISTIC
/begin CHARACTERISTIC DWC_EFLASHB.DWC_K1DeviceControl.DWC_BypassPreparePulse.DWC_PRESSUREPULSEFACTTEMP "" MAP 0x80609A56 RB_PT_PCT_SWC_DWC_RecordLayouts_RL_Map_uint8_21_sint16_7_sint16_3 2.0 RB_PT_PCT_SWC_DWC_CompuMethods_ratio_0p1 0.0 2. FORMAT "%10.5"
 /begin ANNOTATION ANNOTATION_LABEL "Description (coming from AUTOSAR DESC field)"
  /begin ANNOTATION_TEXT "Factor of fill duration to used based on pressure at start of fill and transmission temperature\r\n" /end ANNOTATION_TEXT
 /end ANNOTATION
 /begin AXIS_DESCR STD_AXIS NO_INPUT_QUANTITY RB_PT_PCT_SWC_DWC_CompuMethods_ratio_0p001__2 7 -2. 32. FORMAT "%10.5" DEPOSIT ABSOLUTE /end AXIS_DESCR
 /begin AXIS_DESCR STD_AXIS NO_INPUT_QUANTITY RB_PT_PCT_SWC_DWC_CompuMethods_ident 3 -50. 200. FORMAT "%10.5" DEPOSIT ABSOLUTE /end AXIS_DESCR
/end CHARACTERISTIC
/begin CHARACTERISTIC DWC_EFLASHB.DWC_K1DeviceControl.DWC_BypassPreparePulse.DWC_PULSEPRESSVSTORQUE "" MAP 0x80609A84 RB_PT_PCT_SWC_DWC_RecordLayouts_RL_Map_uint16_50_uint16_10_sint16_5 32.0 RB_PT_PCT_SWC_DWC_CompuMethods_ratio_0p001__2 0.0 32. FORMAT "%10.5"
 /begin ANNOTATION ANNOTATION_LABEL "Description (coming from AUTOSAR DESC field)" /begin ANNOTATION_TEXT "Pulse pressure vs engine speed and torque\r\n" /end ANNOTATION_TEXT /end ANNOTATION
 /begin AXIS_DESCR STD_AXIS NO_INPUT_QUANTITY RB_PT_PCT_SWC_DWC_CompuMethods_ident 10 0.0 20000. FORMAT "%10.5" DEPOSIT ABSOLUTE /end AXIS_DESCR
 /begin AXIS_DESCR STD_AXIS NO_INPUT_QUANTITY RB_PT_PCT_SWC_DWC_CompuMethods_ratio_0p1 5 -2000. 2000. FORMAT "%10.5" DEPOSIT ABSOLUTE /end AXIS_DESCR
/end CHARACTERISTIC
/begin CHARACTERISTIC DWC_EFLASHB.DWC_K1DeviceControl.DWC_BypassPreparePulse.DWC_PULSETIME "" MAP 0x80609B0A RB_PT_PCT_SWC_DWC_RecordLayouts_RL_Map_uint16_50_sint16_10_sint16_5 1.5 RB_PT_PCT_SWC_DWC_CompuMethods_ratio_0p001__2 0.0 1.5 FORMAT "%10.5"
 /begin ANNOTATION ANNOTATION_LABEL "Description (coming from AUTOSAR DESC field)" /begin ANNOTATION_TEXT "Time to pulse clutch\r\n" /end ANNOTATION_TEXT /end ANNOTATION
 /begin AXIS_DESCR STD_AXIS NO_INPUT_QUANTITY RB_PT_PCT_SWC_DWC_CompuMethods_ident 10 -50. 200. FORMAT "%10.5" DEPOSIT ABSOLUTE /end AXIS_DESCR
 /begin AXIS_DESCR STD_AXIS NO_INPUT_QUANTITY RB_PT_PCT_SWC_DWC_CompuMethods_ratio_0p1 5 -2000. 2000. FORMAT "%10.5" DEPOSIT ABSOLUTE /end AXIS_DESCR
/end CHARACTERISTIC
/begin CHARACTERISTIC DWC_EFLASHB.DWC_K1DeviceControl.DWC_CHECKTEMPSTATUS "" VALUE 0x806099C0 DefaultValueRecordLayout_AUTOSAR_Platform_BaseTypes_uint32 4.294967295E9 RB_PT_PCT_SWC_DWC_CompuMethods_ident 0.0 4.294967295E9 FORMAT "%10.5"
 /begin ANNOTATION ANNOTATION_LABEL "Description (coming from AUTOSAR DESC field)" /begin ANNOTATION_TEXT "Mask to only look at temperature status.\r\n" /end ANNOTATION_TEXT /end ANNOTATION
/end CHARACTERISTIC
/begin CHARACTERISTIC DWC_EFLASHB.DWC_K1DeviceControl.DWC_ClosedPressureDiag.DWC_DITHERCHANGETIME "" VALUE 0x80609B90 DefaultValueRecordLayout_AUTOSAR_Platform_BaseTypes_uint16 10.0 RB_PT_PCT_SWC_DWC_CompuMethods_ratio_0p001__2 0.0 10. FORMAT "%10.5"
 /begin ANNOTATION ANNOTATION_LABEL "Description (coming from AUTOSAR DESC field)"
  /begin ANNOTATION_TEXT "Time for which overpressure/underpressure should be active before requesting dither change.\r\n" /end ANNOTATION_TEXT
 /end ANNOTATION
/end CHARACTERISTIC
/begin CHARACTERISTIC DWC_EFLASHB.DWC_K1DeviceControl.DWC_ClosedPressureDiag.DWC_FEEDBLANKTIME "" VALUE 0x80609B92 DefaultValueRecordLayout_AUTOSAR_Platform_BaseTypes_uint16 10.0 RB_PT_PCT_SWC_DWC_CompuMethods_ratio_0p001__2 0.0 10. FORMAT "%10.5"
 /begin ANNOTATION ANNOTATION_LABEL "Description (coming from AUTOSAR DESC field)"
  /begin ANNOTATION_TEXT "Time after failure event before system is considered to be 'healed'\r\n" /end ANNOTATION_TEXT
 /end ANNOTATION
/end CHARACTERISTIC
/begin CHARACTERISTIC DWC_EFLASHB.DWC_K1DeviceControl.DWC_ClosedPressureDiag.DWC_HEALTIME "" VALUE 0x80609B94 DefaultValueRecordLayout_AUTOSAR_Platform_BaseTypes_uint16 10.0 RB_PT_PCT_SWC_DWC_CompuMethods_ratio_0p001__2 0.0 10. FORMAT "%10.5"
 /begin ANNOTATION ANNOTATION_LABEL "Description (coming from AUTOSAR DESC field)"
  /begin ANNOTATION_TEXT "Time after failure event before system is considered to be 'healed'\r\n" /end ANNOTATION_TEXT
 /end ANNOTATION
/end CHARACTERISTIC
/begin CHARACTERISTIC DWC_EFLASHB.DWC_K1DeviceControl.DWC_ClosedPressureDiag.DWC_OVERPRESSURE "" VALUE 0x80609B96 DefaultValueRecordLayout_AUTOSAR_Platform_BaseTypes_sint16 64.0 RB_PT_PCT_SWC_DWC_CompuMethods_ratio_0p001__2 -32. 32. FORMAT "%10.5"
 /begin ANNOTATION ANNOTATION_LABEL "Description (coming from AUTOSAR DESC field)" /begin ANNOTATION_TEXT "Overpressure margin allowed\r\n" /end ANNOTATION_TEXT /end ANNOTATION
/end CHARACTERISTIC
/begin CHARACTERISTIC DWC_EFLASHB.DWC_K1DeviceControl.DWC_ClosedPressureDiag.DWC_OVERPRESSURETHRESHOLD "" VALUE 0x80609B98 DefaultValueRecordLayout_AUTOSAR_Platform_BaseTypes_sint16 64.0 RB_PT_PCT_SWC_DWC_CompuMethods_ratio_0p001__2 -32. 32. FORMAT "%10.5"
 /begin ANNOTATION ANNOTATION_LABEL "Description (coming from AUTOSAR DESC field)" /begin ANNOTATION_TEXT "Min pressure for diag.\r\n" /end ANNOTATION_TEXT /end ANNOTATION
/end CHARACTERISTIC
/begin CHARACTERISTIC DWC_EFLASHB.DWC_K1DeviceControl.DWC_ClosedPressureDiag.DWC_OVERPRESSURETIME "" VALUE 0x80609B9A DefaultValueRecordLayout_AUTOSAR_Platform_BaseTypes_uint16 10.0 RB_PT_PCT_SWC_DWC_CompuMethods_ratio_0p001__2 0.0 10. FORMAT "%10.5"
 /begin ANNOTATION ANNOTATION_LABEL "Description (coming from AUTOSAR DESC field)"
  /begin ANNOTATION_TEXT "Maximum time for overpressure condition before status change\r\n" /end ANNOTATION_TEXT
 /end ANNOTATION
/end CHARACTERISTIC
/begin CHARACTERISTIC DWC_EFLASHB.DWC_K1DeviceControl.DWC_ClosedPressureDiag.DWC_UNDERPRESSURE "" VALUE 0x80609B9C DefaultValueRecordLayout_AUTOSAR_Platform_BaseTypes_sint16 64.0 RB_PT_PCT_SWC_DWC_CompuMethods_ratio_0p001__2 -32. 32. FORMAT "%10.5"
 /begin ANNOTATION ANNOTATION_LABEL "Description (coming from AUTOSAR DESC field)" /begin ANNOTATION_TEXT "Overpressure margin allowed\r\n" /end ANNOTATION_TEXT /end ANNOTATION
/end CHARACTERISTIC
/begin CHARACTERISTIC DWC_EFLASHB.DWC_K1DeviceControl.DWC_ClosedPressureDiag.DWC_UNDERPRESSURELOWTIME "" VALUE 0x80609B9E DefaultValueRecordLayout_AUTOSAR_Platform_BaseTypes_uint16 10.0 RB_PT_PCT_SWC_DWC_CompuMethods_ratio_0p001__2 0.0 10. FORMAT "%10.5"
 /begin ANNOTATION ANNOTATION_LABEL "Description (coming from AUTOSAR DESC field)"
  /begin ANNOTATION_TEXT "Maximum time for 'low' underpressure condition before status change\r\n" /end ANNOTATION_TEXT
 /end ANNOTATION
/end CHARACTERISTIC
/begin CHARACTERISTIC DWC_EFLASHB.DWC_K1DeviceControl.DWC_ClosedPressureDiag.DWC_UNDERPRESSURETHRESHOLD "" VALUE 0x80609BA0 DefaultValueRecordLayout_AUTOSAR_Platform_BaseTypes_sint16 64.0 RB_PT_PCT_SWC_DWC_CompuMethods_ratio_0p001__2 -32. 32. FORMAT "%10.5"
 /begin ANNOTATION ANNOTATION_LABEL "Description (coming from AUTOSAR DESC field)" /begin ANNOTATION_TEXT "Overpressure margin allowed\r\n" /end ANNOTATION_TEXT /end ANNOTATION
/end CHARACTERISTIC
/begin CHARACTERISTIC DWC_EFLASHB.DWC_K1DeviceControl.DWC_ClosedPressureDiag.DWC_UNDERPRESSURETIME "" VALUE 0x80609BA2 DefaultValueRecordLayout_AUTOSAR_Platform_BaseTypes_uint16 10.0 RB_PT_PCT_SWC_DWC_CompuMethods_ratio_0p001__2 0.0 10. FORMAT "%10.5"
 /begin ANNOTATION ANNOTATION_LABEL "Description (coming from AUTOSAR DESC field)"
  /begin ANNOTATION_TEXT "Maximum time for underpressure condition before status change\r\n" /end ANNOTATION_TEXT
 /end ANNOTATION
/end CHARACTERISTIC
/begin CHARACTERISTIC DWC_EFLASHB.DWC_K1DeviceControl.DWC_CLUBLIPABORTPRESABVKP "" VALUE 0x806099E0 DefaultValueRecordLayout_AUTOSAR_Platform_BaseTypes_sint16 34.0 RB_PT_PCT_SWC_DWC_CompuMethods_ratio_0p001__2 -2. 32. FORMAT "%10.5"
 /begin ANNOTATION ANNOTATION_LABEL "Description (coming from AUTOSAR DESC field)" /begin ANNOTATION_TEXT "Clutch pressure additional to kp to abort blip.\r\n" /end ANNOTATION_TEXT /end ANNOTATION
/end CHARACTERISTIC
/begin CHARACTERISTIC DWC_EFLASHB.DWC_K1DeviceControl.DWC_CLUTCHOPENTORQUE "" VALUE 0x806099E2 DefaultValueRecordLayout_AUTOSAR_Platform_BaseTypes_sint16 4000.0 RB_PT_PCT_SWC_DWC_CompuMethods_ratio_0p1 -2000. 2000. FORMAT "%10.5"
 /begin ANNOTATION ANNOTATION_LABEL "Description (coming from AUTOSAR DESC field)" /begin ANNOTATION_TEXT "Torque request for clutch full open\r\n" /end ANNOTATION_TEXT /end ANNOTATION
/end CHARACTERISTIC
/begin CHARACTERISTIC DWC_EFLASHB.DWC_K1DeviceControl.DWC_ENABLEADAPTMASK "" VALUE 0x806099C4 DefaultValueRecordLayout_AUTOSAR_Platform_BaseTypes_uint32 4.294967295E9 RB_PT_PCT_SWC_DWC_CompuMethods_ident 0.0 4.294967295E9 FORMAT "%10.5"
 /begin ANNOTATION ANNOTATION_LABEL "Description (coming from AUTOSAR DESC field)" /begin ANNOTATION_TEXT "Mask to enable adaptions\r\n" /end ANNOTATION_TEXT /end ANNOTATION
/end CHARACTERISTIC
/begin CHARACTERISTIC DWC_EFLASHB.DWC_K1DeviceControl.DWC_ENABLEASGPREPAREWAITVOLUME "" VALUE 0x80609A19 DefaultValueRecordLayout_AUTOSAR_Platform_BaseTypes_boolean 255.0 AUTOSAR_Platform_CompuMethods_boolean 0.0 255. FORMAT "%10.5"
 /begin ANNOTATION ANNOTATION_LABEL "Description (coming from AUTOSAR DESC field)"
  /begin ANNOTATION_TEXT "Flag to enable wait in prepare phase (bypass) on ASG re-engage until volume pulse is complete\r\n" /end ANNOTATION_TEXT
 /end ANNOTATION
/end CHARACTERISTIC
/begin CHARACTERISTIC DWC_EFLASHB.DWC_K1DeviceControl.DWC_ENABLEBLIPMASK "" VALUE 0x806099C8 DefaultValueRecordLayout_AUTOSAR_Platform_BaseTypes_uint32 4.294967295E9 RB_PT_PCT_SWC_DWC_CompuMethods_ident 0.0 4.294967295E9 FORMAT "%10.5"
 /begin ANNOTATION ANNOTATION_LABEL "Description (coming from AUTOSAR DESC field)" /begin ANNOTATION_TEXT "Mask to enable cutch blip.\r\n" /end ANNOTATION_TEXT /end ANNOTATION
/end CHARACTERISTIC
/begin CHARACTERISTIC DWC_EFLASHB.DWC_K1DeviceControl.DWC_ENABLEBYPASSVOLUMEINLINE "" VALUE 0x80609A1A DefaultValueRecordLayout_AUTOSAR_Platform_BaseTypes_boolean 255.0 AUTOSAR_Platform_CompuMethods_boolean 0.0 255. FORMAT "%10.5"
 /begin ANNOTATION ANNOTATION_LABEL "Description (coming from AUTOSAR DESC field)"
  /begin ANNOTATION_TEXT "Flag to bypass volume pulse requests in output from device controller (therefore line pressure demand)\r\n" /end ANNOTATION_TEXT
 /end ANNOTATION
/end CHARACTERISTIC
/begin CHARACTERISTIC DWC_EFLASHB.DWC_K1DeviceControl.DWC_ENABLECLOSEDLOOPFILL "" VALUE 0x80609A1B DefaultValueRecordLayout_AUTOSAR_Platform_BaseTypes_boolean 255.0 AUTOSAR_Platform_CompuMethods_boolean 0.0 255. FORMAT "%10.5"
 /begin ANNOTATION ANNOTATION_LABEL "Description (coming from AUTOSAR DESC field)" /begin ANNOTATION_TEXT "Flag to enable closed loop control during fill time\r\n" /end ANNOTATION_TEXT /end ANNOTATION
/end CHARACTERISTIC
/begin CHARACTERISTIC DWC_EFLASHB.DWC_K1DeviceControl.DWC_ENABLECLOSEDLOOPPREFILL "" VALUE 0x80609A1C DefaultValueRecordLayout_AUTOSAR_Platform_BaseTypes_boolean 255.0 AUTOSAR_Platform_CompuMethods_boolean 0.0 255. FORMAT "%10.5"
 /begin ANNOTATION ANNOTATION_LABEL "Description (coming from AUTOSAR DESC field)"
  /begin ANNOTATION_TEXT "Flag to enable closed loop control during prefill time\r\n" /end ANNOTATION_TEXT
 /end ANNOTATION
/end CHARACTERISTIC
/begin CHARACTERISTIC DWC_EFLASHB.DWC_K1DeviceControl.DWC_ENABLEFILLADAPTMASK "" VALUE 0x806099CC DefaultValueRecordLayout_AUTOSAR_Platform_BaseTypes_uint32 4.294967295E9 RB_PT_PCT_SWC_DWC_CompuMethods_ident 0.0 4.294967295E9 FORMAT "%10.5"
 /begin ANNOTATION ANNOTATION_LABEL "Description (coming from AUTOSAR DESC field)" /begin ANNOTATION_TEXT "Mask to enable Fill adaption system status check.\r\n" /end ANNOTATION_TEXT /end ANNOTATION
/end CHARACTERISTIC
/begin CHARACTERISTIC DWC_EFLASHB.DWC_K1DeviceControl.DWC_ENGINERUNMAXIMUM "" VALUE 0x806099E4 DefaultValueRecordLayout_AUTOSAR_Platform_BaseTypes_uint16 20000.0 RB_PT_PCT_SWC_DWC_CompuMethods_ident 0.0 20000. FORMAT "%10.5"
 /begin ANNOTATION ANNOTATION_LABEL "Description (coming from AUTOSAR DESC field)" /begin ANNOTATION_TEXT "Maximum engine speed for engine running\r\n" /end ANNOTATION_TEXT /end ANNOTATION
/end CHARACTERISTIC
/begin CHARACTERISTIC DWC_EFLASHB.DWC_K1DeviceControl.DWC_ENGINERUNMINIMUM "" VALUE 0x806099E6 DefaultValueRecordLayout_AUTOSAR_Platform_BaseTypes_uint16 20000.0 RB_PT_PCT_SWC_DWC_CompuMethods_ident 0.0 20000. FORMAT "%10.5"
 /begin ANNOTATION ANNOTATION_LABEL "Description (coming from AUTOSAR DESC field)" /begin ANNOTATION_TEXT "Minimum engine speed for engine running\r\n" /end ANNOTATION_TEXT /end ANNOTATION
/end CHARACTERISTIC
/begin CHARACTERISTIC DWC_EFLASHB.DWC_K1DeviceControl.DWC_ENGINESTOPCLEARTIME "" VALUE 0x806099E8 DefaultValueRecordLayout_AUTOSAR_Platform_BaseTypes_sint16 64.0 RB_PT_PCT_SWC_DWC_CompuMethods_time_0p005 0.0 64. FORMAT "%10.5"
 /begin ANNOTATION ANNOTATION_LABEL "Description (coming from AUTOSAR DESC field)"
  /begin ANNOTATION_TEXT "Time after engine restarted before engine stop demand condition is cleared\r\n" /end ANNOTATION_TEXT
 /end ANNOTATION
/end CHARACTERISTIC
/begin CHARACTERISTIC DWC_EFLASHB.DWC_K1DeviceControl.DWC_ENGINESTOPDEMANDTIME "" VALUE 0x806099EA DefaultValueRecordLayout_AUTOSAR_Platform_BaseTypes_sint16 64.0 RB_PT_PCT_SWC_DWC_CompuMethods_time_0p005 0.0 64. FORMAT "%10.5"
 /begin ANNOTATION ANNOTATION_LABEL "Description (coming from AUTOSAR DESC field)"
  /begin ANNOTATION_TEXT "Time after engine stop before clutch can be considered as drained\r\n" /end ANNOTATION_TEXT
 /end ANNOTATION
/end CHARACTERISTIC
/begin CHARACTERISTIC DWC_EFLASHB.DWC_K1DeviceControl.DWC_ENGINESTOPDRAINTIME "" VALUE 0x806099EC DefaultValueRecordLayout_AUTOSAR_Platform_BaseTypes_sint16 64.0 RB_PT_PCT_SWC_DWC_CompuMethods_time_0p005 0.0 64. FORMAT "%10.5"
 /begin ANNOTATION ANNOTATION_LABEL "Description (coming from AUTOSAR DESC field)"
  /begin ANNOTATION_TEXT "Time after engine stop before clutch can be considered as drained\r\n" /end ANNOTATION_TEXT
 /end ANNOTATION
/end CHARACTERISTIC
/begin CHARACTERISTIC DWC_EFLASHB.DWC_K1DeviceControl.DWC_FillController.DWC_FILLLINEPRESSUREFACTOR "" CURVE 0x80609BAE RB_PT_PCT_SWC_DWC_RecordLayouts_RL_Curve_uint16_5_sint16_5 1.0 RB_PT_PCT_SWC_DWC_CompuMethods_ratio_0p001__2 0.0 1. FORMAT "%10.5"
 /begin ANNOTATION ANNOTATION_LABEL "Description (coming from AUTOSAR DESC field)" /begin ANNOTATION_TEXT "Factor linking line pressure to pulse length\r\n" /end ANNOTATION_TEXT /end ANNOTATION
 /begin AXIS_DESCR STD_AXIS NO_INPUT_QUANTITY RB_PT_PCT_SWC_DWC_CompuMethods_ratio_0p005 5 -5. 100. FORMAT "%10.5" DEPOSIT ABSOLUTE /end AXIS_DESCR
/end CHARACTERISTIC
/begin CHARACTERISTIC DWC_EFLASHB.DWC_K1DeviceControl.DWC_FillController.DWC_FILLPRESSVSTORQUE "" MAP 0x80609BC4 RB_PT_PCT_SWC_DWC_RecordLayouts_RL_Map_uint16_50_uint16_10_sint16_5 32.0 RB_PT_PCT_SWC_DWC_CompuMethods_ratio_0p001__2 0.0 32. FORMAT "%10.5"
 /begin ANNOTATION ANNOTATION_LABEL "Description (coming from AUTOSAR DESC field)" /begin ANNOTATION_TEXT "Fill pressure vs engine speed and torque\r\n" /end ANNOTATION_TEXT /end ANNOTATION
 /begin AXIS_DESCR STD_AXIS NO_INPUT_QUANTITY RB_PT_PCT_SWC_DWC_CompuMethods_ident 10 0.0 20000. FORMAT "%10.5" DEPOSIT ABSOLUTE /end AXIS_DESCR
 /begin AXIS_DESCR STD_AXIS NO_INPUT_QUANTITY RB_PT_PCT_SWC_DWC_CompuMethods_ratio_0p1 5 -2000. 2000. FORMAT "%10.5" DEPOSIT ABSOLUTE /end AXIS_DESCR
/end CHARACTERISTIC
/begin CHARACTERISTIC DWC_EFLASHB.DWC_K1DeviceControl.DWC_FillController.DWC_FILLPRESSVSTORQUESOFT "" MAP 0x80609C4A RB_PT_PCT_SWC_DWC_RecordLayouts_RL_Map_uint16_8_uint16_4_sint16_2 32.0 RB_PT_PCT_SWC_DWC_CompuMethods_ratio_0p001__2 0.0 32. FORMAT "%10.5"
 /begin ANNOTATION ANNOTATION_LABEL "Description (coming from AUTOSAR DESC field)" /begin ANNOTATION_TEXT "Fill pressure for soft filling\r\n" /end ANNOTATION_TEXT /end ANNOTATION
 /begin AXIS_DESCR STD_AXIS NO_INPUT_QUANTITY RB_PT_PCT_SWC_DWC_CompuMethods_ident 4 0.0 20000. FORMAT "%10.5" DEPOSIT ABSOLUTE /end AXIS_DESCR
 /begin AXIS_DESCR STD_AXIS NO_INPUT_QUANTITY RB_PT_PCT_SWC_DWC_CompuMethods_ratio_0p1 2 -2000. 2000. FORMAT "%10.5" DEPOSIT ABSOLUTE /end AXIS_DESCR
/end CHARACTERISTIC
/begin CHARACTERISTIC DWC_EFLASHB.DWC_K1DeviceControl.DWC_FillController.DWC_FILLPROFILE "" CURVE 0x80609C6A RB_PT_PCT_SWC_DWC_RecordLayouts_RL_Curve_uint16_11_uint16_11 1.0 RB_PT_PCT_SWC_DWC_CompuMethods_ratio_0p001__2 0.0 1. FORMAT "%10.5"
 /begin ANNOTATION ANNOTATION_LABEL "Description (coming from AUTOSAR DESC field)"
  /begin ANNOTATION_TEXT "Profile of fill pressure demand against progression through the fill duration\r\n" /end ANNOTATION_TEXT
 /end ANNOTATION
 /begin AXIS_DESCR STD_AXIS NO_INPUT_QUANTITY RB_PT_PCT_SWC_DWC_CompuMethods_ratio_0p001__2 11 0.0 1. FORMAT "%10.5" DEPOSIT ABSOLUTE /end AXIS_DESCR
/end CHARACTERISTIC
/begin CHARACTERISTIC DWC_EFLASHB.DWC_K1DeviceControl.DWC_FillController.DWC_FILLPULSETIMEFACTOR "" VALUE 0x80609BA4 DefaultValueRecordLayout_AUTOSAR_Platform_BaseTypes_uint16 1.0 RB_PT_PCT_SWC_DWC_CompuMethods_ratio_0p001__2 0.0 1. FORMAT "%10.5"
 /begin ANNOTATION ANNOTATION_LABEL "Description (coming from AUTOSAR DESC field)"
  /begin ANNOTATION_TEXT "Factor applied to start time that the pulse will run for (all of it = 1.0)\r\n" /end ANNOTATION_TEXT
 /end ANNOTATION
/end CHARACTERISTIC
/begin CHARACTERISTIC DWC_EFLASHB.DWC_K1DeviceControl.DWC_FillController.DWC_FILLTERMINATETORQUE "" VALUE 0x80609BA6 DefaultValueRecordLayout_AUTOSAR_Platform_BaseTypes_sint16 4000.0 RB_PT_PCT_SWC_DWC_CompuMethods_ratio_0p1 -2000. 2000. FORMAT "%10.5"
 /begin ANNOTATION ANNOTATION_LABEL "Description (coming from AUTOSAR DESC field)"
  /begin ANNOTATION_TEXT "Torque level, below which fill is immediately terminated\r\n" /end ANNOTATION_TEXT
 /end ANNOTATION
/end CHARACTERISTIC
/begin CHARACTERISTIC DWC_EFLASHB.DWC_K1DeviceControl.DWC_FillController.DWC_FILLTIME "" MAP 0x80609C98 RB_PT_PCT_SWC_DWC_RecordLayouts_RL_Map_uint16_50_sint16_10_sint16_5 1.5 RB_PT_PCT_SWC_DWC_CompuMethods_ratio_0p001__2 0.0 1.5 FORMAT "%10.5"
 /begin ANNOTATION ANNOTATION_LABEL "Description (coming from AUTOSAR DESC field)" /begin ANNOTATION_TEXT "Time to fill clutch\r\n" /end ANNOTATION_TEXT /end ANNOTATION
 /begin AXIS_DESCR STD_AXIS NO_INPUT_QUANTITY RB_PT_PCT_SWC_DWC_CompuMethods_ident 10 -50. 200. FORMAT "%10.5" DEPOSIT ABSOLUTE /end AXIS_DESCR
 /begin AXIS_DESCR STD_AXIS NO_INPUT_QUANTITY RB_PT_PCT_SWC_DWC_CompuMethods_ratio_0p1 5 -2000. 2000. FORMAT "%10.5" DEPOSIT ABSOLUTE /end AXIS_DESCR
/end CHARACTERISTIC
/begin CHARACTERISTIC DWC_EFLASHB.DWC_K1DeviceControl.DWC_FillController.DWC_FILLTYPE "" VALUE 0x80609BAC DefaultValueRecordLayout_AUTOSAR_Platform_BaseTypes_uint8 2.0 RB_PT_PCT_SWC_DWC_CompuMethods_Enumerations_DWC_FillProfile 0.0 2. FORMAT "%10.5"
 /begin ANNOTATION ANNOTATION_LABEL "Description (coming from AUTOSAR DESC field)" /begin ANNOTATION_TEXT "Fill type to be used\r\n" /end ANNOTATION_TEXT /end ANNOTATION
/end CHARACTERISTIC
/begin CHARACTERISTIC DWC_EFLASHB.DWC_K1DeviceControl.DWC_FillController.DWC_PRESSUREFILLFACTOR "" CURVE 0x80609D1E RB_PT_PCT_SWC_DWC_RecordLayouts_RL_Curve_uint8_5_sint16_5 1.0 RB_PT_PCT_SWC_DWC_CompuMethods_ratio_0p1 0.0 1. FORMAT "%10.5"
 /begin ANNOTATION ANNOTATION_LABEL "Description (coming from AUTOSAR DESC field)"
  /begin ANNOTATION_TEXT "Factor applied to fill time based on current pressure\r\n" /end ANNOTATION_TEXT
 /end ANNOTATION
 /begin AXIS_DESCR STD_AXIS NO_INPUT_QUANTITY RB_PT_PCT_SWC_DWC_CompuMethods_ratio_0p001__2 5 -2. 32. FORMAT "%10.5" DEPOSIT ABSOLUTE /end AXIS_DESCR
/end CHARACTERISTIC
/begin CHARACTERISTIC DWC_EFLASHB.DWC_K1DeviceControl.DWC_FillController.DWC_VALVEPUNCHPRESSURE "" VALUE 0x80609BA8 DefaultValueRecordLayout_AUTOSAR_Platform_BaseTypes_uint16 32.0 RB_PT_PCT_SWC_DWC_CompuMethods_ratio_0p001__2 0.0 32. FORMAT "%10.5"
 /begin ANNOTATION ANNOTATION_LABEL "Description (coming from AUTOSAR DESC field)" /begin ANNOTATION_TEXT "Pressure demand for valve dirt busting pulse\r\n" /end ANNOTATION_TEXT /end ANNOTATION
/end CHARACTERISTIC
/begin CHARACTERISTIC DWC_EFLASHB.DWC_K1DeviceControl.DWC_FillController.DWC_VALVEPUNCHTIME "" VALUE 0x80609BAA DefaultValueRecordLayout_AUTOSAR_Platform_BaseTypes_uint16 1.5 RB_PT_PCT_SWC_DWC_CompuMethods_ratio_0p001__2 0.0 1.5 FORMAT "%10.5"
 /begin ANNOTATION ANNOTATION_LABEL "Description (coming from AUTOSAR DESC field)" /begin ANNOTATION_TEXT "Time for which valve dirt busting pulse is used\r\n" /end ANNOTATION_TEXT /end ANNOTATION
/end CHARACTERISTIC
/begin CHARACTERISTIC DWC_EFLASHB.DWC_K1DeviceControl.DWC_KPAccelFiltAdapt.DWC_FIRSTORDERLPCOEFF "" VALUE 0x80609D30 DefaultValueRecordLayout_AUTOSAR_Platform_BaseTypes_uint8 1.0 RB_PT_PCT_SWC_DWC_CompuMethods_ratio_0p01 0.0 1. FORMAT "%10.5"
 /begin ANNOTATION ANNOTATION_LABEL "Description (coming from AUTOSAR DESC field)" /begin ANNOTATION_TEXT "Coefficient for low pass IIR filter\r\n" /end ANNOTATION_TEXT /end ANNOTATION
/end CHARACTERISTIC
/begin CHARACTERISTIC DWC_EFLASHB.DWC_K1DeviceControl.DWC_KPMINNOPULSE "" VALUE 0x806099EE DefaultValueRecordLayout_AUTOSAR_Platform_BaseTypes_sint16 34.0 RB_PT_PCT_SWC_DWC_CompuMethods_ratio_0p001__2 -2. 32. FORMAT "%10.5"
 /begin ANNOTATION ANNOTATION_LABEL "Description (coming from AUTOSAR DESC field)"
  /begin ANNOTATION_TEXT "Minimum no pulse demand from device controller when kisspoint adaption is active\r\n" /end ANNOTATION_TEXT
 /end ANNOTATION
/end CHARACTERISTIC
/begin CHARACTERISTIC DWC_EFLASHB.DWC_K1DeviceControl.DWC_MASKENABLECLEAN "" VALUE 0x806099D0 DefaultValueRecordLayout_AUTOSAR_Platform_BaseTypes_uint32 4.294967295E9 RB_PT_PCT_SWC_DWC_CompuMethods_ident 0.0 4.294967295E9 FORMAT "%10.5"
 /begin ANNOTATION ANNOTATION_LABEL "Description (coming from AUTOSAR DESC field)" /begin ANNOTATION_TEXT "Mask to enable cutch blip.\r\n" /end ANNOTATION_TEXT /end ANNOTATION
/end CHARACTERISTIC
/begin CHARACTERISTIC DWC_EFLASHB.DWC_K1DeviceControl.DWC_MASKENABLERINSE "" VALUE 0x806099D4 DefaultValueRecordLayout_AUTOSAR_Platform_BaseTypes_uint32 4.294967295E9 RB_PT_PCT_SWC_DWC_CompuMethods_ident 0.0 4.294967295E9 FORMAT "%10.5"
 /begin ANNOTATION ANNOTATION_LABEL "Description (coming from AUTOSAR DESC field)" /begin ANNOTATION_TEXT "Mask to enable cutch blip.\r\n" /end ANNOTATION_TEXT /end ANNOTATION
/end CHARACTERISTIC
/begin CHARACTERISTIC DWC_EFLASHB.DWC_K1DeviceControl.DWC_MAXOPPPRESFORCLUTCHBLIP "" VALUE 0x806099F0 DefaultValueRecordLayout_AUTOSAR_Platform_BaseTypes_sint16 34.0 RB_PT_PCT_SWC_DWC_CompuMethods_ratio_0p001__2 -2. 32. FORMAT "%10.5"
 /begin ANNOTATION ANNOTATION_LABEL "Description (coming from AUTOSAR DESC field)"
  /begin ANNOTATION_TEXT "Maximum opposite clutch pressure at which blip is allowed.\r\n" /end ANNOTATION_TEXT
 /end ANNOTATION
/end CHARACTERISTIC
/begin CHARACTERISTIC DWC_EFLASHB.DWC_K1DeviceControl.DWC_MAXPRESFORCLUTCHBLIP "" VALUE 0x806099F2 DefaultValueRecordLayout_AUTOSAR_Platform_BaseTypes_sint16 34.0 RB_PT_PCT_SWC_DWC_CompuMethods_ratio_0p001__2 -2. 32. FORMAT "%10.5"
 /begin ANNOTATION ANNOTATION_LABEL "Description (coming from AUTOSAR DESC field)" /begin ANNOTATION_TEXT "Maximum clutch pressure at which blip is allowed.\r\n" /end ANNOTATION_TEXT /end ANNOTATION
/end CHARACTERISTIC
/begin CHARACTERISTIC DWC_EFLASHB.DWC_K1DeviceControl.DWC_OPENDEMANDENGINEOFF "" VALUE 0x806099F4 DefaultValueRecordLayout_AUTOSAR_Platform_BaseTypes_sint16 34.0 RB_PT_PCT_SWC_DWC_CompuMethods_ratio_0p001__2 -2. 32. FORMAT "%10.5"
 /begin ANNOTATION ANNOTATION_LABEL "Description (coming from AUTOSAR DESC field)" /begin ANNOTATION_TEXT "Demand pressure when open, engine off\r\n" /end ANNOTATION_TEXT /end ANNOTATION
/end CHARACTERISTIC
/begin CHARACTERISTIC DWC_EFLASHB.DWC_K1DeviceControl.DWC_OPENDEMANDINCREASE "" VALUE 0x806099F6 DefaultValueRecordLayout_AUTOSAR_Platform_BaseTypes_uint16 32.0 RB_PT_PCT_SWC_DWC_CompuMethods_ratio_0p001__2 0.0 32. FORMAT "%10.5"
 /begin ANNOTATION ANNOTATION_LABEL "Description (coming from AUTOSAR DESC field)" /begin ANNOTATION_TEXT "Open demand pressure increase rate\r\n" /end ANNOTATION_TEXT /end ANNOTATION
/end CHARACTERISTIC
/begin CHARACTERISTIC DWC_EFLASHB.DWC_K1DeviceControl.DWC_OPENDEMANDPRIMED "" VALUE 0x806099F8 DefaultValueRecordLayout_AUTOSAR_Platform_BaseTypes_sint16 34.0 RB_PT_PCT_SWC_DWC_CompuMethods_ratio_0p001__2 -2. 32. FORMAT "%10.5"
 /begin ANNOTATION ANNOTATION_LABEL "Description (coming from AUTOSAR DESC field)" /begin ANNOTATION_TEXT "Demand pressure when open, primed condition\r\n" /end ANNOTATION_TEXT /end ANNOTATION
/end CHARACTERISTIC
/begin CHARACTERISTIC DWC_EFLASHB.DWC_K1DeviceControl.DWC_OPENDEMANDUNPRIMED "" VALUE 0x806099FA DefaultValueRecordLayout_AUTOSAR_Platform_BaseTypes_sint16 34.0 RB_PT_PCT_SWC_DWC_CompuMethods_ratio_0p001__2 -2. 32. FORMAT "%10.5"
 /begin ANNOTATION ANNOTATION_LABEL "Description (coming from AUTOSAR DESC field)" /begin ANNOTATION_TEXT "Demand pressure when open, unprimed condition\r\n" /end ANNOTATION_TEXT /end ANNOTATION
/end CHARACTERISTIC
/begin CHARACTERISTIC DWC_EFLASHB.DWC_K1DeviceControl.DWC_OpenPressureDiag.DWC_DITHERCHANGETIME "" VALUE 0x80609D32 DefaultValueRecordLayout_AUTOSAR_Platform_BaseTypes_uint16 10.0 RB_PT_PCT_SWC_DWC_CompuMethods_ratio_0p001__2 0.0 10. FORMAT "%10.5"
 /begin ANNOTATION ANNOTATION_LABEL "Description (coming from AUTOSAR DESC field)"
  /begin ANNOTATION_TEXT "Time for which overpressure/underpressure should be active before requesting dither change.\r\n" /end ANNOTATION_TEXT
 /end ANNOTATION
/end CHARACTERISTIC
/begin CHARACTERISTIC DWC_EFLASHB.DWC_K1DeviceControl.DWC_OpenPressureDiag.DWC_FEEDBLANKTIME "" VALUE 0x80609D34 DefaultValueRecordLayout_AUTOSAR_Platform_BaseTypes_uint16 10.0 RB_PT_PCT_SWC_DWC_CompuMethods_ratio_0p001__2 0.0 10. FORMAT "%10.5"
 /begin ANNOTATION ANNOTATION_LABEL "Description (coming from AUTOSAR DESC field)"
  /begin ANNOTATION_TEXT "Time after failure event before system is considered to be 'healed'\r\n" /end ANNOTATION_TEXT
 /end ANNOTATION
/end CHARACTERISTIC
/begin CHARACTERISTIC DWC_EFLASHB.DWC_K1DeviceControl.DWC_OpenPressureDiag.DWC_HEALTIME "" VALUE 0x80609D36 DefaultValueRecordLayout_AUTOSAR_Platform_BaseTypes_uint16 10.0 RB_PT_PCT_SWC_DWC_CompuMethods_ratio_0p001__2 0.0 10. FORMAT "%10.5"
 /begin ANNOTATION ANNOTATION_LABEL "Description (coming from AUTOSAR DESC field)"
  /begin ANNOTATION_TEXT "Time after failure event before system is considered to be 'healed'\r\n" /end ANNOTATION_TEXT
 /end ANNOTATION
/end CHARACTERISTIC
/begin CHARACTERISTIC DWC_EFLASHB.DWC_K1DeviceControl.DWC_OpenPressureDiag.DWC_OVERPRESSURE "" VALUE 0x80609D38 DefaultValueRecordLayout_AUTOSAR_Platform_BaseTypes_sint16 64.0 RB_PT_PCT_SWC_DWC_CompuMethods_ratio_0p001__2 -32. 32. FORMAT "%10.5"
 /begin ANNOTATION ANNOTATION_LABEL "Description (coming from AUTOSAR DESC field)" /begin ANNOTATION_TEXT "Overpressure margin allowed\r\n" /end ANNOTATION_TEXT /end ANNOTATION
/end CHARACTERISTIC
/begin CHARACTERISTIC DWC_EFLASHB.DWC_K1DeviceControl.DWC_OpenPressureDiag.DWC_OVERPRESSURETHRESHOLD "" VALUE 0x80609D3A DefaultValueRecordLayout_AUTOSAR_Platform_BaseTypes_sint16 64.0 RB_PT_PCT_SWC_DWC_CompuMethods_ratio_0p001__2 -32. 32. FORMAT "%10.5"
 /begin ANNOTATION ANNOTATION_LABEL "Description (coming from AUTOSAR DESC field)" /begin ANNOTATION_TEXT "Min pressure for diag.\r\n" /end ANNOTATION_TEXT /end ANNOTATION
/end CHARACTERISTIC
/begin CHARACTERISTIC DWC_EFLASHB.DWC_K1DeviceControl.DWC_OpenPressureDiag.DWC_OVERPRESSURETIME "" VALUE 0x80609D3C DefaultValueRecordLayout_AUTOSAR_Platform_BaseTypes_uint16 10.0 RB_PT_PCT_SWC_DWC_CompuMethods_ratio_0p001__2 0.0 10. FORMAT "%10.5"
 /begin ANNOTATION ANNOTATION_LABEL "Description (coming from AUTOSAR DESC field)"
  /begin ANNOTATION_TEXT "Maximum time for overpressure condition before status change\r\n" /end ANNOTATION_TEXT
 /end ANNOTATION
/end CHARACTERISTIC
/begin CHARACTERISTIC DWC_EFLASHB.DWC_K1DeviceControl.DWC_OpenPressureDiag.DWC_UNDERPRESSURE "" VALUE 0x80609D3E DefaultValueRecordLayout_AUTOSAR_Platform_BaseTypes_sint16 64.0 RB_PT_PCT_SWC_DWC_CompuMethods_ratio_0p001__2 -32. 32. FORMAT "%10.5"
 /begin ANNOTATION ANNOTATION_LABEL "Description (coming from AUTOSAR DESC field)" /begin ANNOTATION_TEXT "Overpressure margin allowed\r\n" /end ANNOTATION_TEXT /end ANNOTATION
/end CHARACTERISTIC
/begin CHARACTERISTIC DWC_EFLASHB.DWC_K1DeviceControl.DWC_OpenPressureDiag.DWC_UNDERPRESSURELOWTIME "" VALUE 0x80609D40 DefaultValueRecordLayout_AUTOSAR_Platform_BaseTypes_uint16 10.0 RB_PT_PCT_SWC_DWC_CompuMethods_ratio_0p001__2 0.0 10. FORMAT "%10.5"
 /begin ANNOTATION ANNOTATION_LABEL "Description (coming from AUTOSAR DESC field)"
  /begin ANNOTATION_TEXT "Maximum time for 'low' underpressure condition before status change\r\n" /end ANNOTATION_TEXT
 /end ANNOTATION
/end CHARACTERISTIC
/begin CHARACTERISTIC DWC_EFLASHB.DWC_K1DeviceControl.DWC_OpenPressureDiag.DWC_UNDERPRESSURETHRESHOLD "" VALUE 0x80609D42 DefaultValueRecordLayout_AUTOSAR_Platform_BaseTypes_sint16 64.0 RB_PT_PCT_SWC_DWC_CompuMethods_ratio_0p001__2 -32. 32. FORMAT "%10.5"
 /begin ANNOTATION ANNOTATION_LABEL "Description (coming from AUTOSAR DESC field)" /begin ANNOTATION_TEXT "Overpressure margin allowed\r\n" /end ANNOTATION_TEXT /end ANNOTATION
/end CHARACTERISTIC
/begin CHARACTERISTIC DWC_EFLASHB.DWC_K1DeviceControl.DWC_OpenPressureDiag.DWC_UNDERPRESSURETIME "" VALUE 0x80609D44 DefaultValueRecordLayout_AUTOSAR_Platform_BaseTypes_uint16 10.0 RB_PT_PCT_SWC_DWC_CompuMethods_ratio_0p001__2 0.0 10. FORMAT "%10.5"
 /begin ANNOTATION ANNOTATION_LABEL "Description (coming from AUTOSAR DESC field)"
  /begin ANNOTATION_TEXT "Maximum time for underpressure condition before status change\r\n" /end ANNOTATION_TEXT
 /end ANNOTATION
/end CHARACTERISTIC
/begin CHARACTERISTIC DWC_EFLASHB.DWC_K1DeviceControl.DWC_PCMINNOPULSE "" VALUE 0x806099FC DefaultValueRecordLayout_AUTOSAR_Platform_BaseTypes_sint16 34.0 RB_PT_PCT_SWC_DWC_CompuMethods_ratio_0p001__2 -2. 32. FORMAT "%10.5"
 /begin ANNOTATION ANNOTATION_LABEL "Description (coming from AUTOSAR DESC field)"
  /begin ANNOTATION_TEXT "Minimum no pulse demand from device controller when pressure to current adaption is active\r\n" /end ANNOTATION_TEXT
 /end ANNOTATION
/end CHARACTERISTIC
/begin CHARACTERISTIC DWC_EFLASHB.DWC_K1DeviceControl.DWC_PKFILTVSENGSPEED "" CURVE 0x8060A006 RB_PT_PCT_SWC_DWC_RecordLayouts_RL_Curve_uint16_10_uint16_10 1.0 RB_PT_PCT_SWC_DWC_CompuMethods_ratio_0p01 0.0 1. FORMAT "%10.5"
 /begin ANNOTATION ANNOTATION_LABEL "Description (coming from AUTOSAR DESC field)"
  /begin ANNOTATION_TEXT "Filter constant used to filter Pk in relation to engine speed.\r\n" /end ANNOTATION_TEXT
 /end ANNOTATION
 /begin AXIS_DESCR STD_AXIS NO_INPUT_QUANTITY RB_PT_PCT_SWC_DWC_CompuMethods_ident 10 0.0 20000. FORMAT "%10.5" DEPOSIT ABSOLUTE /end AXIS_DESCR
/end CHARACTERISTIC
/begin CHARACTERISTIC DWC_EFLASHB.DWC_K1DeviceControl.DWC_PREFILLCLOSEDLOOPLIMIT "" VALUE 0x806099FE DefaultValueRecordLayout_AUTOSAR_Platform_BaseTypes_sint16 34.0 RB_PT_PCT_SWC_DWC_CompuMethods_ratio_0p001__2 -2. 32. FORMAT "%10.5"
 /begin ANNOTATION ANNOTATION_LABEL "Description (coming from AUTOSAR DESC field)" /begin ANNOTATION_TEXT "Limits above/below prefill that closed loop can run\r\n" /end ANNOTATION_TEXT /end ANNOTATION
/end CHARACTERISTIC
/begin CHARACTERISTIC DWC_EFLASHB.DWC_K1DeviceControl.DWC_PressCurrent.DWC_ADAPTDELAY "" VALUE 0x80609D66 DefaultValueRecordLayout_AUTOSAR_Platform_BaseTypes_uint8 25.5 RB_PT_PCT_SWC_DWC_CompuMethods_ratio_0p1 0.0 25.5 FORMAT "%10.5"
 /begin ANNOTATION ANNOTATION_LABEL "Description (coming from AUTOSAR DESC field)"
  /begin ANNOTATION_TEXT "Time until adaption is started when conditions are good\r\n" /end ANNOTATION_TEXT
 /end ANNOTATION
/end CHARACTERISTIC
/begin CHARACTERISTIC DWC_EFLASHB.DWC_K1DeviceControl.DWC_PressCurrent.DWC_ADAPTDELAYFILL "" VALUE 0x80609D67 DefaultValueRecordLayout_AUTOSAR_Platform_BaseTypes_uint8 25.5 RB_PT_PCT_SWC_DWC_CompuMethods_ratio_0p1 0.0 25.5 FORMAT "%10.5"
 /begin ANNOTATION ANNOTATION_LABEL "Description (coming from AUTOSAR DESC field)"
  /begin ANNOTATION_TEXT "Time until adaption is started when conditions are good - after a fill\r\n" /end ANNOTATION_TEXT
 /end ANNOTATION
/end CHARACTERISTIC
/begin CHARACTERISTIC DWC_EFLASHB.DWC_K1DeviceControl.DWC_PressCurrent.DWC_ADAPTIONBOOTSTRAPPRESSURE "" VALUE 0x80609D46 DefaultValueRecordLayout_AUTOSAR_Platform_BaseTypes_uint16 32.0 RB_PT_PCT_SWC_DWC_CompuMethods_ratio_0p001__2 0.0 32. FORMAT "%10.5"
 /begin ANNOTATION ANNOTATION_LABEL "Description (coming from AUTOSAR DESC field)" /begin ANNOTATION_TEXT "Adaption enable pressure hysteresis\r\n" /end ANNOTATION_TEXT /end ANNOTATION
/end CHARACTERISTIC
/begin CHARACTERISTIC DWC_EFLASHB.DWC_K1DeviceControl.DWC_PressCurrent.DWC_ADAPTIONENABLEHYSTPRESSURE "" VALUE 0x80609D48 DefaultValueRecordLayout_AUTOSAR_Platform_BaseTypes_uint16 32.0 RB_PT_PCT_SWC_DWC_CompuMethods_ratio_0p001__2 0.0 32. FORMAT "%10.5"
 /begin ANNOTATION ANNOTATION_LABEL "Description (coming from AUTOSAR DESC field)" /begin ANNOTATION_TEXT "Adaption enable pressure hysteresis\r\n" /end ANNOTATION_TEXT /end ANNOTATION
/end CHARACTERISTIC
/begin CHARACTERISTIC DWC_EFLASHB.DWC_K1DeviceControl.DWC_PressCurrent.DWC_ENABLEPRESSCURRENTADAPT "" VALUE 0x80609D68 DefaultValueRecordLayout_AUTOSAR_Platform_BaseTypes_boolean 255.0 AUTOSAR_Platform_CompuMethods_boolean 0.0 255. FORMAT "%10.5"
 /begin ANNOTATION ANNOTATION_LABEL "Description (coming from AUTOSAR DESC field)" /begin ANNOTATION_TEXT "Flag to enable pressure to current adaption\r\n" /end ANNOTATION_TEXT /end ANNOTATION
/end CHARACTERISTIC
/begin CHARACTERISTIC DWC_EFLASHB.DWC_K1DeviceControl.DWC_PressCurrent.DWC_HYSTBANDCROSSINGGAIN "" VALUE 0x80609D69 DefaultValueRecordLayout_AUTOSAR_Platform_BaseTypes_uint8 1.0 RB_PT_PCT_SWC_DWC_CompuMethods_ratio_0p01 0.0 1. FORMAT "%10.5"
 /begin ANNOTATION ANNOTATION_LABEL "Description (coming from AUTOSAR DESC field)" /begin ANNOTATION_TEXT "Hysterisis band crossing linear gain\r\n" /end ANNOTATION_TEXT /end ANNOTATION
/end CHARACTERISTIC
/begin CHARACTERISTIC DWC_EFLASHB.DWC_K1DeviceControl.DWC_PressCurrent.DWC_INTEGRATORMAX "" VALUE 0x80609D4A DefaultValueRecordLayout_AUTOSAR_Platform_BaseTypes_sint16 400.0 RB_PT_PCT_SWC_DWC_CompuMethods_ident -200. 200. FORMAT "%10.5"
 /begin ANNOTATION ANNOTATION_LABEL "Description (coming from AUTOSAR DESC field)" /begin ANNOTATION_TEXT "Limit for I term\r\n" /end ANNOTATION_TEXT /end ANNOTATION
/end CHARACTERISTIC
/begin CHARACTERISTIC DWC_EFLASHB.DWC_K1DeviceControl.DWC_PressCurrent.DWC_INTEGRATORMIN "" VALUE 0x80609D4C DefaultValueRecordLayout_AUTOSAR_Platform_BaseTypes_sint16 400.0 RB_PT_PCT_SWC_DWC_CompuMethods_ident -200. 200. FORMAT "%10.5"
 /begin ANNOTATION ANNOTATION_LABEL "Description (coming from AUTOSAR DESC field)" /begin ANNOTATION_TEXT "limit for I term\r\n" /end ANNOTATION_TEXT /end ANNOTATION
/end CHARACTERISTIC
/begin CHARACTERISTIC DWC_EFLASHB.DWC_K1DeviceControl.DWC_PressCurrent.DWC_ITERMTOVALVEERRORGAIN "" VALUE 0x80609D6A DefaultValueRecordLayout_AUTOSAR_Platform_BaseTypes_uint8 0.1 RB_PT_PCT_SWC_DWC_CompuMethods_ratio_0p001__2 0.0 0.1 FORMAT "%10.5"
 /begin ANNOTATION ANNOTATION_LABEL "Description (coming from AUTOSAR DESC field)"
  /begin ANNOTATION_TEXT "Linear gain to generate an error term for adaption from I term\r\n" /end ANNOTATION_TEXT
 /end ANNOTATION
/end CHARACTERISTIC
/begin CHARACTERISTIC DWC_EFLASHB.DWC_K1DeviceControl.DWC_PressCurrent.DWC_KISSPOINTGAININCKPLEARN "" VALUE 0x80609D6B DefaultValueRecordLayout_AUTOSAR_Platform_BaseTypes_uint8 10.0 RB_PT_PCT_SWC_DWC_CompuMethods_ident 0.0 10. FORMAT "%10.5"
 /begin ANNOTATION ANNOTATION_LABEL "Description (coming from AUTOSAR DESC field)" /begin ANNOTATION_TEXT "Gain increase for kisspoint learning function\r\n" /end ANNOTATION_TEXT /end ANNOTATION
/end CHARACTERISTIC
/begin CHARACTERISTIC DWC_EFLASHB.DWC_K1DeviceControl.DWC_PressCurrent.DWC_KISSPOINTGAININCPCLEARN "" VALUE 0x80609D6C DefaultValueRecordLayout_AUTOSAR_Platform_BaseTypes_uint8 10.0 RB_PT_PCT_SWC_DWC_CompuMethods_ident 0.0 10. FORMAT "%10.5"
 /begin ANNOTATION ANNOTATION_LABEL "Description (coming from AUTOSAR DESC field)"
  /begin ANNOTATION_TEXT "Gain increase for pressure to current learning function\r\n" /end ANNOTATION_TEXT
 /end ANNOTATION
/end CHARACTERISTIC
/begin CHARACTERISTIC DWC_EFLASHB.DWC_K1DeviceControl.DWC_PressCurrent.DWC_KISSPOINTNEGOFFSETMAX "" VALUE 0x80609D4E DefaultValueRecordLayout_AUTOSAR_Platform_BaseTypes_sint16 2000.0 RB_PT_PCT_SWC_DWC_CompuMethods_ratio_0p1 -1000. 1000. FORMAT "%10.5"
 /begin ANNOTATION ANNOTATION_LABEL "Description (coming from AUTOSAR DESC field)" /begin ANNOTATION_TEXT "Limit for adption\r\n" /end ANNOTATION_TEXT /end ANNOTATION
/end CHARACTERISTIC
/begin CHARACTERISTIC DWC_EFLASHB.DWC_K1DeviceControl.DWC_PressCurrent.DWC_KISSPOINTPOSOFFSETMAX "" VALUE 0x80609D50 DefaultValueRecordLayout_AUTOSAR_Platform_BaseTypes_sint16 2000.0 RB_PT_PCT_SWC_DWC_CompuMethods_ratio_0p1 -1000. 1000. FORMAT "%10.5"
 /begin ANNOTATION ANNOTATION_LABEL "Description (coming from AUTOSAR DESC field)" /begin ANNOTATION_TEXT "limit for adaption\r\n" /end ANNOTATION_TEXT /end ANNOTATION
/end CHARACTERISTIC
/begin CHARACTERISTIC DWC_EFLASHB.DWC_K1DeviceControl.DWC_PressCurrent.DWC_KPADAPTCLOSEDLOOPPC "" VALUE 0x80609D6D DefaultValueRecordLayout_AUTOSAR_Platform_BaseTypes_boolean 255.0 AUTOSAR_Platform_CompuMethods_boolean 0.0 255. FORMAT "%10.5"
 /begin ANNOTATION ANNOTATION_LABEL "Description (coming from AUTOSAR DESC field)"
  /begin ANNOTATION_TEXT "Flag to enable closed loop P to C during kisspoint learn\r\n" /end ANNOTATION_TEXT
 /end ANNOTATION
/end CHARACTERISTIC
/begin CHARACTERISTIC DWC_EFLASHB.DWC_K1DeviceControl.DWC_PressCurrent.DWC_KPADAPTFORCELINEDEPENDENCY "" VALUE 0x80609D6E DefaultValueRecordLayout_AUTOSAR_Platform_BaseTypes_boolean 255.0 AUTOSAR_Platform_CompuMethods_boolean 0.0 255. FORMAT "%10.5"
 /begin ANNOTATION ANNOTATION_LABEL "Description (coming from AUTOSAR DESC field)"
  /begin ANNOTATION_TEXT "Flag to force line pressure dependency during KP learn\r\n" /end ANNOTATION_TEXT
 /end ANNOTATION
/end CHARACTERISTIC
/begin CHARACTERISTIC DWC_EFLASHB.DWC_K1DeviceControl.DWC_PressCurrent.DWC_MAXDEMANDDELTAADAPTION "" VALUE 0x80609D52 DefaultValueRecordLayout_AUTOSAR_Platform_BaseTypes_uint16 32.0 RB_PT_PCT_SWC_DWC_CompuMethods_ratio_0p001__2 0.0 32. FORMAT "%10.5"
 /begin ANNOTATION ANNOTATION_LABEL "Description (coming from AUTOSAR DESC field)"
  /begin ANNOTATION_TEXT "Maximum delta in demand pressure before adaption timer is reset\r\n" /end ANNOTATION_TEXT
 /end ANNOTATION
/end CHARACTERISTIC
/begin CHARACTERISTIC DWC_EFLASHB.DWC_K1DeviceControl.DWC_PressCurrent.DWC_MAXIMUMGAININCPCLEARN "" VALUE 0x80609D6F DefaultValueRecordLayout_AUTOSAR_Platform_BaseTypes_uint8 10.0 RB_PT_PCT_SWC_DWC_CompuMethods_ident 0.0 10. FORMAT "%10.5"
 /begin ANNOTATION ANNOTATION_LABEL "Description (coming from AUTOSAR DESC field)"
  /begin ANNOTATION_TEXT "Gain increase for pressure to current learning function\r\n" /end ANNOTATION_TEXT
 /end ANNOTATION
/end CHARACTERISTIC
/begin CHARACTERISTIC DWC_EFLASHB.DWC_K1DeviceControl.DWC_PressCurrent.DWC_MAXPRESSADAPT "" VALUE 0x80609D54 DefaultValueRecordLayout_AUTOSAR_Platform_BaseTypes_sint16 34.0 RB_PT_PCT_SWC_DWC_CompuMethods_ratio_0p001__2 -2. 32. FORMAT "%10.5"
 /begin ANNOTATION ANNOTATION_LABEL "Description (coming from AUTOSAR DESC field)" /begin ANNOTATION_TEXT "Maximum pressure point for valve adaption\r\n" /end ANNOTATION_TEXT /end ANNOTATION
/end CHARACTERISTIC
/begin CHARACTERISTIC DWC_EFLASHB.DWC_K1DeviceControl.DWC_PressCurrent.DWC_MAXPRESSNEGOFFSETMAX "" VALUE 0x80609D56 DefaultValueRecordLayout_AUTOSAR_Platform_BaseTypes_sint16 2000.0 RB_PT_PCT_SWC_DWC_CompuMethods_ratio_0p1 -1000. 1000. FORMAT "%10.5"
 /begin ANNOTATION ANNOTATION_LABEL "Description (coming from AUTOSAR DESC field)" /begin ANNOTATION_TEXT "Limit for adption\r\n" /end ANNOTATION_TEXT /end ANNOTATION
/end CHARACTERISTIC
/begin CHARACTERISTIC DWC_EFLASHB.DWC_K1DeviceControl.DWC_PressCurrent.DWC_MAXPRESSPOSOFFSETMAX "" VALUE 0x80609D58 DefaultValueRecordLayout_AUTOSAR_Platform_BaseTypes_sint16 2000.0 RB_PT_PCT_SWC_DWC_CompuMethods_ratio_0p1 -1000. 1000. FORMAT "%10.5"
 /begin ANNOTATION ANNOTATION_LABEL "Description (coming from AUTOSAR DESC field)" /begin ANNOTATION_TEXT "limit for adaption\r\n" /end ANNOTATION_TEXT /end ANNOTATION
/end CHARACTERISTIC
/begin CHARACTERISTIC DWC_EFLASHB.DWC_K1DeviceControl.DWC_PressCurrent.DWC_MINENGINESPEEDVALVEADAPT "" VALUE 0x80609D5A DefaultValueRecordLayout_AUTOSAR_Platform_BaseTypes_uint16 20000.0 RB_PT_PCT_SWC_DWC_CompuMethods_ident 0.0 20000. FORMAT "%10.5"
 /begin ANNOTATION ANNOTATION_LABEL "Description (coming from AUTOSAR DESC field)"
  /begin ANNOTATION_TEXT "Minimum engine speed before valve characteristic is trimmed\r\n" /end ANNOTATION_TEXT
 /end ANNOTATION
/end CHARACTERISTIC
/begin CHARACTERISTIC DWC_EFLASHB.DWC_K1DeviceControl.DWC_PressCurrent.DWC_OVERPRESSUREADAPTIONALLOWED "" VALUE 0x80609D5C DefaultValueRecordLayout_AUTOSAR_Platform_BaseTypes_sint16 34.0 RB_PT_PCT_SWC_DWC_CompuMethods_ratio_0p001__2 -2. 32. FORMAT "%10.5"
 /begin ANNOTATION ANNOTATION_LABEL "Description (coming from AUTOSAR DESC field)"
  /begin ANNOTATION_TEXT "Pressure over adaption maximum limit for which adaption is still allowed\r\n" /end ANNOTATION_TEXT
 /end ANNOTATION
/end CHARACTERISTIC
/begin CHARACTERISTIC DWC_EFLASHB.DWC_K1DeviceControl.DWC_PressCurrent.DWC_PCPOSTVOLPCHANGETIME "" CURVE 0x80609D78 RB_PT_PCT_SWC_DWC_RecordLayouts_RL_Curve_uint16_5_sint16_5 10.0 RB_PT_PCT_SWC_DWC_CompuMethods_ratio_0p001__2 0.0 10. FORMAT "%10.5"
 /begin ANNOTATION ANNOTATION_LABEL "Description (coming from AUTOSAR DESC field)"
  /begin ANNOTATION_TEXT "Time after volume pulse for which different P gain is used\r\n" /end ANNOTATION_TEXT
 /end ANNOTATION
 /begin AXIS_DESCR STD_AXIS NO_INPUT_QUANTITY RB_PT_PCT_SWC_DWC_CompuMethods_ident 5 -50. 200. FORMAT "%10.5" DEPOSIT ABSOLUTE /end AXIS_DESCR
/end CHARACTERISTIC
/begin CHARACTERISTIC DWC_EFLASHB.DWC_K1DeviceControl.DWC_PressCurrent.DWC_PressDemandLP.DWC_FIRSTORDERLPCOEFF "" VALUE 0x80609D73 DefaultValueRecordLayout_AUTOSAR_Platform_BaseTypes_uint8 1.0 RB_PT_PCT_SWC_DWC_CompuMethods_ratio_0p01 0.0 1. FORMAT "%10.5"
 /begin ANNOTATION ANNOTATION_LABEL "Description (coming from AUTOSAR DESC field)" /begin ANNOTATION_TEXT "Coefficient for low pass IIR filter\r\n" /end ANNOTATION_TEXT /end ANNOTATION
/end CHARACTERISTIC
/begin CHARACTERISTIC DWC_EFLASHB.DWC_K1DeviceControl.DWC_PressCurrent.DWC_PRESSERRORTOCORRECTION "" CURVE 0x80609D8E RB_PT_PCT_SWC_DWC_RecordLayouts_RL_Curve_sint16_5_sint16_5 2000.0 RB_PT_PCT_SWC_DWC_CompuMethods_ratio_0p1 -1000. 1000. FORMAT "%10.5"
 /begin ANNOTATION ANNOTATION_LABEL "Description (coming from AUTOSAR DESC field)"
  /begin ANNOTATION_TEXT "Correction error to be made to lower and upper values\r\n" /end ANNOTATION_TEXT
 /end ANNOTATION
 /begin AXIS_DESCR STD_AXIS NO_INPUT_QUANTITY RB_PT_PCT_SWC_DWC_CompuMethods_ratio_0p001__2 5 -5. 5. FORMAT "%10.5" DEPOSIT ABSOLUTE /end AXIS_DESCR
/end CHARACTERISTIC
/end MODULE
/end PROJECT
