VERSION ""

NS_ :

BS_:

BU_: TRC_Node

BO_ 498 Motor_01: 8 TRC_Node
 SG_ Engine_RPM : 0|16@1+ (0.25,0) [0|8000] "rpm" Vector__XXX

BO_ 499 Esp_01: 8 TRC_Node
 SG_ Vehicle_Speed : 0|16@1+ (0.01,0) [0|300] "km/h" Vector__XXX
