ASAP2_VERSION 1 60
/begin PROJECT LB74x_TCU "5201C621"
/begin HEADER "" VERSION "5201C621" PROJECT_NO LB74x_TCU /end HEADER
/begin MODULE DIM ""
/begin MOD_COMMON "" BYTE_ORDER MSB_LAST ALIGNMENT_BYTE 1 ALIGNMENT_WORD 2 ALIGNMENT_LONG 4 ALIGNMENT_INT64 4 ALIGNMENT_FLOAT32_IEEE 4 ALIGNMENT_FLOAT64_IEEE 4 DATA_SIZE 32 /end MOD_COMMON
/begin CHARACTERISTIC DWC_EFLASHB.DWC_TorqueControl.DWC_SLCDENGINETORQUEMAXMSADAPT "" VALUE 0x8060B4A6 DefaultValueRecordLayout_AUTOSAR_Platform_BaseTypes_uint16 10000.0 RB_PT_PCT_SWC_DWC_CompuMethods_ident 0.0 10000. FORMAT "%10.5"
 /begin ANNOTATION ANNOTATION_LABEL "Description (coming from AUTOSAR DESC field)"
  /begin ANNOTATION_TEXT "Maximum rate of change of engine torque for MS adaptation\r\n" /end ANNOTATION_TEXT
 /end ANNOTATION
/end CHARACTERISTIC
/begin CHARACTERISTIC DWC_EFLASHB.DWC_TorqueControl.DWC_SLCDRIVECOASTCHANGESLIP "" VALUE 0x8060B4A8 DefaultValueRecordLayout_AUTOSAR_Platform_BaseTypes_uint16 20000.0 RB_PT_PCT_SWC_DWC_CompuMethods_ident 0.0 20000. FORMAT "%10.5"
 /begin ANNOTATION ANNOTATION_LABEL "Description (coming from AUTOSAR DESC field)" /begin ANNOTATION_TEXT "Slip required to change from drive to coast and back\r\n" /end ANNOTATION_TEXT /end ANNOTATION
/end CHARACTERISTIC
/begin CHARACTERISTIC DWC_EFLASHB.DWC_TorqueControl.DWC_SLCESPEEDABOVEIDLEFORASGSLIPRULE "" VALUE 0x8060B4AA DefaultValueRecordLayout_AUTOSAR_Platform_BaseTypes_uint16 20000.0 RB_PT_PCT_SWC_DWC_CompuMethods_ident 0.0 20000. FORMAT "%10.5"
 /begin ANNOTATION ANNOTATION_LABEL "Description (coming from AUTOSAR DESC field)"
  /begin ANNOTATION_TEXT "Engine speed above idle before slip too high can be set\r\n" /end ANNOTATION_TEXT
 /end ANNOTATION
/end CHARACTERISTIC
/begin CHARACTERISTIC DWC_EFLASHB.DWC_TorqueControl.DWC_SLCGEARTORQUEFORFILTSLIP "" VAL_BLK 0x8060B388 DefaultValueRecordLayout_AUTOSAR_Platform_BaseTypes_uint16 2000.0 RB_PT_PCT_SWC_DWC_CompuMethods_ratio_0p1 0.0 2000. FORMAT "%10.5"
 /begin ANNOTATION ANNOTATION_LABEL "Description (coming from AUTOSAR DESC field)" /begin ANNOTATION_TEXT "Maximum torque, above which filtered slip is used\r\n" /end ANNOTATION_TEXT /end ANNOTATION
 MATRIX_DIM 12 1 1 /end CHARACTERISTIC
/begin CHARACTERISTIC DWC_EFLASHB.DWC_TorqueControl.DWC_SLCINTEGRALGAIN "" VALUE 0x8060B4AC DefaultValueRecordLayout_AUTOSAR_Platform_BaseTypes_uint16 0.15 RB_PT_PCT_SWC_DWC_CompuMethods_ratio_0p00001 0.0 0.15 FORMAT "%10.5"
 /begin ANNOTATION ANNOTATION_LABEL "Description (coming from AUTOSAR DESC field)" /begin ANNOTATION_TEXT "Integral gain of slip controller\r\n" /end ANNOTATION_TEXT /end ANNOTATION
/end CHARACTERISTIC
/begin CHARACTERISTIC DWC_EFLASHB.DWC_TorqueControl.DWC_SLCINTEGRALGAINSCHEDADAPTNORM "" CURVE 0x8060D6EE RB_PT_PCT_SWC_DWC_RecordLayouts_RL_Curve_uint16_5_sint16_5 0.15 RB_PT_PCT_SWC_DWC_CompuMethods_ratio_0p00001 0.0 0.15 FORMAT "%10.5"
 /begin ANNOTATION ANNOTATION_LABEL "Description (coming from AUTOSAR DESC field)" /begin ANNOTATION_TEXT "Scheduled I gain - adaption\r\n" /end ANNOTATION_TEXT /end ANNOTATION
 /begin AXIS_DESCR STD_AXIS NO_INPUT_QUANTITY RB_PT_PCT_SWC_DWC_CompuMethods_ident 5 -20000. 20000. FORMAT "%10.5" DEPOSIT ABSOLUTE /end AXIS_DESCR
/end CHARACTERISTIC
/begin CHARACTERISTIC DWC_EFLASHB.DWC_TorqueControl.DWC_SLCINTEGRALGAINSCHEDADAPTPOWEROFF "" CURVE 0x8060D704 RB_PT_PCT_SWC_DWC_RecordLayouts_RL_Curve_uint16_5_sint16_5 0.15 RB_PT_PCT_SWC_DWC_CompuMethods_ratio_0p00001 0.0 0.15 FORMAT "%10.5"
 /begin ANNOTATION ANNOTATION_LABEL "Description (coming from AUTOSAR DESC field)" /begin ANNOTATION_TEXT "Scheduled I gain - adaption power off\r\n" /end ANNOTATION_TEXT /end ANNOTATION
 /begin AXIS_DESCR STD_AXIS NO_INPUT_QUANTITY RB_PT_PCT_SWC_DWC_CompuMethods_ident 5 -20000. 20000. FORMAT "%10.5" DEPOSIT ABSOLUTE /end AXIS_DESCR
/end CHARACTERISTIC
/begin CHARACTERISTIC DWC_EFLASHB.DWC_TorqueControl.DWC_SLCINTEGRALGAINSCHEDMICRO "" CURVE 0x8060D71A RB_PT_PCT_SWC_DWC_RecordLayouts_RL_Curve_uint16_5_sint16_5 0.15 RB_PT_PCT_SWC_DWC_CompuMethods_ratio_0p00001 0.0 0.15 FORMAT "%10.5"
 /begin ANNOTATION ANNOTATION_LABEL "Description (coming from AUTOSAR DESC field)" /begin ANNOTATION_TEXT "Scheduled I gain - microslip\r\n" /end ANNOTATION_TEXT /end ANNOTATION
 /begin AXIS_DESCR STD_AXIS NO_INPUT_QUANTITY RB_PT_PCT_SWC_DWC_CompuMethods_ident 5 -20000. 20000. FORMAT "%10.5" DEPOSIT ABSOLUTE /end AXIS_DESCR
/end CHARACTERISTIC
/begin CHARACTERISTIC DWC_EFLASHB.DWC_TorqueControl.DWC_SLCINTEGRALGAINSCHEDMICROPA "" MAP 0x8060D730 RB_PT_PCT_SWC_DWC_RecordLayouts_RL_Map_uint16_25_sint16_5_sint16_5 0.15 RB_PT_PCT_SWC_DWC_CompuMethods_ratio_0p00001 0.0 0.15 FORMAT "%10.5"
 /begin ANNOTATION ANNOTATION_LABEL "Description (coming from AUTOSAR DESC field)"
  /begin ANNOTATION_TEXT "Integral gain of controller for microslip in pullaway gears\r\n" /end ANNOTATION_TEXT
 /end ANNOTATION
 /begin AXIS_DESCR STD_AXIS NO_INPUT_QUANTITY RB_PT_PCT_SWC_DWC_CompuMethods_ident 5 -20000. 20000. FORMAT "%10.5" DEPOSIT ABSOLUTE /end AXIS_DESCR
 /begin AXIS_DESCR STD_AXIS NO_INPUT_QUANTITY RB_PT_PCT_SWC_DWC_CompuMethods_ratio_0p1 5 -2000. 2000. FORMAT "%10.5" DEPOSIT ABSOLUTE /end AXIS_DESCR
/end CHARACTERISTIC
/begin CHARACTERISTIC DWC_EFLASHB.DWC_TorqueControl.DWC_SLCINTEGRALGAINSCHEDMICRORECONNECT "" MAP 0x8060D77A RB_PT_PCT_SWC_DWC_RecordLayouts_RL_Map_uint16_25_uint16_5_sint16_5 0.15 RB_PT_PCT_SWC_DWC_CompuMethods_ratio_0p00001 0.0 0.15 FORMAT "%10.5"
 /begin ANNOTATION ANNOTATION_LABEL "Description (coming from AUTOSAR DESC field)"
  /begin ANNOTATION_TEXT "Integral gain of controller for microslip during reconnect\r\n" /end ANNOTATION_TEXT
 /end ANNOTATION
 /begin AXIS_DESCR STD_AXIS NO_INPUT_QUANTITY RB_PT_PCT_SWC_DWC_CompuMethods_ident 5 0.0 20000. FORMAT "%10.5" DEPOSIT ABSOLUTE /end AXIS_DESCR
 /begin AXIS_DESCR STD_AXIS NO_INPUT_QUANTITY RB_PT_PCT_SWC_DWC_CompuMethods_ratio_0p1 5 -2000. 2000. FORMAT "%10.5" DEPOSIT ABSOLUTE /end AXIS_DESCR
/end CHARACTERISTIC
/begin CHARACTERISTIC DWC_EFLASHB.DWC_TorqueControl.DWC_SLCINTEGRALGAINSCHEDMICRORECONNERROR "" CURVE 0x8060D7C4 RB_PT_PCT_SWC_DWC_RecordLayouts_RL_Curve_uint8_5_sint16_5 1.0 RB_PT_PCT_SWC_DWC_CompuMethods_ratio_0p01 0.0 1. FORMAT "%10.5"
 /begin ANNOTATION ANNOTATION_LABEL "Description (coming from AUTOSAR DESC field)"
  /begin ANNOTATION_TEXT "Factor of integral gain to use for reconnect based on error\r\n" /end ANNOTATION_TEXT
 /end ANNOTATION
 /begin AXIS_DESCR STD_AXIS NO_INPUT_QUANTITY RB_PT_PCT_SWC_DWC_CompuMethods_ident 5 -20000. 20000. FORMAT "%10.5" DEPOSIT ABSOLUTE /end AXIS_DESCR
/end CHARACTERISTIC
/begin CHARACTERISTIC DWC_EFLASHB.DWC_TorqueControl.DWC_SLCINTEGRALGAINSCHEDPOWERONDOWN "" CURVE 0x8060D7D6 RB_PT_PCT_SWC_DWC_RecordLayouts_RL_Curve_uint16_5_sint16_5 0.15 RB_PT_PCT_SWC_DWC_CompuMethods_ratio_0p00001 0.0 0.15 FORMAT "%10.5"
 /begin ANNOTATION ANNOTATION_LABEL "Description (coming from AUTOSAR DESC field)" /begin ANNOTATION_TEXT "Scheduled I gain - power on down shifts\r\n" /end ANNOTATION_TEXT /end ANNOTATION
 /begin AXIS_DESCR STD_AXIS NO_INPUT_QUANTITY RB_PT_PCT_SWC_DWC_CompuMethods_ident 5 -20000. 20000. FORMAT "%10.5" DEPOSIT ABSOLUTE /end AXIS_DESCR
/end CHARACTERISTIC
/begin CHARACTERISTIC DWC_EFLASHB.DWC_TorqueControl.DWC_SLCINTEGRALGAINTORQUEPHASE "" CURVE 0x8060D7EC RB_PT_PCT_SWC_DWC_RecordLayouts_RL_Curve_uint16_5_sint16_5 0.15 RB_PT_PCT_SWC_DWC_CompuMethods_ratio_0p00001 0.0 0.15 FORMAT "%10.5"
 /begin ANNOTATION ANNOTATION_LABEL "Description (coming from AUTOSAR DESC field)" /begin ANNOTATION_TEXT "Scheduled I gain - TORQUEPHASE\r\n" /end ANNOTATION_TEXT /end ANNOTATION
 /begin AXIS_DESCR STD_AXIS NO_INPUT_QUANTITY RB_PT_PCT_SWC_DWC_CompuMethods_ident 5 -20000. 20000. FORMAT "%10.5" DEPOSIT ABSOLUTE /end AXIS_DESCR
/end CHARACTERISTIC
/begin CHARACTERISTIC DWC_EFLASHB.DWC_TorqueControl.DWC_SLCLATACCMAXMSADAPT "" VALUE 0x8060B4AE DefaultValueRecordLayout_AUTOSAR_Platform_BaseTypes_uint16 1.27 RB_PT_PCT_SWC_DWC_CompuMethods_ratio_0p01 0.0 1.27 FORMAT "%10.5"
 /begin ANNOTATION ANNOTATION_LABEL "Description (coming from AUTOSAR DESC field)" /begin ANNOTATION_TEXT "Maximum lateral acceleration for microslip adaption\r\n" /end ANNOTATION_TEXT /end ANNOTATION
/end CHARACTERISTIC
/begin CHARACTERISTIC DWC_EFLASHB.DWC_TorqueControl.DWC_SLCLEADTORQUEFORIFREEZE "" VALUE 0x8060B4B0 DefaultValueRecordLayout_AUTOSAR_Platform_BaseTypes_sint16 4000.0 RB_PT_PCT_SWC_DWC_CompuMethods_ratio_0p1 -2000. 2000. FORMAT "%10.5"
 /begin ANNOTATION ANNOTATION_LABEL "Description (coming from AUTOSAR DESC field)"
  /begin ANNOTATION_TEXT "FF Lead torque above which the clutch can be considered locked and so a slip controller ITerm unwind should prevented\r\n" /end ANNOTATION_TEXT
 /end ANNOTATION
/end CHARACTERISTIC
/begin CHARACTERISTIC DWC_EFLASHB.DWC_TorqueControl.DWC_SLCMAXCONTROLLERTORQUEADAPT "" VALUE 0x8060B4B2 DefaultValueRecordLayout_AUTOSAR_Platform_BaseTypes_uint16 2000.0 RB_PT_PCT_SWC_DWC_CompuMethods_ratio_0p1 0.0 2000. FORMAT "%10.5"
 /begin ANNOTATION ANNOTATION_LABEL "Description (coming from AUTOSAR DESC field)" /begin ANNOTATION_TEXT "Maximum allowed controller torque for adaption\r\n" /end ANNOTATION_TEXT /end ANNOTATION
/end CHARACTERISTIC
/begin CHARACTERISTIC DWC_EFLASHB.DWC_TorqueControl.DWC_SLCMAXENGINESPEEDMSADAPT "" VALUE 0x8060B4B4 DefaultValueRecordLayout_AUTOSAR_Platform_BaseTypes_uint16 20000.0 RB_PT_PCT_SWC_DWC_CompuMethods_ident 0.0 20000. FORMAT "%10.5"
 /begin ANNOTATION ANNOTATION_LABEL "Description (coming from AUTOSAR DESC field)" /begin ANNOTATION_TEXT "Maximum engine speed for microslip adaptation\r\n" /end ANNOTATION_TEXT /end ANNOTATION
/end CHARACTERISTIC
/begin CHARACTERISTIC DWC_EFLASHB.DWC_TorqueControl.DWC_SLCMAXENGINETEMPMSADAPT "" VALUE 0x8060B4B6 DefaultValueRecordLayout_AUTOSAR_Platform_BaseTypes_sint16 255.0 RB_PT_PCT_SWC_DWC_CompuMethods_ident -60. 195. FORMAT "%10.5"
 /begin ANNOTATION ANNOTATION_LABEL "Description (coming from AUTOSAR DESC field)" /begin ANNOTATION_TEXT "Maximum engine temperature for microslip adaption\r\n" /end ANNOTATION_TEXT /end ANNOTATION
/end CHARACTERISTIC
/begin CHARACTERISTIC DWC_EFLASHB.DWC_TorqueControl.DWC_SLCMAXGEARMICROSLIPADAPT "" VALUE 0x8060B54F DefaultValueRecordLayout_AUTOSAR_Platform_BaseTypes_uint8 11.0 RB_PT_PCT_SWC_DWC_CompuMethods_ident 0.0 11. FORMAT "%10.5"
 /begin ANNOTATION ANNOTATION_LABEL "Description (coming from AUTOSAR DESC field)" /begin ANNOTATION_TEXT "Maximum gear for microslip adaptation\r\n" /end ANNOTATION_TEXT /end ANNOTATION
/end CHARACTERISTIC
/begin CHARACTERISTIC DWC_EFLASHB.DWC_TorqueControl.DWC_SLCMAXSLIPFORASGENGAGE "" VALUE 0x8060B4B8 DefaultValueRecordLayout_AUTOSAR_Platform_BaseTypes_uint16 20000.0 RB_PT_PCT_SWC_DWC_CompuMethods_ident 0.0 20000. FORMAT "%10.5"
 /begin ANNOTATION ANNOTATION_LABEL "Description (coming from AUTOSAR DESC field)" /begin ANNOTATION_TEXT "Maximum slip for ASG engagement\r\n" /end ANNOTATION_TEXT /end ANNOTATION
/end CHARACTERISTIC
/begin CHARACTERISTIC DWC_EFLASHB.DWC_TorqueControl.DWC_SLCMAXTEMPMSADAPT "" VALUE 0x8060B4BA DefaultValueRecordLayout_AUTOSAR_Platform_BaseTypes_sint16 250.0 RB_PT_PCT_SWC_DWC_CompuMethods_ident -50. 200. FORMAT "%10.5"
 /begin ANNOTATION ANNOTATION_LABEL "Description (coming from AUTOSAR DESC field)" /begin ANNOTATION_TEXT "Maximum temperature for microslip adaption\r\n" /end ANNOTATION_TEXT /end ANNOTATION
/end CHARACTERISTIC
/begin CHARACTERISTIC DWC_EFLASHB.DWC_TorqueControl.DWC_SLCMICROSLIPMAXSPEEDADAPT "" VALUE 0x8060B4BC DefaultValueRecordLayout_AUTOSAR_Platform_BaseTypes_uint16 20000.0 RB_PT_PCT_SWC_DWC_CompuMethods_ident 0.0 20000. FORMAT "%10.5"
 /begin ANNOTATION ANNOTATION_LABEL "Description (coming from AUTOSAR DESC field)" /begin ANNOTATION_TEXT "Maximum speed considered to be micro slip\r\n" /end ANNOTATION_TEXT /end ANNOTATION
/end CHARACTERISTIC
/begin CHARACTERISTIC DWC_EFLASHB.DWC_TorqueControl.DWC_SLCMICROSLIPMINSPEEDADAPT "" VALUE 0x8060B4BE DefaultValueRecordLayout_AUTOSAR_Platform_BaseTypes_uint16 20000.0 RB_PT_PCT_SWC_DWC_CompuMethods_ident 0.0 20000. FORMAT "%10.5"
 /begin ANNOTATION ANNOTATION_LABEL "Description (coming from AUTOSAR DESC field)" /begin ANNOTATION_TEXT "Minimum speed considered to be micro slip\r\n" /end ANNOTATION_TEXT /end ANNOTATION
/end CHARACTERISTIC
/begin CHARACTERISTIC DWC_EFLASHB.DWC_TorqueControl.DWC_SLCMINCONTROLLERTORQUEADAPT "" VALUE 0x8060B4C0 DefaultValueRecordLayout_AUTOSAR_Platform_BaseTypes_uint16 2000.0 RB_PT_PCT_SWC_DWC_CompuMethods_ratio_0p1 0.0 2000. FORMAT "%10.5"
 /begin ANNOTATION ANNOTATION_LABEL "Description (coming from AUTOSAR DESC field)" /begin ANNOTATION_TEXT "Minimum allowed controller torque for adaption\r\n" /end ANNOTATION_TEXT /end ANNOTATION
/end CHARACTERISTIC
/begin CHARACTERISTIC DWC_EFLASHB.DWC_TorqueControl.DWC_SLCMINEMOTORTORQUEADAPT "" VALUE 0x8060B4C2 DefaultValueRecordLayout_AUTOSAR_Platform_BaseTypes_uint16 2000.0 RB_PT_PCT_SWC_DWC_CompuMethods_ratio_0p1 0.0 2000. FORMAT "%10.5"
 /begin ANNOTATION ANNOTATION_LABEL "Description (coming from AUTOSAR DESC field)" /begin ANNOTATION_TEXT "Minimum allowed E Motor torque for adaption\r\n" /end ANNOTATION_TEXT /end ANNOTATION
/end CHARACTERISTIC
/begin CHARACTERISTIC DWC_EFLASHB.DWC_TorqueControl.DWC_SLCMINENGINESPEEDMSADAPT "" VALUE 0x8060B4C4 DefaultValueRecordLayout_AUTOSAR_Platform_BaseTypes_uint16 20000.0 RB_PT_PCT_SWC_DWC_CompuMethods_ident 0.0 20000. FORMAT "%10.5"
 /begin ANNOTATION ANNOTATION_LABEL "Description (coming from AUTOSAR DESC field)" /begin ANNOTATION_TEXT "Minimum engine speed for microslip adaptation\r\n" /end ANNOTATION_TEXT /end ANNOTATION
/end CHARACTERISTIC
/begin CHARACTERISTIC DWC_EFLASHB.DWC_TorqueControl.DWC_SLCMINENGINETEMPMSADAPT "" VALUE 0x8060B4C6 DefaultValueRecordLayout_AUTOSAR_Platform_BaseTypes_sint16 255.0 RB_PT_PCT_SWC_DWC_CompuMethods_ident -60. 195. FORMAT "%10.5"
 /begin ANNOTATION ANNOTATION_LABEL "Description (coming from AUTOSAR DESC field)" /begin ANNOTATION_TEXT "Minimum engine temperature for microslip adaption\r\n" /end ANNOTATION_TEXT /end ANNOTATION
/end CHARACTERISTIC
/begin CHARACTERISTIC DWC_EFLASHB.DWC_TorqueControl.DWC_SLCMINGEARMICROSLIPADAPT "" VALUE 0x8060B550 DefaultValueRecordLayout_AUTOSAR_Platform_BaseTypes_uint8 11.0 RB_PT_PCT_SWC_DWC_CompuMethods_ident 0.0 11. FORMAT "%10.5"
 /begin ANNOTATION ANNOTATION_LABEL "Description (coming from AUTOSAR DESC field)" /begin ANNOTATION_TEXT "Minimum gear for microslip adaptation\r\n" /end ANNOTATION_TEXT /end ANNOTATION
/end CHARACTERISTIC
/begin CHARACTERISTIC DWC_EFLASHB.DWC_TorqueControl.DWC_SLCMINICMOTORTORQUEADAPT "" VALUE 0x8060B4C8 DefaultValueRecordLayout_AUTOSAR_Platform_BaseTypes_uint16 2000.0 RB_PT_PCT_SWC_DWC_CompuMethods_ratio_0p1 0.0 2000. FORMAT "%10.5"
 /begin ANNOTATION ANNOTATION_LABEL "Description (coming from AUTOSAR DESC field)" /begin ANNOTATION_TEXT "Minimum allowed IC torque for adaption\r\n" /end ANNOTATION_TEXT /end ANNOTATION
/end CHARACTERISTIC
/begin CHARACTERISTIC DWC_EFLASHB.DWC_TorqueControl.DWC_SLCMINTEMPMSADAPT "" VALUE 0x8060B4CA DefaultValueRecordLayout_AUTOSAR_Platform_BaseTypes_sint16 250.0 RB_PT_PCT_SWC_DWC_CompuMethods_ident -50. 200. FORMAT "%10.5"
 /begin ANNOTATION ANNOTATION_LABEL "Description (coming from AUTOSAR DESC field)" /begin ANNOTATION_TEXT "Minimum temperature for microslip adaption\r\n" /end ANNOTATION_TEXT /end ANNOTATION
/end CHARACTERISTIC
/begin CHARACTERISTIC DWC_EFLASHB.DWC_TorqueControl.DWC_SLCMinTorqueManager.DWC_SLCBYPASSINGEARSLIPTORQUEMIN "" VALUE 0x8060BDD8 DefaultValueRecordLayout_AUTOSAR_Platform_BaseTypes_boolean 255.0 AUTOSAR_Platform_CompuMethods_boolean 0.0 255. FORMAT "%10.5"
 /begin ANNOTATION ANNOTATION_LABEL "Description (coming from AUTOSAR DESC field)"
  /begin ANNOTATION_TEXT "Flag to bypass slip torque min in gear only condition\r\n" /end ANNOTATION_TEXT
 /end ANNOTATION
/end CHARACTERISTIC
/begin CHARACTERISTIC DWC_EFLASHB.DWC_TorqueControl.DWC_SLCMinTorqueManager.DWC_SLCENGABVSETPOSRATE "" VALUE 0x8060BDB8 DefaultValueRecordLayout_AUTOSAR_Platform_BaseTypes_sint32 40000.0 RB_PT_PCT_SWC_DWC_CompuMethods_ratio_0p1 -20000. 20000. FORMAT "%10.5"
 /begin ANNOTATION ANNOTATION_LABEL "Description (coming from AUTOSAR DESC field)"
  /begin ANNOTATION_TEXT "Rate limit for engine above setpoint (positive rate only, negative is unlimited)\r\n" /end ANNOTATION_TEXT
 /end ANNOTATION
/end CHARACTERISTIC
/begin CHARACTERISTIC DWC_EFLASHB.DWC_TorqueControl.DWC_SLCMinTorqueManager.DWC_SLCENGINETORQUEFORCEDLOCKHYST "" VALUE 0x8060BDBC DefaultValueRecordLayout_AUTOSAR_Platform_BaseTypes_uint16 2000.0 RB_PT_PCT_SWC_DWC_CompuMethods_ratio_0p1 0.0 2000. FORMAT "%10.5"
 /begin ANNOTATION ANNOTATION_LABEL "Description (coming from AUTOSAR DESC field)" /begin ANNOTATION_TEXT "Hysteresis for forced lock torque level\r\n" /end ANNOTATION_TEXT /end ANNOTATION
/end CHARACTERISTIC
/begin CHARACTERISTIC DWC_EFLASHB.DWC_TorqueControl.DWC_SLCMinTorqueManager.DWC_SLCIGNOREBYPASSPREPARE "" VALUE 0x8060BDD9 DefaultValueRecordLayout_AUTOSAR_Platform_BaseTypes_boolean 255.0 AUTOSAR_Platform_CompuMethods_boolean 0.0 255. FORMAT "%10.5"
 /begin ANNOTATION ANNOTATION_LABEL "Description (coming from AUTOSAR DESC field)"
  /begin ANNOTATION_TEXT "Flag to force unlock in all prepare cases, including bypass prepare\r\n" /end ANNOTATION_TEXT
 /end ANNOTATION
/end CHARACTERISTIC
/begin CHARACTERISTIC DWC_EFLASHB.DWC_TorqueControl.DWC_SLCMinTorqueManager.DWC_SLCLAUNCHGEARFORLOCKUP "" VAL_BLK 0x8060BD2C DefaultValueRecordLayout_AUTOSAR_Platform_BaseTypes_uint8 2.0 RB_PT_PCT_SWC_DWC_CompuMethods_ident 0.0 2. FORMAT "%10.5"
 /begin ANNOTATION ANNOTATION_LABEL "Description (coming from AUTOSAR DESC field)" /begin ANNOTATION_TEXT "Gear for lockup - launch control active\r\n" /end ANNOTATION_TEXT /end ANNOTATION
 MATRIX_DIM 14 1 1 /end CHARACTERISTIC
/begin CHARACTERISTIC DWC_EFLASHB.DWC_TorqueControl.DWC_SLCMinTorqueManager.DWC_SLCLOCKUPFASTDROPTORQUE "" VALUE 0x8060BDBE DefaultValueRecordLayout_AUTOSAR_Platform_BaseTypes_uint16 2000.0 RB_PT_PCT_SWC_DWC_CompuMethods_ratio_0p1 0.0 2000. FORMAT "%10.5"
 /begin ANNOTATION ANNOTATION_LABEL "Description (coming from AUTOSAR DESC field)"
  /begin ANNOTATION_TEXT "Overclamp amount, above which a 'fast drop' minimum time will be applied\r\n" /end ANNOTATION_TEXT
 /end ANNOTATION
/end CHARACTERISTIC
/begin CHARACTERISTIC DWC_EFLASHB.DWC_TorqueControl.DWC_SLCMinTorqueManager.DWC_SLCLOCKUPINCRATE "" CURVE 0x8060BDE2 RB_PT_PCT_SWC_DWC_RecordLayouts_RL_Curve_uint16_5_sint16_5 2000.0 RB_PT_PCT_SWC_DWC_CompuMethods_ratio_0p1 0.0 2000. FORMAT "%10.5"
 /begin ANNOTATION ANNOTATION_LABEL "Description (coming from AUTOSAR DESC field)" /begin ANNOTATION_TEXT "Increase rate of lockup torque against engine torque\r\n" /end ANNOTATION_TEXT /end ANNOTATION
 /begin AXIS_DESCR STD_AXIS NO_INPUT_QUANTITY RB_PT_PCT_SWC_DWC_CompuMethods_ratio_0p1 5 -2000. 2000. FORMAT "%10.5" DEPOSIT ABSOLUTE /end AXIS_DESCR
/end CHARACTERISTIC
/begin CHARACTERISTIC DWC_EFLASHB.DWC_TorqueControl.DWC_SLCMinTorqueManager.DWC_SLCLOCKUPMAXSLIPACTUAL "" VALUE 0x8060BDC0 DefaultValueRecordLayout_AUTOSAR_Platform_BaseTypes_uint16 20000.0 RB_PT_PCT_SWC_DWC_CompuMethods_ident 0.0 20000. FORMAT "%10.5"
 /begin ANNOTATION ANNOTATION_LABEL "Description (coming from AUTOSAR DESC field)" /begin ANNOTATION_TEXT "Actual slip, below which lockup is allowed\r\n" /end ANNOTATION_TEXT /end ANNOTATION
/end CHARACTERISTIC
/begin CHARACTERISTIC DWC_EFLASHB.DWC_TorqueControl.DWC_SLCMinTorqueManager.DWC_SLCLOCKUPMAXSLIPTARGET "" VALUE 0x8060BDC2 DefaultValueRecordLayout_AUTOSAR_Platform_BaseTypes_uint16 20000.0 RB_PT_PCT_SWC_DWC_CompuMethods_ident 0.0 20000. FORMAT "%10.5"
 /begin ANNOTATION ANNOTATION_LABEL "Description (coming from AUTOSAR DESC field)" /begin ANNOTATION_TEXT "Target slip, below which lockup is allowed\r\n" /end ANNOTATION_TEXT /end ANNOTATION
/end CHARACTERISTIC
/begin CHARACTERISTIC DWC_EFLASHB.DWC_TorqueControl.DWC_SLCMinTorqueManager.DWC_SLCLOCKUPMINTEMPERATURE "" VALUE 0x8060BDC4 DefaultValueRecordLayout_AUTOSAR_Platform_BaseTypes_sint16 250.0 RB_PT_PCT_SWC_DWC_CompuMethods_ident -50. 200. FORMAT "%10.5"
 /begin ANNOTATION ANNOTATION_LABEL "Description (coming from AUTOSAR DESC field)"
  /begin ANNOTATION_TEXT "Minimum temperature (bulk oil) for lockup functionality\r\n" /end ANNOTATION_TEXT
 /end ANNOTATION
/end CHARACTERISTIC
/begin CHARACTERISTIC DWC_EFLASHB.DWC_TorqueControl.DWC_SLCMinTorqueManager.DWC_SLCLOCKUPMINTQABVENG "" VALUE 0x8060BDC6 DefaultValueRecordLayout_AUTOSAR_Platform_BaseTypes_uint16 2000.0 RB_PT_PCT_SWC_DWC_CompuMethods_ratio_0p1 0.0 2000. FORMAT "%10.5"
 /begin ANNOTATION ANNOTATION_LABEL "Description (coming from AUTOSAR DESC field)" /begin ANNOTATION_TEXT "Minimum torque above engine for ramp off calculation\r\n" /end ANNOTATION_TEXT /end ANNOTATION
/end CHARACTERISTIC
/begin CHARACTERISTIC DWC_EFLASHB.DWC_TorqueControl.DWC_SLCMinTorqueManager.DWC_SLCLOCKUPOFFSET "" VALUE 0x8060BDC8 DefaultValueRecordLayout_AUTOSAR_Platform_BaseTypes_uint16 2000.0 RB_PT_PCT_SWC_DWC_CompuMethods_ratio_0p1 0.0 2000. FORMAT "%10.5"
 /begin ANNOTATION ANNOTATION_LABEL "Description (coming from AUTOSAR DESC field)" /begin ANNOTATION_TEXT "Additional static offset on minimum torque request\r\n" /end ANNOTATION_TEXT /end ANNOTATION
/end CHARACTERISTIC
/begin CHARACTERISTIC DWC_EFLASHB.DWC_TorqueControl.DWC_SLCMinTorqueManager.DWC_SLCLOCKUPSAFETYMARGIN "" VALUE 0x8060BDDA DefaultValueRecordLayout_AUTOSAR_Platform_BaseTypes_uint8 2.0 RB_PT_PCT_SWC_DWC_CompuMethods_ratio_0p01 0.0 2. FORMAT "%10.5"
 /begin ANNOTATION ANNOTATION_LABEL "Description (coming from AUTOSAR DESC field)" /begin ANNOTATION_TEXT "Safety margin over engine torque for lockup request\r\n" /end ANNOTATION_TEXT /end ANNOTATION
/end CHARACTERISTIC
/begin CHARACTERISTIC DWC_EFLASHB.DWC_TorqueControl.DWC_SLCMinTorqueManager.DWC_SLCMINENGABOVEPASPDLOCKUP "" VAL_BLK 0x8060BDAA DefaultValueRecordLayout_AUTOSAR_Platform_BaseTypes_uint16 20000.0 RB_PT_PCT_SWC_DWC_CompuMethods_ident 0.0 20000. FORMAT "%10.5"
 /begin ANNOTATION ANNOTATION_LABEL "Description (coming from AUTOSAR DESC field)"
  /begin ANNOTATION_TEXT "Minimum engine speed above pullaway setpoint for lockup to start vs gear. (0 = Gear1/R1, 1 = Gear2/R2, 3 = Gear 3 onwards/R3)\r\n" /end ANNOTATION_TEXT
 /end ANNOTATION
 MATRIX_DIM 3 1 1 /end CHARACTERISTIC
/begin CHARACTERISTIC DWC_EFLASHB.DWC_TorqueControl.DWC_SLCMinTorqueManager.DWC_SLCMINENGABOVEPASPDUNLOCK "" VAL_BLK 0x8060BDB0 DefaultValueRecordLayout_AUTOSAR_Platform_BaseTypes_uint16 20000.0 RB_PT_PCT_SWC_DWC_CompuMethods_ident 0.0 20000. FORMAT "%10.5"
 /begin ANNOTATION ANNOTATION_LABEL "Description (coming from AUTOSAR DESC field)"
  /begin ANNOTATION_TEXT "Engine speed above pullaway setpoint which forces clutch to unlock vs gear. (0 = Gear1/R1, 1 = Gear2/R2, 3 = Gear 3 onwards/R3)\r\n" /end ANNOTATION_TEXT
 /end ANNOTATION
 MATRIX_DIM 3 1 1 /end CHARACTERISTIC
/begin CHARACTERISTIC DWC_EFLASHB.DWC_TorqueControl.DWC_SLCMinTorqueManager.DWC_SLCMINENGINESPEEDLOCKUPGEAR "" VAL_BLK 0x8060BD14 DefaultValueRecordLayout_AUTOSAR_Platform_BaseTypes_uint16 20000.0 RB_PT_PCT_SWC_DWC_CompuMethods_ident 0.0 20000. FORMAT "%10.5"
 /begin ANNOTATION ANNOTATION_LABEL "Description (coming from AUTOSAR DESC field)"
  /begin ANNOTATION_TEXT "Minimum engine speed, above which clutch locks vs gear\r\n" /end ANNOTATION_TEXT
 /end ANNOTATION
 MATRIX_DIM 12 1 1 /end CHARACTERISTIC
/begin CHARACTERISTIC DWC_EFLASHB.DWC_TorqueControl.DWC_SLCMinTorqueManager.DWC_SLCMINENGINESPEEDUNLOCKGEAR "" VAL_BLK 0x8060BCF8 DefaultValueRecordLayout_AUTOSAR_Platform_BaseTypes_uint16 20000.0 RB_PT_PCT_SWC_DWC_CompuMethods_ident 0.0 20000. FORMAT "%10.5"
 /begin ANNOTATION ANNOTATION_LABEL "Description (coming from AUTOSAR DESC field)"
  /begin ANNOTATION_TEXT "Minimum engine speed, below which clutch unlocks vs gear\r\n" /end ANNOTATION_TEXT
 /end ANNOTATION
 MATRIX_DIM 14 1 1 /end CHARACTERISTIC
/begin CHARACTERISTIC DWC_EFLASHB.DWC_TorqueControl.DWC_SLCMinTorqueManager.DWC_SLCMINTORQUESLIPCONTROLFAULT "" CURVE 0x8060BDF8 RB_PT_PCT_SWC_DWC_RecordLayouts_RL_Curve_uint16_5_sint16_5 2000.0 RB_PT_PCT_SWC_DWC_CompuMethods_ratio_0p1 0.0 2000. FORMAT "%10.5"
 /begin ANNOTATION ANNOTATION_LABEL "Description (coming from AUTOSAR DESC field)"
  /begin ANNOTATION_TEXT "Minimum clutch torque in slip control mode - with engine torque fault\r\n" /end ANNOTATION_TEXT
 /end ANNOTATION
 /begin AXIS_DESCR STD_AXIS NO_INPUT_QUANTITY RB_PT_PCT_SWC_DWC_CompuMethods_ident 5 -20000. 20000. FORMAT "%10.5" DEPOSIT ABSOLUTE /end AXIS_DESCR
/end CHARACTERISTIC
/begin CHARACTERISTIC DWC_EFLASHB.DWC_TorqueControl.DWC_SLCMinTorqueManager.DWC_SLCMINTORQUESLIPCONTROLMAX "" CURVE 0x8060BE0E RB_PT_PCT_SWC_DWC_RecordLayouts_RL_Curve_uint16_5_sint16_5 2000.0 RB_PT_PCT_SWC_DWC_CompuMethods_ratio_0p1 0.0 2000. FORMAT "%10.5"
 /begin ANNOTATION ANNOTATION_LABEL "Description (coming from AUTOSAR DESC field)"
  /begin ANNOTATION_TEXT "Minimum clutch torque in slip control mode - with engine torque fault\r\n" /end ANNOTATION_TEXT
 /end ANNOTATION
 /begin AXIS_DESCR STD_AXIS NO_INPUT_QUANTITY RB_PT_PCT_SWC_DWC_CompuMethods_ident 5 -20000. 20000. FORMAT "%10.5" DEPOSIT ABSOLUTE /end AXIS_DESCR
/end CHARACTERISTIC
/begin CHARACTERISTIC DWC_EFLASHB.DWC_TorqueControl.DWC_SLCMinTorqueManager.DWC_SLCMINTORQUESLIPCONTROLNORM "" MAP 0x8060BE24 RB_PT_PCT_SWC_DWC_RecordLayouts_RL_Map_uint16_25_sint16_5_sint16_5 2000.0 RB_PT_PCT_SWC_DWC_CompuMethods_ratio_0p1 0.0 2000. FORMAT "%10.5"
 /begin ANNOTATION ANNOTATION_LABEL "Description (coming from AUTOSAR DESC field)"
  /begin ANNOTATION_TEXT "Minimum slip controller torque in normal operation against speed above setpoint, and dTorque.dT\r\n" /end ANNOTATION_TEXT
 /end ANNOTATION
 /begin AXIS_DESCR STD_AXIS NO_INPUT_QUANTITY RB_PT_PCT_SWC_DWC_CompuMethods_ident 5 -20000. 20000. FORMAT "%10.5" DEPOSIT ABSOLUTE /end AXIS_DESCR
 /begin AXIS_DESCR STD_AXIS NO_INPUT_QUANTITY RB_PT_PCT_SWC_DWC_CompuMethods_ident 5 -10000. 10000. FORMAT "%10.5" DEPOSIT ABSOLUTE /end AXIS_DESCR
/end CHARACTERISTIC
/begin CHARACTERISTIC DWC_EFLASHB.DWC_TorqueControl.DWC_SLCMinTorqueManager.DWC_SLCMODEFORLOCKUPTRQNOKAY "" VALUE 0x8060BDDB DefaultValueRecordLayout_AUTOSAR_Platform_BaseTypes_uint8 2.0 RB_PT_PCT_SWC_DWC_CompuMethods_ident 0.0 2. FORMAT "%10.5"
 /begin ANNOTATION ANNOTATION_LABEL "Description (coming from AUTOSAR DESC field)" /begin ANNOTATION_TEXT "Lockup mode to use torque ok flag false.\r\n" /end ANNOTATION_TEXT /end ANNOTATION
/end CHARACTERISTIC
/begin CHARACTERISTIC DWC_EFLASHB.DWC_TorqueControl.DWC_SLCMinTorqueManager.DWC_SLCMODEGEARFORLOCKUP "" VAL_BLK 0x8060BD3A DefaultValueRecordLayout_AUTOSAR_Platform_BaseTypes_uint8 2.0 RB_PT_PCT_SWC_DWC_CompuMethods_ident 0.0 2. FORMAT "%10.5"
 /begin ANNOTATION ANNOTATION_LABEL "Description (coming from AUTOSAR DESC field)"
  /begin ANNOTATION_TEXT "Lockup condition request (0 = no lock, 1 = lock conditional, 2 = lock always) modes 0 - Normal Auto, 1 - Sport Auto, 2 - Track Auto, 3 - Normal Manual, 4 - Sport Manual, 5 - Track Manual, 6 - Electric, 7 - Eco\r\n" /end ANNOTATION_TEXT
 /end ANNOTATION
 MATRIX_DIM 14 8 1 /end CHARACTERISTIC
/begin CHARACTERISTIC DWC_EFLASHB.DWC_TorqueControl.DWC_SLCMinTorqueManager.DWC_SLCMODEINPUTFAILFORLOCKUP "" VALUE 0x8060BDDC DefaultValueRecordLayout_AUTOSAR_Platform_BaseTypes_uint8 2.0 RB_PT_PCT_SWC_DWC_CompuMethods_ident 0.0 2. FORMAT "%10.5"
 /begin ANNOTATION ANNOTATION_LABEL "Description (coming from AUTOSAR DESC field)"
  /begin ANNOTATION_TEXT "Lockup mode to use when in either input shaft sensors have failed (2 = activate)\r\n" /end ANNOTATION_TEXT
 /end ANNOTATION
/end CHARACTERISTIC
/begin CHARACTERISTIC DWC_EFLASHB.DWC_TorqueControl.DWC_SLCMinTorqueManager.DWC_SLCMODELOWTEMPFORLOCKUP "" VALUE 0x8060BDDD DefaultValueRecordLayout_AUTOSAR_Platform_BaseTypes_uint8 2.0 RB_PT_PCT_SWC_DWC_CompuMethods_ident 0.0 2. FORMAT "%10.5"
 /begin ANNOTATION ANNOTATION_LABEL "Description (coming from AUTOSAR DESC field)"
  /begin ANNOTATION_TEXT "Lockup mode to use when in brake system intervention mode (2 = activate)\r\n" /end ANNOTATION_TEXT
 /end ANNOTATION
/end CHARACTERISTIC
/begin CHARACTERISTIC DWC_EFLASHB.DWC_TorqueControl.DWC_SLCMinTorqueManager.DWC_SLCMODEPASWFORLOCKUP "" VALUE 0x8060BDDE DefaultValueRecordLayout_AUTOSAR_Platform_BaseTypes_uint8 2.0 RB_PT_PCT_SWC_DWC_CompuMethods_ident 0.0 2. FORMAT "%10.5"
 /begin ANNOTATION ANNOTATION_LABEL "Description (coming from AUTOSAR DESC field)"
  /begin ANNOTATION_TEXT "Lockup mode to use when in slipping wheels PA (2 = activate)\r\n" /end ANNOTATION_TEXT
 /end ANNOTATION
/end CHARACTERISTIC
/begin CHARACTERISTIC DWC_EFLASHB.DWC_TorqueControl.DWC_SLCMinTorqueManager.DWC_SLCMODETCSFORLOCKUP "" VALUE 0x8060BDDF DefaultValueRecordLayout_AUTOSAR_Platform_BaseTypes_uint8 2.0 RB_PT_PCT_SWC_DWC_CompuMethods_ident 0.0 2. FORMAT "%10.5"
 /begin ANNOTATION ANNOTATION_LABEL "Description (coming from AUTOSAR DESC field)"
  /begin ANNOTATION_TEXT "Lockup mode to use when in brake system intervention mode (2 = activate)\r\n" /end ANNOTATION_TEXT
 /end ANNOTATION
/end CHARACTERISTIC
/begin CHARACTERISTIC DWC_EFLASHB.DWC_TorqueControl.DWC_SLCMinTorqueManager.DWC_SLCTLOCKUPDECRATECNTRL "" VALUE 0x8060BDCA DefaultValueRecordLayout_AUTOSAR_Platform_BaseTypes_uint16 9.99 RB_PT_PCT_SWC_DWC_CompuMethods_ratio_0p001__2 0.01 10. FORMAT "%10.5"
 /begin ANNOTATION ANNOTATION_LABEL "Description (coming from AUTOSAR DESC field)"
  /begin ANNOTATION_TEXT "Decrease rate for lockup - non-slip controller called\r\n" /end ANNOTATION_TEXT
 /end ANNOTATION
/end CHARACTERISTIC
/begin CHARACTERISTIC DWC_EFLASHB.DWC_TorqueControl.DWC_SLCMinTorqueManager.DWC_SLCTLOCKUPDECRATEFAST "" VALUE 0x8060BDCC DefaultValueRecordLayout_AUTOSAR_Platform_BaseTypes_uint16 9.99 RB_PT_PCT_SWC_DWC_CompuMethods_ratio_0p001__2 0.01 10. FORMAT "%10.5"
 /begin ANNOTATION ANNOTATION_LABEL "Description (coming from AUTOSAR DESC field)"
  /begin ANNOTATION_TEXT "Decrease rate of lockup - fast drop at high overclamp torque\r\n" /end ANNOTATION_TEXT
 /end ANNOTATION
/end CHARACTERISTIC
/begin CHARACTERISTIC DWC_EFLASHB.DWC_TorqueControl.DWC_SLCMinTorqueManager.DWC_SLCTLOCKUPDECRATENOTINGEAR "" VALUE 0x8060BDCE DefaultValueRecordLayout_AUTOSAR_Platform_BaseTypes_uint16 9.99 RB_PT_PCT_SWC_DWC_CompuMethods_ratio_0p001__2 0.01 10. FORMAT "%10.5"
 /begin ANNOTATION ANNOTATION_LABEL "Description (coming from AUTOSAR DESC field)" /begin ANNOTATION_TEXT "Decrease rate for lockup - Out of 'In Gear'\r\n" /end ANNOTATION_TEXT /end ANNOTATION
/end CHARACTERISTIC
/begin CHARACTERISTIC DWC_EFLASHB.DWC_TorqueControl.DWC_SLCMinTorqueManager.DWC_SLCTLOCKUPDECRATEOTHER "" VALUE 0x8060BDD0 DefaultValueRecordLayout_AUTOSAR_Platform_BaseTypes_uint16 9.99 RB_PT_PCT_SWC_DWC_CompuMethods_ratio_0p001__2 0.01 10. FORMAT "%10.5"
 /begin ANNOTATION ANNOTATION_LABEL "Description (coming from AUTOSAR DESC field)" /begin ANNOTATION_TEXT "Decrease rate of lockup - all other conditions\r\n" /end ANNOTATION_TEXT /end ANNOTATION
/end CHARACTERISTIC
/begin CHARACTERISTIC DWC_EFLASHB.DWC_TorqueControl.DWC_SLCMinTorqueManager.DWC_SLCTLOCKUPDECRATEPREPARE "" VALUE 0x8060BDD2 DefaultValueRecordLayout_AUTOSAR_Platform_BaseTypes_uint16 9.99 RB_PT_PCT_SWC_DWC_CompuMethods_ratio_0p001__2 0.01 10. FORMAT "%10.5"
 /begin ANNOTATION ANNOTATION_LABEL "Description (coming from AUTOSAR DESC field)" /begin ANNOTATION_TEXT "Decrease rate for lockup - coming prepare\r\n" /end ANNOTATION_TEXT /end ANNOTATION
/end CHARACTERISTIC
/begin CHARACTERISTIC DWC_EFLASHB.DWC_TorqueControl.DWC_SLCMinTorqueManager.DWC_SLCTLOCKUPDECRATESPD "" VALUE 0x8060BDD4 DefaultValueRecordLayout_AUTOSAR_Platform_BaseTypes_uint16 9.99 RB_PT_PCT_SWC_DWC_CompuMethods_ratio_0p001__2 0.01 10. FORMAT "%10.5"
 /begin ANNOTATION ANNOTATION_LABEL "Description (coming from AUTOSAR DESC field)" /begin ANNOTATION_TEXT "Decrease rate for lockup - speed condition\r\n" /end ANNOTATION_TEXT /end ANNOTATION
/end CHARACTERISTIC
/begin CHARACTERISTIC DWC_EFLASHB.DWC_TorqueControl.DWC_SLCMinTorqueManager.DWC_SLCUNLOCKMINSLIPACTUAL "" VALUE 0x8060BDD6 DefaultValueRecordLayout_AUTOSAR_Platform_BaseTypes_uint16 20000.0 RB_PT_PCT_SWC_DWC_CompuMethods_ident 0.0 20000. FORMAT "%10.5"
 /begin ANNOTATION ANNOTATION_LABEL "Description (coming from AUTOSAR DESC field)" /begin ANNOTATION_TEXT "Actual slip, above which unlock should be detected\r\n" /end ANNOTATION_TEXT /end ANNOTATION
/end CHARACTERISTIC
/begin CHARACTERISTIC DWC_EFLASHB.DWC_TorqueControl.DWC_SLCMinTorqueManager.DWC_SLCUSEDRIVERTORQUEASMINIMUM "" VALUE 0x8060BDE0 DefaultValueRecordLayout_AUTOSAR_Platform_BaseTypes_boolean 255.0 AUTOSAR_Platform_CompuMethods_boolean 0.0 255. FORMAT "%10.5"
 /begin ANNOTATION ANNOTATION_LABEL "Description (coming from AUTOSAR DESC field)"
  /begin ANNOTATION_TEXT "Flag to force driver demand torque to be the minimum used\r\n" /end ANNOTATION_TEXT
 /end ANNOTATION
/end CHARACTERISTIC
/begin CHARACTERISTIC DWC_EFLASHB.DWC_TorqueControl.DWC_SLCMSADAPTGOODTIME "" VALUE 0x8060B4CC DefaultValueRecordLayout_AUTOSAR_Platform_BaseTypes_uint16 10.0 RB_PT_PCT_SWC_DWC_CompuMethods_ratio_0p001__2 0.0 10. FORMAT "%10.5"
 /begin ANNOTATION ANNOTATION_LABEL "Description (coming from AUTOSAR DESC field)"
  /begin ANNOTATION_TEXT "Time for which conditions must be good before adaptation is allowed to start\r\n" /end ANNOTATION_TEXT
 /end ANNOTATION
/end CHARACTERISTIC
/begin CHARACTERISTIC DWC_EFLASHB.DWC_TorqueControl.DWC_SLCOPENSTATEMINSLIP "" VALUE 0x8060B4CE DefaultValueRecordLayout_AUTOSAR_Platform_BaseTypes_uint16 20000.0 RB_PT_PCT_SWC_DWC_CompuMethods_ident 0.0 20000. FORMAT "%10.5"
 /begin ANNOTATION ANNOTATION_LABEL "Description (coming from AUTOSAR DESC field)" /begin ANNOTATION_TEXT "Minimum slip before the clutch is open\r\n" /end ANNOTATION_TEXT /end ANNOTATION
/end CHARACTERISTIC
/begin CHARACTERISTIC DWC_EFLASHB.DWC_TorqueControl.DWC_SLCPROPGAINMAP "" MAP 0x8060D802 RB_PT_PCT_SWC_DWC_RecordLayouts_RL_Map_sint16_10_sint16_2_sint16_5 1.0 RB_PT_PCT_SWC_DWC_CompuMethods_ratio_0p001__2 0.0 1. FORMAT "%10.5"
 /begin ANNOTATION ANNOTATION_LABEL "Description (coming from AUTOSAR DESC field)" /begin ANNOTATION_TEXT "Proportional slip gain vs slip\r\n" /end ANNOTATION_TEXT /end ANNOTATION
 /begin AXIS_DESCR STD_AXIS NO_INPUT_QUANTITY RB_PT_PCT_SWC_DWC_CompuMethods_ident 2 0.0 13. FORMAT "%10.5" DEPOSIT ABSOLUTE /end AXIS_DESCR
 /begin AXIS_DESCR STD_AXIS NO_INPUT_QUANTITY RB_PT_PCT_SWC_DWC_CompuMethods_ident 5 -20000. 20000. FORMAT "%10.5" DEPOSIT ABSOLUTE /end AXIS_DESCR
/end CHARACTERISTIC
/begin CHARACTERISTIC DWC_EFLASHB.DWC_TorqueControl.DWC_SLCPROPGAINMAPPA "" MAP 0x8060D828 RB_PT_PCT_SWC_DWC_RecordLayouts_RL_Map_sint16_25_sint16_5_sint16_5 1.0 RB_PT_PCT_SWC_DWC_CompuMethods_ratio_0p001__2 0.0 1. FORMAT "%10.5"
 /begin ANNOTATION ANNOTATION_LABEL "Description (coming from AUTOSAR DESC field)" /begin ANNOTATION_TEXT "Proportional slip gain vs error and torque\r\n" /end ANNOTATION_TEXT /end ANNOTATION
 /begin AXIS_DESCR STD_AXIS NO_INPUT_QUANTITY RB_PT_PCT_SWC_DWC_CompuMethods_ident 5 -20000. 20000. FORMAT "%10.5" DEPOSIT ABSOLUTE /end AXIS_DESCR
 /begin AXIS_DESCR STD_AXIS NO_INPUT_QUANTITY RB_PT_PCT_SWC_DWC_CompuMethods_ratio_0p1 5 -2000. 2000. FORMAT "%10.5" DEPOSIT ABSOLUTE /end AXIS_DESCR
/end CHARACTERISTIC
/begin CHARACTERISTIC DWC_EFLASHB.DWC_TorqueControl.DWC_SLCPROPGAINMAPRECONNECT "" MAP 0x8060D872 RB_PT_PCT_SWC_DWC_RecordLayouts_RL_Map_uint16_25_uint16_5_sint16_5 1.0 RB_PT_PCT_SWC_DWC_CompuMethods_ratio_0p001__2 0.0 1. FORMAT "%10.5"
 /begin ANNOTATION ANNOTATION_LABEL "Description (coming from AUTOSAR DESC field)" /begin ANNOTATION_TEXT "Proportional slip gain vs error and torque\r\n" /end ANNOTATION_TEXT /end ANNOTATION
 /begin AXIS_DESCR STD_AXIS NO_INPUT_QUANTITY RB_PT_PCT_SWC_DWC_CompuMethods_ident 5 0.0 20000. FORMAT "%10.5" DEPOSIT ABSOLUTE /end AXIS_DESCR
 /begin AXIS_DESCR STD_AXIS NO_INPUT_QUANTITY RB_PT_PCT_SWC_DWC_CompuMethods_ratio_0p1 5 -2000. 2000. FORMAT "%10.5" DEPOSIT ABSOLUTE /end AXIS_DESCR
/end CHARACTERISTIC
/begin CHARACTERISTIC DWC_EFLASHB.DWC_TorqueControl.DWC_SLCPROPGAINMAPRECONNECTERROR "" CURVE 0x8060D8BC RB_PT_PCT_SWC_DWC_RecordLayouts_RL_Curve_uint8_5_sint16_5 1.0 RB_PT_PCT_SWC_DWC_CompuMethods_ratio_0p01 0.0 1. FORMAT "%10.5"
 /begin ANNOTATION ANNOTATION_LABEL "Description (coming from AUTOSAR DESC field)"
  /begin ANNOTATION_TEXT "Factor of proportional gain to use for reconnect based on error\r\n" /end ANNOTATION_TEXT
 /end ANNOTATION
 /begin AXIS_DESCR STD_AXIS NO_INPUT_QUANTITY RB_PT_PCT_SWC_DWC_CompuMethods_ident 5 -20000. 20000. FORMAT "%10.5" DEPOSIT ABSOLUTE /end AXIS_DESCR
/end CHARACTERISTIC
/begin CHARACTERISTIC DWC_EFLASHB.DWC_TorqueControl.DWC_SLCPROPORTIONALGAIN "" VALUE 0x8060B4D0 DefaultValueRecordLayout_AUTOSAR_Platform_BaseTypes_sint16 2.0 RB_PT_PCT_SWC_DWC_CompuMethods_ratio_0p001__2 -1. 1. FORMAT "%10.5"
 /begin ANNOTATION ANNOTATION_LABEL "Description (coming from AUTOSAR DESC field)" /begin ANNOTATION_TEXT "Proportional gain of slip controller\r\n" /end ANNOTATION_TEXT /end ANNOTATION
/end CHARACTERISTIC
/begin CHARACTERISTIC DWC_EFLASHB.DWC_TorqueControl.DWC_SLCRESETIMINTORQUE "" VALUE 0x8060B551 DefaultValueRecordLayout_AUTOSAR_Platform_BaseTypes_boolean 255.0 AUTOSAR_Platform_CompuMethods_boolean 0.0 255. FORMAT "%10.5"
 /begin ANNOTATION ANNOTATION_LABEL "Description (coming from AUTOSAR DESC field)" /begin ANNOTATION_TEXT "Flag to reset I term on minimum torque\r\n" /end ANNOTATION_TEXT /end ANNOTATION
/end CHARACTERISTIC
/begin CHARACTERISTIC DWC_EFLASHB.DWC_TorqueControl.DWC_SLCSlipFiltAdapt.DWC_FIRSTORDERLPCOEFF "" VALUE 0x8060BE70 DefaultValueRecordLayout_AUTOSAR_Platform_BaseTypes_uint8 1.0 RB_PT_PCT_SWC_DWC_CompuMethods_ratio_0p01 0.0 1. FORMAT "%10.5"
 /begin ANNOTATION ANNOTATION_LABEL "Description (coming from AUTOSAR DESC field)" /begin ANNOTATION_TEXT "Coefficient for low pass IIR filter\r\n" /end ANNOTATION_TEXT /end ANNOTATION
/end CHARACTERISTIC
/begin CHARACTERISTIC DWC_EFLASHB.DWC_TorqueControl.DWC_SLCSPEEDCONTROLRECONNECTTIME "" VALUE 0x8060B4D2 DefaultValueRecordLayout_AUTOSAR_Platform_BaseTypes_uint16 10.0 RB_PT_PCT_SWC_DWC_CompuMethods_ratio_0p001__2 0.0 10. FORMAT "%10.5"
 /begin ANNOTATION ANNOTATION_LABEL "Description (coming from AUTOSAR DESC field)" /begin ANNOTATION_TEXT "Time after speed control for reconnect gain change\r\n" /end ANNOTATION_TEXT /end ANNOTATION
/end CHARACTERISTIC
/begin CHARACTERISTIC DWC_EFLASHB.DWC_TorqueControl.DWC_SLCTIMEINSLIPENDUNWIND "" VALUE 0x8060B4D4 DefaultValueRecordLayout_AUTOSAR_Platform_BaseTypes_uint16 10.0 RB_PT_PCT_SWC_DWC_CompuMethods_ratio_0p001__2 0.0 10. FORMAT "%10.5"
 /begin ANNOTATION ANNOTATION_LABEL "Description (coming from AUTOSAR DESC field)"
  /begin ANNOTATION_TEXT "Time in slip control before unwind of I term is completed\r\n" /end ANNOTATION_TEXT
 /end ANNOTATION
/end CHARACTERISTIC
/begin CHARACTERISTIC DWC_EFLASHB.DWC_TorqueControl.DWC_SLCUNWINDILIM "" VALUE 0x8060B3E8 DefaultValueRecordLayout_AUTOSAR_Platform_BaseTypes_sint32 4000.0 RB_PT_PCT_SWC_DWC_CompuMethods_ratio_0p0001 -2000. 2000. FORMAT "%10.5"
 /begin ANNOTATION ANNOTATION_LABEL "Description (coming from AUTOSAR DESC field)" /begin ANNOTATION_TEXT "Lower limit of unwind integrator function\r\n" /end ANNOTATION_TEXT /end ANNOTATION
/end CHARACTERISTIC
/begin CHARACTERISTIC DWC_EFLASHB.DWC_TorqueControl.DWC_SLCUNWINDIRATE "" CURVE 0x8060D8CE RB_PT_PCT_SWC_DWC_RecordLayouts_RL_Curve_uint16_5_uint16_5 10.0 RB_PT_PCT_SWC_DWC_CompuMethods_ratio_0p001__2 0.0 10. FORMAT "%10.5"
 /begin ANNOTATION ANNOTATION_LABEL "Description (coming from AUTOSAR DESC field)" /begin ANNOTATION_TEXT "Wind off rate of integrator vs itself\r\n" /end ANNOTATION_TEXT /end ANNOTATION
 /begin AXIS_DESCR STD_AXIS NO_INPUT_QUANTITY RB_PT_PCT_SWC_DWC_CompuMethods_ratio_0p001__2 5 0.0 50. FORMAT "%10.5" DEPOSIT ABSOLUTE /end AXIS_DESCR
/end CHARACTERISTIC
/begin CHARACTERISTIC DWC_EFLASHB.DWC_TorqueControl.DWC_SLCUSERECONNECTGAINSGT "" VALUE 0x8060B552 DefaultValueRecordLayout_AUTOSAR_Platform_BaseTypes_boolean 255.0 AUTOSAR_Platform_CompuMethods_boolean 0.0 255. FORMAT "%10.5"
 /begin ANNOTATION ANNOTATION_LABEL "Description (coming from AUTOSAR DESC field)" /begin ANNOTATION_TEXT "Use reconnect gains in a GT style shift\r\n" /end ANNOTATION_TEXT /end ANNOTATION
/end CHARACTERISTIC
/begin CHARACTERISTIC DWC_EFLASHB.DWC_TorqueControl.DWC_SLIPFORLOCK "" VALUE 0x8060B4D6 DefaultValueRecordLayout_AUTOSAR_Platform_BaseTypes_uint16 20000.0 RB_PT_PCT_SWC_DWC_CompuMethods_ident 0.0 20000. FORMAT "%10.5"
 /begin ANNOTATION ANNOTATION_LABEL "Description (coming from AUTOSAR DESC field)"
  /begin ANNOTATION_TEXT "Absolute slip below which clutch locked signal can be sent\r\n" /end ANNOTATION_TEXT
 /end ANNOTATION
/end CHARACTERISTIC
/begin CHARACTERISTIC DWC_EFLASHB.DWC_TorqueControl.DWC_SLIPFORUNLOCK "" VALUE 0x8060B4D8 DefaultValueRecordLayout_AUTOSAR_Platform_BaseTypes_uint16 20000.0 RB_PT_PCT_SWC_DWC_CompuMethods_ident 0.0 20000. FORMAT "%10.5"
 /begin ANNOTATION ANNOTATION_LABEL "Description (coming from AUTOSAR DESC field)"
  /begin ANNOTATION_TEXT "Absolute slip above which clutch locked signal is cleared\r\n" /end ANNOTATION_TEXT
 /end ANNOTATION
/end CHARACTERISTIC
/begin CHARACTERISTIC DWC_EFLASHB.DWC_TorqueControl.DWC_TASlipReconnect.DWC_TABYPASSSR "" VALUE 0x8060BE8A DefaultValueRecordLayout_AUTOSAR_Platform_BaseTypes_boolean 255.0 AUTOSAR_Platform_CompuMethods_boolean 0.0 255. FORMAT "%10.5"
 /begin ANNOTATION ANNOTATION_LABEL "Description (coming from AUTOSAR DESC field)" /begin ANNOTATION_TEXT "Flag to bypass SR latch\r\n" /end ANNOTATION_TEXT /end ANNOTATION
/end CHARACTERISTIC
/begin CHARACTERISTIC DWC_EFLASHB.DWC_TorqueControl.DWC_TASlipReconnect.DWC_TAENABLEENGINERECONNECT "" VALUE 0x8060BE8B DefaultValueRecordLayout_AUTOSAR_Platform_BaseTypes_boolean 255.0 AUTOSAR_Platform_CompuMethods_boolean 0.0 255. FORMAT "%10.5"
 /begin ANNOTATION ANNOTATION_LABEL "Description (coming from AUTOSAR DESC field)" /begin ANNOTATION_TEXT "Flag to enable engine torque request on reconnect\r\n" /end ANNOTATION_TEXT /end ANNOTATION
/end CHARACTERISTIC
/begin CHARACTERISTIC DWC_EFLASHB.DWC_TorqueControl.DWC_TASlipReconnect.DWC_TARECONNECTGEAR "" VAL_BLK 0x8060BE72 DefaultValueRecordLayout_AUTOSAR_Platform_BaseTypes_uint16 1.0 RB_PT_PCT_SWC_DWC_CompuMethods_ratio_0p001__2 0.0 1. FORMAT "%10.5"
 /begin ANNOTATION ANNOTATION_LABEL "Description (coming from AUTOSAR DESC field)" /begin ANNOTATION_TEXT "Gear factor of reconnect rate\r\n" /end ANNOTATION_TEXT /end ANNOTATION
 MATRIX_DIM 12 1 1 /end CHARACTERISTIC
/begin CHARACTERISTIC DWC_EFLASHB.DWC_TorqueControl.DWC_TASlipReconnect.DWC_TARECONNECTRATE "" MAP 0x8060BE8C RB_PT_PCT_SWC_DWC_RecordLayouts_RL_Map_uint16_49_uint16_7_uint16_7 100000.0 RB_PT_PCT_SWC_DWC_CompuMethods_ratio_20p0 0.0 100000. FORMAT "%10.5"
 /begin ANNOTATION ANNOTATION_LABEL "Description (coming from AUTOSAR DESC field)" /begin ANNOTATION_TEXT "Reconnection rate demand for end of speed phase\r\n" /end ANNOTATION_TEXT /end ANNOTATION
 /begin AXIS_DESCR STD_AXIS NO_INPUT_QUANTITY RB_PT_PCT_SWC_DWC_CompuMethods_ident 7 0.0 20000. FORMAT "%10.5" DEPOSIT ABSOLUTE /end AXIS_DESCR
 /begin AXIS_DESCR STD_AXIS NO_INPUT_QUANTITY RB_PT_PCT_SWC_DWC_CompuMethods_ratio_0p1 7 0.0 2000. FORMAT "%10.5" DEPOSIT ABSOLUTE /end AXIS_DESCR
/end CHARACTERISTIC
/begin CHARACTERISTIC DWC_EFLASHB.DWC_TorqueControl.DWC_TEdDriverTorqueCalc.DWC_DELTACYCLES "" VALUE 0x8060BF28 DefaultValueRecordLayout_AUTOSAR_Platform_BaseTypes_uint8 8.0 RB_PT_PCT_SWC_DWC_CompuMethods_ident 1. 9. FORMAT "%10.5"
 /begin ANNOTATION ANNOTATION_LABEL "Description (coming from AUTOSAR DESC field)" /begin ANNOTATION_TEXT "Cycles over which the delta is done\r\n" /end ANNOTATION_TEXT /end ANNOTATION
/end CHARACTERISTIC
/begin CHARACTERISTIC DWC_EFLASHB.DWC_TorqueControl.DWC_TEdDriverTorqueCalc.DWC_IIRCOEFFFAST "" VALUE 0x8060BF29 DefaultValueRecordLayout_AUTOSAR_Platform_BaseTypes_uint8 1.0 RB_PT_PCT_SWC_DWC_CompuMethods_ratio_0p01 0.0 1. FORMAT "%10.5"
 /begin ANNOTATION ANNOTATION_LABEL "Description (coming from AUTOSAR DESC field)"
  /begin ANNOTATION_TEXT "Co-efficient for first order filter on delta torque - fast filter\r\n" /end ANNOTATION_TEXT
 /end ANNOTATION
/end CHARACTERISTIC
/begin CHARACTERISTIC DWC_EFLASHB.DWC_TorqueControl.DWC_TEdDriverTorqueCalc.DWC_IIRCOEFFSLOW "" VALUE 0x8060BF2A DefaultValueRecordLayout_AUTOSAR_Platform_BaseTypes_uint8 1.0 RB_PT_PCT_SWC_DWC_CompuMethods_ratio_0p01 0.0 1. FORMAT "%10.5"
 /begin ANNOTATION ANNOTATION_LABEL "Description (coming from AUTOSAR DESC field)"
  /begin ANNOTATION_TEXT "Co-efficient for first order filter on delta torque - Slow filter\r\n" /end ANNOTATION_TEXT
 /end ANNOTATION
/end CHARACTERISTIC
/begin CHARACTERISTIC DWC_EFLASHB.DWC_TorqueControl.DWC_TEdEngineTorqueCalc.DWC_DELTACYCLES "" VALUE 0x8060BF2C DefaultValueRecordLayout_AUTOSAR_Platform_BaseTypes_uint8 8.0 RB_PT_PCT_SWC_DWC_CompuMethods_ident 1. 9. FORMAT "%10.5"
 /begin ANNOTATION ANNOTATION_LABEL "Description (coming from AUTOSAR DESC field)" /begin ANNOTATION_TEXT "Cycles over which the delta is done\r\n" /end ANNOTATION_TEXT /end ANNOTATION
/end CHARACTERISTIC
/begin CHARACTERISTIC DWC_EFLASHB.DWC_TorqueControl.DWC_TEdEngineTorqueCalc.DWC_IIRCOEFFFAST "" VALUE 0x8060BF2D DefaultValueRecordLayout_AUTOSAR_Platform_BaseTypes_uint8 1.0 RB_PT_PCT_SWC_DWC_CompuMethods_ratio_0p01 0.0 1. FORMAT "%10.5"
 /begin ANNOTATION ANNOTATION_LABEL "Description (coming from AUTOSAR DESC field)"
  /begin ANNOTATION_TEXT "Co-efficient for first order filter on delta torque - fast filter\r\n" /end ANNOTATION_TEXT
 /end ANNOTATION
/end CHARACTERISTIC
/begin CHARACTERISTIC DWC_EFLASHB.DWC_TorqueControl.DWC_TEdEngineTorqueCalc.DWC_IIRCOEFFSLOW "" VALUE 0x8060BF2E DefaultValueRecordLayout_AUTOSAR_Platform_BaseTypes_uint8 1.0 RB_PT_PCT_SWC_DWC_CompuMethods_ratio_0p01 0.0 1. FORMAT "%10.5"
 /begin ANNOTATION ANNOTATION_LABEL "Description (coming from AUTOSAR DESC field)"
  /begin ANNOTATION_TEXT "Co-efficient for first order filter on delta torque - Slow filter\r\n" /end ANNOTATION_TEXT
 /end ANNOTATION
/end CHARACTERISTIC
/begin CHARACTERISTIC DWC_EFLASHB.DWC_TorqueControl.DWC_TEENABLEENGTQMAXINLOCKMIN "" VALUE 0x8060B553 DefaultValueRecordLayout_AUTOSAR_Platform_BaseTypes_boolean 255.0 AUTOSAR_Platform_CompuMethods_boolean 0.0 255. FORMAT "%10.5"
 /begin ANNOTATION ANNOTATION_LABEL "Description (coming from AUTOSAR DESC field)"
  /begin ANNOTATION_TEXT "Flag to use engine torque maximum in lockup min torque\r\n" /end ANNOTATION_TEXT
 /end ANNOTATION
/end CHARACTERISTIC
/begin CHARACTERISTIC DWC_EFLASHB.DWC_TorqueControl.DWC_TEENABLEFRICTIONINLOCKMIN "" VALUE 0x8060B554 DefaultValueRecordLayout_AUTOSAR_Platform_BaseTypes_boolean 255.0 AUTOSAR_Platform_CompuMethods_boolean 0.0 255. FORMAT "%10.5"
 /begin ANNOTATION ANNOTATION_LABEL "Description (coming from AUTOSAR DESC field)"
  /begin ANNOTATION_TEXT "Flag use fo friction torque in lockup torque request (as addition)\r\n" /end ANNOTATION_TEXT
 /end ANNOTATION
/end CHARACTERISTIC
/begin CHARACTERISTIC DWC_EFLASHB.DWC_TorqueControl.DWC_TEFRICTIONTORQUESELECT "" VALUE 0x8060B555 DefaultValueRecordLayout_AUTOSAR_Platform_BaseTypes_boolean 255.0 AUTOSAR_Platform_CompuMethods_boolean 0.0 255. FORMAT "%10.5"
 /begin ANNOTATION ANNOTATION_LABEL "Description (coming from AUTOSAR DESC field)"
  /begin ANNOTATION_TEXT "Switch for friction torque data source. False = IOP_EngineTorqueFriction, true = IOP_EngineTorqueMinimum\r\n" /end ANNOTATION_TEXT
 /end ANNOTATION
/end CHARACTERISTIC
/begin CHARACTERISTIC DWC_EFLASHB.DWC_TorqueControl.DWC_TEInertiaCompensation.DWC_TEMAXDECELERATIONCOMP "" VALUE 0x8060BF0E DefaultValueRecordLayout_AUTOSAR_Platform_BaseTypes_sint16 4000.0 RB_PT_PCT_SWC_DWC_CompuMethods_ratio_0p1 -2000. 2000. FORMAT "%10.5"
 /begin ANNOTATION ANNOTATION_LABEL "Description (coming from AUTOSAR DESC field)"
  /begin ANNOTATION_TEXT "Maximum (negative) compensation that can be used for decelerating input speeds\r\n" /end ANNOTATION_TEXT
 /end ANNOTATION
/end CHARACTERISTIC
/begin CHARACTERISTIC DWC_EFLASHB.DWC_TorqueControl.DWC_TEInertiaCompensation.DWC_TEMAXINERTIACOMPVSPULLAWAY "" CURVE 0x8060BF12 RB_PT_PCT_SWC_DWC_RecordLayouts_RL_Curve_sint16_5_sint16_5 4000.0 RB_PT_PCT_SWC_DWC_CompuMethods_ratio_0p1 -2000. 2000. FORMAT "%10.5"
 /begin ANNOTATION ANNOTATION_LABEL "Description (coming from AUTOSAR DESC field)" /begin ANNOTATION_TEXT "Maximum inertia compensation vs pullaway speed\r\n" /end ANNOTATION_TEXT /end ANNOTATION
 /begin AXIS_DESCR STD_AXIS NO_INPUT_QUANTITY RB_PT_PCT_SWC_DWC_CompuMethods_ident 5 -20000. 20000. FORMAT "%10.5" DEPOSIT ABSOLUTE /end AXIS_DESCR
/end CHARACTERISTIC
/begin CHARACTERISTIC DWC_EFLASHB.DWC_TorqueControl.DWC_TEInertiaCompensation.DWC_TEUSEDRIVELINEGRADCOMP "" VALUE 0x8060BF10 DefaultValueRecordLayout_AUTOSAR_Platform_BaseTypes_boolean 255.0 AUTOSAR_Platform_CompuMethods_boolean 0.0 255. FORMAT "%10.5"
 /begin ANNOTATION ANNOTATION_LABEL "Description (coming from AUTOSAR DESC field)"
  /begin ANNOTATION_TEXT "Flag to use driveline gradient, not rate of change of output speed, for torque compensation. 0 = dOutput, 1 = Driveline gradient\r\n" /end ANNOTATION_TEXT
 /end ANNOTATION
/end CHARACTERISTIC
/begin CHARACTERISTIC DWC_EFLASHB.DWC_TorqueControl.DWC_TELEADDRIVERTORQUEDELTAGAIN "" MAP 0x8060D8E4 RB_PT_PCT_SWC_DWC_RecordLayouts_RL_Map_sint16_49_sint16_7_sint16_7 2.0 RB_PT_PCT_SWC_DWC_CompuMethods_ratio_0p001__2 -1. 1. FORMAT "%10.5"
 /begin ANNOTATION ANNOTATION_LABEL "Description (coming from AUTOSAR DESC field)" /begin ANNOTATION_TEXT "Driver torque to engine torque gain for delta\r\n" /end ANNOTATION_TEXT /end ANNOTATION
 /begin AXIS_DESCR STD_AXIS NO_INPUT_QUANTITY RB_PT_PCT_SWC_DWC_CompuMethods_ratio_0p1 7 -2000. 2000. FORMAT "%10.5" DEPOSIT ABSOLUTE /end AXIS_DESCR
 /begin AXIS_DESCR STD_AXIS NO_INPUT_QUANTITY RB_PT_PCT_SWC_DWC_CompuMethods_ratio_0p1 7 -2000. 2000. FORMAT "%10.5" DEPOSIT ABSOLUTE /end AXIS_DESCR
/end CHARACTERISTIC
/begin CHARACTERISTIC DWC_EFLASHB.DWC_TorqueControl.DWC_TELEADDTORQUE "" MAP 0x8060D966 RB_PT_PCT_SWC_DWC_RecordLayouts_RL_Map_sint16_49_sint16_7_sint16_7 4000.0 RB_PT_PCT_SWC_DWC_CompuMethods_ratio_0p1 -2000. 2000. FORMAT "%10.5"
 /begin ANNOTATION ANNOTATION_LABEL "Description (coming from AUTOSAR DESC field)" /begin ANNOTATION_TEXT "Engine torque mapping with leads based on dTorque.dT\r\n" /end ANNOTATION_TEXT /end ANNOTATION
 /begin AXIS_DESCR STD_AXIS NO_INPUT_QUANTITY RB_PT_PCT_SWC_DWC_CompuMethods_ratio_0p1 7 -2000. 2000. FORMAT "%10.5" DEPOSIT ABSOLUTE /end AXIS_DESCR
 /begin AXIS_DESCR STD_AXIS NO_INPUT_QUANTITY RB_PT_PCT_SWC_DWC_CompuMethods_ident 7 -10000. 10000. FORMAT "%10.5" DEPOSIT ABSOLUTE /end AXIS_DESCR
/end CHARACTERISTIC
/begin CHARACTERISTIC DWC_EFLASHB.DWC_TorqueControl.DWC_TELOCKUPOFFSET "" VALUE 0x8060B4DA DefaultValueRecordLayout_AUTOSAR_Platform_BaseTypes_uint16 2000.0 RB_PT_PCT_SWC_DWC_CompuMethods_ratio_0p1 0.0 2000. FORMAT "%10.5"
 /begin ANNOTATION ANNOTATION_LABEL "Description (coming from AUTOSAR DESC field)" /begin ANNOTATION_TEXT "Additional static offset on minimum torque request\r\n" /end ANNOTATION_TEXT /end ANNOTATION
/end CHARACTERISTIC
/begin CHARACTERISTIC DWC_EFLASHB.DWC_TorqueControl.DWC_TELOCKUPOFFSETENGTQ "" VALUE 0x8060B4DC DefaultValueRecordLayout_AUTOSAR_Platform_BaseTypes_uint16 2000.0 RB_PT_PCT_SWC_DWC_CompuMethods_ratio_0p1 0.0 2000. FORMAT "%10.5"
 /begin ANNOTATION ANNOTATION_LABEL "Description (coming from AUTOSAR DESC field)"
  /begin ANNOTATION_TEXT "Additional static offset on minimum torque request - on actual engine torque only\r\n" /end ANNOTATION_TEXT
 /end ANNOTATION
/end CHARACTERISTIC
/begin CHARACTERISTIC DWC_EFLASHB.DWC_TorqueControl.DWC_TELOCKUPSAFETYMARGIN "" VALUE 0x8060B556 DefaultValueRecordLayout_AUTOSAR_Platform_BaseTypes_uint8 2.0 RB_PT_PCT_SWC_DWC_CompuMethods_ratio_0p01 0.0 2. FORMAT "%10.5"
 /begin ANNOTATION ANNOTATION_LABEL "Description (coming from AUTOSAR DESC field)" /begin ANNOTATION_TEXT "Safety margin over driver demand for lockup request\r\n" /end ANNOTATION_TEXT /end ANNOTATION
/end CHARACTERISTIC
/begin CHARACTERISTIC DWC_EFLASHB.DWC_TorqueControl.DWC_TEUSEDRIVERDTORQUELEAD "" VALUE 0x8060B557 DefaultValueRecordLayout_AUTOSAR_Platform_BaseTypes_boolean 255.0 AUTOSAR_Platform_CompuMethods_boolean 0.0 255. FORMAT "%10.5"
 /begin ANNOTATION ANNOTATION_LABEL "Description (coming from AUTOSAR DESC field)" /begin ANNOTATION_TEXT "Flag to use driver d torque for lead component\r\n" /end ANNOTATION_TEXT /end ANNOTATION
/end CHARACTERISTIC
/begin CHARACTERISTIC DWC_EFLASHB.DWC_TorqueControl.DWC_TEUSEDRIVERDTORQUELOCK "" VALUE 0x8060B558 DefaultValueRecordLayout_AUTOSAR_Platform_BaseTypes_boolean 255.0 AUTOSAR_Platform_CompuMethods_boolean 0.0 255. FORMAT "%10.5"
 /begin ANNOTATION ANNOTATION_LABEL "Description (coming from AUTOSAR DESC field)" /begin ANNOTATION_TEXT "Flag to use driver d torque for lockup component\r\n" /end ANNOTATION_TEXT /end ANNOTATION
/end CHARACTERISTIC
/begin CHARACTERISTIC DWC_EFLASHB.DWC_TorqueControl.DWC_TEUSEDRIVERDTORQUEMIN "" VALUE 0x8060B559 DefaultValueRecordLayout_AUTOSAR_Platform_BaseTypes_boolean 255.0 AUTOSAR_Platform_CompuMethods_boolean 0.0 255. FORMAT "%10.5"
 /begin ANNOTATION ANNOTATION_LABEL "Description (coming from AUTOSAR DESC field)"
  /begin ANNOTATION_TEXT "Flag to use driver d torque for minimum torque component\r\n" /end ANNOTATION_TEXT
 /end ANNOTATION
/end CHARACTERISTIC
/begin CHARACTERISTIC DWC_EFLASHB.DWC_TorqueControl.DWC_TORQUEASSISTFACTOR "" MAP 0x8060D9E8 RB_PT_PCT_SWC_DWC_RecordLayouts_RL_Map_uint16_96_uint8_8_uint8_12 10.0 RB_PT_PCT_SWC_DWC_CompuMethods_ratio_0p1 0.0 10. FORMAT "%10.5"
 /begin ANNOTATION ANNOTATION_LABEL "Description (coming from AUTOSAR DESC field)"
  /begin ANNOTATION_TEXT "Map of assist factor used to decide how close to engine torque no gearbox to engage to\r\n" /end ANNOTATION_TEXT
 /end ANNOTATION
 /begin AXIS_DESCR STD_AXIS NO_INPUT_QUANTITY RB_PT_PCT_SWC_DWC_CompuMethods_ident 8 0.0 7. FORMAT "%10.5" DEPOSIT ABSOLUTE /end AXIS_DESCR
 /begin AXIS_DESCR STD_AXIS NO_INPUT_QUANTITY RB_PT_PCT_SWC_DWC_CompuMethods_ident 12 0.0 11. FORMAT "%10.5" DEPOSIT ABSOLUTE /end AXIS_DESCR
/end CHARACTERISTIC
/begin CHARACTERISTIC DWC_EFLASHB.DWC_TorqueControl.DWC_TORQUECONDITIONSFORUNLOCK "" VALUE 0x8060B55A DefaultValueRecordLayout_AUTOSAR_Platform_BaseTypes_boolean 255.0 AUTOSAR_Platform_CompuMethods_boolean 0.0 255. FORMAT "%10.5"
 /begin ANNOTATION ANNOTATION_LABEL "Description (coming from AUTOSAR DESC field)"
  /begin ANNOTATION_TEXT "Flag to enable torque conditions to be used to derive an unlock condition for the torque lock-up signal\r\n" /end ANNOTATION_TEXT
 /end ANNOTATION
/end CHARACTERISTIC
/begin CHARACTERISTIC DWC_EFLASHB.DWC_TorqueControl.DWC_TORQUEDOWNMAXENGINETORQUE "" CURVE 0x8060DAC0 RB_PT_PCT_SWC_DWC_RecordLayouts_RL_Curve_sint16_5_sint16_5 4000.0 RB_PT_PCT_SWC_DWC_CompuMethods_ratio_0p1 -2000. 2000. FORMAT "%10.5"
 /begin ANNOTATION ANNOTATION_LABEL "Description (coming from AUTOSAR DESC field)" /begin ANNOTATION_TEXT "Maximum allowed torque down against engine torque\r\n" /end ANNOTATION_TEXT /end ANNOTATION
 /begin AXIS_DESCR STD_AXIS NO_INPUT_QUANTITY RB_PT_PCT_SWC_DWC_CompuMethods_ratio_0p1 5 -2000. 2000. FORMAT "%10.5" DEPOSIT ABSOLUTE /end AXIS_DESCR
/end CHARACTERISTIC
/begin CHARACTERISTIC DWC_EFLASHB.DWC_TorqueControl.DWC_TorquePhaseTorque.DWC_ENGINELAGTIMEVSSPEEDMODE "" MAP 0x8060C064 RB_PT_PCT_SWC_DWC_RecordLayouts_RL_Map_uint16_16_uint16_2_uint8_8 10.0 RB_PT_PCT_SWC_DWC_CompuMethods_ratio_0p001__2 0.0 10. FORMAT "%10.5"
 /begin ANNOTATION ANNOTATION_LABEL "Description (coming from AUTOSAR DESC field)"
  /begin ANNOTATION_TEXT "Early torque down time vs engine speed and shift mode\r\n" /end ANNOTATION_TEXT
 /end ANNOTATION
 /begin AXIS_DESCR STD_AXIS NO_INPUT_QUANTITY RB_PT_PCT_SWC_DWC_CompuMethods_ident 2 0.0 20000. FORMAT "%10.5" DEPOSIT ABSOLUTE /end AXIS_DESCR
 /begin AXIS_DESCR STD_AXIS NO_INPUT_QUANTITY RB_PT_PCT_SWC_DWC_CompuMethods_ident 8 0.0 7. FORMAT "%10.5" DEPOSIT ABSOLUTE /end AXIS_DESCR
/end CHARACTERISTIC
/begin CHARACTERISTIC DWC_EFLASHB.DWC_TorqueControl.DWC_TorquePhaseTorque.DWC_FFGTDELAYONFALLING "" CURVE 0x8060C094 RB_PT_PCT_SWC_DWC_RecordLayouts_RL_Curve_uint16_7_sint8_7 10.0 RB_PT_PCT_SWC_DWC_CompuMethods_ratio_0p001__2 0.0 10. FORMAT "%10.5"
 /begin ANNOTATION ANNOTATION_LABEL "Description (coming from AUTOSAR DESC field)"
  /begin ANNOTATION_TEXT "Delay to going clutch torque factor to create falling engine FF\r\n" /end ANNOTATION_TEXT
 /end ANNOTATION
 /begin AXIS_DESCR STD_AXIS NO_INPUT_QUANTITY RB_PT_PCT_SWC_DWC_CompuMethods_ratio_0p01 7 -1. 1. FORMAT "%10.5" DEPOSIT ABSOLUTE /end AXIS_DESCR
/end CHARACTERISTIC
/begin CHARACTERISTIC DWC_EFLASHB.DWC_TorqueControl.DWC_TorquePhaseTorque.DWC_FFGTDELAYONRISING "" CURVE 0x8060C0AC RB_PT_PCT_SWC_DWC_RecordLayouts_RL_Curve_uint16_7_sint8_7 10.0 RB_PT_PCT_SWC_DWC_CompuMethods_ratio_0p001__2 0.0 10. FORMAT "%10.5"
 /begin ANNOTATION ANNOTATION_LABEL "Description (coming from AUTOSAR DESC field)"
  /begin ANNOTATION_TEXT "Delay to going clutch torque factor to create falling engine FF\r\n" /end ANNOTATION_TEXT
 /end ANNOTATION
 /begin AXIS_DESCR STD_AXIS NO_INPUT_QUANTITY RB_PT_PCT_SWC_DWC_CompuMethods_ratio_0p01 7 -1. 1. FORMAT "%10.5" DEPOSIT ABSOLUTE /end AXIS_DESCR
/end CHARACTERISTIC
/begin CHARACTERISTIC DWC_EFLASHB.DWC_TorqueControl.DWC_TorquePhaseTorque.DWC_SHIFTINDEXFORFFFACTOROFF "" VALUE 0x8060C05C DefaultValueRecordLayout_AUTOSAR_Platform_BaseTypes_sint8 2.0 RB_PT_PCT_SWC_DWC_CompuMethods_ratio_0p01 -1. 1. FORMAT "%10.5"
 /begin ANNOTATION ANNOTATION_LABEL "Description (coming from AUTOSAR DESC field)"
  /begin ANNOTATION_TEXT "Shift type index above which the engine FF factor is set to 1.\r\n" /end ANNOTATION_TEXT
 /end ANNOTATION
/end CHARACTERISTIC
/begin CHARACTERISTIC DWC_EFLASHB.DWC_TorqueControl.DWC_TorquePhaseTorque.DWC_TPClutchFactorLP.DWC_FIRSTORDERLPCOEFF "" VALUE 0x8060C060 DefaultValueRecordLayout_AUTOSAR_Platform_BaseTypes_uint8 1.0 RB_PT_PCT_SWC_DWC_CompuMethods_ratio_0p01 0.0 1. FORMAT "%10.5"
 /begin ANNOTATION ANNOTATION_LABEL "Description (coming from AUTOSAR DESC field)" /begin ANNOTATION_TEXT "Coefficient for low pass IIR filter\r\n" /end ANNOTATION_TEXT /end ANNOTATION
/end CHARACTERISTIC
/begin CHARACTERISTIC DWC_EFLASHB.DWC_TorqueControl.DWC_TorquePhaseTorque.DWC_TPCOMINGCOMPFACTOR "" CURVE 0x8060C0C4 RB_PT_PCT_SWC_DWC_RecordLayouts_RL_Curve_uint16_9_uint16_9 1.0 RB_PT_PCT_SWC_DWC_CompuMethods_ratio_0p001__2 0.0 1. FORMAT "%10.5"
 /begin ANNOTATION ANNOTATION_LABEL "Description (coming from AUTOSAR DESC field)"
  /begin ANNOTATION_TEXT "Factor to use on coming clutch compensation vs progression\r\n" /end ANNOTATION_TEXT
 /end ANNOTATION
 /begin AXIS_DESCR STD_AXIS NO_INPUT_QUANTITY RB_PT_PCT_SWC_DWC_CompuMethods_ratio_0p001__2 9 0.0 1. FORMAT "%10.5" DEPOSIT ABSOLUTE /end AXIS_DESCR
/end CHARACTERISTIC
/begin CHARACTERISTIC DWC_EFLASHB.DWC_TorqueControl.DWC_TorquePhaseTorque.DWC_TPCOMINGFACTORHIGH "" MAP 0x8060C0EA RB_PT_PCT_SWC_DWC_RecordLayouts_RL_Map_uint16_99_uint16_9_uint8_11 2.0 RB_PT_PCT_SWC_DWC_CompuMethods_ratio_0p001__2 0.0 2. FORMAT "%10.5"
 /begin ANNOTATION ANNOTATION_LABEL "Description (coming from AUTOSAR DESC field)"
  /begin ANNOTATION_TEXT "Factor of clutch torque for the coming clutch at low torque - 0 = Pullaway, 1 = Supported, 2=Normal Auto, 3 = Sport auto, 4 = Track auto, 5 = Normal manual, 6 = Sport manual, 7 = Track manual, 8 = Power On Down End, 9 - Electric mode, 10 - eco mode\r\n" /end ANNOTATION_TEXT
 /end ANNOTATION
 /begin AXIS_DESCR STD_AXIS NO_INPUT_QUANTITY RB_PT_PCT_SWC_DWC_CompuMethods_ratio_0p001__2 9 0.0 1. FORMAT "%10.5" DEPOSIT ABSOLUTE /end AXIS_DESCR
 /begin AXIS_DESCR STD_AXIS NO_INPUT_QUANTITY RB_PT_PCT_SWC_DWC_CompuMethods_ident 11 0.0 10. FORMAT "%10.5" DEPOSIT ABSOLUTE /end AXIS_DESCR
/end CHARACTERISTIC
/begin CHARACTERISTIC DWC_EFLASHB.DWC_TorqueControl.DWC_TorquePhaseTorque.DWC_TPCOMINGFACTORLOW "" MAP 0x8060C1D2 RB_PT_PCT_SWC_DWC_RecordLayouts_RL_Map_uint16_99_uint16_9_uint8_11 2.0 RB_PT_PCT_SWC_DWC_CompuMethods_ratio_0p001__2 0.0 2. FORMAT "%10.5"
 /begin ANNOTATION ANNOTATION_LABEL "Description (coming from AUTOSAR DESC field)"
  /begin ANNOTATION_TEXT "Factor of clutch torque for the coming clutch at low torque - 0 = Pullaway, 1 = Supported, 2=Normal Auto, 3 = Sport auto, 4 = Track auto, 5 = Normal manual, 6 = Sport manual, 7 = Track manual, 8 = Power On Down End, 9 - Electric mode, 10 - eco mode\r\n" /end ANNOTATION_TEXT
 /end ANNOTATION
 /begin AXIS_DESCR STD_AXIS NO_INPUT_QUANTITY RB_PT_PCT_SWC_DWC_CompuMethods_ratio_0p001__2 9 0.0 1. FORMAT "%10.5" DEPOSIT ABSOLUTE /end AXIS_DESCR
 /begin AXIS_DESCR STD_AXIS NO_INPUT_QUANTITY RB_PT_PCT_SWC_DWC_CompuMethods_ident 11 0.0 10. FORMAT "%10.5" DEPOSIT ABSOLUTE /end AXIS_DESCR
/end CHARACTERISTIC
/begin CHARACTERISTIC DWC_EFLASHB.DWC_TorqueControl.DWC_TorquePhaseTorque.DWC_TPCOMINGFILLTIME "" MAP 0x8060C2BA RB_PT_PCT_SWC_DWC_RecordLayouts_RL_Map_uint16_42_sint16_7_sint16_6 1.0 RB_PT_PCT_SWC_DWC_CompuMethods_ratio_0p001__2 0.0 1. FORMAT "%10.5"
 /begin ANNOTATION ANNOTATION_LABEL "Description (coming from AUTOSAR DESC field)" /begin ANNOTATION_TEXT "Fill time for coming clutch for GT style shifts\r\n" /end ANNOTATION_TEXT /end ANNOTATION
 /begin AXIS_DESCR STD_AXIS NO_INPUT_QUANTITY RB_PT_PCT_SWC_DWC_CompuMethods_ratio_0p01 7 -1. 1. FORMAT "%10.5" DEPOSIT ABSOLUTE /end AXIS_DESCR
 /begin AXIS_DESCR STD_AXIS NO_INPUT_QUANTITY RB_PT_PCT_SWC_DWC_CompuMethods_ratio_0p001__2 6 0.0 2. FORMAT "%10.5" DEPOSIT ABSOLUTE /end AXIS_DESCR
/end CHARACTERISTIC
/begin CHARACTERISTIC DWC_EFLASHB.DWC_TorqueControl.DWC_TorquePhaseTorque.DWC_TPCOMINGFILLTORQUEGT "" MAP 0x8060C32C RB_PT_PCT_SWC_DWC_RecordLayouts_RL_Map_uint16_42_uint16_7_uint16_6 2.0 RB_PT_PCT_SWC_DWC_CompuMethods_ratio_0p001__2 0.0 2. FORMAT "%10.5"
 /begin ANNOTATION ANNOTATION_LABEL "Description (coming from AUTOSAR DESC field)"
  /begin ANNOTATION_TEXT "Fill torque target for coming clutch during GT style shift\r\n" /end ANNOTATION_TEXT
 /end ANNOTATION
 /begin AXIS_DESCR STD_AXIS NO_INPUT_QUANTITY RB_PT_PCT_SWC_DWC_CompuMethods_ratio_0p1 7 0.0 2000. FORMAT "%10.5" DEPOSIT ABSOLUTE /end AXIS_DESCR
 /begin AXIS_DESCR STD_AXIS NO_INPUT_QUANTITY RB_PT_PCT_SWC_DWC_CompuMethods_ratio_0p001__2 6 0.0 10. FORMAT "%10.5" DEPOSIT ABSOLUTE /end AXIS_DESCR
/end CHARACTERISTIC
/begin CHARACTERISTIC DWC_EFLASHB.DWC_TorqueControl.DWC_TorquePhaseTorque.DWC_TPCOMPCOMINGFORPREPARE "" VAL_BLK 0x8060BFB4 DefaultValueRecordLayout_AUTOSAR_Platform_BaseTypes_boolean 255.0 AUTOSAR_Platform_CompuMethods_boolean 0.0 255. FORMAT "%10.5"
 /begin ANNOTATION ANNOTATION_LABEL "Description (coming from AUTOSAR DESC field)"
  /begin ANNOTATION_TEXT "Flag to indicate that coming clutch should be compensated for prepare phase 0 = Pullaway, 1 = Supported, 2=Normal Auto, 3 = Sport auto, 4 = Track auto, 5 = Normal manual, 6 = Sport manual, 7 = Track manual, 8 = Power On Down End, 9 - Electric mode, 10 - eco mode\r\n" /end ANNOTATION_TEXT
 /end ANNOTATION
 MATRIX_DIM 11 1 1 /end CHARACTERISTIC
/begin CHARACTERISTIC DWC_EFLASHB.DWC_TorqueControl.DWC_TorquePhaseTorque.DWC_TPCOMPCOMINGMODE "" VAL_BLK 0x8060BFBF DefaultValueRecordLayout_AUTOSAR_Platform_BaseTypes_uint8 2.0 RB_PT_PCT_SWC_DWC_CompuMethods_ident 0.0 2. FORMAT "%10.5"
 /begin ANNOTATION ANNOTATION_LABEL "Description (coming from AUTOSAR DESC field)"
  /begin ANNOTATION_TEXT "Mode to compensate coming clutch - 0 = Don't, 1 = only slip increase, 2 = slip increase + engine accel 0 = Pullaway, 1 = Supported, 2=Normal Auto, 3 = Sport auto, 4 = Track auto, 5 = Normal manual, 6 = Sport manual, 7 = Track manual, 8 = Power On Down End, 9 - Electric mode, 10 - eco mode\r\n" /end ANNOTATION_TEXT
 /end ANNOTATION
 MATRIX_DIM 11 1 1 /end CHARACTERISTIC
/begin CHARACTERISTIC DWC_EFLASHB.DWC_TorqueControl.DWC_TorquePhaseTorque.DWC_TPEARLYCOMPLETETORQUE "" VALUE 0x8060C04E DefaultValueRecordLayout_AUTOSAR_Platform_BaseTypes_uint16 2000.0 RB_PT_PCT_SWC_DWC_CompuMethods_ratio_0p1 0.0 2000. FORMAT "%10.5"
 /begin ANNOTATION ANNOTATION_LABEL "Description (coming from AUTOSAR DESC field)"
  /begin ANNOTATION_TEXT "Controller torque demand below which an early complete is allowed\r\n" /end ANNOTATION_TEXT
 /end ANNOTATION
/end CHARACTERISTIC
/begin CHARACTERISTIC DWC_EFLASHB.DWC_TorqueControl.DWC_TorquePhaseTorque.DWC_TPENGINEINERTIA "" VALUE 0x8060C05D DefaultValueRecordLayout_AUTOSAR_Platform_BaseTypes_uint8 1.0 RB_PT_PCT_SWC_DWC_CompuMethods_ratio_0p01 0.0 1. FORMAT "%10.5"
 /begin ANNOTATION ANNOTATION_LABEL "Description (coming from AUTOSAR DESC field)"
  /begin ANNOTATION_TEXT "Intertia of engine  - used for compensation of coming clutch\r\n" /end ANNOTATION_TEXT
 /end ANNOTATION
/end CHARACTERISTIC
/begin CHARACTERISTIC DWC_EFLASHB.DWC_TorqueControl.DWC_TorquePhaseTorque.DWC_TPGOINGFACTORHIGH "" MAP 0x8060C39E RB_PT_PCT_SWC_DWC_RecordLayouts_RL_Map_sint16_99_uint16_9_uint8_11 3.0 RB_PT_PCT_SWC_DWC_CompuMethods_ratio_0p001__2 -1. 2. FORMAT "%10.5"
 /begin ANNOTATION ANNOTATION_LABEL "Description (coming from AUTOSAR DESC field)"
  /begin ANNOTATION_TEXT "Factor of clutch torque for going clutch at high torque - 0 = Pullaway, 1 = Supported, 2=Normal Auto, 3 = Sport auto, 4 = Track auto, 5 = Normal manual, 6 = Sport manual, 7 = Track manual, 8 = Power On Down End, 9 = electric mode, 10 = eco mode\r\n" /end ANNOTATION_TEXT
 /end ANNOTATION
 /begin AXIS_DESCR STD_AXIS NO_INPUT_QUANTITY RB_PT_PCT_SWC_DWC_CompuMethods_ratio_0p001__2 9 0.0 1. FORMAT "%10.5" DEPOSIT ABSOLUTE /end AXIS_DESCR
 /begin AXIS_DESCR STD_AXIS NO_INPUT_QUANTITY RB_PT_PCT_SWC_DWC_CompuMethods_ident 11 0.0 10. FORMAT "%10.5" DEPOSIT ABSOLUTE /end AXIS_DESCR
/end CHARACTERISTIC
/begin CHARACTERISTIC DWC_EFLASHB.DWC_TorqueControl.DWC_TorquePhaseTorque.DWC_TPGOINGFACTORLOW "" MAP 0x8060C486 RB_PT_PCT_SWC_DWC_RecordLayouts_RL_Map_sint16_99_uint16_9_uint8_11 3.0 RB_PT_PCT_SWC_DWC_CompuMethods_ratio_0p001__2 -1. 2. FORMAT "%10.5"
 /begin ANNOTATION ANNOTATION_LABEL "Description (coming from AUTOSAR DESC field)"
  /begin ANNOTATION_TEXT "Factor of clutch torque for going clutch at low torque - 0 = Pullaway, 1 = Supported, 2=Normal Auto, 3 = Sport auto, 4 = Track auto, 5 = Normal manual, 6 = Sport manual, 7 = Track manual, 8 = Power On Down End, 9 = electric mode, 10 = eco mode\r\n" /end ANNOTATION_TEXT
 /end ANNOTATION
 /begin AXIS_DESCR STD_AXIS NO_INPUT_QUANTITY RB_PT_PCT_SWC_DWC_CompuMethods_ratio_0p001__2 9 0.0 1. FORMAT "%10.5" DEPOSIT ABSOLUTE /end AXIS_DESCR
 /begin AXIS_DESCR STD_AXIS NO_INPUT_QUANTITY RB_PT_PCT_SWC_DWC_CompuMethods_ident 11 0.0 10. FORMAT "%10.5" DEPOSIT ABSOLUTE /end AXIS_DESCR
/end CHARACTERISTIC
/begin CHARACTERISTIC DWC_EFLASHB.DWC_TorqueControl.DWC_TorquePhaseTorque.DWC_TPGOINGFINALTORQUE "" VALUE 0x8060C050 DefaultValueRecordLayout_AUTOSAR_Platform_BaseTypes_sint16 3.0 RB_PT_PCT_SWC_DWC_CompuMethods_ratio_0p001__2 -1. 2. FORMAT "%10.5"
 /begin ANNOTATION ANNOTATION_LABEL "Description (coming from AUTOSAR DESC field)" /begin ANNOTATION_TEXT "Target final going clutch factor\r\n" /end ANNOTATION_TEXT /end ANNOTATION
/end CHARACTERISTIC
/begin CHARACTERISTIC DWC_EFLASHB.DWC_TorqueControl.DWC_TorquePhaseTorque.DWC_TPGOINGHOLDTRQ "" MAP 0x8060C56E RB_PT_PCT_SWC_DWC_RecordLayouts_RL_Map_sint16_42_sint16_7_sint16_6 3.0 RB_PT_PCT_SWC_DWC_CompuMethods_ratio_0p001__2 -1. 2. FORMAT "%10.5"
 /begin ANNOTATION ANNOTATION_LABEL "Description (coming from AUTOSAR DESC field)" /begin ANNOTATION_TEXT "Hold torque factor for going clutch\r\n" /end ANNOTATION_TEXT /end ANNOTATION
 /begin AXIS_DESCR STD_AXIS NO_INPUT_QUANTITY RB_PT_PCT_SWC_DWC_CompuMethods_ratio_0p01 7 -1. 1. FORMAT "%10.5" DEPOSIT ABSOLUTE /end AXIS_DESCR
 /begin AXIS_DESCR STD_AXIS NO_INPUT_QUANTITY RB_PT_PCT_SWC_DWC_CompuMethods_ratio_0p1 6 0.0 2000. FORMAT "%10.5" DEPOSIT ABSOLUTE /end AXIS_DESCR
/end CHARACTERISTIC
/begin CHARACTERISTIC DWC_EFLASHB.DWC_TorqueControl.DWC_TorquePhaseTorque.DWC_TPGOINGOPENHOLD "" CURVE 0x8060C5E0 RB_PT_PCT_SWC_DWC_RecordLayouts_RL_Curve_uint16_7_sint8_7 1.0 RB_PT_PCT_SWC_DWC_CompuMethods_ratio_0p001__2 0.0 1. FORMAT "%10.5"
 /begin ANNOTATION ANNOTATION_LABEL "Description (coming from AUTOSAR DESC field)" /begin ANNOTATION_TEXT "Torque progression to hold the torque plateau Trq1\r\n" /end ANNOTATION_TEXT /end ANNOTATION
 /begin AXIS_DESCR STD_AXIS NO_INPUT_QUANTITY RB_PT_PCT_SWC_DWC_CompuMethods_ratio_0p01 7 -1. 1. FORMAT "%10.5" DEPOSIT ABSOLUTE /end AXIS_DESCR
/end CHARACTERISTIC
/begin CHARACTERISTIC DWC_EFLASHB.DWC_TorqueControl.DWC_TorquePhaseTorque.DWC_TPGOINGOPENTIME "" CURVE 0x8060C5F8 RB_PT_PCT_SWC_DWC_RecordLayouts_RL_Curve_uint16_7_sint8_7 1.0 RB_PT_PCT_SWC_DWC_CompuMethods_ratio_0p001__2 0.0 1. FORMAT "%10.5"
 /begin ANNOTATION ANNOTATION_LABEL "Description (coming from AUTOSAR DESC field)" /begin ANNOTATION_TEXT "Torque progression to hold the torque plateau Trq1\r\n" /end ANNOTATION_TEXT /end ANNOTATION
 /begin AXIS_DESCR STD_AXIS NO_INPUT_QUANTITY RB_PT_PCT_SWC_DWC_CompuMethods_ratio_0p01 7 -1. 1. FORMAT "%10.5" DEPOSIT ABSOLUTE /end AXIS_DESCR
/end CHARACTERISTIC
/begin CHARACTERISTIC DWC_EFLASHB.DWC_TorqueControl.DWC_TorquePhaseTorque.DWC_TPGOINGOPENTIMEGT "" VALUE 0x8060C052 DefaultValueRecordLayout_AUTOSAR_Platform_BaseTypes_uint16 1.0 RB_PT_PCT_SWC_DWC_CompuMethods_ratio_0p001__2 0.0 1. FORMAT "%10.5"
 /begin ANNOTATION ANNOTATION_LABEL "Description (coming from AUTOSAR DESC field)"
  /begin ANNOTATION_TEXT "Delta TP progression to ramp from TRQ1 to 0 for GT stlye shift\r\n" /end ANNOTATION_TEXT
 /end ANNOTATION
/end CHARACTERISTIC
/begin CHARACTERISTIC DWC_EFLASHB.DWC_TorqueControl.DWC_TorquePhaseTorque.DWC_TPGOINGPLATEAUTORQUE "" CURVE 0x8060C610 RB_PT_PCT_SWC_DWC_RecordLayouts_RL_Curve_uint16_5_sint16_5 2000.0 RB_PT_PCT_SWC_DWC_CompuMethods_ratio_0p1 0.0 2000. FORMAT "%10.5"
 /begin ANNOTATION ANNOTATION_LABEL "Description (coming from AUTOSAR DESC field)"
  /begin ANNOTATION_TEXT "Torque plateau maximum level during unlock against driver demand\r\n" /end ANNOTATION_TEXT
 /end ANNOTATION
 /begin AXIS_DESCR STD_AXIS NO_INPUT_QUANTITY RB_PT_PCT_SWC_DWC_CompuMethods_ratio_0p1 5 -2000. 2000. FORMAT "%10.5" DEPOSIT ABSOLUTE /end AXIS_DESCR
/end CHARACTERISTIC
/begin CHARACTERISTIC DWC_EFLASHB.DWC_TorqueControl.DWC_TorquePhaseTorque.DWC_TPGOINGROLLOFFTIME "" MAP 0x8060C626 RB_PT_PCT_SWC_DWC_RecordLayouts_RL_Map_uint16_49_sint8_7_sint8_7 1.0 RB_PT_PCT_SWC_DWC_CompuMethods_ratio_0p001__2 0.0 1. FORMAT "%10.5"
 /begin ANNOTATION ANNOTATION_LABEL "Description (coming from AUTOSAR DESC field)"
  /begin ANNOTATION_TEXT "Time for roll off of going clutch to hold torque offset from T1 for GT style shift\r\n" /end ANNOTATION_TEXT
 /end ANNOTATION
 /begin AXIS_DESCR STD_AXIS NO_INPUT_QUANTITY RB_PT_PCT_SWC_DWC_CompuMethods_ratio_0p01 7 -1. 1. FORMAT "%10.5" DEPOSIT ABSOLUTE /end AXIS_DESCR
 /begin AXIS_DESCR STD_AXIS NO_INPUT_QUANTITY RB_PT_PCT_SWC_DWC_CompuMethods_ident 7 0.0 11. FORMAT "%10.5" DEPOSIT ABSOLUTE /end AXIS_DESCR
/end CHARACTERISTIC
/begin CHARACTERISTIC DWC_EFLASHB.DWC_TorqueControl.DWC_TorquePhaseTorque.DWC_TPGOINGTIMEOFFSETGEAR "" MAP 0x8060C69A RB_PT_PCT_SWC_DWC_RecordLayouts_RL_Map_uint16_49_sint8_7_sint8_7 1.0 RB_PT_PCT_SWC_DWC_CompuMethods_ratio_0p001__2 0.0 1. FORMAT "%10.5"
 /begin ANNOTATION ANNOTATION_LABEL "Description (coming from AUTOSAR DESC field)"
  /begin ANNOTATION_TEXT "Torque progression for roll off of going clutch during GT style shift\r\n" /end ANNOTATION_TEXT
 /end ANNOTATION
 /begin AXIS_DESCR STD_AXIS NO_INPUT_QUANTITY RB_PT_PCT_SWC_DWC_CompuMethods_ratio_0p01 7 -1. 1. FORMAT "%10.5" DEPOSIT ABSOLUTE /end AXIS_DESCR
 /begin AXIS_DESCR STD_AXIS NO_INPUT_QUANTITY RB_PT_PCT_SWC_DWC_CompuMethods_ident 7 0.0 11. FORMAT "%10.5" DEPOSIT ABSOLUTE /end AXIS_DESCR
/end CHARACTERISTIC
/begin CHARACTERISTIC DWC_EFLASHB.DWC_TorqueControl.DWC_TorquePhaseTorque.DWC_TPHIGHTORQUE "" VALUE 0x8060C054 DefaultValueRecordLayout_AUTOSAR_Platform_BaseTypes_uint16 1950.0 RB_PT_PCT_SWC_DWC_CompuMethods_ratio_0p1 50. 2000. FORMAT "%10.5"
 /begin ANNOTATION ANNOTATION_LABEL "Description (coming from AUTOSAR DESC field)"
  /begin ANNOTATION_TEXT "Controller torque demand considered to be the highest normal for table scaling\r\n" /end ANNOTATION_TEXT
 /end ANNOTATION
/end CHARACTERISTIC
/begin CHARACTERISTIC DWC_EFLASHB.DWC_TorqueControl.DWC_TorquePhaseTorque.DWC_TPJumpTimer.DWC_DELAYTIME "" VALUE 0x8060C062 DefaultValueRecordLayout_AUTOSAR_Platform_BaseTypes_uint16 10.0 RB_PT_PCT_SWC_DWC_CompuMethods_ratio_0p001__2 0.0 10. FORMAT "%10.5"
 /begin ANNOTATION ANNOTATION_LABEL "Description (coming from AUTOSAR DESC field)" /begin ANNOTATION_TEXT "Event delay time\r\n" /end ANNOTATION_TEXT /end ANNOTATION
/end CHARACTERISTIC
/begin CHARACTERISTIC DWC_EFLASHB.DWC_TorqueControl.DWC_TorquePhaseTorque.DWC_TPJUMPTOCONDITION "" VAL_BLK 0x8060BF30 DefaultValueRecordLayout_AUTOSAR_Platform_BaseTypes_uint16 2.0 RB_PT_PCT_SWC_DWC_CompuMethods_ratio_0p001__2 0.0 2. FORMAT "%10.5"
 /begin ANNOTATION ANNOTATION_LABEL "Description (coming from AUTOSAR DESC field)"
  /begin ANNOTATION_TEXT "Factor of oncoming torque demand to be reached before jump can occur 0 = Pullaway, 1 = Supported, 2=Normal Auto, 3 = Sport auto, 4 = Track auto, 5 = Normal manual, 6 = Sport manual, 7 = Track manual, 8 = Power On Down End, 9 = electric mode, 10 = eco mode\r\n" /end ANNOTATION_TEXT
 /end ANNOTATION
 MATRIX_DIM 11 3 1 /end CHARACTERISTIC
/begin CHARACTERISTIC DWC_EFLASHB.DWC_TorqueControl.DWC_TorquePhaseTorque.DWC_TPJUMPTOPROGRESSION "" VAL_BLK 0x8060BF72 DefaultValueRecordLayout_AUTOSAR_Platform_BaseTypes_uint16 1.0 RB_PT_PCT_SWC_DWC_CompuMethods_ratio_0p001__2 0.0 1. FORMAT "%10.5"
 /begin ANNOTATION ANNOTATION_LABEL "Description (coming from AUTOSAR DESC field)"
  /begin ANNOTATION_TEXT "Factor of oncoming torque demand to be reached before jump can occur 0 = Pullaway, 1 = Supported, 2=Normal Auto, 3 = Sport auto, 4 = Track auto, 5 = Normal manual, 6 = Sport manual, 7 = Track manual, 8 = Power On Down End, 9 = electric mode, 10 = eco mode\r\n" /end ANNOTATION_TEXT
 /end ANNOTATION
 MATRIX_DIM 11 3 1 /end CHARACTERISTIC
/begin CHARACTERISTIC DWC_EFLASHB.DWC_TorqueControl.DWC_TorquePhaseTorque.DWC_TPMAXCOMINGCOMP "" VALUE 0x8060C056 DefaultValueRecordLayout_AUTOSAR_Platform_BaseTypes_sint16 4000.0 RB_PT_PCT_SWC_DWC_CompuMethods_ratio_0p1 -2000. 2000. FORMAT "%10.5"
 /begin ANNOTATION ANNOTATION_LABEL "Description (coming from AUTOSAR DESC field)" /begin ANNOTATION_TEXT "Maximum allowed coming clutch compensation\r\n" /end ANNOTATION_TEXT /end ANNOTATION
/end CHARACTERISTIC
/begin CHARACTERISTIC DWC_EFLASHB.DWC_TorqueControl.DWC_TorquePhaseTorque.DWC_TPMINCOMINGCOMP "" VALUE 0x8060C058 DefaultValueRecordLayout_AUTOSAR_Platform_BaseTypes_sint16 4000.0 RB_PT_PCT_SWC_DWC_CompuMethods_ratio_0p1 -2000. 2000. FORMAT "%10.5"
 /begin ANNOTATION ANNOTATION_LABEL "Description (coming from AUTOSAR DESC field)" /begin ANNOTATION_TEXT "Minimum allowed coming clutch compensation\r\n" /end ANNOTATION_TEXT /end ANNOTATION
/end CHARACTERISTIC
/begin CHARACTERISTIC DWC_EFLASHB.DWC_TorqueControl.DWC_TorquePhaseTorque.DWC_TPMINJUMPTOCONDITION "" MAP 0x8060C70E RB_PT_PCT_SWC_DWC_RecordLayouts_RL_Map_uint16_9_uint16_3_uint16_3 2.0 RB_PT_PCT_SWC_DWC_CompuMethods_ratio_0p001__2 0.0 2. FORMAT "%10.5"
 /begin ANNOTATION ANNOTATION_LABEL "Description (coming from AUTOSAR DESC field)" /begin ANNOTATION_TEXT "Minimum jump to condition based on torque and speed\r\n" /end ANNOTATION_TEXT /end ANNOTATION
 /begin AXIS_DESCR STD_AXIS NO_INPUT_QUANTITY RB_PT_PCT_SWC_DWC_CompuMethods_ratio_0p1 3 0.0 2000. FORMAT "%10.5" DEPOSIT ABSOLUTE /end AXIS_DESCR
 /begin AXIS_DESCR STD_AXIS NO_INPUT_QUANTITY RB_PT_PCT_SWC_DWC_CompuMethods_ident 3 0.0 20000. FORMAT "%10.5" DEPOSIT ABSOLUTE /end AXIS_DESCR
/end CHARACTERISTIC
/begin CHARACTERISTIC DWC_EFLASHB.DWC_TorqueControl.DWC_TorquePhaseTorque.DWC_TPMINJUMPTOPROGRESSION "" MAP 0x8060C730 RB_PT_PCT_SWC_DWC_RecordLayouts_RL_Map_uint16_9_uint16_3_uint16_3 1.0 RB_PT_PCT_SWC_DWC_CompuMethods_ratio_0p001__2 0.0 1. FORMAT "%10.5"
 /begin ANNOTATION ANNOTATION_LABEL "Description (coming from AUTOSAR DESC field)"
  /begin ANNOTATION_TEXT "Minimum jump progression based on torque and engine speed\r\n" /end ANNOTATION_TEXT
 /end ANNOTATION
 /begin AXIS_DESCR STD_AXIS NO_INPUT_QUANTITY RB_PT_PCT_SWC_DWC_CompuMethods_ratio_0p1 3 0.0 2000. FORMAT "%10.5" DEPOSIT ABSOLUTE /end AXIS_DESCR
 /begin AXIS_DESCR STD_AXIS NO_INPUT_QUANTITY RB_PT_PCT_SWC_DWC_CompuMethods_ident 3 0.0 20000. FORMAT "%10.5" DEPOSIT ABSOLUTE /end AXIS_DESCR
/end CHARACTERISTIC
/begin CHARACTERISTIC DWC_EFLASHB.DWC_TorqueControl.DWC_TorquePhaseTorque.DWC_TPMINPROGRESSIONFORJUMP "" VALUE 0x8060C05A DefaultValueRecordLayout_AUTOSAR_Platform_BaseTypes_uint16 2.0 RB_PT_PCT_SWC_DWC_CompuMethods_ratio_0p001__2 0.0 2. FORMAT "%10.5"
 /begin ANNOTATION ANNOTATION_LABEL "Description (coming from AUTOSAR DESC field)"
  /begin ANNOTATION_TEXT "Minimum torque phase progression before jump is allowed\r\n" /end ANNOTATION_TEXT
 /end ANNOTATION
/end CHARACTERISTIC
/begin CHARACTERISTIC DWC_EFLASHB.DWC_TorqueControl.DWC_TorquePhaseTorque.DWC_TPMINPROGRESSIONFORJUMPGT "" CURVE 0x8060C752 RB_PT_PCT_SWC_DWC_RecordLayouts_RL_Curve_uint16_7_sint8_7 2.0 RB_PT_PCT_SWC_DWC_CompuMethods_ratio_0p001__2 0.0 2. FORMAT "%10.5"
 /begin ANNOTATION ANNOTATION_LABEL "Description (coming from AUTOSAR DESC field)" /begin ANNOTATION_TEXT "Minimum progression for jump during GT style shift\r\n" /end ANNOTATION_TEXT /end ANNOTATION
 /begin AXIS_DESCR STD_AXIS NO_INPUT_QUANTITY RB_PT_PCT_SWC_DWC_CompuMethods_ratio_0p01 7 -1. 1. FORMAT "%10.5" DEPOSIT ABSOLUTE /end AXIS_DESCR
/end CHARACTERISTIC
/begin CHARACTERISTIC DWC_EFLASHB.DWC_TorqueControl.DWC_TorquePhaseTorque.DWC_TPOFFSETFORSPEEDPHASE "" MAP 0x8060C76A RB_PT_PCT_SWC_DWC_RecordLayouts_RL_Map_uint16_36_sint16_6_sint8_6 1.0 RB_PT_PCT_SWC_DWC_CompuMethods_ratio_0p001__2 0.0 1. FORMAT "%10.5"
 /begin ANNOTATION ANNOTATION_LABEL "Description (coming from AUTOSAR DESC field)"
  /begin ANNOTATION_TEXT "Torque progression offset from T1 to begin speed phase\r\n" /end ANNOTATION_TEXT
 /end ANNOTATION
 /begin AXIS_DESCR STD_AXIS NO_INPUT_QUANTITY RB_PT_PCT_SWC_DWC_CompuMethods_ratio_0p1 6 -2000. 2000. FORMAT "%10.5" DEPOSIT ABSOLUTE /end AXIS_DESCR
 /begin AXIS_DESCR STD_AXIS NO_INPUT_QUANTITY RB_PT_PCT_SWC_DWC_CompuMethods_ratio_0p01 6 -1. 1. FORMAT "%10.5" DEPOSIT ABSOLUTE /end AXIS_DESCR
/end CHARACTERISTIC
/begin CHARACTERISTIC DWC_EFLASHB.DWC_TorqueControl.DWC_TorquePhaseTorque.DWC_TPRESETIPARTSTART "" VAL_BLK 0x8060BFCA DefaultValueRecordLayout_AUTOSAR_Platform_BaseTypes_boolean 255.0 AUTOSAR_Platform_CompuMethods_boolean 0.0 255. FORMAT "%10.5"
 /begin ANNOTATION ANNOTATION_LABEL "Description (coming from AUTOSAR DESC field)"
  /begin ANNOTATION_TEXT "Table to request I part reset on coming clutch at start of torque phase\r\n" /end ANNOTATION_TEXT
 /end ANNOTATION
 MATRIX_DIM 11 12 1 /end CHARACTERISTIC
/begin CHARACTERISTIC DWC_EFLASHB.DWC_TorqueControl.DWC_TorquePhaseTorque.DWC_TPRISINGFFCLUTCHTIME "" MAP 0x8060C7C8 RB_PT_PCT_SWC_DWC_RecordLayouts_RL_Map_uint16_49_sint8_7_sint8_7 1.0 RB_PT_PCT_SWC_DWC_CompuMethods_ratio_0p001__2 0.0 1. FORMAT "%10.5"
 /begin ANNOTATION ANNOTATION_LABEL "Description (coming from AUTOSAR DESC field)"
  /begin ANNOTATION_TEXT "Estimated clutch filled progression for engine FF derivation during GT style shifts\r\n" /end ANNOTATION_TEXT
 /end ANNOTATION
 /begin AXIS_DESCR STD_AXIS NO_INPUT_QUANTITY RB_PT_PCT_SWC_DWC_CompuMethods_ratio_0p01 7 -1. 1. FORMAT "%10.5" DEPOSIT ABSOLUTE /end AXIS_DESCR
 /begin AXIS_DESCR STD_AXIS NO_INPUT_QUANTITY RB_PT_PCT_SWC_DWC_CompuMethods_ident 7 0.0 11. FORMAT "%10.5" DEPOSIT ABSOLUTE /end AXIS_DESCR
/end CHARACTERISTIC
/begin CHARACTERISTIC DWC_EFLASHB.DWC_TorqueControl.DWC_TorquePhaseTorque.DWC_TPSLIPPGAINFACTOR "" MAP 0x8060C83C RB_PT_PCT_SWC_DWC_RecordLayouts_RL_Map_uint16_22_uint16_2_uint8_11 1.0 RB_PT_PCT_SWC_DWC_CompuMethods_ratio_0p001__2 0.0 1. FORMAT "%10.5"
 /begin ANNOTATION ANNOTATION_LABEL "Description (coming from AUTOSAR DESC field)"
  /begin ANNOTATION_TEXT "Factor of slip control P gain to be used against torque phase progression 0 = Pullaway, 1 = Supported, 2=Normal Auto, 3 = Sport auto, 4 = Track auto, 5 = Normal manual, 6 = Sport manual, 7 = Track manual, 8 = Power On Down End, 9 = electric mode, 10 = eco mode\r\n" /end ANNOTATION_TEXT
 /end ANNOTATION
 /begin AXIS_DESCR STD_AXIS NO_INPUT_QUANTITY RB_PT_PCT_SWC_DWC_CompuMethods_ratio_0p001__2 2 0.0 1. FORMAT "%10.5" DEPOSIT ABSOLUTE /end AXIS_DESCR
 /begin AXIS_DESCR STD_AXIS NO_INPUT_QUANTITY RB_PT_PCT_SWC_DWC_CompuMethods_ident 11 0.0 10. FORMAT "%10.5" DEPOSIT ABSOLUTE /end AXIS_DESCR
/end CHARACTERISTIC
/begin CHARACTERISTIC DWC_EFLASHB.DWC_TorqueControl.DWC_TorquePhaseTorque.DWC_TPTWOCLUTCHABORTINSLIPONLY "" VALUE 0x8060C05E DefaultValueRecordLayout_AUTOSAR_Platform_BaseTypes_boolean 255.0 AUTOSAR_Platform_CompuMethods_boolean 0.0 255. FORMAT "%10.5"
 /begin ANNOTATION ANNOTATION_LABEL "Description (coming from AUTOSAR DESC field)"
  /begin ANNOTATION_TEXT "Flag requesting that two clutch launch should abort in slip control only.\r\n" /end ANNOTATION_TEXT
 /end ANNOTATION
/end CHARACTERISTIC
/begin CHARACTERISTIC DWC_EFLASHB.DWC_TorqueControl.DWC_TorquePhaseTorque.DWC_TPTWOCLUTCHABORTTOFIRST "" VALUE 0x8060C05F DefaultValueRecordLayout_AUTOSAR_Platform_BaseTypes_uint8 1.0 RB_PT_PCT_SWC_DWC_CompuMethods_ratio_0p01 0.0 1. FORMAT "%10.5"
 /begin ANNOTATION ANNOTATION_LABEL "Description (coming from AUTOSAR DESC field)" /begin ANNOTATION_TEXT "Abort to first gear threshold for two clutch launch\r\n" /end ANNOTATION_TEXT /end ANNOTATION
/end CHARACTERISTIC
/begin CHARACTERISTIC DWC_EFLASHB.DWC_TorqueControl.DWC_TORQUETOHOLDLOCKSTATE "" VALUE 0x8060B4DE DefaultValueRecordLayout_AUTOSAR_Platform_BaseTypes_sint16 4000.0 RB_PT_PCT_SWC_DWC_CompuMethods_ratio_0p1 -2000. 2000. FORMAT "%10.5"
 /begin ANNOTATION ANNOTATION_LABEL "Description (coming from AUTOSAR DESC field)"
  /begin ANNOTATION_TEXT "Min torque threshold to transition from lockup active not inactive.\r\n" /end ANNOTATION_TEXT
 /end ANNOTATION
/end CHARACTERISTIC
/begin CHARACTERISTIC DWC_EFLASHB.DWC_TorqueControl.DWC_TPASGTORQUEESTIMATE "" VALUE 0x8060B4E0 DefaultValueRecordLayout_AUTOSAR_Platform_BaseTypes_sint16 4000.0 RB_PT_PCT_SWC_DWC_CompuMethods_ratio_0p1 -2000. 2000. FORMAT "%10.5"
 /begin ANNOTATION ANNOTATION_LABEL "Description (coming from AUTOSAR DESC field)"
  /begin ANNOTATION_TEXT "Torque estimate for ASG shifts - (-2000.0Nm = don't use)\r\n" /end ANNOTATION_TEXT
 /end ANNOTATION
/end CHARACTERISTIC
/begin CHARACTERISTIC DWC_EFLASHB.DWC_TorqueControl.DWC_TPGEARFACTOR "" VAL_BLK 0x8060B30E DefaultValueRecordLayout_AUTOSAR_Platform_BaseTypes_uint16 3.0 RB_PT_PCT_SWC_DWC_CompuMethods_ratio_0p001__2 0.0 3. FORMAT "%10.5"
 /begin ANNOTATION ANNOTATION_LABEL "Description (coming from AUTOSAR DESC field)" /begin ANNOTATION_TEXT "Factor applied to torque phase time\r\n" /end ANNOTATION_TEXT /end ANNOTATION
 MATRIX_DIM 13 1 1 /end CHARACTERISTIC
/begin CHARACTERISTIC DWC_EFLASHB.DWC_TorqueControl.DWC_TPMINGEARFACTOR "" MAP 0x8060DAD6 RB_PT_PCT_SWC_DWC_RecordLayouts_RL_Map_uint16_9_sint16_3_sint16_3 3.0 RB_PT_PCT_SWC_DWC_CompuMethods_ratio_0p001__2 0.0 3. FORMAT "%10.5"
 /begin ANNOTATION ANNOTATION_LABEL "Description (coming from AUTOSAR DESC field)" /begin ANNOTATION_TEXT "Minimum gear factor based on torque and engine speed\r\n" /end ANNOTATION_TEXT /end ANNOTATION
 /begin AXIS_DESCR STD_AXIS NO_INPUT_QUANTITY RB_PT_PCT_SWC_DWC_CompuMethods_ratio_0p1 3 -2000. 2000. FORMAT "%10.5" DEPOSIT ABSOLUTE /end AXIS_DESCR
 /begin AXIS_DESCR STD_AXIS NO_INPUT_QUANTITY RB_PT_PCT_SWC_DWC_CompuMethods_ident 3 0.0 20000. FORMAT "%10.5" DEPOSIT ABSOLUTE /end AXIS_DESCR
/end CHARACTERISTIC
/begin CHARACTERISTIC DWC_EFLASHB.DWC_TorqueControl.DWC_TPOVERLAPSLIPTHRESHOLDOVER "" VALUE 0x8060B4E2 DefaultValueRecordLayout_AUTOSAR_Platform_BaseTypes_uint16 20000.0 RB_PT_PCT_SWC_DWC_CompuMethods_ident 0.0 20000. FORMAT "%10.5"
 /begin ANNOTATION ANNOTATION_LABEL "Description (coming from AUTOSAR DESC field)"
  /begin ANNOTATION_TEXT "Passive clutch slip threshold below which an overlap torque phase is allowed\r\n" /end ANNOTATION_TEXT
 /end ANNOTATION
/end CHARACTERISTIC
/begin CHARACTERISTIC DWC_EFLASHB.DWC_TorqueControl.DWC_TPOVERLAPSLIPTHRESHOLDUNDER "" VALUE 0x8060B4E4 DefaultValueRecordLayout_AUTOSAR_Platform_BaseTypes_uint16 20000.0 RB_PT_PCT_SWC_DWC_CompuMethods_ident 0.0 20000. FORMAT "%10.5"
 /begin ANNOTATION ANNOTATION_LABEL "Description (coming from AUTOSAR DESC field)"
  /begin ANNOTATION_TEXT "Passive clutch slip threshold below which an overlap torque phase is allowed\r\n" /end ANNOTATION_TEXT
 /end ANNOTATION
/end CHARACTERISTIC
/begin CHARACTERISTIC DWC_EFLASHB.DWC_TorqueControl.DWC_TPPOWEROFFDOWNFASTFILLVSMODE "" VAL_BLK 0x8060B3C0 DefaultValueRecordLayout_AUTOSAR_Platform_BaseTypes_boolean 255.0 AUTOSAR_Platform_CompuMethods_boolean 0.0 255. FORMAT "%10.5"
 /begin ANNOTATION ANNOTATION_LABEL "Description (coming from AUTOSAR DESC field)"
  /begin ANNOTATION_TEXT "Power off down fast fill enable vs mode (0 = auto normal, 1 = auto sport, 2 = auto track, 3 = manual normal, 4 = manual sport, 5 = manual track, 6 = electric mode, 7 = eco mode)\r\n" /end ANNOTATION_TEXT
 /end ANNOTATION
 MATRIX_DIM 8 1 1 /end CHARACTERISTIC
/begin CHARACTERISTIC DWC_EFLASHB.DWC_TorqueControl.DWC_TPPOWEROFFUPFASTFILLVSMODE "" VAL_BLK 0x8060B3C8 DefaultValueRecordLayout_AUTOSAR_Platform_BaseTypes_boolean 255.0 AUTOSAR_Platform_CompuMethods_boolean 0.0 255. FORMAT "%10.5"
 /begin ANNOTATION ANNOTATION_LABEL "Description (coming from AUTOSAR DESC field)"
  /begin ANNOTATION_TEXT "Power off up fast fill enable vs mode (0 = auto normal, 1 = auto sport, 2 = auto track, 3 = manual normal, 4 = manual sport, 5 = manual track, 6 = electric mode, 7 = eco mode)\r\n" /end ANNOTATION_TEXT
 /end ANNOTATION
 MATRIX_DIM 8 1 1 /end CHARACTERISTIC
/begin CHARACTERISTIC DWC_EFLASHB.DWC_TorqueControl.DWC_TPPOWERONUPFASTFILLVSMODE "" VAL_BLK 0x8060B3D0 DefaultValueRecordLayout_AUTOSAR_Platform_BaseTypes_boolean 255.0 AUTOSAR_Platform_CompuMethods_boolean 0.0 255. FORMAT "%10.5"
 /begin ANNOTATION ANNOTATION_LABEL "Description (coming from AUTOSAR DESC field)"
  /begin ANNOTATION_TEXT "Power on up fast fill enable vs mode (0 = auto normal, 1 = auto sport, 2 = auto track, 3 = manual normal, 4 = manual sport, 5 = manual track, 6 = electric mode, 7 = eco mode)\r\n" /end ANNOTATION_TEXT
 /end ANNOTATION
 MATRIX_DIM 8 1 1 /end CHARACTERISTIC
/begin CHARACTERISTIC DWC_EFLASHB.DWC_TorqueControl.DWC_TPTIMEMINGEAR "" MAP 0x8060DAF8 RB_PT_PCT_SWC_DWC_RecordLayouts_RL_Map_uint16_40_sint8_5_sint8_8 10.0 RB_PT_PCT_SWC_DWC_CompuMethods_ratio_0p001__2 0.0 10. FORMAT "%10.5"
 /begin ANNOTATION ANNOTATION_LABEL "Description (coming from AUTOSAR DESC field)"
  /begin ANNOTATION_TEXT "Minimum torque phase time for the GT shift as a function of the shift type index and target gear\r\n" /end ANNOTATION_TEXT
 /end ANNOTATION
 /begin AXIS_DESCR STD_AXIS NO_INPUT_QUANTITY RB_PT_PCT_SWC_DWC_CompuMethods_ratio_0p01 5 -1. 1. FORMAT "%10.5" DEPOSIT ABSOLUTE /end AXIS_DESCR
 /begin AXIS_DESCR STD_AXIS NO_INPUT_QUANTITY RB_PT_PCT_SWC_DWC_CompuMethods_ident 8 0.0 11. FORMAT "%10.5" DEPOSIT ABSOLUTE /end AXIS_DESCR
/end CHARACTERISTIC
/begin CHARACTERISTIC DWC_EFLASHB.DWC_TorqueControl.DWC_TPTIMEMINGTTEMPRPM "" MAP 0x8060DB5A RB_PT_PCT_SWC_DWC_RecordLayouts_RL_Map_uint16_36_sint16_6_sint16_6 10.0 RB_PT_PCT_SWC_DWC_CompuMethods_ratio_0p001__2 0.0 10. FORMAT "%10.5"
 /begin ANNOTATION ANNOTATION_LABEL "Description (coming from AUTOSAR DESC field)"
  /begin ANNOTATION_TEXT "Minimum torque phase time for GT style shifts as function of temperature and engine speed\r\n" /end ANNOTATION_TEXT
 /end ANNOTATION
 /begin AXIS_DESCR STD_AXIS NO_INPUT_QUANTITY RB_PT_PCT_SWC_DWC_CompuMethods_ident 6 -50. 200. FORMAT "%10.5" DEPOSIT ABSOLUTE /end AXIS_DESCR
 /begin AXIS_DESCR STD_AXIS NO_INPUT_QUANTITY RB_PT_PCT_SWC_DWC_CompuMethods_ident 6 0.0 20000. FORMAT "%10.5" DEPOSIT ABSOLUTE /end AXIS_DESCR
/end CHARACTERISTIC
/begin CHARACTERISTIC DWC_EFLASHB.DWC_TorqueControl.DWC_TPTIMEPOWERONUPSHIFTS "" MAP 0x8060DBBE RB_PT_PCT_SWC_DWC_RecordLayouts_RL_Map_uint16_88_sint8_11_sint8_8 10.0 RB_PT_PCT_SWC_DWC_CompuMethods_ratio_0p001__2 0.0 10. FORMAT "%10.5"
 /begin ANNOTATION ANNOTATION_LABEL "Description (coming from AUTOSAR DESC field)"
  /begin ANNOTATION_TEXT "Torque phase time for the GT shift as a function of the shift type index and aggression at the start of the shift\r\n" /end ANNOTATION_TEXT
 /end ANNOTATION
 /begin AXIS_DESCR STD_AXIS NO_INPUT_QUANTITY RB_PT_PCT_SWC_DWC_CompuMethods_ratio_0p01 11 -1. 1. FORMAT "%10.5" DEPOSIT ABSOLUTE /end AXIS_DESCR
 /begin AXIS_DESCR STD_AXIS NO_INPUT_QUANTITY RB_PT_PCT_SWC_DWC_CompuMethods_ident 8 -100. 100. FORMAT "%10.5" DEPOSIT ABSOLUTE /end AXIS_DESCR
/end CHARACTERISTIC
/begin CHARACTERISTIC DWC_EFLASHB.DWC_TorqueControl.DWC_TPTORQUEESTIMATEPREFILL "" VALUE 0x8060B4E6 DefaultValueRecordLayout_AUTOSAR_Platform_BaseTypes_sint16 4000.0 RB_PT_PCT_SWC_DWC_CompuMethods_ratio_0p1 -2000. 2000. FORMAT "%10.5"
 /begin ANNOTATION ANNOTATION_LABEL "Description (coming from AUTOSAR DESC field)"
  /begin ANNOTATION_TEXT "Torque estimate for pre-prefill requests (-2000.0 = do not use)\r\n" /end ANNOTATION_TEXT
 /end ANNOTATION
/end CHARACTERISTIC
/begin CHARACTERISTIC DWC_EFLASHB.DWC_TorqueControl.DWC_TPTORQUEPHASETIME "" MAP 0x8060DC86 RB_PT_PCT_SWC_DWC_RecordLayouts_RL_Map_uint16_99_sint8_9_sint8_11 10.0 RB_PT_PCT_SWC_DWC_CompuMethods_ratio_0p001__2 0.0 10. FORMAT "%10.5"
 /begin ANNOTATION ANNOTATION_LABEL "Description (coming from AUTOSAR DESC field)"
  /begin ANNOTATION_TEXT "Target torque phase time table - 0 = Pullaway, 1 = Supported, 2=Normal Auto, 3 = Sport auto, 4 = Track auto, 5 = Normal manual, 6 = Sport manual, 7 = Track manual, 8 = Power On Down End, 9 = electric mode, 10 = eco mode)\r\n" /end ANNOTATION_TEXT
 /end ANNOTATION
 /begin AXIS_DESCR STD_AXIS NO_INPUT_QUANTITY RB_PT_PCT_SWC_DWC_CompuMethods_ident 9 -100. 100. FORMAT "%10.5" DEPOSIT ABSOLUTE /end AXIS_DESCR
 /begin AXIS_DESCR STD_AXIS NO_INPUT_QUANTITY RB_PT_PCT_SWC_DWC_CompuMethods_ident 11 0.0 10. FORMAT "%10.5" DEPOSIT ABSOLUTE /end AXIS_DESCR
/end CHARACTERISTIC
/begin CHARACTERISTIC DWC_EFLASHB.DWC_TorqueControl.DWC_USEFILTEREDSPEEDARB "" VALUE 0x8060B55B DefaultValueRecordLayout_AUTOSAR_Platform_BaseTypes_boolean 255.0 AUTOSAR_Platform_CompuMethods_boolean 0.0 255. FORMAT "%10.5"
 /begin ANNOTATION ANNOTATION_LABEL "Description (coming from AUTOSAR DESC field)" /begin ANNOTATION_TEXT "Flag to use filtered input speeds for the arbitrator\r\n" /end ANNOTATION_TEXT /end ANNOTATION
/end CHARACTERISTIC
/begin CHARACTERISTIC DWC_EFLASHB.DWC_TorqueControl.DWC_USENEWPOWERONUPCODE "" VALUE 0x8060B55C DefaultValueRecordLayout_AUTOSAR_Platform_BaseTypes_boolean 255.0 AUTOSAR_Platform_CompuMethods_boolean 0.0 255. FORMAT "%10.5"
 /begin ANNOTATION ANNOTATION_LABEL "Description (coming from AUTOSAR DESC field)" /begin ANNOTATION_TEXT "Flag to activate the new code for power on upshifts\r\n" /end ANNOTATION_TEXT /end ANNOTATION
/end CHARACTERISTIC
/begin CHARACTERISTIC DWC_EFLASHB.DWC_TorqueControl.DWC_USEPULLAWAYDATAFORTIMETOSHIFT "" VALUE 0x8060B55D DefaultValueRecordLayout_AUTOSAR_Platform_BaseTypes_boolean 255.0 AUTOSAR_Platform_CompuMethods_boolean 0.0 255. FORMAT "%10.5"
 /begin ANNOTATION ANNOTATION_LABEL "Description (coming from AUTOSAR DESC field)"
  /begin ANNOTATION_TEXT "Flag to allow the calculation of time to shift to include pullaway\r\n" /end ANNOTATION_TEXT
 /end ANNOTATION
/end CHARACTERISTIC
/begin CHARACTERISTIC DWC_EFLASHB.DWC_TorqueControl.DWC_USERAWDSPEEDGRAD "" VALUE 0x8060B55E DefaultValueRecordLayout_AUTOSAR_Platform_BaseTypes_boolean 255.0 AUTOSAR_Platform_CompuMethods_boolean 0.0 255. FORMAT "%10.5"
 /begin ANNOTATION ANNOTATION_LABEL "Description (coming from AUTOSAR DESC field)"
  /begin ANNOTATION_TEXT "Flag to request the use of raw error on the slip control I term\r\n" /end ANNOTATION_TEXT
 /end ANNOTATION
/end CHARACTERISTIC
/begin CHARACTERISTIC DWC_EFLASHB.DWC_TorqueControl.DWC_USERAWERRORITERM "" VALUE 0x8060B55F DefaultValueRecordLayout_AUTOSAR_Platform_BaseTypes_boolean 255.0 AUTOSAR_Platform_CompuMethods_boolean 0.0 255. FORMAT "%10.5"
 /begin ANNOTATION ANNOTATION_LABEL "Description (coming from AUTOSAR DESC field)"
  /begin ANNOTATION_TEXT "Flag to request the use of raw error on the slip control I term\r\n" /end ANNOTATION_TEXT
 /end ANNOTATION
/end CHARACTERISTIC
/begin CHARACTERISTIC DWC_EFLASHB.DWC_TorqueControl.DWC_WSCDelayTrigger.DWC_DELAYTIME "" VALUE 0x8060C87C DefaultValueRecordLayout_AUTOSAR_Platform_BaseTypes_uint16 10.0 RB_PT_PCT_SWC_DWC_CompuMethods_ratio_0p001__2 0.0 10. FORMAT "%10.5"
 /begin ANNOTATION ANNOTATION_LABEL "Description (coming from AUTOSAR DESC field)" /begin ANNOTATION_TEXT "Event delay time\r\n" /end ANNOTATION_TEXT /end ANNOTATION
/end CHARACTERISTIC
/begin CHARACTERISTIC DWC_EFLASHB.DWC_TorqueControl.DWC_WSCENABLEIMMEDIATECONTROL "" VALUE 0x8060B560 DefaultValueRecordLayout_AUTOSAR_Platform_BaseTypes_boolean 255.0 AUTOSAR_Platform_CompuMethods_boolean 0.0 255. FORMAT "%10.5"
 /begin ANNOTATION ANNOTATION_LABEL "Description (coming from AUTOSAR DESC field)" /begin ANNOTATION_TEXT "Flag to enable immediate P and I term calculation\r\n" /end ANNOTATION_TEXT /end ANNOTATION
/end CHARACTERISTIC
/begin CHARACTERISTIC DWC_EFLASHB.DWC_TorqueControl.DWC_WSCIGAIN "" CURVE 0x8060DD64 RB_PT_PCT_SWC_DWC_RecordLayouts_RL_Curve_sint16_7_sint16_7 0.2 RB_PT_PCT_SWC_DWC_CompuMethods_ratio_0p00001 -0.1 0.1 FORMAT "%10.5"
 /begin ANNOTATION ANNOTATION_LABEL "Description (coming from AUTOSAR DESC field)" /begin ANNOTATION_TEXT "Integral gain of wheel slip controller\r\n" /end ANNOTATION_TEXT /end ANNOTATION
 /begin AXIS_DESCR STD_AXIS NO_INPUT_QUANTITY RB_PT_PCT_SWC_DWC_CompuMethods_ident 7 -20000. 20000. FORMAT "%10.5" DEPOSIT ABSOLUTE /end AXIS_DESCR
/end CHARACTERISTIC
/begin CHARACTERISTIC DWC_EFLASHB.DWC_TorqueControl.DWC_WSCITERMOFFSETSPEEDDELTA "" CURVE 0x8060DD82 RB_PT_PCT_SWC_DWC_RecordLayouts_RL_Curve_sint16_5_sint16_5 4000.0 RB_PT_PCT_SWC_DWC_CompuMethods_ratio_0p1 -2000. 2000. FORMAT "%10.5"
 /begin ANNOTATION ANNOTATION_LABEL "Description (coming from AUTOSAR DESC field)"
  /begin ANNOTATION_TEXT "WSC I term offset to load based on delta driven axle speed\r\n" /end ANNOTATION_TEXT
 /end ANNOTATION
 /begin AXIS_DESCR STD_AXIS NO_INPUT_QUANTITY RB_PT_PCT_SWC_DWC_CompuMethods_ident 5 -20000. 20000. FORMAT "%10.5" DEPOSIT ABSOLUTE /end AXIS_DESCR
/end CHARACTERISTIC
/begin CHARACTERISTIC DWC_EFLASHB.DWC_TorqueControl.DWC_WSCMAXUNDRIVENFORWSC "" VALUE 0x8060B4E8 DefaultValueRecordLayout_AUTOSAR_Platform_BaseTypes_sint16 40000.0 RB_PT_PCT_SWC_DWC_CompuMethods_ident -20000. 20000. FORMAT "%10.5"
 /begin ANNOTATION ANNOTATION_LABEL "Description (coming from AUTOSAR DESC field)"
  /begin ANNOTATION_TEXT "Maximum undriven axle speed for wheel slip control to be enabled\r\n" /end ANNOTATION_TEXT
 /end ANNOTATION
/end CHARACTERISTIC
/begin CHARACTERISTIC DWC_EFLASHB.DWC_TorqueControl.DWC_WSCMAXUNDRIVENFORWSCHYST "" VALUE 0x8060B4EA DefaultValueRecordLayout_AUTOSAR_Platform_BaseTypes_uint16 20000.0 RB_PT_PCT_SWC_DWC_CompuMethods_ident 0.0 20000. FORMAT "%10.5"
 /begin ANNOTATION ANNOTATION_LABEL "Description (coming from AUTOSAR DESC field)"
  /begin ANNOTATION_TEXT "Maximum undriven axle speed for wheel slip control to be enabled\r\n" /end ANNOTATION_TEXT
 /end ANNOTATION
/end CHARACTERISTIC
/begin CHARACTERISTIC DWC_EFLASHB.DWC_TorqueControl.DWC_WSCMUTESTINTERPOINTTIME "" VALUE 0x8060B4EC DefaultValueRecordLayout_AUTOSAR_Platform_BaseTypes_uint16 10.0 RB_PT_PCT_SWC_DWC_CompuMethods_ratio_0p001__2 0.0 10. FORMAT "%10.5"
 /begin ANNOTATION ANNOTATION_LABEL "Description (coming from AUTOSAR DESC field)" /begin ANNOTATION_TEXT "Maximum time between wheel speed sample points\r\n" /end ANNOTATION_TEXT /end ANNOTATION
/end CHARACTERISTIC
/begin CHARACTERISTIC DWC_EFLASHB.DWC_TorqueControl.DWC_WSCMUTESTTIMEOUT "" VALUE 0x8060B4EE DefaultValueRecordLayout_AUTOSAR_Platform_BaseTypes_uint16 10.0 RB_PT_PCT_SWC_DWC_CompuMethods_ratio_0p001__2 0.0 10. FORMAT "%10.5"
 /begin ANNOTATION ANNOTATION_LABEL "Description (coming from AUTOSAR DESC field)" /begin ANNOTATION_TEXT "Maximum time for mu test before abort occurs\r\n" /end ANNOTATION_TEXT /end ANNOTATION
/end CHARACTERISTIC
/begin CHARACTERISTIC DWC_EFLASHB.DWC_TorqueControl.DWC_WSCPTERMPOSIIR "" VALUE 0x8060B561 DefaultValueRecordLayout_AUTOSAR_Platform_BaseTypes_uint8 1.0 RB_PT_PCT_SWC_DWC_CompuMethods_ratio_0p01 0.0 1. FORMAT "%10.5"
 /begin ANNOTATION ANNOTATION_LABEL "Description (coming from AUTOSAR DESC field)" /begin ANNOTATION_TEXT "IIR filter coeff on positive going P terms\r\n" /end ANNOTATION_TEXT /end ANNOTATION
/end CHARACTERISTIC
/begin CHARACTERISTIC DWC_EFLASHB.DWC_TorqueControl.DWC_WSCPTERMWINDOWMAX "" CURVE 0x8060DD98 RB_PT_PCT_SWC_DWC_RecordLayouts_RL_Curve_sint16_7_sint16_7 4000.0 RB_PT_PCT_SWC_DWC_CompuMethods_ratio_0p1 -2000. 2000. FORMAT "%10.5"
 /begin ANNOTATION ANNOTATION_LABEL "Description (coming from AUTOSAR DESC field)" /begin ANNOTATION_TEXT "max p term in ration to max torque based around\r\n" /end ANNOTATION_TEXT /end ANNOTATION
 /begin AXIS_DESCR STD_AXIS NO_INPUT_QUANTITY RB_PT_PCT_SWC_DWC_CompuMethods_ident 7 -20000. 20000. FORMAT "%10.5" DEPOSIT ABSOLUTE /end AXIS_DESCR
/end CHARACTERISTIC
/begin CHARACTERISTIC DWC_EFLASHB.DWC_TorqueControl.DWC_WSCPTQ "" CURVE 0x8060DDB6 RB_PT_PCT_SWC_DWC_RecordLayouts_RL_Curve_sint16_7_sint16_7 4000.0 RB_PT_PCT_SWC_DWC_CompuMethods_ratio_0p1 -2000. 2000. FORMAT "%10.5"
 /begin ANNOTATION ANNOTATION_LABEL "Description (coming from AUTOSAR DESC field)" /begin ANNOTATION_TEXT "Proportional term of wheel slip controller\r\n" /end ANNOTATION_TEXT /end ANNOTATION
 /begin AXIS_DESCR STD_AXIS NO_INPUT_QUANTITY RB_PT_PCT_SWC_DWC_CompuMethods_ident 7 -20000. 20000. FORMAT "%10.5" DEPOSIT ABSOLUTE /end AXIS_DESCR
/end CHARACTERISTIC
/begin CHARACTERISTIC DWC_EFLASHB.DWC_TorqueControl.DWC_WSCTARGETDRIVENVSUNDRIVENSPEED "" CURVE 0x8060DDD4 RB_PT_PCT_SWC_DWC_RecordLayouts_RL_Curve_sint16_11_sint16_11 40000.0 RB_PT_PCT_SWC_DWC_CompuMethods_ident -20000. 20000. FORMAT "%10.5"
 /begin ANNOTATION ANNOTATION_LABEL "Description (coming from AUTOSAR DESC field)" /begin ANNOTATION_TEXT "Target driven axle speed vs. undriven axle speed\r\n" /end ANNOTATION_TEXT /end ANNOTATION
 /begin AXIS_DESCR STD_AXIS NO_INPUT_QUANTITY RB_PT_PCT_SWC_DWC_CompuMethods_ident 11 -20000. 20000. FORMAT "%10.5" DEPOSIT ABSOLUTE /end AXIS_DESCR
/end CHARACTERISTIC
/begin CHARACTERISTIC DWC_EFLASHB.DWC_TransmissionLosses.DWC_HIGHTEMPTHRES "" VALUE 0x8060DE20 DefaultValueRecordLayout_AUTOSAR_Platform_BaseTypes_sint16 250.0 RB_PT_PCT_SWC_DWC_CompuMethods_ident -50. 200. FORMAT "%10.5"
 /begin ANNOTATION ANNOTATION_LABEL "Description (coming from AUTOSAR DESC field)" /begin ANNOTATION_TEXT "Temperature of low temp map data\r\n" /end ANNOTATION_TEXT /end ANNOTATION
/end CHARACTERISTIC
/begin CHARACTERISTIC DWC_EFLASHB.DWC_TransmissionLosses.DWC_LOWTEMPTHRES "" VALUE 0x8060DE22 DefaultValueRecordLayout_AUTOSAR_Platform_BaseTypes_sint16 250.0 RB_PT_PCT_SWC_DWC_CompuMethods_ident -50. 200. FORMAT "%10.5"
 /begin ANNOTATION ANNOTATION_LABEL "Description (coming from AUTOSAR DESC field)" /begin ANNOTATION_TEXT "Temperature of low temp map data\r\n" /end ANNOTATION_TEXT /end ANNOTATION
/end CHARACTERISTIC
/begin CHARACTERISTIC DWC_EFLASHB.DWC_TransmissionLosses.DWC_MAXCCVALVECURRENT "" VALUE 0x8060DE24 DefaultValueRecordLayout_AUTOSAR_Platform_BaseTypes_uint16 4999.0 RB_PT_PCT_SWC_DWC_CompuMethods_ident 1. 5000. FORMAT "%10.5"
 /begin ANNOTATION ANNOTATION_LABEL "Description (coming from AUTOSAR DESC field)" /begin ANNOTATION_TEXT "Maximum sum of the two cooling valave currents\r\n" /end ANNOTATION_TEXT /end ANNOTATION
/end CHARACTERISTIC
/begin CHARACTERISTIC DWC_EFLASHB.DWC_TransmissionLosses.DWC_MAXSUMOFVALVECURRENTS "" VALUE 0x8060DE26 DefaultValueRecordLayout_AUTOSAR_Platform_BaseTypes_uint16 4999.0 RB_PT_PCT_SWC_DWC_CompuMethods_ident 1. 5000. FORMAT "%10.5"
 /begin ANNOTATION ANNOTATION_LABEL "Description (coming from AUTOSAR DESC field)" /begin ANNOTATION_TEXT "Maximum sum of the two cooling valave currents\r\n" /end ANNOTATION_TEXT /end ANNOTATION
/end CHARACTERISTIC
/begin CHARACTERISTIC DWC_EFLASHB.DWC_TransmissionLosses.DWC_MEDTEMPTHRES "" VALUE 0x8060DE28 DefaultValueRecordLayout_AUTOSAR_Platform_BaseTypes_sint16 250.0 RB_PT_PCT_SWC_DWC_CompuMethods_ident -50. 200. FORMAT "%10.5"
 /begin ANNOTATION ANNOTATION_LABEL "Description (coming from AUTOSAR DESC field)" /begin ANNOTATION_TEXT "Temperature of low temp map data\r\n" /end ANNOTATION_TEXT /end ANNOTATION
/end CHARACTERISTIC
/begin CHARACTERISTIC DWC_EFLASHB.DWC_TransmissionLosses.DWC_TRANSMISSIONLOSS "" VALUE 0x8060DE2A DefaultValueRecordLayout_AUTOSAR_Platform_BaseTypes_uint16 2000.0 RB_PT_PCT_SWC_DWC_CompuMethods_ratio_0p1 0.0 2000. FORMAT "%10.5"
 /begin ANNOTATION ANNOTATION_LABEL "Description (coming from AUTOSAR DESC field)" /begin ANNOTATION_TEXT "Transmission drag torque on engine\r\n" /end ANNOTATION_TEXT /end ANNOTATION
/end CHARACTERISTIC
/begin CHARACTERISTIC DWC_EFLASHB.DWC_TransmissionLosses.DWC_USEFIXEDLOSS "" VALUE 0x8060DE2C DefaultValueRecordLayout_AUTOSAR_Platform_BaseTypes_boolean 255.0 AUTOSAR_Platform_CompuMethods_boolean 0.0 255. FORMAT "%10.5"
 /begin ANNOTATION ANNOTATION_LABEL "Description (coming from AUTOSAR DESC field)"
  /begin ANNOTATION_TEXT "Parameter to enable the transmission losses to be set to a fixed value\r\n" /end ANNOTATION_TEXT
 /end ANNOTATION
/end CHARACTERISTIC
/begin CHARACTERISTIC DWC_EFLASHB.DWC_TransmissionLosses.DWC_VISCOUSDRAGMAXK1 "" MAP 0x8060DE2E RB_PT_PCT_SWC_DWC_RecordLayouts_RL_Map_sint16_156_sint16_6_sint16_26 4000.0 RB_PT_PCT_SWC_DWC_CompuMethods_ratio_0p1 -2000. 2000. FORMAT "%10.5"
 /begin ANNOTATION ANNOTATION_LABEL "Description (coming from AUTOSAR DESC field)"
  /begin ANNOTATION_TEXT "Temperature related viscous drag related to demand torque\r\n" /end ANNOTATION_TEXT
 /end ANNOTATION
 /begin AXIS_DESCR STD_AXIS NO_INPUT_QUANTITY RB_PT_PCT_SWC_DWC_CompuMethods_ident 6 -50. 200. FORMAT "%10.5" DEPOSIT ABSOLUTE /end AXIS_DESCR
 /begin AXIS_DESCR STD_AXIS NO_INPUT_QUANTITY RB_PT_PCT_SWC_DWC_CompuMethods_ident 26 -20000. 20000. FORMAT "%10.5" DEPOSIT ABSOLUTE /end AXIS_DESCR
/end CHARACTERISTIC
/begin CHARACTERISTIC DWC_EFLASHB.DWC_TransmissionLosses.DWC_VISCOUSDRAGMAXK2 "" MAP 0x8060DFAA RB_PT_PCT_SWC_DWC_RecordLayouts_RL_Map_sint16_156_sint16_6_sint16_26 4000.0 RB_PT_PCT_SWC_DWC_CompuMethods_ratio_0p1 -2000. 2000. FORMAT "%10.5"
 /begin ANNOTATION ANNOTATION_LABEL "Description (coming from AUTOSAR DESC field)"
  /begin ANNOTATION_TEXT "Temperature related viscous drag related to demand torque\r\n" /end ANNOTATION_TEXT
 /end ANNOTATION
 /begin AXIS_DESCR STD_AXIS NO_INPUT_QUANTITY RB_PT_PCT_SWC_DWC_CompuMethods_ident 6 -50. 200. FORMAT "%10.5" DEPOSIT ABSOLUTE /end AXIS_DESCR
 /begin AXIS_DESCR STD_AXIS NO_INPUT_QUANTITY RB_PT_PCT_SWC_DWC_CompuMethods_ident 26 -20000. 20000. FORMAT "%10.5" DEPOSIT ABSOLUTE /end AXIS_DESCR
/end CHARACTERISTIC
/begin CHARACTERISTIC DWC_EFLASHB.DWC_TransmissionLosses.DWC_VISCOUSDRAGMINK1 "" MAP 0x8060E126 RB_PT_PCT_SWC_DWC_RecordLayouts_RL_Map_sint16_156_sint16_6_sint16_26 4000.0 RB_PT_PCT_SWC_DWC_CompuMethods_ratio_0p1 -2000. 2000. FORMAT "%10.5"
 /begin ANNOTATION ANNOTATION_LABEL "Description (coming from AUTOSAR DESC field)"
  /begin ANNOTATION_TEXT "Temperature related viscous drag related to demand torque\r\n" /end ANNOTATION_TEXT
 /end ANNOTATION
 /begin AXIS_DESCR STD_AXIS NO_INPUT_QUANTITY RB_PT_PCT_SWC_DWC_CompuMethods_ident 6 -50. 200. FORMAT "%10.5" DEPOSIT ABSOLUTE /end AXIS_DESCR
 /begin AXIS_DESCR STD_AXIS NO_INPUT_QUANTITY RB_PT_PCT_SWC_DWC_CompuMethods_ident 26 -20000. 20000. FORMAT "%10.5" DEPOSIT ABSOLUTE /end AXIS_DESCR
/end CHARACTERISTIC
/begin CHARACTERISTIC DWC_EFLASHB.DWC_TransmissionLosses.DWC_VISCOUSDRAGMINK2 "" MAP 0x8060E2A2 RB_PT_PCT_SWC_DWC_RecordLayouts_RL_Map_sint16_156_sint16_6_sint16_26 4000.0 RB_PT_PCT_SWC_DWC_CompuMethods_ratio_0p1 -2000. 2000. FORMAT "%10.5"
 /begin ANNOTATION ANNOTATION_LABEL "Description (coming from AUTOSAR DESC field)"
  /begin ANNOTATION_TEXT "Temperature related viscous drag related to demand torque\r\n" /end ANNOTATION_TEXT
 /end ANNOTATION
 /begin AXIS_DESCR STD_AXIS NO_INPUT_QUANTITY RB_PT_PCT_SWC_DWC_CompuMethods_ident 6 -50. 200. FORMAT "%10.5" DEPOSIT ABSOLUTE /end AXIS_DESCR
 /begin AXIS_DESCR STD_AXIS NO_INPUT_QUANTITY RB_PT_PCT_SWC_DWC_CompuMethods_ident 26 -20000. 20000. FORMAT "%10.5" DEPOSIT ABSOLUTE /end AXIS_DESCR
/end CHARACTERISTIC
/begin CHARACTERISTIC DWC_EFLASHB.DWC_USERAWSLIPSPEEDPHASECTRL "" VALUE 0x806098CC DefaultValueRecordLayout_AUTOSAR_Platform_BaseTypes_boolean 255.0 AUTOSAR_Platform_CompuMethods_boolean 0.0 255. FORMAT "%10.5"
 /begin ANNOTATION ANNOTATION_LABEL "Description (coming from AUTOSAR DESC field)" /begin ANNOTATION_TEXT "Flag to use raw slip for speed phase control module\r\n" /end ANNOTATION_TEXT /end ANNOTATION
/end CHARACTERISTIC
/begin CHARACTERISTIC DWC_EFLASHROMB.DWC_HIGHESTTORQUEGEARHYST "" VALUE 0x806076FC DefaultValueRecordLayout_AUTOSAR_Platform_BaseTypes_uint16 2000.0 RB_PT_PCT_SWC_DWC_CompuMethods_ratio_0p1 0.0 2000. FORMAT "%10.5"
 /begin ANNOTATION ANNOTATION_LABEL "Description (coming from AUTOSAR DESC field)" /begin ANNOTATION_TEXT "Hysteresis on decision for highest torque gear\r\n" /end ANNOTATION_TEXT /end ANNOTATION
/end CHARACTERISTIC
/begin CHARACTERISTIC DWC_EFLASHROMB.DWC_InputProcessing.DWC_AGGRESSIVEMANUAL "" VALUE 0x80607704 DefaultValueRecordLayout_AUTOSAR_Platform_BaseTypes_boolean 255.0 AUTOSAR_Platform_CompuMethods_boolean 0.0 255. FORMAT "%10.5"
 /begin ANNOTATION ANNOTATION_LABEL "Description (coming from AUTOSAR DESC field)" /begin ANNOTATION_TEXT "Aggressive manual mode shifts enable\r\n" /end ANNOTATION_TEXT /end ANNOTATION
/end CHARACTERISTIC
/begin CHARACTERISTIC DWC_EFLASHROMB.DWC_InputProcessing.DWC_BRAKEPRESSURENOTBACKEDUP "" VALUE 0x80607705 DefaultValueRecordLayout_AUTOSAR_Platform_BaseTypes_boolean 255.0 AUTOSAR_Platform_CompuMethods_boolean 0.0 255. FORMAT "%10.5"
 /begin ANNOTATION ANNOTATION_LABEL "Description (coming from AUTOSAR DESC field)"
  /begin ANNOTATION_TEXT "Flag to indicate that brake pressure signal is not substituted, therefore requiring DWC to do it\r\n" /end ANNOTATION_TEXT
 /end ANNOTATION
/end CHARACTERISTIC
/begin CHARACTERISTIC DWC_EFLASHROMB.DWC_InputProcessing.DWC_DEFAULTTEMPERATURE "" VALUE 0x80607700 DefaultValueRecordLayout_AUTOSAR_Platform_BaseTypes_sint16 250.0 RB_PT_PCT_SWC_DWC_CompuMethods_ident -50. 200. FORMAT "%10.5"
 /begin ANNOTATION ANNOTATION_LABEL "Description (coming from AUTOSAR DESC field)"
  /begin ANNOTATION_TEXT "Calibrated default temperature in the case of all sensors failed\r\n" /end ANNOTATION_TEXT
 /end ANNOTATION
/end CHARACTERISTIC
/begin CHARACTERISTIC DWC_EFLASHROMB.DWC_InputProcessing.DWC_DRIVERTORQUEMAXIMUM "" VALUE 0x80607702 DefaultValueRecordLayout_AUTOSAR_Platform_BaseTypes_uint16 1900.0 RB_PT_PCT_SWC_DWC_CompuMethods_ratio_0p1 100. 2000. FORMAT "%10.5"
 /begin ANNOTATION ANNOTATION_LABEL "Description (coming from AUTOSAR DESC field)"
  /begin ANNOTATION_TEXT "Maximum driver demand torque (for calculation of percentage aggression - optionally)\r\n" /end ANNOTATION_TEXT
 /end ANNOTATION
/end CHARACTERISTIC
/begin CHARACTERISTIC DWC_EFLASHROMB.DWC_InputProcessing.DWC_INPUT1SIGNED "" VALUE 0x80607706 DefaultValueRecordLayout_AUTOSAR_Platform_BaseTypes_boolean 255.0 AUTOSAR_Platform_CompuMethods_boolean 0.0 255. FORMAT "%10.5"
 /begin ANNOTATION ANNOTATION_LABEL "Description (coming from AUTOSAR DESC field)"
  /begin ANNOTATION_TEXT "Flag indicating that input shaft 1 speed is signed on input to DWC\r\n" /end ANNOTATION_TEXT
 /end ANNOTATION
/end CHARACTERISTIC
/begin CHARACTERISTIC DWC_EFLASHROMB.DWC_InputProcessing.DWC_INPUT2SIGNED "" VALUE 0x80607707 DefaultValueRecordLayout_AUTOSAR_Platform_BaseTypes_boolean 255.0 AUTOSAR_Platform_CompuMethods_boolean 0.0 255. FORMAT "%10.5"
 /begin ANNOTATION ANNOTATION_LABEL "Description (coming from AUTOSAR DESC field)"
  /begin ANNOTATION_TEXT "Flag indicating that input shaft 1 speed is signed on input to DWC\r\n" /end ANNOTATION_TEXT
 /end ANNOTATION
/end CHARACTERISTIC
/begin CHARACTERISTIC DWC_EFLASHROMB.DWC_InputProcessing.DWC_K1PressureCorrect.DWC_ADAPTDELTATEMP "" VAL_BLK 0x8060770C DefaultValueRecordLayout_AUTOSAR_Platform_BaseTypes_sint16 64.0 RB_PT_PCT_SWC_DWC_CompuMethods_ratio_0p001__2 -32. 32. FORMAT "%10.5"
 /begin ANNOTATION ANNOTATION_LABEL "Description (coming from AUTOSAR DESC field)" /begin ANNOTATION_TEXT "Working points of temperature adaptation\r\n" /end ANNOTATION_TEXT /end ANNOTATION
 MATRIX_DIM 7 1 1 /end CHARACTERISTIC
/begin CHARACTERISTIC DWC_EFLASHROMB.DWC_InputProcessing.DWC_K1PressureCorrect.DWC_MAXOFFSETTEMP "" VAL_BLK 0x8060771A DefaultValueRecordLayout_AUTOSAR_Platform_BaseTypes_sint16 64.0 RB_PT_PCT_SWC_DWC_CompuMethods_ratio_0p001__2 -32. 32. FORMAT "%10.5"
 /begin ANNOTATION ANNOTATION_LABEL "Description (coming from AUTOSAR DESC field)" /begin ANNOTATION_TEXT "Working points of temperature adaptation\r\n" /end ANNOTATION_TEXT /end ANNOTATION
 MATRIX_DIM 7 1 1 /end CHARACTERISTIC
/begin CHARACTERISTIC DWC_EFLASHROMB.DWC_InputProcessing.DWC_K1PressureCorrect.DWC_MINOFFSETTEMP "" VAL_BLK 0x80607728 DefaultValueRecordLayout_AUTOSAR_Platform_BaseTypes_sint16 64.0 RB_PT_PCT_SWC_DWC_CompuMethods_ratio_0p001__2 -32. 32. FORMAT "%10.5"
 /begin ANNOTATION ANNOTATION_LABEL "Description (coming from AUTOSAR DESC field)" /begin ANNOTATION_TEXT "Working points of temperature adaptation\r\n" /end ANNOTATION_TEXT /end ANNOTATION
 MATRIX_DIM 7 1 1 /end CHARACTERISTIC
/begin CHARACTERISTIC DWC_EFLASHROMB.DWC_InputProcessing.DWC_K1PressureCorrect.DWC_TEMPPOINTS "" VAL_BLK 0x80607736 DefaultValueRecordLayout_AUTOSAR_Platform_BaseTypes_sint16 250.0 RB_PT_PCT_SWC_DWC_CompuMethods_ident -50. 200. FORMAT "%10.5"
 /begin ANNOTATION ANNOTATION_LABEL "Description (coming from AUTOSAR DESC field)" /begin ANNOTATION_TEXT "Working points of temperature adaptation\r\n" /end ANNOTATION_TEXT /end ANNOTATION
 MATRIX_DIM 7 1 1 /end CHARACTERISTIC
/begin CHARACTERISTIC DWC_EFLASHROMB.DWC_InputProcessing.DWC_K1PressureCorrect.DWC_TIMEUNTILADAPTTEMP "" VAL_BLK 0x80607744 DefaultValueRecordLayout_AUTOSAR_Platform_BaseTypes_uint16 10.0 RB_PT_PCT_SWC_DWC_CompuMethods_ratio_0p001__2 0.0 10. FORMAT "%10.5"
 /begin ANNOTATION ANNOTATION_LABEL "Description (coming from AUTOSAR DESC field)" /begin ANNOTATION_TEXT "Time until adaptation against temperature point\r\n" /end ANNOTATION_TEXT /end ANNOTATION
 MATRIX_DIM 7 1 1 /end CHARACTERISTIC
/begin CHARACTERISTIC DWC_EFLASHROMB.DWC_InputProcessing.DWC_K2PressureCorrect.DWC_ADAPTDELTATEMP "" VAL_BLK 0x80607752 DefaultValueRecordLayout_AUTOSAR_Platform_BaseTypes_sint16 64.0 RB_PT_PCT_SWC_DWC_CompuMethods_ratio_0p001__2 -32. 32. FORMAT "%10.5"
 /begin ANNOTATION ANNOTATION_LABEL "Description (coming from AUTOSAR DESC field)" /begin ANNOTATION_TEXT "Working points of temperature adaptation\r\n" /end ANNOTATION_TEXT /end ANNOTATION
 MATRIX_DIM 7 1 1 /end CHARACTERISTIC
/begin CHARACTERISTIC DWC_EFLASHROMB.DWC_InputProcessing.DWC_K2PressureCorrect.DWC_MAXOFFSETTEMP "" VAL_BLK 0x80607760 DefaultValueRecordLayout_AUTOSAR_Platform_BaseTypes_sint16 64.0 RB_PT_PCT_SWC_DWC_CompuMethods_ratio_0p001__2 -32. 32. FORMAT "%10.5"
 /begin ANNOTATION ANNOTATION_LABEL "Description (coming from AUTOSAR DESC field)" /begin ANNOTATION_TEXT "Working points of temperature adaptation\r\n" /end ANNOTATION_TEXT /end ANNOTATION
 MATRIX_DIM 7 1 1 /end CHARACTERISTIC
/begin CHARACTERISTIC DWC_EFLASHROMB.DWC_InputProcessing.DWC_K2PressureCorrect.DWC_MINOFFSETTEMP "" VAL_BLK 0x8060776E DefaultValueRecordLayout_AUTOSAR_Platform_BaseTypes_sint16 64.0 RB_PT_PCT_SWC_DWC_CompuMethods_ratio_0p001__2 -32. 32. FORMAT "%10.5"
 /begin ANNOTATION ANNOTATION_LABEL "Description (coming from AUTOSAR DESC field)" /begin ANNOTATION_TEXT "Working points of temperature adaptation\r\n" /end ANNOTATION_TEXT /end ANNOTATION
 MATRIX_DIM 7 1 1 /end CHARACTERISTIC
/begin CHARACTERISTIC DWC_EFLASHROMB.DWC_InputProcessing.DWC_K2PressureCorrect.DWC_TEMPPOINTS "" VAL_BLK 0x8060777C DefaultValueRecordLayout_AUTOSAR_Platform_BaseTypes_sint16 250.0 RB_PT_PCT_SWC_DWC_CompuMethods_ident -50. 200. FORMAT "%10.5"
 /begin ANNOTATION ANNOTATION_LABEL "Description (coming from AUTOSAR DESC field)" /begin ANNOTATION_TEXT "Working points of temperature adaptation\r\n" /end ANNOTATION_TEXT /end ANNOTATION
 MATRIX_DIM 7 1 1 /end CHARACTERISTIC
/begin CHARACTERISTIC DWC_EFLASHROMB.DWC_InputProcessing.DWC_K2PressureCorrect.DWC_TIMEUNTILADAPTTEMP "" VAL_BLK 0x8060778A DefaultValueRecordLayout_AUTOSAR_Platform_BaseTypes_uint16 10.0 RB_PT_PCT_SWC_DWC_CompuMethods_ratio_0p001__2 0.0 10. FORMAT "%10.5"
 /begin ANNOTATION ANNOTATION_LABEL "Description (coming from AUTOSAR DESC field)" /begin ANNOTATION_TEXT "Time until adaptation against temperature point\r\n" /end ANNOTATION_TEXT /end ANNOTATION
 MATRIX_DIM 7 1 1 /end CHARACTERISTIC
/begin CHARACTERISTIC DWC_EFLASHROMB.DWC_InputProcessing.DWC_OUTPUTSPEEDNOTBACKEDUP "" VALUE 0x80607708 DefaultValueRecordLayout_AUTOSAR_Platform_BaseTypes_boolean 255.0 AUTOSAR_Platform_CompuMethods_boolean 0.0 255. FORMAT "%10.5"
 /begin ANNOTATION ANNOTATION_LABEL "Description (coming from AUTOSAR DESC field)"
  /begin ANNOTATION_TEXT "Flag to indicate that output speed signal is not substituted, therefore requiring DWC to do it\r\n" /end ANNOTATION_TEXT
 /end ANNOTATION
/end CHARACTERISTIC
/begin CHARACTERISTIC DWC_EFLASHROMB.DWC_InputProcessing.DWC_PEDALPOSITIVEAGGRESSION "" VALUE 0x80607709 DefaultValueRecordLayout_AUTOSAR_Platform_BaseTypes_uint8 102.0 RB_PT_PCT_SWC_DWC_CompuMethods_ratio_0p4 0.0 102. FORMAT "%10.5"
 /begin ANNOTATION ANNOTATION_LABEL "Description (coming from AUTOSAR DESC field)"
  /begin ANNOTATION_TEXT "Percentage throttle for positive only shift aggression\r\n" /end ANNOTATION_TEXT
 /end ANNOTATION
/end CHARACTERISTIC
/begin CHARACTERISTIC DWC_EFLASHROMB.DWC_InputProcessing.DWC_USEPTMODEFORSHIFTMODE "" VALUE 0x8060770A DefaultValueRecordLayout_AUTOSAR_Platform_BaseTypes_boolean 255.0 AUTOSAR_Platform_CompuMethods_boolean 0.0 255. FORMAT "%10.5"
 /begin ANNOTATION ANNOTATION_LABEL "Description (coming from AUTOSAR DESC field)"
  /begin ANNOTATION_TEXT "Flag to force the use of powertrain mode for shifting mode, rather than gear lever state\r\n" /end ANNOTATION_TEXT
 /end ANNOTATION
/end CHARACTERISTIC
/begin CHARACTERISTIC DWC_EFLASHROMB.DWC_K1DeviceControl.DWC_ASGSlipConditions.DWC_TIMERDT "" VALUE 0x80607850 DefaultValueRecordLayout_AUTOSAR_Platform_BaseTypes_uint16 10.0 RB_PT_PCT_SWC_DWC_CompuMethods_ratio_0p001__2 0.0 10. FORMAT "%10.5"
 /begin ANNOTATION ANNOTATION_LABEL "Description (coming from AUTOSAR DESC field)"
  /begin ANNOTATION_TEXT "Count down rate of timer (call rate of timed out task)\r\n" /end ANNOTATION_TEXT
 /end ANNOTATION
/end CHARACTERISTIC
/begin CHARACTERISTIC DWC_EFLASHROMB.DWC_K1DeviceControl.DWC_FAILUREBANKID "" VALUE 0x8060784C DefaultValueRecordLayout_AUTOSAR_Platform_BaseTypes_uint8 2.0 RB_PT_PCT_SWC_DWC_CompuMethods_ident 0.0 2. FORMAT "%10.5"
 /begin ANNOTATION ANNOTATION_LABEL "Description (coming from AUTOSAR DESC field)" /begin ANNOTATION_TEXT "Data to be loaded into failed gear table on failure\r\n" /end ANNOTATION_TEXT /end ANNOTATION
/end CHARACTERISTIC
/begin CHARACTERISTIC DWC_EFLASHROMB.DWC_K1DeviceControl.DWC_FAILUREGEARID "" VALUE 0x8060784D DefaultValueRecordLayout_AUTOSAR_Platform_BaseTypes_uint8 11.0 RB_PT_PCT_SWC_DWC_CompuMethods_ident 0.0 11. FORMAT "%10.5"
 /begin ANNOTATION ANNOTATION_LABEL "Description (coming from AUTOSAR DESC field)" /begin ANNOTATION_TEXT "Data to be loaded into failed gear table on failure\r\n" /end ANNOTATION_TEXT /end ANNOTATION
/end CHARACTERISTIC
/begin CHARACTERISTIC DWC_EFLASHROMB.DWC_K1DeviceControl.DWC_FAILUREHYBID "" VALUE 0x8060784E DefaultValueRecordLayout_AUTOSAR_Platform_BaseTypes_uint8 6.0 RB_PT_PCT_SWC_DWC_CompuMethods_ident 0.0 6. FORMAT "%10.5"
 /begin ANNOTATION ANNOTATION_LABEL "Description (coming from AUTOSAR DESC field)" /begin ANNOTATION_TEXT "Index of failed hybrid mode table to be written to.\r\n" /end ANNOTATION_TEXT /end ANNOTATION
/end CHARACTERISTIC
/begin CHARACTERISTIC DWC_EFLASHROMB.DWC_K1DeviceControl.DWC_FillController.DWC_FILLPULSETIMEFACTORSOFT "" VALUE 0x80607852 DefaultValueRecordLayout_AUTOSAR_Platform_BaseTypes_uint16 1.0 RB_PT_PCT_SWC_DWC_CompuMethods_ratio_0p001__2 0.0 1. FORMAT "%10.5"
 /begin ANNOTATION ANNOTATION_LABEL "Description (coming from AUTOSAR DESC field)"
  /begin ANNOTATION_TEXT "Factor applied to start time that the pulse will run for (all of it = 1.0)\r\n" /end ANNOTATION_TEXT
 /end ANNOTATION
/end CHARACTERISTIC
/begin CHARACTERISTIC DWC_EFLASHROMB.DWC_K1DeviceControl.DWC_OBDKPLEARNMAXLIMIT "" VALUE 0x80607844 DefaultValueRecordLayout_AUTOSAR_Platform_BaseTypes_sint16 34.0 RB_PT_PCT_SWC_DWC_CompuMethods_ratio_0p001__2 -2. 32. FORMAT "%10.5"
 /begin ANNOTATION ANNOTATION_LABEL "Description (coming from AUTOSAR DESC field)"
  /begin ANNOTATION_TEXT "Maximum allowable kisspoint learnt by EOL kisspoint test\r\n" /end ANNOTATION_TEXT
 /end ANNOTATION
/end CHARACTERISTIC
/begin CHARACTERISTIC DWC_EFLASHROMB.DWC_K1DeviceControl.DWC_OBDKPLEARNMINLIMIT "" VALUE 0x80607846 DefaultValueRecordLayout_AUTOSAR_Platform_BaseTypes_sint16 34.0 RB_PT_PCT_SWC_DWC_CompuMethods_ratio_0p001__2 -2. 32. FORMAT "%10.5"
 /begin ANNOTATION ANNOTATION_LABEL "Description (coming from AUTOSAR DESC field)"
  /begin ANNOTATION_TEXT "Minimum allowable kisspoint learnt by EOL kisspoint test\r\n" /end ANNOTATION_TEXT
 /end ANNOTATION
/end CHARACTERISTIC
/begin CHARACTERISTIC DWC_EFLASHROMB.DWC_K1DeviceControl.DWC_OBDPCLEARNMAXLIMIT "" VALUE 0x80607848 DefaultValueRecordLayout_AUTOSAR_Platform_BaseTypes_sint16 2000.0 RB_PT_PCT_SWC_DWC_CompuMethods_ratio_0p1 -1000. 1000. FORMAT "%10.5"
 /begin ANNOTATION ANNOTATION_LABEL "Description (coming from AUTOSAR DESC field)" /begin ANNOTATION_TEXT "Maximum PC offset current for EOL adaption\r\n" /end ANNOTATION_TEXT /end ANNOTATION
/end CHARACTERISTIC
/begin CHARACTERISTIC DWC_EFLASHROMB.DWC_K1DeviceControl.DWC_OBDPCLEARNMINLIMIT "" VALUE 0x8060784A DefaultValueRecordLayout_AUTOSAR_Platform_BaseTypes_sint16 2000.0 RB_PT_PCT_SWC_DWC_CompuMethods_ratio_0p1 -1000. 1000. FORMAT "%10.5"
 /begin ANNOTATION ANNOTATION_LABEL "Description (coming from AUTOSAR DESC field)" /begin ANNOTATION_TEXT "Minimum PC offset current for EOL adaption\r\n" /end ANNOTATION_TEXT /end ANNOTATION
/end CHARACTERISTIC
/begin CHARACTERISTIC DWC_EFLASHROMB.DWC_K1DeviceControl.DWC_OBDTESTDECODE "" VAL_BLK 0x80607798 DefaultValueRecordLayout_AUTOSAR_Platform_BaseTypes_uint8 6.0 RB_PT_PCT_SWC_DWC_CompuMethods_ident 0.0 6. FORMAT "%10.5"
 /begin ANNOTATION ANNOTATION_LABEL "Description (coming from AUTOSAR DESC field)" /begin ANNOTATION_TEXT "Decoder for OBD tests and state/status'\r\n" /end ANNOTATION_TEXT /end ANNOTATION
 MATRIX_DIM 55 3 1 /end CHARACTERISTIC
/begin CHARACTERISTIC DWC_EFLASHROMB.DWC_K1DeviceControl.DWC_OPTIONSMASK "" VALUE 0x80607840 DefaultValueRecordLayout_AUTOSAR_Platform_BaseTypes_uint32 4.294967295E9 RB_PT_PCT_SWC_DWC_CompuMethods_ident 0.0 4.294967295E9 FORMAT "%10.5"
 /begin ANNOTATION ANNOTATION_LABEL "Description (coming from AUTOSAR DESC field)" /begin ANNOTATION_TEXT "Mask to enable device controller options\r\n" /end ANNOTATION_TEXT /end ANNOTATION
/end CHARACTERISTIC
/begin CHARACTERISTIC DWC_EFLASHROMB.DWC_K1DeviceControl.DWC_PressCurrent.DWC_MAXPRESSVSENGSPD "" CURVE 0x80607854 RB_PT_PCT_SWC_DWC_RecordLayouts_RL_Curve_sint16_5_uint16_5 34.0 RB_PT_PCT_SWC_DWC_CompuMethods_ratio_0p001__2 -2. 32. FORMAT "%10.5"
 /begin ANNOTATION ANNOTATION_LABEL "Description (coming from AUTOSAR DESC field)"
  /begin ANNOTATION_TEXT "Maximum pressure demand vs. engine speed (clutch seal PV rating limited)\r\n" /end ANNOTATION_TEXT
 /end ANNOTATION
 /begin AXIS_DESCR STD_AXIS NO_INPUT_QUANTITY RB_PT_PCT_SWC_DWC_CompuMethods_ident 5 0.0 20000. FORMAT "%10.5" DEPOSIT ABSOLUTE /end AXIS_DESCR
/end CHARACTERISTIC
/begin CHARACTERISTIC DWC_EFLASHROMB.DWC_K1DeviceControl.DWC_PressCurrent.DWC_VALVEFFCORRECTION "" MAP 0x8060786A RB_PT_PCT_SWC_DWC_RecordLayouts_RL_Map_uint16_35_sint16_7_sint16_5 1.0 RB_PT_PCT_SWC_DWC_CompuMethods_ratio_0p001__2 0.0 1. FORMAT "%10.5"
 /begin ANNOTATION ANNOTATION_LABEL "Description (coming from AUTOSAR DESC field)"
  /begin ANNOTATION_TEXT "Proportional current offset vs error and target pressure\r\n" /end ANNOTATION_TEXT
 /end ANNOTATION
 /begin AXIS_DESCR STD_AXIS NO_INPUT_QUANTITY RB_PT_PCT_SWC_DWC_CompuMethods_ratio_0p001__2 7 -32. 32. FORMAT "%10.5" DEPOSIT ABSOLUTE /end AXIS_DESCR
 /begin AXIS_DESCR STD_AXIS NO_INPUT_QUANTITY RB_PT_PCT_SWC_DWC_CompuMethods_ratio_0p001__2 5 -32. 32. FORMAT "%10.5" DEPOSIT ABSOLUTE /end AXIS_DESCR
/end CHARACTERISTIC
/begin CHARACTERISTIC DWC_EFLASHROMB.DWC_K1DeviceControl.DWC_PressCurrent.DWC_VALVENORMALDERIVGAINTEMP "" MAP 0x806078CC RB_PT_PCT_SWC_DWC_RecordLayouts_RL_Map_sint16_9_sint16_3_sint16_3 20.0 RB_PT_PCT_SWC_DWC_CompuMethods_ratio_0p001__2 -10. 10. FORMAT "%10.5"
 /begin ANNOTATION ANNOTATION_LABEL "Description (coming from AUTOSAR DESC field)" /begin ANNOTATION_TEXT "Derivative gain against temperature\r\n" /end ANNOTATION_TEXT /end ANNOTATION
 /begin AXIS_DESCR STD_AXIS NO_INPUT_QUANTITY RB_PT_PCT_SWC_DWC_CompuMethods_ratio_0p001__2 3 -32. 32. FORMAT "%10.5" DEPOSIT ABSOLUTE /end AXIS_DESCR
 /begin AXIS_DESCR STD_AXIS NO_INPUT_QUANTITY RB_PT_PCT_SWC_DWC_CompuMethods_ident 3 -50. 200. FORMAT "%10.5" DEPOSIT ABSOLUTE /end AXIS_DESCR
/end CHARACTERISTIC
/begin CHARACTERISTIC DWC_EFLASHROMB.DWC_K1DeviceControl.DWC_PressCurrent.DWC_VALVEPRESSCURRENTVSTEMP "" MAP 0x806078EE RB_PT_PCT_SWC_DWC_RecordLayouts_RL_Map_uint16_55_sint16_11_sint16_5 5000.0 RB_PT_PCT_SWC_DWC_CompuMethods_ident 0.0 5000. FORMAT "%10.5"
 /begin ANNOTATION ANNOTATION_LABEL "Description (coming from AUTOSAR DESC field)"
  /begin ANNOTATION_TEXT "Pressure to current characteristic of valve, compensated for temperature\r\n" /end ANNOTATION_TEXT
 /end ANNOTATION
 /begin AXIS_DESCR STD_AXIS NO_INPUT_QUANTITY RB_PT_PCT_SWC_DWC_CompuMethods_ratio_0p001__2 11 -2. 32. FORMAT "%10.5" DEPOSIT ABSOLUTE /end AXIS_DESCR
 /begin AXIS_DESCR STD_AXIS NO_INPUT_QUANTITY RB_PT_PCT_SWC_DWC_CompuMethods_ident 5 -50. 200. FORMAT "%10.5" DEPOSIT ABSOLUTE /end AXIS_DESCR
/end CHARACTERISTIC
/begin CHARACTERISTIC DWC_EFLASHROMB.DWC_K1DeviceControl.DWC_PressCurrent.DWC_VALVEPROPCORRPOSTFILL "" MAP 0x80607980 RB_PT_PCT_SWC_DWC_RecordLayouts_RL_Map_sint16_35_sint16_7_sint16_5 2000.0 RB_PT_PCT_SWC_DWC_CompuMethods_ident -1000. 1000. FORMAT "%10.5"
 /begin ANNOTATION ANNOTATION_LABEL "Description (coming from AUTOSAR DESC field)"
  /begin ANNOTATION_TEXT "Proportional current offset vs error and target pressure\r\n" /end ANNOTATION_TEXT
 /end ANNOTATION
 /begin AXIS_DESCR STD_AXIS NO_INPUT_QUANTITY RB_PT_PCT_SWC_DWC_CompuMethods_ratio_0p001__2 7 -32. 32. FORMAT "%10.5" DEPOSIT ABSOLUTE /end AXIS_DESCR
 /begin AXIS_DESCR STD_AXIS NO_INPUT_QUANTITY RB_PT_PCT_SWC_DWC_CompuMethods_ratio_0p001__2 5 -32. 32. FORMAT "%10.5" DEPOSIT ABSOLUTE /end AXIS_DESCR
/end CHARACTERISTIC
/begin CHARACTERISTIC DWC_EFLASHROMB.DWC_K1DeviceControl.DWC_PressCurrent.DWC_VALVEPROPORTIONALCORRECTION "" MAP 0x806079E2 RB_PT_PCT_SWC_DWC_RecordLayouts_RL_Map_sint16_35_sint16_7_sint16_5 2000.0 RB_PT_PCT_SWC_DWC_CompuMethods_ident -1000. 1000. FORMAT "%10.5"
 /begin ANNOTATION ANNOTATION_LABEL "Description (coming from AUTOSAR DESC field)"
  /begin ANNOTATION_TEXT "Proportional current offset vs error and target pressure\r\n" /end ANNOTATION_TEXT
 /end ANNOTATION
 /begin AXIS_DESCR STD_AXIS NO_INPUT_QUANTITY RB_PT_PCT_SWC_DWC_CompuMethods_ratio_0p001__2 7 -32. 32. FORMAT "%10.5" DEPOSIT ABSOLUTE /end AXIS_DESCR
 /begin AXIS_DESCR STD_AXIS NO_INPUT_QUANTITY RB_PT_PCT_SWC_DWC_CompuMethods_ratio_0p001__2 5 -32. 32. FORMAT "%10.5" DEPOSIT ABSOLUTE /end AXIS_DESCR
/end CHARACTERISTIC
/begin CHARACTERISTIC DWC_EFLASHROMB.DWC_K1DeviceControl.DWC_PressCurrent.DWC_VALVESTATICLINEPRESSUREDEPENDENCY "" MAP 0x80607A44 RB_PT_PCT_SWC_DWC_RecordLayouts_RL_Map_sint16_15_sint16_5_sint16_3 64.0 RB_PT_PCT_SWC_DWC_CompuMethods_ratio_0p001__2 -32. 32. FORMAT "%10.5"
 /begin ANNOTATION ANNOTATION_LABEL "Description (coming from AUTOSAR DESC field)"
  /begin ANNOTATION_TEXT "Offset for static line pressure dependency, based on line pressure and demand\r\n" /end ANNOTATION_TEXT
 /end ANNOTATION
 /begin AXIS_DESCR STD_AXIS NO_INPUT_QUANTITY RB_PT_PCT_SWC_DWC_CompuMethods_ratio_0p001__2 5 -2. 32. FORMAT "%10.5" DEPOSIT ABSOLUTE /end AXIS_DESCR
 /begin AXIS_DESCR STD_AXIS NO_INPUT_QUANTITY RB_PT_PCT_SWC_DWC_CompuMethods_ratio_0p005 3 -5. 100. FORMAT "%10.5" DEPOSIT ABSOLUTE /end AXIS_DESCR
/end CHARACTERISTIC
/begin CHARACTERISTIC DWC_EFLASHROMB.DWC_K1DeviceControl.DWC_PtoCSequence.DWC_PCMAXROW "" VALUE 0x80607AAE DefaultValueRecordLayout_AUTOSAR_Platform_BaseTypes_uint8 1.0 RB_PT_PCT_SWC_DWC_CompuMethods_ident 0.0 1. FORMAT "%10.5"
 /begin ANNOTATION ANNOTATION_LABEL "Description (coming from AUTOSAR DESC field)" /begin ANNOTATION_TEXT "Row associated with minimum speeds\r\n" /end ANNOTATION_TEXT /end ANNOTATION
/end CHARACTERISTIC
/begin CHARACTERISTIC DWC_EFLASHROMB.DWC_K1DeviceControl.DWC_PtoCSequence.DWC_PCMINROW "" VALUE 0x80607AAF DefaultValueRecordLayout_AUTOSAR_Platform_BaseTypes_uint8 1.0 RB_PT_PCT_SWC_DWC_CompuMethods_ident 0.0 1. FORMAT "%10.5"
 /begin ANNOTATION ANNOTATION_LABEL "Description (coming from AUTOSAR DESC field)" /begin ANNOTATION_TEXT "Row associated with minimum speeds\r\n" /end ANNOTATION_TEXT /end ANNOTATION
/end CHARACTERISTIC
/begin CHARACTERISTIC DWC_EFLASHROMB.DWC_K1DeviceControl.DWC_PtoCSequence.DWC_PCSPEEDGEAR "" VAL_BLK 0x80607A76 DefaultValueRecordLayout_AUTOSAR_Platform_BaseTypes_uint16 20000.0 RB_PT_PCT_SWC_DWC_CompuMethods_ident 0.0 20000. FORMAT "%10.5"
 /begin ANNOTATION ANNOTATION_LABEL "Description (coming from AUTOSAR DESC field)" /begin ANNOTATION_TEXT "Min max engine speeds for valve adaption\r\n" /end ANNOTATION_TEXT /end ANNOTATION
 MATRIX_DIM 14 2 1 /end CHARACTERISTIC
/begin CHARACTERISTIC DWC_EFLASHROMB.DWC_K1DeviceControl.DWC_TrqPress.DWC_ENABLEFILLKISSPOINTADAPT "" VALUE 0x80607AB2 DefaultValueRecordLayout_AUTOSAR_Platform_BaseTypes_boolean 255.0 AUTOSAR_Platform_CompuMethods_boolean 0.0 255. FORMAT "%10.5"
 /begin ANNOTATION ANNOTATION_LABEL "Description (coming from AUTOSAR DESC field)"
  /begin ANNOTATION_TEXT "Flag to enable kisspoint adaption during fill (separately from other methods)\r\n" /end ANNOTATION_TEXT
 /end ANNOTATION
/end CHARACTERISTIC
/begin CHARACTERISTIC DWC_EFLASHROMB.DWC_K1DeviceControl.DWC_TrqPress.DWC_FLGPRESSPOSNARRAYFIX "" VALUE 0x80607AB3 DefaultValueRecordLayout_AUTOSAR_Platform_BaseTypes_boolean 255.0 AUTOSAR_Platform_CompuMethods_boolean 0.0 255. FORMAT "%10.5"
 /begin ANNOTATION ANNOTATION_LABEL "Description (coming from AUTOSAR DESC field)"
  /begin ANNOTATION_TEXT "Flag to enable kisspoint adaption DXC_PressPosnPoints update fix\r\n" /end ANNOTATION_TEXT
 /end ANNOTATION
/end CHARACTERISTIC
/begin CHARACTERISTIC DWC_EFLASHROMB.DWC_K1DeviceControl.DWC_TrqPress.DWC_FrictionCompensator.DXC_FRCFRICTIONTEMP "" VAL_BLK 0x80607AB4 DefaultValueRecordLayout_AUTOSAR_Platform_BaseTypes_sint16 550.0 RB_PT_PCT_SWC_DWC_CompuMethods_ident -50. 500. FORMAT "%10.5"
 /begin ANNOTATION ANNOTATION_LABEL "Description (coming from AUTOSAR DESC field)"
  /begin ANNOTATION_TEXT "Temperature break points for use of different friction data\r\n" /end ANNOTATION_TEXT
 /end ANNOTATION
 MATRIX_DIM 4 1 1 /end CHARACTERISTIC
/begin CHARACTERISTIC DWC_EFLASHROMB.DWC_K1DeviceControl.DWC_TrqPress.DWC_FrictionCompensator.DXC_FRCFRICTIONTEMP1 "" MAP 0x80607ABC RB_PT_PCT_SWC_DWC_RecordLayouts_RL_MapGrouped_sint16_256_uint16_16_sint16_16 1.5 RB_PT_PCT_SWC_DWC_CompuMethods_ratio_0p0001 0.5 2. FORMAT "%10.5"
 /begin ANNOTATION ANNOTATION_LABEL "Description (coming from AUTOSAR DESC field)"
  /begin ANNOTATION_TEXT "Relative coefficient of friction - temperature point 1\r\n" /end ANNOTATION_TEXT
 /end ANNOTATION
 /begin AXIS_DESCR COM_AXIS NO_INPUT_QUANTITY RB_PT_PCT_SWC_DWC_CompuMethods_ident 16 0.0 20000. FORMAT "%10.5" AXIS_PTS_REF DWC_EFLASHROMB.DWC_K1DeviceControl.DWC_TrqPress.DWC_FrictionCompensator.DXC_FRCFRICTIONRPM DEPOSIT ABSOLUTE /end AXIS_DESCR
 /begin AXIS_DESCR COM_AXIS NO_INPUT_QUANTITY RB_PT_PCT_SWC_DWC_CompuMethods_ratio_0p1 16 -2000. 2000. FORMAT "%10.5" AXIS_PTS_REF DWC_EFLASHROMB.DWC_K1DeviceControl.DWC_TrqPress.DWC_FrictionCompensator.DXC_FRCFRICTIONTORQUE DEPOSIT ABSOLUTE /end AXIS_DESCR
/end CHARACTERISTIC
/begin CHARACTERISTIC DWC_EFLASHROMB.DWC_K1DeviceControl.DWC_TrqPress.DWC_FrictionCompensator.DXC_FRCFRICTIONTEMP2 "" MAP 0x80607CBC RB_PT_PCT_SWC_DWC_RecordLayouts_RL_MapGrouped_sint16_256_uint16_16_sint16_16 1.5 RB_PT_PCT_SWC_DWC_CompuMethods_ratio_0p0001 0.5 2. FORMAT "%10.5"
 /begin ANNOTATION ANNOTATION_LABEL "Description (coming from AUTOSAR DESC field)"
  /begin ANNOTATION_TEXT "Relative coefficient of friction - temperature point 2\r\n" /end ANNOTATION_TEXT
 /end ANNOTATION
 /begin AXIS_DESCR COM_AXIS NO_INPUT_QUANTITY RB_PT_PCT_SWC_DWC_CompuMethods_ident 16 0.0 20000. FORMAT "%10.5" AXIS_PTS_REF DWC_EFLASHROMB.DWC_K1DeviceControl.DWC_TrqPress.DWC_FrictionCompensator.DXC_FRCFRICTIONRPM DEPOSIT ABSOLUTE /end AXIS_DESCR
 /begin AXIS_DESCR COM_AXIS NO_INPUT_QUANTITY RB_PT_PCT_SWC_DWC_CompuMethods_ratio_0p1 16 -2000. 2000. FORMAT "%10.5" AXIS_PTS_REF DWC_EFLASHROMB.DWC_K1DeviceControl.DWC_TrqPress.DWC_FrictionCompensator.DXC_FRCFRICTIONTORQUE DEPOSIT ABSOLUTE /end AXIS_DESCR
/end CHARACTERISTIC
/begin CHARACTERISTIC DWC_EFLASHROMB.DWC_K1DeviceControl.DWC_TrqPress.DWC_FrictionCompensator.DXC_FRCFRICTIONTEMP3 "" MAP 0x80607EBC RB_PT_PCT_SWC_DWC_RecordLayouts_RL_MapGrouped_sint16_256_uint16_16_sint16_16 1.5 RB_PT_PCT_SWC_DWC_CompuMethods_ratio_0p0001 0.5 2. FORMAT "%10.5"
 /begin ANNOTATION ANNOTATION_LABEL "Description (coming from AUTOSAR DESC field)"
  /begin ANNOTATION_TEXT "Relative coefficient of friction - temperature point 3\r\n" /end ANNOTATION_TEXT
 /end ANNOTATION
 /begin AXIS_DESCR COM_AXIS NO_INPUT_QUANTITY RB_PT_PCT_SWC_DWC_CompuMethods_ident 16 0.0 20000. FORMAT "%10.5" AXIS_PTS_REF DWC_EFLASHROMB.DWC_K1DeviceControl.DWC_TrqPress.DWC_FrictionCompensator.DXC_FRCFRICTIONRPM DEPOSIT ABSOLUTE /end AXIS_DESCR
 /begin AXIS_DESCR COM_AXIS NO_INPUT_QUANTITY RB_PT_PCT_SWC_DWC_CompuMethods_ratio_0p1 16 -2000. 2000. FORMAT "%10.5" AXIS_PTS_REF DWC_EFLASHROMB.DWC_K1DeviceControl.DWC_TrqPress.DWC_FrictionCompensator.DXC_FRCFRICTIONTORQUE DEPOSIT ABSOLUTE /end AXIS_DESCR
/end CHARACTERISTIC
/begin CHARACTERISTIC DWC_EFLASHROMB.DWC_K1DeviceControl.DWC_TrqPress.DWC_FrictionCompensator.DXC_FRCFRICTIONTEMP4 "" MAP 0x806080BC RB_PT_PCT_SWC_DWC_RecordLayouts_RL_MapGrouped_sint16_256_uint16_16_sint16_16 1.5 RB_PT_PCT_SWC_DWC_CompuMethods_ratio_0p0001 0.5 2. FORMAT "%10.5"
 /begin ANNOTATION ANNOTATION_LABEL "Description (coming from AUTOSAR DESC field)"
  /begin ANNOTATION_TEXT "Relative coefficient of friction - temperature point 4\r\n" /end ANNOTATION_TEXT
 /end ANNOTATION
 /begin AXIS_DESCR COM_AXIS NO_INPUT_QUANTITY RB_PT_PCT_SWC_DWC_CompuMethods_ident 16 0.0 20000. FORMAT "%10.5" AXIS_PTS_REF DWC_EFLASHROMB.DWC_K1DeviceControl.DWC_TrqPress.DWC_FrictionCompensator.DXC_FRCFRICTIONRPM DEPOSIT ABSOLUTE /end AXIS_DESCR
 /begin AXIS_DESCR COM_AXIS NO_INPUT_QUANTITY RB_PT_PCT_SWC_DWC_CompuMethods_ratio_0p1 16 -2000. 2000. FORMAT "%10.5" AXIS_PTS_REF DWC_EFLASHROMB.DWC_K1DeviceControl.DWC_TrqPress.DWC_FrictionCompensator.DXC_FRCFRICTIONTORQUE DEPOSIT ABSOLUTE /end AXIS_DESCR
/end CHARACTERISTIC
/begin CHARACTERISTIC DWC_EFLASHROMB.DWC_K1DeviceControl.DWC_TrqPress.DWC_KISSPOINTADAPTTF "" CURVE 0x8060835C RB_PT_PCT_SWC_DWC_RecordLayouts_RL_Curve_sint16_5_sint16_5 64.0 RB_PT_PCT_SWC_DWC_CompuMethods_ratio_0p001__2 -32. 32. FORMAT "%10.5"
 /begin ANNOTATION ANNOTATION_LABEL "Description (coming from AUTOSAR DESC field)"
  /begin ANNOTATION_TEXT "Adaption transfer function from kisspoint error to correction\r\n" /end ANNOTATION_TEXT
 /end ANNOTATION
 /begin AXIS_DESCR STD_AXIS NO_INPUT_QUANTITY RB_PT_PCT_SWC_DWC_CompuMethods_ratio_0p1 5 -2000. 2000. FORMAT "%10.5" DEPOSIT ABSOLUTE /end AXIS_DESCR
/end CHARACTERISTIC
/begin CHARACTERISTIC DWC_EFLASHROMB.DWC_K1DeviceControl.DWC_TrqPress.DWC_KisspointSequencer.DWC_ENABLEKPCONDSWHYST "" VALUE 0x80608344 DefaultValueRecordLayout_AUTOSAR_Platform_BaseTypes_boolean 255.0 AUTOSAR_Platform_CompuMethods_boolean 0.0 255. FORMAT "%10.5"
 /begin ANNOTATION ANNOTATION_LABEL "Description (coming from AUTOSAR DESC field)" /begin ANNOTATION_TEXT "Flag to enable dynamic kisspoint learn sequence\r\n" /end ANNOTATION_TEXT /end ANNOTATION
/end CHARACTERISTIC
/begin CHARACTERISTIC DWC_EFLASHROMB.DWC_K1DeviceControl.DWC_TrqPress.DWC_KisspointSequencer.DWC_KPCOOLINGCUTREQUEST "" VALUE 0x80608345 DefaultValueRecordLayout_AUTOSAR_Platform_BaseTypes_boolean 255.0 AUTOSAR_Platform_CompuMethods_boolean 0.0 255. FORMAT "%10.5"
 /begin ANNOTATION ANNOTATION_LABEL "Description (coming from AUTOSAR DESC field)"
  /begin ANNOTATION_TEXT "Flag to enable cooling cut request during kisspoint learn\r\n" /end ANNOTATION_TEXT
 /end ANNOTATION
/end CHARACTERISTIC
/begin CHARACTERISTIC DWC_EFLASHROMB.DWC_K1DeviceControl.DWC_TrqPress.DWC_KisspointSequencer.DWC_KPDYNENABLEDYNAMIC "" VALUE 0x80608346 DefaultValueRecordLayout_AUTOSAR_Platform_BaseTypes_boolean 255.0 AUTOSAR_Platform_CompuMethods_boolean 0.0 255. FORMAT "%10.5"
 /begin ANNOTATION ANNOTATION_LABEL "Description (coming from AUTOSAR DESC field)" /begin ANNOTATION_TEXT "Flag to enable dynamic kisspoint learn sequence\r\n" /end ANNOTATION_TEXT /end ANNOTATION
/end CHARACTERISTIC
/begin CHARACTERISTIC DWC_EFLASHROMB.DWC_K1DeviceControl.DWC_TrqPress.DWC_KisspointSequencer.DWC_KPDYNENDSLIP "" VALUE 0x80608330 DefaultValueRecordLayout_AUTOSAR_Platform_BaseTypes_uint16 20000.0 RB_PT_PCT_SWC_DWC_CompuMethods_ident 0.0 20000. FORMAT "%10.5"
 /begin ANNOTATION ANNOTATION_LABEL "Description (coming from AUTOSAR DESC field)" /begin ANNOTATION_TEXT "Slip for point of sampling gradient\r\n" /end ANNOTATION_TEXT /end ANNOTATION
/end CHARACTERISTIC
/begin CHARACTERISTIC DWC_EFLASHROMB.DWC_K1DeviceControl.DWC_TrqPress.DWC_KisspointSequencer.DWC_KPDYNGRADENDFACTOR "" VALUE 0x80608347 DefaultValueRecordLayout_AUTOSAR_Platform_BaseTypes_uint8 1.0 RB_PT_PCT_SWC_DWC_CompuMethods_ratio_0p1 0.0 1. FORMAT "%10.5"
 /begin ANNOTATION ANNOTATION_LABEL "Description (coming from AUTOSAR DESC field)"
  /begin ANNOTATION_TEXT "Factor of initial snapshot slip, considered as the end of the measurement period\r\n" /end ANNOTATION_TEXT
 /end ANNOTATION
/end CHARACTERISTIC
/begin CHARACTERISTIC DWC_EFLASHROMB.DWC_K1DeviceControl.DWC_TrqPress.DWC_KisspointSequencer.DWC_KPDYNGRADSTARTFACTOR "" VALUE 0x80608348 DefaultValueRecordLayout_AUTOSAR_Platform_BaseTypes_uint8 1.0 RB_PT_PCT_SWC_DWC_CompuMethods_ratio_0p1 0.0 1. FORMAT "%10.5"
 /begin ANNOTATION ANNOTATION_LABEL "Description (coming from AUTOSAR DESC field)"
  /begin ANNOTATION_TEXT "Factor of initial snapshot slip, considered as the start of the measurement period\r\n" /end ANNOTATION_TEXT
 /end ANNOTATION
/end CHARACTERISTIC
/begin CHARACTERISTIC DWC_EFLASHROMB.DWC_K1DeviceControl.DWC_TrqPress.DWC_KisspointSequencer.DWC_KPDYNINTERLEARNTIMEMIN "" CURVE 0x8060834C RB_PT_PCT_SWC_DWC_RecordLayouts_RL_Curve_uint16_3_sint16_3 131.07 RB_PT_PCT_SWC_DWC_CompuMethods_ratio_0p002 0.0 131.07 FORMAT "%10.5"
 /begin ANNOTATION ANNOTATION_LABEL "Description (coming from AUTOSAR DESC field)"
  /begin ANNOTATION_TEXT "Minimum time between learns vs number of completed learns over life\r\n" /end ANNOTATION_TEXT
 /end ANNOTATION
 /begin AXIS_DESCR STD_AXIS NO_INPUT_QUANTITY RB_PT_PCT_SWC_DWC_CompuMethods_ident 3 0.0 32760. FORMAT "%10.5" DEPOSIT ABSOLUTE /end AXIS_DESCR
/end CHARACTERISTIC
/begin CHARACTERISTIC DWC_EFLASHROMB.DWC_K1DeviceControl.DWC_TrqPress.DWC_KisspointSequencer.DWC_KPDYNMAXTEMPERATURE "" VALUE 0x80608332 DefaultValueRecordLayout_AUTOSAR_Platform_BaseTypes_sint16 250.0 RB_PT_PCT_SWC_DWC_CompuMethods_ident -50. 200. FORMAT "%10.5"
 /begin ANNOTATION ANNOTATION_LABEL "Description (coming from AUTOSAR DESC field)" /begin ANNOTATION_TEXT "Minimum temperature for kisspoint learn\r\n" /end ANNOTATION_TEXT /end ANNOTATION
/end CHARACTERISTIC
/begin CHARACTERISTIC DWC_EFLASHROMB.DWC_K1DeviceControl.DWC_TrqPress.DWC_KisspointSequencer.DWC_KPDYNMAXTIME "" VALUE 0x80608334 DefaultValueRecordLayout_AUTOSAR_Platform_BaseTypes_uint16 10.0 RB_PT_PCT_SWC_DWC_CompuMethods_ratio_0p001__2 0.0 10. FORMAT "%10.5"
 /begin ANNOTATION ANNOTATION_LABEL "Description (coming from AUTOSAR DESC field)"
  /begin ANNOTATION_TEXT "Time considered too long for input speed to fall to engine speed\r\n" /end ANNOTATION_TEXT
 /end ANNOTATION
/end CHARACTERISTIC
/begin CHARACTERISTIC DWC_EFLASHROMB.DWC_K1DeviceControl.DWC_TrqPress.DWC_KisspointSequencer.DWC_KPDYNMININITIALSLIP "" VALUE 0x80608336 DefaultValueRecordLayout_AUTOSAR_Platform_BaseTypes_uint16 20000.0 RB_PT_PCT_SWC_DWC_CompuMethods_ident 0.0 20000. FORMAT "%10.5"
 /begin ANNOTATION ANNOTATION_LABEL "Description (coming from AUTOSAR DESC field)"
  /begin ANNOTATION_TEXT "Maximum output shaft speed change during dynamic kisspoint sequence\r\n" /end ANNOTATION_TEXT
 /end ANNOTATION
/end CHARACTERISTIC
/begin CHARACTERISTIC DWC_EFLASHROMB.DWC_K1DeviceControl.DWC_TrqPress.DWC_KisspointSequencer.DWC_KPDYNMINTEMPERATURE "" VALUE 0x80608338 DefaultValueRecordLayout_AUTOSAR_Platform_BaseTypes_sint16 250.0 RB_PT_PCT_SWC_DWC_CompuMethods_ident -50. 200. FORMAT "%10.5"
 /begin ANNOTATION ANNOTATION_LABEL "Description (coming from AUTOSAR DESC field)" /begin ANNOTATION_TEXT "Minimum temperature for kisspoint learn\r\n" /end ANNOTATION_TEXT /end ANNOTATION
/end CHARACTERISTIC
/begin CHARACTERISTIC DWC_EFLASHROMB.DWC_K1DeviceControl.DWC_TrqPress.DWC_KisspointSequencer.DWC_KPDYNOVERDUETIMEBEFOREDSTREQUEST "" VALUE 0x8060832C DefaultValueRecordLayout_AUTOSAR_Platform_BaseTypes_uint32 1000.0 RB_PT_PCT_SWC_DWC_CompuMethods_ratio_0p001__2 0.0 1000. FORMAT "%10.5"
 /begin ANNOTATION ANNOTATION_LABEL "Description (coming from AUTOSAR DESC field)"
  /begin ANNOTATION_TEXT "Maximum time that a kisspoint learn is overdue for before a kisspoint learn is requested\r\n" /end ANNOTATION_TEXT
 /end ANNOTATION
/end CHARACTERISTIC
/begin CHARACTERISTIC DWC_EFLASHROMB.DWC_K1DeviceControl.DWC_TrqPress.DWC_KisspointSequencer.DWC_KPENGINESPEEDCONDHYST "" VALUE 0x8060833A DefaultValueRecordLayout_AUTOSAR_Platform_BaseTypes_uint16 20000.0 RB_PT_PCT_SWC_DWC_CompuMethods_ident 0.0 20000. FORMAT "%10.5"
 /begin ANNOTATION ANNOTATION_LABEL "Description (coming from AUTOSAR DESC field)" /begin ANNOTATION_TEXT "Minimum engine speed for kisspoint learn\r\n" /end ANNOTATION_TEXT /end ANNOTATION
/end CHARACTERISTIC
/begin CHARACTERISTIC DWC_EFLASHROMB.DWC_K1DeviceControl.DWC_TrqPress.DWC_KisspointSequencer.DWC_KPLOADINGGEAR "" VAL_BLK 0x8060831C DefaultValueRecordLayout_AUTOSAR_Platform_BaseTypes_uint8 254.0 RB_PT_PCT_SWC_DWC_CompuMethods_ident 0.0 254. FORMAT "%10.5"
 /begin ANNOTATION ANNOTATION_LABEL "Description (coming from AUTOSAR DESC field)"
  /begin ANNOTATION_TEXT "Loading gear array against current torque gear (254 = do not run)\r\n" /end ANNOTATION_TEXT
 /end ANNOTATION
 MATRIX_DIM 14 1 1 /end CHARACTERISTIC
/begin CHARACTERISTIC DWC_EFLASHROMB.DWC_K1DeviceControl.DWC_TrqPress.DWC_KisspointSequencer.DWC_KPMAXENGINESPEED "" VAL_BLK 0x80608300 DefaultValueRecordLayout_AUTOSAR_Platform_BaseTypes_uint16 20000.0 RB_PT_PCT_SWC_DWC_CompuMethods_ident 0.0 20000. FORMAT "%10.5"
 /begin ANNOTATION ANNOTATION_LABEL "Description (coming from AUTOSAR DESC field)" /begin ANNOTATION_TEXT "Maximum engine speed for kisspoint learn per gear\r\n" /end ANNOTATION_TEXT /end ANNOTATION
 MATRIX_DIM 14 1 1 /end CHARACTERISTIC
/begin CHARACTERISTIC DWC_EFLASHROMB.DWC_K1DeviceControl.DWC_TrqPress.DWC_KisspointSequencer.DWC_KPMINENGINESPEED "" VALUE 0x8060833C DefaultValueRecordLayout_AUTOSAR_Platform_BaseTypes_uint16 20000.0 RB_PT_PCT_SWC_DWC_CompuMethods_ident 0.0 20000. FORMAT "%10.5"
 /begin ANNOTATION ANNOTATION_LABEL "Description (coming from AUTOSAR DESC field)" /begin ANNOTATION_TEXT "Minimum engine speed for kisspoint learn\r\n" /end ANNOTATION_TEXT /end ANNOTATION
/end CHARACTERISTIC
/begin CHARACTERISTIC DWC_EFLASHROMB.DWC_K1DeviceControl.DWC_TrqPress.DWC_KisspointSequencer.DWC_KPSTATLOCKTIMEOUT "" VALUE 0x8060833E DefaultValueRecordLayout_AUTOSAR_Platform_BaseTypes_uint16 10.0 RB_PT_PCT_SWC_DWC_CompuMethods_ratio_0p001__2 0.0 10. FORMAT "%10.5"
 /begin ANNOTATION ANNOTATION_LABEL "Description (coming from AUTOSAR DESC field)" /begin ANNOTATION_TEXT "Time considered too long to expect a lock\r\n" /end ANNOTATION_TEXT /end ANNOTATION
/end CHARACTERISTIC
/begin CHARACTERISTIC DWC_EFLASHROMB.DWC_K1DeviceControl.DWC_TrqPress.DWC_KisspointSequencer.DWC_KPSTATOUTPUTMAX "" VALUE 0x80608340 DefaultValueRecordLayout_AUTOSAR_Platform_BaseTypes_sint16 40000.0 RB_PT_PCT_SWC_DWC_CompuMethods_ident -20000. 20000. FORMAT "%10.5"
 /begin ANNOTATION ANNOTATION_LABEL "Description (coming from AUTOSAR DESC field)" /begin ANNOTATION_TEXT "Maximum output speed for static kisspoint learn\r\n" /end ANNOTATION_TEXT /end ANNOTATION
/end CHARACTERISTIC
/begin CHARACTERISTIC DWC_EFLASHROMB.DWC_K1DeviceControl.DWC_TrqPress.DWC_KisspointSequencer.DWC_KPSTATOUTPUTMIN "" VALUE 0x80608342 DefaultValueRecordLayout_AUTOSAR_Platform_BaseTypes_sint16 40000.0 RB_PT_PCT_SWC_DWC_CompuMethods_ident -20000. 20000. FORMAT "%10.5"
 /begin ANNOTATION ANNOTATION_LABEL "Description (coming from AUTOSAR DESC field)" /begin ANNOTATION_TEXT "Minimum output speed for static kisspoint learn\r\n" /end ANNOTATION_TEXT /end ANNOTATION
/end CHARACTERISTIC
/begin CHARACTERISTIC DWC_EFLASHROMB.DWC_K1DeviceControl.DWC_TrqPress.DWC_KisspointSequencer.DWC_KPSTATSLIPSTARTFACTOR "" VALUE 0x80608349 DefaultValueRecordLayout_AUTOSAR_Platform_BaseTypes_uint8 1.0 RB_PT_PCT_SWC_DWC_CompuMethods_ratio_0p1 0.0 1. FORMAT "%10.5"
 /begin ANNOTATION ANNOTATION_LABEL "Description (coming from AUTOSAR DESC field)"
  /begin ANNOTATION_TEXT "Factor of initial snapshot slip, after which engagement is closely monitored\r\n" /end ANNOTATION_TEXT
 /end ANNOTATION
/end CHARACTERISTIC
/begin CHARACTERISTIC DWC_EFLASHROMB.DWC_K1DeviceControl.DWC_TrqPress.DWC_KisspointSequencer.DWC_KPWETCLUTCH "" VALUE 0x8060834A DefaultValueRecordLayout_AUTOSAR_Platform_BaseTypes_boolean 255.0 AUTOSAR_Platform_CompuMethods_boolean 0.0 255. FORMAT "%10.5"
 /begin ANNOTATION ANNOTATION_LABEL "Description (coming from AUTOSAR DESC field)" /begin ANNOTATION_TEXT "Flag indicating that the clutch is wet\r\n" /end ANNOTATION_TEXT /end ANNOTATION
/end CHARACTERISTIC
/begin CHARACTERISTIC DWC_EFLASHROMB.DWC_K1DeviceControl.DWC_TrqPress.DWC_KPADAPTSTEPS "" CURVE 0x80608372 RB_PT_PCT_SWC_DWC_RecordLayouts_RL_Curve_sint16_7_sint8_7 64.0 RB_PT_PCT_SWC_DWC_CompuMethods_ratio_0p001__2 -32. 32. FORMAT "%10.5"
 /begin ANNOTATION ANNOTATION_LABEL "Description (coming from AUTOSAR DESC field)"
  /begin ANNOTATION_TEXT "Adaption step based on request from kisspoint learn state machine\r\n" /end ANNOTATION_TEXT
 /end ANNOTATION
 /begin AXIS_DESCR STD_AXIS NO_INPUT_QUANTITY RB_PT_PCT_SWC_DWC_CompuMethods_ident 7 -3. 3. FORMAT "%10.5" DEPOSIT ABSOLUTE /end AXIS_DESCR
/end CHARACTERISTIC
/begin CHARACTERISTIC DWC_EFLASHROMB.DWC_K1DeviceControl.DWC_TrqPress.DWC_MINTORQUEOFFSETTEMP "" CURVE 0x8060838A RB_PT_PCT_SWC_DWC_RecordLayouts_RL_Curve_sint16_5_sint16_5 64.0 RB_PT_PCT_SWC_DWC_CompuMethods_ratio_0p001__2 -32. 32. FORMAT "%10.5"
 /begin ANNOTATION ANNOTATION_LABEL "Description (coming from AUTOSAR DESC field)" /begin ANNOTATION_TEXT "Offset applied to kisspoint for temperature\r\n" /end ANNOTATION_TEXT /end ANNOTATION
 /begin AXIS_DESCR STD_AXIS NO_INPUT_QUANTITY RB_PT_PCT_SWC_DWC_CompuMethods_ident 5 -50. 200. FORMAT "%10.5" DEPOSIT ABSOLUTE /end AXIS_DESCR
/end CHARACTERISTIC
/begin CHARACTERISTIC DWC_EFLASHROMB.DWC_K1DeviceControl.DWC_TrqPress.DXC_MINPRESSPOSDEMAND "" VALUE 0x80607AB0 DefaultValueRecordLayout_AUTOSAR_Platform_BaseTypes_sint16 64.0 RB_PT_PCT_SWC_DWC_CompuMethods_ratio_0p001__2 -32. 32. FORMAT "%10.5"
 /begin ANNOTATION ANNOTATION_LABEL "Description (coming from AUTOSAR DESC field)" /begin ANNOTATION_TEXT "Minimum demand for pressure/position out of class\r\n" /end ANNOTATION_TEXT /end ANNOTATION
/end CHARACTERISTIC
/begin CHARACTERISTIC DWC_EFLASHROMB.DWC_K1DeviceControl.DWC_TrqPress.DXC_RPMTEMPOFFSETPOINT1 "" MAP 0x806083A0 RB_PT_PCT_SWC_DWC_RecordLayouts_RL_MapGrouped_sint16_48_uint16_8_sint16_6 64.0 RB_PT_PCT_SWC_DWC_CompuMethods_ratio_0p001__2 -32. 32. FORMAT "%10.5"
 /begin ANNOTATION ANNOTATION_LABEL "Description (coming from AUTOSAR DESC field)"
  /begin ANNOTATION_TEXT "Offset data at torque point based on engine speed and temperature\r\n" /end ANNOTATION_TEXT
 /end ANNOTATION
 /begin AXIS_DESCR COM_AXIS NO_INPUT_QUANTITY RB_PT_PCT_SWC_DWC_CompuMethods_ident 8 0.0 20000. FORMAT "%10.5" AXIS_PTS_REF DWC_EFLASHROMB.DWC_K1DeviceControl.DWC_TrqPress.DXC_RPMAXISOFFSETTABLES DEPOSIT ABSOLUTE /end AXIS_DESCR
 /begin AXIS_DESCR COM_AXIS NO_INPUT_QUANTITY RB_PT_PCT_SWC_DWC_CompuMethods_ident 6 -50. 500. FORMAT "%10.5" AXIS_PTS_REF DWC_EFLASHROMB.DWC_K1DeviceControl.DWC_TrqPress.DXC_TEMPAXISOFFSETTABLES DEPOSIT ABSOLUTE /end AXIS_DESCR
/end CHARACTERISTIC
/begin CHARACTERISTIC DWC_EFLASHROMB.DWC_K1DeviceControl.DWC_TrqPress.DXC_RPMTEMPOFFSETPOINT2 "" MAP 0x80608400 RB_PT_PCT_SWC_DWC_RecordLayouts_RL_MapGrouped_sint16_48_uint16_8_sint16_6 64.0 RB_PT_PCT_SWC_DWC_CompuMethods_ratio_0p001__2 -32. 32. FORMAT "%10.5"
 /begin ANNOTATION ANNOTATION_LABEL "Description (coming from AUTOSAR DESC field)"
  /begin ANNOTATION_TEXT "Offset data at torque point based on engine speed and temperature\r\n" /end ANNOTATION_TEXT
 /end ANNOTATION
 /begin AXIS_DESCR COM_AXIS NO_INPUT_QUANTITY RB_PT_PCT_SWC_DWC_CompuMethods_ident 8 0.0 20000. FORMAT "%10.5" AXIS_PTS_REF DWC_EFLASHROMB.DWC_K1DeviceControl.DWC_TrqPress.DXC_RPMAXISOFFSETTABLES DEPOSIT ABSOLUTE /end AXIS_DESCR
 /begin AXIS_DESCR COM_AXIS NO_INPUT_QUANTITY RB_PT_PCT_SWC_DWC_CompuMethods_ident 6 -50. 500. FORMAT "%10.5" AXIS_PTS_REF DWC_EFLASHROMB.DWC_K1DeviceControl.DWC_TrqPress.DXC_TEMPAXISOFFSETTABLES DEPOSIT ABSOLUTE /end AXIS_DESCR
/end CHARACTERISTIC
/begin CHARACTERISTIC DWC_EFLASHROMB.DWC_K1DeviceControl.DWC_TrqPress.DXC_RPMTEMPOFFSETPOINT3 "" MAP 0x80608460 RB_PT_PCT_SWC_DWC_RecordLayouts_RL_MapGrouped_sint16_48_uint16_8_sint16_6 64.0 RB_PT_PCT_SWC_DWC_CompuMethods_ratio_0p001__2 -32. 32. FORMAT "%10.5"
 /begin ANNOTATION ANNOTATION_LABEL "Description (coming from AUTOSAR DESC field)"
  /begin ANNOTATION_TEXT "Offset data at torque point based on engine speed and temperature\r\n" /end ANNOTATION_TEXT
 /end ANNOTATION
 /begin AXIS_DESCR COM_AXIS NO_INPUT_QUANTITY RB_PT_PCT_SWC_DWC_CompuMethods_ident 8 0.0 20000. FORMAT "%10.5" AXIS_PTS_REF DWC_EFLASHROMB.DWC_K1DeviceControl.DWC_TrqPress.DXC_RPMAXISOFFSETTABLES DEPOSIT ABSOLUTE /end AXIS_DESCR
 /begin AXIS_DESCR COM_AXIS NO_INPUT_QUANTITY RB_PT_PCT_SWC_DWC_CompuMethods_ident 6 -50. 500. FORMAT "%10.5" AXIS_PTS_REF DWC_EFLASHROMB.DWC_K1DeviceControl.DWC_TrqPress.DXC_TEMPAXISOFFSETTABLES DEPOSIT ABSOLUTE /end AXIS_DESCR
/end CHARACTERISTIC
/begin CHARACTERISTIC DWC_EFLASHROMB.DWC_K1DeviceControl.DWC_TrqPress.DXC_RPMTEMPOFFSETPOINT4 "" MAP 0x806084C0 RB_PT_PCT_SWC_DWC_RecordLayouts_RL_MapGrouped_sint16_48_uint16_8_sint16_6 64.0 RB_PT_PCT_SWC_DWC_CompuMethods_ratio_0p001__2 -32. 32. FORMAT "%10.5"
 /begin ANNOTATION ANNOTATION_LABEL "Description (coming from AUTOSAR DESC field)"
  /begin ANNOTATION_TEXT "Offset data at torque point based on engine speed and temperature\r\n" /end ANNOTATION_TEXT
 /end ANNOTATION
 /begin AXIS_DESCR COM_AXIS NO_INPUT_QUANTITY RB_PT_PCT_SWC_DWC_CompuMethods_ident 8 0.0 20000. FORMAT "%10.5" AXIS_PTS_REF DWC_EFLASHROMB.DWC_K1DeviceControl.DWC_TrqPress.DXC_RPMAXISOFFSETTABLES DEPOSIT ABSOLUTE /end AXIS_DESCR
 /begin AXIS_DESCR COM_AXIS NO_INPUT_QUANTITY RB_PT_PCT_SWC_DWC_CompuMethods_ident 6 -50. 500. FORMAT "%10.5" AXIS_PTS_REF DWC_EFLASHROMB.DWC_K1DeviceControl.DWC_TrqPress.DXC_TEMPAXISOFFSETTABLES DEPOSIT ABSOLUTE /end AXIS_DESCR
/end CHARACTERISTIC
/begin CHARACTERISTIC DWC_EFLASHROMB.DWC_K1DeviceControl.DWC_TrqPress.DXC_RPMTEMPOFFSETPOINT5 "" MAP 0x80608520 RB_PT_PCT_SWC_DWC_RecordLayouts_RL_MapGrouped_sint16_48_uint16_8_sint16_6 64.0 RB_PT_PCT_SWC_DWC_CompuMethods_ratio_0p001__2 -32. 32. FORMAT "%10.5"
 /begin ANNOTATION ANNOTATION_LABEL "Description (coming from AUTOSAR DESC field)"
  /begin ANNOTATION_TEXT "Offset data at torque point based on engine speed and temperature\r\n" /end ANNOTATION_TEXT
 /end ANNOTATION
 /begin AXIS_DESCR COM_AXIS NO_INPUT_QUANTITY RB_PT_PCT_SWC_DWC_CompuMethods_ident 8 0.0 20000. FORMAT "%10.5" AXIS_PTS_REF DWC_EFLASHROMB.DWC_K1DeviceControl.DWC_TrqPress.DXC_RPMAXISOFFSETTABLES DEPOSIT ABSOLUTE /end AXIS_DESCR
 /begin AXIS_DESCR COM_AXIS NO_INPUT_QUANTITY RB_PT_PCT_SWC_DWC_CompuMethods_ident 6 -50. 500. FORMAT "%10.5" AXIS_PTS_REF DWC_EFLASHROMB.DWC_K1DeviceControl.DWC_TrqPress.DXC_TEMPAXISOFFSETTABLES DEPOSIT ABSOLUTE /end AXIS_DESCR
/end CHARACTERISTIC
/begin CHARACTERISTIC DWC_EFLASHROMB.DWC_K1DeviceControl.DWC_TrqPress.DXC_RPMTEMPOFFSETPOINT6 "" MAP 0x80608580 RB_PT_PCT_SWC_DWC_RecordLayouts_RL_MapGrouped_sint16_48_uint16_8_sint16_6 64.0 RB_PT_PCT_SWC_DWC_CompuMethods_ratio_0p001__2 -32. 32. FORMAT "%10.5"
 /begin ANNOTATION ANNOTATION_LABEL "Description (coming from AUTOSAR DESC field)"
  /begin ANNOTATION_TEXT "Offset data at torque point based on engine speed and temperature\r\n" /end ANNOTATION_TEXT
 /end ANNOTATION
 /begin AXIS_DESCR COM_AXIS NO_INPUT_QUANTITY RB_PT_PCT_SWC_DWC_CompuMethods_ident 8 0.0 20000. FORMAT "%10.5" AXIS_PTS_REF DWC_EFLASHROMB.DWC_K1DeviceControl.DWC_TrqPress.DXC_RPMAXISOFFSETTABLES DEPOSIT ABSOLUTE /end AXIS_DESCR
 /begin AXIS_DESCR COM_AXIS NO_INPUT_QUANTITY RB_PT_PCT_SWC_DWC_CompuMethods_ident 6 -50. 500. FORMAT "%10.5" AXIS_PTS_REF DWC_EFLASHROMB.DWC_K1DeviceControl.DWC_TrqPress.DXC_TEMPAXISOFFSETTABLES DEPOSIT ABSOLUTE /end AXIS_DESCR
/end CHARACTERISTIC
/begin CHARACTERISTIC DWC_EFLASHROMB.DWC_K1DeviceControl.DWC_TrqPress.DXC_RPMTEMPOFFSETPOINT7 "" MAP 0x806085E0 RB_PT_PCT_SWC_DWC_RecordLayouts_RL_MapGrouped_sint16_48_uint16_8_sint16_6 64.0 RB_PT_PCT_SWC_DWC_CompuMethods_ratio_0p001__2 -32. 32. FORMAT "%10.5"
 /begin ANNOTATION ANNOTATION_LABEL "Description (coming from AUTOSAR DESC field)"
  /begin ANNOTATION_TEXT "Offset data at torque point based on engine speed and temperature\r\n" /end ANNOTATION_TEXT
 /end ANNOTATION
 /begin AXIS_DESCR COM_AXIS NO_INPUT_QUANTITY RB_PT_PCT_SWC_DWC_CompuMethods_ident 8 0.0 20000. FORMAT "%10.5" AXIS_PTS_REF DWC_EFLASHROMB.DWC_K1DeviceControl.DWC_TrqPress.DXC_RPMAXISOFFSETTABLES DEPOSIT ABSOLUTE /end AXIS_DESCR
 /begin AXIS_DESCR COM_AXIS NO_INPUT_QUANTITY RB_PT_PCT_SWC_DWC_CompuMethods_ident 6 -50. 500. FORMAT "%10.5" AXIS_PTS_REF DWC_EFLASHROMB.DWC_K1DeviceControl.DWC_TrqPress.DXC_TEMPAXISOFFSETTABLES DEPOSIT ABSOLUTE /end AXIS_DESCR
/end CHARACTERISTIC
/begin CHARACTERISTIC DWC_EFLASHROMB.DWC_K2DeviceControl.DWC_ASGSlipConditions.DWC_TIMERDT "" VALUE 0x80608718 DefaultValueRecordLayout_AUTOSAR_Platform_BaseTypes_uint16 10.0 RB_PT_PCT_SWC_DWC_CompuMethods_ratio_0p001__2 0.0 10. FORMAT "%10.5"
 /begin ANNOTATION ANNOTATION_LABEL "Description (coming from AUTOSAR DESC field)"
  /begin ANNOTATION_TEXT "Count down rate of timer (call rate of timed out task)\r\n" /end ANNOTATION_TEXT
 /end ANNOTATION
/end CHARACTERISTIC
/begin CHARACTERISTIC DWC_EFLASHROMB.DWC_K2DeviceControl.DWC_FAILUREBANKID "" VALUE 0x80608714 DefaultValueRecordLayout_AUTOSAR_Platform_BaseTypes_uint8 2.0 RB_PT_PCT_SWC_DWC_CompuMethods_ident 0.0 2. FORMAT "%10.5"
 /begin ANNOTATION ANNOTATION_LABEL "Description (coming from AUTOSAR DESC field)" /begin ANNOTATION_TEXT "Data to be loaded into failed gear table on failure\r\n" /end ANNOTATION_TEXT /end ANNOTATION
/end CHARACTERISTIC
/begin CHARACTERISTIC DWC_EFLASHROMB.DWC_K2DeviceControl.DWC_FAILUREGEARID "" VALUE 0x80608715 DefaultValueRecordLayout_AUTOSAR_Platform_BaseTypes_uint8 11.0 RB_PT_PCT_SWC_DWC_CompuMethods_ident 0.0 11. FORMAT "%10.5"
 /begin ANNOTATION ANNOTATION_LABEL "Description (coming from AUTOSAR DESC field)" /begin ANNOTATION_TEXT "Data to be loaded into failed gear table on failure\r\n" /end ANNOTATION_TEXT /end ANNOTATION
/end CHARACTERISTIC
/begin CHARACTERISTIC DWC_EFLASHROMB.DWC_K2DeviceControl.DWC_FAILUREHYBID "" VALUE 0x80608716 DefaultValueRecordLayout_AUTOSAR_Platform_BaseTypes_uint8 6.0 RB_PT_PCT_SWC_DWC_CompuMethods_ident 0.0 6. FORMAT "%10.5"
 /begin ANNOTATION ANNOTATION_LABEL "Description (coming from AUTOSAR DESC field)" /begin ANNOTATION_TEXT "Index of failed hybrid mode table to be written to.\r\n" /end ANNOTATION_TEXT /end ANNOTATION
/end CHARACTERISTIC
/begin CHARACTERISTIC DWC_EFLASHROMB.DWC_K2DeviceControl.DWC_FillController.DWC_FILLPULSETIMEFACTORSOFT "" VALUE 0x8060871A DefaultValueRecordLayout_AUTOSAR_Platform_BaseTypes_uint16 1.0 RB_PT_PCT_SWC_DWC_CompuMethods_ratio_0p001__2 0.0 1. FORMAT "%10.5"
 /begin ANNOTATION ANNOTATION_LABEL "Description (coming from AUTOSAR DESC field)"
  /begin ANNOTATION_TEXT "Factor applied to start time that the pulse will run for (all of it = 1.0)\r\n" /end ANNOTATION_TEXT
 /end ANNOTATION
/end CHARACTERISTIC
/begin CHARACTERISTIC DWC_EFLASHROMB.DWC_K2DeviceControl.DWC_OBDKPLEARNMAXLIMIT "" VALUE 0x8060870C DefaultValueRecordLayout_AUTOSAR_Platform_BaseTypes_sint16 34.0 RB_PT_PCT_SWC_DWC_CompuMethods_ratio_0p001__2 -2. 32. FORMAT "%10.5"
 /begin ANNOTATION ANNOTATION_LABEL "Description (coming from AUTOSAR DESC field)"
  /begin ANNOTATION_TEXT "Maximum allowable kisspoint learnt by EOL kisspoint test\r\n" /end ANNOTATION_TEXT
 /end ANNOTATION
/end CHARACTERISTIC
/begin CHARACTERISTIC DWC_EFLASHROMB.DWC_K2DeviceControl.DWC_OBDKPLEARNMINLIMIT "" VALUE 0x8060870E DefaultValueRecordLayout_AUTOSAR_Platform_BaseTypes_sint16 34.0 RB_PT_PCT_SWC_DWC_CompuMethods_ratio_0p001__2 -2. 32. FORMAT "%10.5"
 /begin ANNOTATION ANNOTATION_LABEL "Description (coming from AUTOSAR DESC field)"
  /begin ANNOTATION_TEXT "Minimum allowable kisspoint learnt by EOL kisspoint test\r\n" /end ANNOTATION_TEXT
 /end ANNOTATION
/end CHARACTERISTIC
/begin CHARACTERISTIC DWC_EFLASHROMB.DWC_K2DeviceControl.DWC_OBDPCLEARNMAXLIMIT "" VALUE 0x80608710 DefaultValueRecordLayout_AUTOSAR_Platform_BaseTypes_sint16 2000.0 RB_PT_PCT_SWC_DWC_CompuMethods_ratio_0p1 -1000. 1000. FORMAT "%10.5"
 /begin ANNOTATION ANNOTATION_LABEL "Description (coming from AUTOSAR DESC field)" /begin ANNOTATION_TEXT "Maximum PC offset current for EOL adaption\r\n" /end ANNOTATION_TEXT /end ANNOTATION
/end CHARACTERISTIC
/begin CHARACTERISTIC DWC_EFLASHROMB.DWC_K2DeviceControl.DWC_OBDPCLEARNMINLIMIT "" VALUE 0x80608712 DefaultValueRecordLayout_AUTOSAR_Platform_BaseTypes_sint16 2000.0 RB_PT_PCT_SWC_DWC_CompuMethods_ratio_0p1 -1000. 1000. FORMAT "%10.5"
 /begin ANNOTATION ANNOTATION_LABEL "Description (coming from AUTOSAR DESC field)" /begin ANNOTATION_TEXT "Minimum PC offset current for EOL adaption\r\n" /end ANNOTATION_TEXT /end ANNOTATION
/end CHARACTERISTIC
/begin CHARACTERISTIC DWC_EFLASHROMB.DWC_K2DeviceControl.DWC_OBDTESTDECODE "" VAL_BLK 0x80608660 DefaultValueRecordLayout_AUTOSAR_Platform_BaseTypes_uint8 6.0 RB_PT_PCT_SWC_DWC_CompuMethods_ident 0.0 6. FORMAT "%10.5"
 /begin ANNOTATION ANNOTATION_LABEL "Description (coming from AUTOSAR DESC field)" /begin ANNOTATION_TEXT "Decoder for OBD tests and state/status'\r\n" /end ANNOTATION_TEXT /end ANNOTATION
 MATRIX_DIM 55 3 1 /end CHARACTERISTIC
/begin CHARACTERISTIC DWC_EFLASHROMB.DWC_K2DeviceControl.DWC_OPTIONSMASK "" VALUE 0x80608708 DefaultValueRecordLayout_AUTOSAR_Platform_BaseTypes_uint32 4.294967295E9 RB_PT_PCT_SWC_DWC_CompuMethods_ident 0.0 4.294967295E9 FORMAT "%10.5"
 /begin ANNOTATION ANNOTATION_LABEL "Description (coming from AUTOSAR DESC field)" /begin ANNOTATION_TEXT "Mask to enable device controller options\r\n" /end ANNOTATION_TEXT /end ANNOTATION
/end CHARACTERISTIC
/begin CHARACTERISTIC DWC_EFLASHROMB.DWC_K2DeviceControl.DWC_PressCurrent.DWC_MAXPRESSVSENGSPD "" CURVE 0x8060871C RB_PT_PCT_SWC_DWC_RecordLayouts_RL_Curve_sint16_5_uint16_5 34.0 RB_PT_PCT_SWC_DWC_CompuMethods_ratio_0p001__2 -2. 32. FORMAT "%10.5"
 /begin ANNOTATION ANNOTATION_LABEL "Description (coming from AUTOSAR DESC field)"
  /begin ANNOTATION_TEXT "Maximum pressure demand vs. engine speed (clutch seal PV rating limited)\r\n" /end ANNOTATION_TEXT
 /end ANNOTATION
 /begin AXIS_DESCR STD_AXIS NO_INPUT_QUANTITY RB_PT_PCT_SWC_DWC_CompuMethods_ident 5 0.0 20000. FORMAT "%10.5" DEPOSIT ABSOLUTE /end AXIS_DESCR
/end CHARACTERISTIC
/begin CHARACTERISTIC DWC_EFLASHROMB.DWC_K2DeviceControl.DWC_PressCurrent.DWC_VALVEFFCORRECTION "" MAP 0x80608732 RB_PT_PCT_SWC_DWC_RecordLayouts_RL_Map_uint16_35_sint16_7_sint16_5 1.0 RB_PT_PCT_SWC_DWC_CompuMethods_ratio_0p001__2 0.0 1. FORMAT "%10.5"
 /begin ANNOTATION ANNOTATION_LABEL "Description (coming from AUTOSAR DESC field)"
  /begin ANNOTATION_TEXT "Proportional current offset vs error and target pressure\r\n" /end ANNOTATION_TEXT
 /end ANNOTATION
 /begin AXIS_DESCR STD_AXIS NO_INPUT_QUANTITY RB_PT_PCT_SWC_DWC_CompuMethods_ratio_0p001__2 7 -32. 32. FORMAT "%10.5" DEPOSIT ABSOLUTE /end AXIS_DESCR
 /begin AXIS_DESCR STD_AXIS NO_INPUT_QUANTITY RB_PT_PCT_SWC_DWC_CompuMethods_ratio_0p001__2 5 -32. 32. FORMAT "%10.5" DEPOSIT ABSOLUTE /end AXIS_DESCR
/end CHARACTERISTIC
/begin CHARACTERISTIC DWC_EFLASHROMB.DWC_K2DeviceControl.DWC_PressCurrent.DWC_VALVENORMALDERIVGAINTEMP "" MAP 0x80608794 RB_PT_PCT_SWC_DWC_RecordLayouts_RL_Map_sint16_9_sint16_3_sint16_3 20.0 RB_PT_PCT_SWC_DWC_CompuMethods_ratio_0p001__2 -10. 10. FORMAT "%10.5"
 /begin ANNOTATION ANNOTATION_LABEL "Description (coming from AUTOSAR DESC field)" /begin ANNOTATION_TEXT "Derivative gain against temperature\r\n" /end ANNOTATION_TEXT /end ANNOTATION
 /begin AXIS_DESCR STD_AXIS NO_INPUT_QUANTITY RB_PT_PCT_SWC_DWC_CompuMethods_ratio_0p001__2 3 -32. 32. FORMAT "%10.5" DEPOSIT ABSOLUTE /end AXIS_DESCR
 /begin AXIS_DESCR STD_AXIS NO_INPUT_QUANTITY RB_PT_PCT_SWC_DWC_CompuMethods_ident 3 -50. 200. FORMAT "%10.5" DEPOSIT ABSOLUTE /end AXIS_DESCR
/end CHARACTERISTIC
/begin CHARACTERISTIC DWC_EFLASHROMB.DWC_K2DeviceControl.DWC_PressCurrent.DWC_VALVEPRESSCURRENTVSTEMP "" MAP 0x806087B6 RB_PT_PCT_SWC_DWC_RecordLayouts_RL_Map_uint16_55_sint16_11_sint16_5 5000.0 RB_PT_PCT_SWC_DWC_CompuMethods_ident 0.0 5000. FORMAT "%10.5"
 /begin ANNOTATION ANNOTATION_LABEL "Description (coming from AUTOSAR DESC field)"
  /begin ANNOTATION_TEXT "Pressure to current characteristic of valve, compensated for temperature\r\n" /end ANNOTATION_TEXT
 /end ANNOTATION
 /begin AXIS_DESCR STD_AXIS NO_INPUT_QUANTITY RB_PT_PCT_SWC_DWC_CompuMethods_ratio_0p001__2 11 -2. 32. FORMAT "%10.5" DEPOSIT ABSOLUTE /end AXIS_DESCR
 /begin AXIS_DESCR STD_AXIS NO_INPUT_QUANTITY RB_PT_PCT_SWC_DWC_CompuMethods_ident 5 -50. 200. FORMAT "%10.5" DEPOSIT ABSOLUTE /end AXIS_DESCR
/end CHARACTERISTIC
/begin CHARACTERISTIC DWC_EFLASHROMB.DWC_K2DeviceControl.DWC_PressCurrent.DWC_VALVEPROPCORRPOSTFILL "" MAP 0x80608848 RB_PT_PCT_SWC_DWC_RecordLayouts_RL_Map_sint16_35_sint16_7_sint16_5 2000.0 RB_PT_PCT_SWC_DWC_CompuMethods_ident -1000. 1000. FORMAT "%10.5"
 /begin ANNOTATION ANNOTATION_LABEL "Description (coming from AUTOSAR DESC field)"
  /begin ANNOTATION_TEXT "Proportional current offset vs error and target pressure\r\n" /end ANNOTATION_TEXT
 /end ANNOTATION
 /begin AXIS_DESCR STD_AXIS NO_INPUT_QUANTITY RB_PT_PCT_SWC_DWC_CompuMethods_ratio_0p001__2 7 -32. 32. FORMAT "%10.5" DEPOSIT ABSOLUTE /end AXIS_DESCR
 /begin AXIS_DESCR STD_AXIS NO_INPUT_QUANTITY RB_PT_PCT_SWC_DWC_CompuMethods_ratio_0p001__2 5 -32. 32. FORMAT "%10.5" DEPOSIT ABSOLUTE /end AXIS_DESCR
/end CHARACTERISTIC
/begin CHARACTERISTIC DWC_EFLASHROMB.DWC_K2DeviceControl.DWC_PressCurrent.DWC_VALVEPROPORTIONALCORRECTION "" MAP 0x806088AA RB_PT_PCT_SWC_DWC_RecordLayouts_RL_Map_sint16_35_sint16_7_sint16_5 2000.0 RB_PT_PCT_SWC_DWC_CompuMethods_ident -1000. 1000. FORMAT "%10.5"
 /begin ANNOTATION ANNOTATION_LABEL "Description (coming from AUTOSAR DESC field)"
  /begin ANNOTATION_TEXT "Proportional current offset vs error and target pressure\r\n" /end ANNOTATION_TEXT
 /end ANNOTATION
 /begin AXIS_DESCR STD_AXIS NO_INPUT_QUANTITY RB_PT_PCT_SWC_DWC_CompuMethods_ratio_0p001__2 7 -32. 32. FORMAT "%10.5" DEPOSIT ABSOLUTE /end AXIS_DESCR
 /begin AXIS_DESCR STD_AXIS NO_INPUT_QUANTITY RB_PT_PCT_SWC_DWC_CompuMethods_ratio_0p001__2 5 -32. 32. FORMAT "%10.5" DEPOSIT ABSOLUTE /end AXIS_DESCR
/end CHARACTERISTIC
/begin CHARACTERISTIC DWC_EFLASHROMB.DWC_K2DeviceControl.DWC_PressCurrent.DWC_VALVESTATICLINEPRESSUREDEPENDENCY "" MAP 0x8060890C RB_PT_PCT_SWC_DWC_RecordLayouts_RL_Map_sint16_15_sint16_5_sint16_3 64.0 RB_PT_PCT_SWC_DWC_CompuMethods_ratio_0p001__2 -32. 32. FORMAT "%10.5"
 /begin ANNOTATION ANNOTATION_LABEL "Description (coming from AUTOSAR DESC field)"
  /begin ANNOTATION_TEXT "Offset for static line pressure dependency, based on line pressure and demand\r\n" /end ANNOTATION_TEXT
 /end ANNOTATION
 /begin AXIS_DESCR STD_AXIS NO_INPUT_QUANTITY RB_PT_PCT_SWC_DWC_CompuMethods_ratio_0p001__2 5 -2. 32. FORMAT "%10.5" DEPOSIT ABSOLUTE /end AXIS_DESCR
 /begin AXIS_DESCR STD_AXIS NO_INPUT_QUANTITY RB_PT_PCT_SWC_DWC_CompuMethods_ratio_0p005 3 -5. 100. FORMAT "%10.5" DEPOSIT ABSOLUTE /end AXIS_DESCR
/end CHARACTERISTIC
/begin CHARACTERISTIC DWC_EFLASHROMB.DWC_K2DeviceControl.DWC_PtoCSequence.DWC_PCMAXROW "" VALUE 0x80608976 DefaultValueRecordLayout_AUTOSAR_Platform_BaseTypes_uint8 1.0 RB_PT_PCT_SWC_DWC_CompuMethods_ident 0.0 1. FORMAT "%10.5"
 /begin ANNOTATION ANNOTATION_LABEL "Description (coming from AUTOSAR DESC field)" /begin ANNOTATION_TEXT "Row associated with minimum speeds\r\n" /end ANNOTATION_TEXT /end ANNOTATION
/end CHARACTERISTIC
/begin CHARACTERISTIC DWC_EFLASHROMB.DWC_K2DeviceControl.DWC_PtoCSequence.DWC_PCMINROW "" VALUE 0x80608977 DefaultValueRecordLayout_AUTOSAR_Platform_BaseTypes_uint8 1.0 RB_PT_PCT_SWC_DWC_CompuMethods_ident 0.0 1. FORMAT "%10.5"
 /begin ANNOTATION ANNOTATION_LABEL "Description (coming from AUTOSAR DESC field)" /begin ANNOTATION_TEXT "Row associated with minimum speeds\r\n" /end ANNOTATION_TEXT /end ANNOTATION
/end CHARACTERISTIC
/begin CHARACTERISTIC DWC_EFLASHROMB.DWC_K2DeviceControl.DWC_PtoCSequence.DWC_PCSPEEDGEAR "" VAL_BLK 0x8060893E DefaultValueRecordLayout_AUTOSAR_Platform_BaseTypes_uint16 20000.0 RB_PT_PCT_SWC_DWC_CompuMethods_ident 0.0 20000. FORMAT "%10.5"
 /begin ANNOTATION ANNOTATION_LABEL "Description (coming from AUTOSAR DESC field)" /begin ANNOTATION_TEXT "Min max engine speeds for valve adaption\r\n" /end ANNOTATION_TEXT /end ANNOTATION
 MATRIX_DIM 14 2 1 /end CHARACTERISTIC
/begin CHARACTERISTIC DWC_EFLASHROMB.DWC_K2DeviceControl.DWC_TrqPress.DWC_ENABLEFILLKISSPOINTADAPT "" VALUE 0x8060897A DefaultValueRecordLayout_AUTOSAR_Platform_BaseTypes_boolean 255.0 AUTOSAR_Platform_CompuMethods_boolean 0.0 255. FORMAT "%10.5"
 /begin ANNOTATION ANNOTATION_LABEL "Description (coming from AUTOSAR DESC field)"
  /begin ANNOTATION_TEXT "Flag to enable kisspoint adaption during fill (separately from other methods)\r\n" /end ANNOTATION_TEXT
 /end ANNOTATION
/end CHARACTERISTIC
/begin CHARACTERISTIC DWC_EFLASHROMB.DWC_K2DeviceControl.DWC_TrqPress.DWC_FLGPRESSPOSNARRAYFIX "" VALUE 0x8060897B DefaultValueRecordLayout_AUTOSAR_Platform_BaseTypes_boolean 255.0 AUTOSAR_Platform_CompuMethods_boolean 0.0 255. FORMAT "%10.5"
 /begin ANNOTATION ANNOTATION_LABEL "Description (coming from AUTOSAR DESC field)"
  /begin ANNOTATION_TEXT "Flag to enable kisspoint adaption DXC_PressPosnPoints update fix\r\n" /end ANNOTATION_TEXT
 /end ANNOTATION
/end CHARACTERISTIC
/begin CHARACTERISTIC DWC_EFLASHROMB.DWC_K2DeviceControl.DWC_TrqPress.DWC_FrictionCompensator.DXC_FRCFRICTIONTEMP "" VAL_BLK 0x8060897C DefaultValueRecordLayout_AUTOSAR_Platform_BaseTypes_sint16 550.0 RB_PT_PCT_SWC_DWC_CompuMethods_ident -50. 500. FORMAT "%10.5"
 /begin ANNOTATION ANNOTATION_LABEL "Description (coming from AUTOSAR DESC field)"
  /begin ANNOTATION_TEXT "Temperature break points for use of different friction data\r\n" /end ANNOTATION_TEXT
 /end ANNOTATION
 MATRIX_DIM 4 1 1 /end CHARACTERISTIC
/begin CHARACTERISTIC DWC_EFLASHROMB.DWC_K2DeviceControl.DWC_TrqPress.DWC_FrictionCompensator.DXC_FRCFRICTIONTEMP1 "" MAP 0x80608984 RB_PT_PCT_SWC_DWC_RecordLayouts_RL_MapGrouped_sint16_256_uint16_16_sint16_16 1.5 RB_PT_PCT_SWC_DWC_CompuMethods_ratio_0p0001 0.5 2. FORMAT "%10.5"
 /begin ANNOTATION ANNOTATION_LABEL "Description (coming from AUTOSAR DESC field)"
  /begin ANNOTATION_TEXT "Relative coefficient of friction - temperature point 1\r\n" /end ANNOTATION_TEXT
 /end ANNOTATION
 /begin AXIS_DESCR COM_AXIS NO_INPUT_QUANTITY RB_PT_PCT_SWC_DWC_CompuMethods_ident 16 0.0 20000. FORMAT "%10.5" AXIS_PTS_REF DWC_EFLASHROMB.DWC_K2DeviceControl.DWC_TrqPress.DWC_FrictionCompensator.DXC_FRCFRICTIONRPM DEPOSIT ABSOLUTE /end AXIS_DESCR
 /begin AXIS_DESCR COM_AXIS NO_INPUT_QUANTITY RB_PT_PCT_SWC_DWC_CompuMethods_ratio_0p1 16 -2000. 2000. FORMAT "%10.5" AXIS_PTS_REF DWC_EFLASHROMB.DWC_K2DeviceControl.DWC_TrqPress.DWC_FrictionCompensator.DXC_FRCFRICTIONTORQUE DEPOSIT ABSOLUTE /end AXIS_DESCR
/end CHARACTERISTIC
/begin CHARACTERISTIC DWC_EFLASHROMB.DWC_K2DeviceControl.DWC_TrqPress.DWC_FrictionCompensator.DXC_FRCFRICTIONTEMP2 "" MAP 0x80608B84 RB_PT_PCT_SWC_DWC_RecordLayouts_RL_MapGrouped_sint16_256_uint16_16_sint16_16 1.5 RB_PT_PCT_SWC_DWC_CompuMethods_ratio_0p0001 0.5 2. FORMAT "%10.5"
 /begin ANNOTATION ANNOTATION_LABEL "Description (coming from AUTOSAR DESC field)"
  /begin ANNOTATION_TEXT "Relative coefficient of friction - temperature point 2\r\n" /end ANNOTATION_TEXT
 /end ANNOTATION
 /begin AXIS_DESCR COM_AXIS NO_INPUT_QUANTITY RB_PT_PCT_SWC_DWC_CompuMethods_ident 16 0.0 20000. FORMAT "%10.5" AXIS_PTS_REF DWC_EFLASHROMB.DWC_K2DeviceControl.DWC_TrqPress.DWC_FrictionCompensator.DXC_FRCFRICTIONRPM DEPOSIT ABSOLUTE /end AXIS_DESCR
 /begin AXIS_DESCR COM_AXIS NO_INPUT_QUANTITY RB_PT_PCT_SWC_DWC_CompuMethods_ratio_0p1 16 -2000. 2000. FORMAT "%10.5" AXIS_PTS_REF DWC_EFLASHROMB.DWC_K2DeviceControl.DWC_TrqPress.DWC_FrictionCompensator.DXC_FRCFRICTIONTORQUE DEPOSIT ABSOLUTE /end AXIS_DESCR
/end CHARACTERISTIC
/begin CHARACTERISTIC DWC_EFLASHROMB.DWC_K2DeviceControl.DWC_TrqPress.DWC_FrictionCompensator.DXC_FRCFRICTIONTEMP3 "" MAP 0x80608D84 RB_PT_PCT_SWC_DWC_RecordLayouts_RL_MapGrouped_sint16_256_uint16_16_sint16_16 1.5 RB_PT_PCT_SWC_DWC_CompuMethods_ratio_0p0001 0.5 2. FORMAT "%10.5"
 /begin ANNOTATION ANNOTATION_LABEL "Description (coming from AUTOSAR DESC field)"
  /begin ANNOTATION_TEXT "Relative coefficient of friction - temperature point 3\r\n" /end ANNOTATION_TEXT
 /end ANNOTATION
 /begin AXIS_DESCR COM_AXIS NO_INPUT_QUANTITY RB_PT_PCT_SWC_DWC_CompuMethods_ident 16 0.0 20000. FORMAT "%10.5" AXIS_PTS_REF DWC_EFLASHROMB.DWC_K2DeviceControl.DWC_TrqPress.DWC_FrictionCompensator.DXC_FRCFRICTIONRPM DEPOSIT ABSOLUTE /end AXIS_DESCR
 /begin AXIS_DESCR COM_AXIS NO_INPUT_QUANTITY RB_PT_PCT_SWC_DWC_CompuMethods_ratio_0p1 16 -2000. 2000. FORMAT "%10.5" AXIS_PTS_REF DWC_EFLASHROMB.DWC_K2DeviceControl.DWC_TrqPress.DWC_FrictionCompensator.DXC_FRCFRICTIONTORQUE DEPOSIT ABSOLUTE /end AXIS_DESCR
/end CHARACTERISTIC
/begin CHARACTERISTIC DWC_EFLASHROMB.DWC_K2DeviceControl.DWC_TrqPress.DWC_FrictionCompensator.DXC_FRCFRICTIONTEMP4 "" MAP 0x80608F84 RB_PT_PCT_SWC_DWC_RecordLayouts_RL_MapGrouped_sint16_256_uint16_16_sint16_16 1.5 RB_PT_PCT_SWC_DWC_CompuMethods_ratio_0p0001 0.5 2. FORMAT "%10.5"
 /begin ANNOTATION ANNOTATION_LABEL "Description (coming from AUTOSAR DESC field)"
  /begin ANNOTATION_TEXT "Relative coefficient of friction - temperature point 4\r\n" /end ANNOTATION_TEXT
 /end ANNOTATION
 /begin AXIS_DESCR COM_AXIS NO_INPUT_QUANTITY RB_PT_PCT_SWC_DWC_CompuMethods_ident 16 0.0 20000. FORMAT "%10.5" AXIS_PTS_REF DWC_EFLASHROMB.DWC_K2DeviceControl.DWC_TrqPress.DWC_FrictionCompensator.DXC_FRCFRICTIONRPM DEPOSIT ABSOLUTE /end AXIS_DESCR
 /begin AXIS_DESCR COM_AXIS NO_INPUT_QUANTITY RB_PT_PCT_SWC_DWC_CompuMethods_ratio_0p1 16 -2000. 2000. FORMAT "%10.5" AXIS_PTS_REF DWC_EFLASHROMB.DWC_K2DeviceControl.DWC_TrqPress.DWC_FrictionCompensator.DXC_FRCFRICTIONTORQUE DEPOSIT ABSOLUTE /end AXIS_DESCR
/end CHARACTERISTIC
/begin CHARACTERISTIC DWC_EFLASHROMB.DWC_K2DeviceControl.DWC_TrqPress.DWC_KISSPOINTADAPTTF "" CURVE 0x80609224 RB_PT_PCT_SWC_DWC_RecordLayouts_RL_Curve_sint16_5_sint16_5 64.0 RB_PT_PCT_SWC_DWC_CompuMethods_ratio_0p001__2 -32. 32. FORMAT "%10.5"
 /begin ANNOTATION ANNOTATION_LABEL "Description (coming from AUTOSAR DESC field)"
  /begin ANNOTATION_TEXT "Adaption transfer function from kisspoint error to correction\r\n" /end ANNOTATION_TEXT
 /end ANNOTATION
 /begin AXIS_DESCR STD_AXIS NO_INPUT_QUANTITY RB_PT_PCT_SWC_DWC_CompuMethods_ratio_0p1 5 -2000. 2000. FORMAT "%10.5" DEPOSIT ABSOLUTE /end AXIS_DESCR
/end CHARACTERISTIC
/begin CHARACTERISTIC DWC_EFLASHROMB.DWC_K2DeviceControl.DWC_TrqPress.DWC_KisspointSequencer.DWC_ENABLEKPCONDSWHYST "" VALUE 0x8060920C DefaultValueRecordLayout_AUTOSAR_Platform_BaseTypes_boolean 255.0 AUTOSAR_Platform_CompuMethods_boolean 0.0 255. FORMAT "%10.5"
 /begin ANNOTATION ANNOTATION_LABEL "Description (coming from AUTOSAR DESC field)" /begin ANNOTATION_TEXT "Flag to enable dynamic kisspoint learn sequence\r\n" /end ANNOTATION_TEXT /end ANNOTATION
/end CHARACTERISTIC
/begin CHARACTERISTIC DWC_EFLASHROMB.DWC_K2DeviceControl.DWC_TrqPress.DWC_KisspointSequencer.DWC_KPCOOLINGCUTREQUEST "" VALUE 0x8060920D DefaultValueRecordLayout_AUTOSAR_Platform_BaseTypes_boolean 255.0 AUTOSAR_Platform_CompuMethods_boolean 0.0 255. FORMAT "%10.5"
 /begin ANNOTATION ANNOTATION_LABEL "Description (coming from AUTOSAR DESC field)"
  /begin ANNOTATION_TEXT "Flag to enable cooling cut request during kisspoint learn\r\n" /end ANNOTATION_TEXT
 /end ANNOTATION
/end CHARACTERISTIC
/begin CHARACTERISTIC DWC_EFLASHROMB.DWC_K2DeviceControl.DWC_TrqPress.DWC_KisspointSequencer.DWC_KPDYNENABLEDYNAMIC "" VALUE 0x8060920E DefaultValueRecordLayout_AUTOSAR_Platform_BaseTypes_boolean 255.0 AUTOSAR_Platform_CompuMethods_boolean 0.0 255. FORMAT "%10.5"
 /begin ANNOTATION ANNOTATION_LABEL "Description (coming from AUTOSAR DESC field)" /begin ANNOTATION_TEXT "Flag to enable dynamic kisspoint learn sequence\r\n" /end ANNOTATION_TEXT /end ANNOTATION
/end CHARACTERISTIC
/begin CHARACTERISTIC DWC_EFLASHROMB.DWC_K2DeviceControl.DWC_TrqPress.DWC_KisspointSequencer.DWC_KPDYNENDSLIP "" VALUE 0x806091F8 DefaultValueRecordLayout_AUTOSAR_Platform_BaseTypes_uint16 20000.0 RB_PT_PCT_SWC_DWC_CompuMethods_ident 0.0 20000. FORMAT "%10.5"
 /begin ANNOTATION ANNOTATION_LABEL "Description (coming from AUTOSAR DESC field)" /begin ANNOTATION_TEXT "Slip for point of sampling gradient\r\n" /end ANNOTATION_TEXT /end ANNOTATION
/end CHARACTERISTIC
/begin CHARACTERISTIC DWC_EFLASHROMB.DWC_K2DeviceControl.DWC_TrqPress.DWC_KisspointSequencer.DWC_KPDYNGRADENDFACTOR "" VALUE 0x8060920F DefaultValueRecordLayout_AUTOSAR_Platform_BaseTypes_uint8 1.0 RB_PT_PCT_SWC_DWC_CompuMethods_ratio_0p1 0.0 1. FORMAT "%10.5"
 /begin ANNOTATION ANNOTATION_LABEL "Description (coming from AUTOSAR DESC field)"
  /begin ANNOTATION_TEXT "Factor of initial snapshot slip, considered as the end of the measurement period\r\n" /end ANNOTATION_TEXT
 /end ANNOTATION
/end CHARACTERISTIC
/begin CHARACTERISTIC DWC_EFLASHROMB.DWC_K2DeviceControl.DWC_TrqPress.DWC_KisspointSequencer.DWC_KPDYNGRADSTARTFACTOR "" VALUE 0x80609210 DefaultValueRecordLayout_AUTOSAR_Platform_BaseTypes_uint8 1.0 RB_PT_PCT_SWC_DWC_CompuMethods_ratio_0p1 0.0 1. FORMAT "%10.5"
 /begin ANNOTATION ANNOTATION_LABEL "Description (coming from AUTOSAR DESC field)"
  /begin ANNOTATION_TEXT "Factor of initial snapshot slip, considered as the start of the measurement period\r\n" /end ANNOTATION_TEXT
 /end ANNOTATION
/end CHARACTERISTIC
/begin CHARACTERISTIC DWC_EFLASHROMB.DWC_K2DeviceControl.DWC_TrqPress.DWC_KisspointSequencer.DWC_KPDYNINTERLEARNTIMEMIN "" CURVE 0x80609214 RB_PT_PCT_SWC_DWC_RecordLayouts_RL_Curve_uint16_3_sint16_3 131.07 RB_PT_PCT_SWC_DWC_CompuMethods_ratio_0p002 0.0 131.07 FORMAT "%10.5"
 /begin ANNOTATION ANNOTATION_LABEL "Description (coming from AUTOSAR DESC field)"
  /begin ANNOTATION_TEXT "Minimum time between learns vs number of completed learns over life\r\n" /end ANNOTATION_TEXT
 /end ANNOTATION
 /begin AXIS_DESCR STD_AXIS NO_INPUT_QUANTITY RB_PT_PCT_SWC_DWC_CompuMethods_ident 3 0.0 32760. FORMAT "%10.5" DEPOSIT ABSOLUTE /end AXIS_DESCR
/end CHARACTERISTIC
/begin CHARACTERISTIC DWC_EFLASHROMB.DWC_K2DeviceControl.DWC_TrqPress.DWC_KisspointSequencer.DWC_KPDYNMAXTEMPERATURE "" VALUE 0x806091FA DefaultValueRecordLayout_AUTOSAR_Platform_BaseTypes_sint16 250.0 RB_PT_PCT_SWC_DWC_CompuMethods_ident -50. 200. FORMAT "%10.5"
 /begin ANNOTATION ANNOTATION_LABEL "Description (coming from AUTOSAR DESC field)" /begin ANNOTATION_TEXT "Minimum temperature for kisspoint learn\r\n" /end ANNOTATION_TEXT /end ANNOTATION
/end CHARACTERISTIC
/begin CHARACTERISTIC DWC_EFLASHROMB.DWC_K2DeviceControl.DWC_TrqPress.DWC_KisspointSequencer.DWC_KPDYNMAXTIME "" VALUE 0x806091FC DefaultValueRecordLayout_AUTOSAR_Platform_BaseTypes_uint16 10.0 RB_PT_PCT_SWC_DWC_CompuMethods_ratio_0p001__2 0.0 10. FORMAT "%10.5"
 /begin ANNOTATION ANNOTATION_LABEL "Description (coming from AUTOSAR DESC field)"
  /begin ANNOTATION_TEXT "Time considered too long for input speed to fall to engine speed\r\n" /end ANNOTATION_TEXT
 /end ANNOTATION
/end CHARACTERISTIC
/begin CHARACTERISTIC DWC_EFLASHROMB.DWC_K2DeviceControl.DWC_TrqPress.DWC_KisspointSequencer.DWC_KPDYNMININITIALSLIP "" VALUE 0x806091FE DefaultValueRecordLayout_AUTOSAR_Platform_BaseTypes_uint16 20000.0 RB_PT_PCT_SWC_DWC_CompuMethods_ident 0.0 20000. FORMAT "%10.5"
 /begin ANNOTATION ANNOTATION_LABEL "Description (coming from AUTOSAR DESC field)"
  /begin ANNOTATION_TEXT "Maximum output shaft speed change during dynamic kisspoint sequence\r\n" /end ANNOTATION_TEXT
 /end ANNOTATION
/end CHARACTERISTIC
/begin CHARACTERISTIC DWC_EFLASHROMB.DWC_K2DeviceControl.DWC_TrqPress.DWC_KisspointSequencer.DWC_KPDYNMINTEMPERATURE "" VALUE 0x80609200 DefaultValueRecordLayout_AUTOSAR_Platform_BaseTypes_sint16 250.0 RB_PT_PCT_SWC_DWC_CompuMethods_ident -50. 200. FORMAT "%10.5"
 /begin ANNOTATION ANNOTATION_LABEL "Description (coming from AUTOSAR DESC field)" /begin ANNOTATION_TEXT "Minimum temperature for kisspoint learn\r\n" /end ANNOTATION_TEXT /end ANNOTATION
/end CHARACTERISTIC
/begin CHARACTERISTIC DWC_EFLASHROMB.DWC_K2DeviceControl.DWC_TrqPress.DWC_KisspointSequencer.DWC_KPDYNOVERDUETIMEBEFOREDSTREQUEST "" VALUE 0x806091F4 DefaultValueRecordLayout_AUTOSAR_Platform_BaseTypes_uint32 1000.0 RB_PT_PCT_SWC_DWC_CompuMethods_ratio_0p001__2 0.0 1000. FORMAT "%10.5"
 /begin ANNOTATION ANNOTATION_LABEL "Description (coming from AUTOSAR DESC field)"
  /begin ANNOTATION_TEXT "Maximum time that a kisspoint learn is overdue for before a kisspoint learn is requested\r\n" /end ANNOTATION_TEXT
 /end ANNOTATION
/end CHARACTERISTIC
/begin CHARACTERISTIC DWC_EFLASHROMB.DWC_K2DeviceControl.DWC_TrqPress.DWC_KisspointSequencer.DWC_KPENGINESPEEDCONDHYST "" VALUE 0x80609202 DefaultValueRecordLayout_AUTOSAR_Platform_BaseTypes_uint16 20000.0 RB_PT_PCT_SWC_DWC_CompuMethods_ident 0.0 20000. FORMAT "%10.5"
 /begin ANNOTATION ANNOTATION_LABEL "Description (coming from AUTOSAR DESC field)" /begin ANNOTATION_TEXT "Minimum engine speed for kisspoint learn\r\n" /end ANNOTATION_TEXT /end ANNOTATION
/end CHARACTERISTIC
/begin CHARACTERISTIC DWC_EFLASHROMB.DWC_K2DeviceControl.DWC_TrqPress.DWC_KisspointSequencer.DWC_KPLOADINGGEAR "" VAL_BLK 0x806091E4 DefaultValueRecordLayout_AUTOSAR_Platform_BaseTypes_uint8 254.0 RB_PT_PCT_SWC_DWC_CompuMethods_ident 0.0 254. FORMAT "%10.5"
 /begin ANNOTATION ANNOTATION_LABEL "Description (coming from AUTOSAR DESC field)"
  /begin ANNOTATION_TEXT "Loading gear array against current torque gear (254 = do not run)\r\n" /end ANNOTATION_TEXT
 /end ANNOTATION
 MATRIX_DIM 14 1 1 /end CHARACTERISTIC
/begin CHARACTERISTIC DWC_EFLASHROMB.DWC_K2DeviceControl.DWC_TrqPress.DWC_KisspointSequencer.DWC_KPMAXENGINESPEED "" VAL_BLK 0x806091C8 DefaultValueRecordLayout_AUTOSAR_Platform_BaseTypes_uint16 20000.0 RB_PT_PCT_SWC_DWC_CompuMethods_ident 0.0 20000. FORMAT "%10.5"
 /begin ANNOTATION ANNOTATION_LABEL "Description (coming from AUTOSAR DESC field)" /begin ANNOTATION_TEXT "Maximum engine speed for kisspoint learn per gear\r\n" /end ANNOTATION_TEXT /end ANNOTATION
 MATRIX_DIM 14 1 1 /end CHARACTERISTIC
/begin CHARACTERISTIC DWC_EFLASHROMB.DWC_K2DeviceControl.DWC_TrqPress.DWC_KisspointSequencer.DWC_KPMINENGINESPEED "" VALUE 0x80609204 DefaultValueRecordLayout_AUTOSAR_Platform_BaseTypes_uint16 20000.0 RB_PT_PCT_SWC_DWC_CompuMethods_ident 0.0 20000. FORMAT "%10.5"
 /begin ANNOTATION ANNOTATION_LABEL "Description (coming from AUTOSAR DESC field)" /begin ANNOTATION_TEXT "Minimum engine speed for kisspoint learn\r\n" /end ANNOTATION_TEXT /end ANNOTATION
/end CHARACTERISTIC
/begin CHARACTERISTIC DWC_EFLASHROMB.DWC_K2DeviceControl.DWC_TrqPress.DWC_KisspointSequencer.DWC_KPSTATLOCKTIMEOUT "" VALUE 0x80609206 DefaultValueRecordLayout_AUTOSAR_Platform_BaseTypes_uint16 10.0 RB_PT_PCT_SWC_DWC_CompuMethods_ratio_0p001__2 0.0 10. FORMAT "%10.5"
 /begin ANNOTATION ANNOTATION_LABEL "Description (coming from AUTOSAR DESC field)" /begin ANNOTATION_TEXT "Time considered too long to expect a lock\r\n" /end ANNOTATION_TEXT /end ANNOTATION
/end CHARACTERISTIC
/begin CHARACTERISTIC DWC_EFLASHROMB.DWC_K2DeviceControl.DWC_TrqPress.DWC_KisspointSequencer.DWC_KPSTATOUTPUTMAX "" VALUE 0x80609208 DefaultValueRecordLayout_AUTOSAR_Platform_BaseTypes_sint16 40000.0 RB_PT_PCT_SWC_DWC_CompuMethods_ident -20000. 20000. FORMAT "%10.5"
 /begin ANNOTATION ANNOTATION_LABEL "Description (coming from AUTOSAR DESC field)" /begin ANNOTATION_TEXT "Maximum output speed for static kisspoint learn\r\n" /end ANNOTATION_TEXT /end ANNOTATION
/end CHARACTERISTIC
/begin CHARACTERISTIC DWC_EFLASHROMB.DWC_K2DeviceControl.DWC_TrqPress.DWC_KisspointSequencer.DWC_KPSTATOUTPUTMIN "" VALUE 0x8060920A DefaultValueRecordLayout_AUTOSAR_Platform_BaseTypes_sint16 40000.0 RB_PT_PCT_SWC_DWC_CompuMethods_ident -20000. 20000. FORMAT "%10.5"
 /begin ANNOTATION ANNOTATION_LABEL "Description (coming from AUTOSAR DESC field)" /begin ANNOTATION_TEXT "Minimum output speed for static kisspoint learn\r\n" /end ANNOTATION_TEXT /end ANNOTATION
/end CHARACTERISTIC
/begin CHARACTERISTIC DWC_EFLASHROMB.DWC_K2DeviceControl.DWC_TrqPress.DWC_KisspointSequencer.DWC_KPSTATSLIPSTARTFACTOR "" VALUE 0x80609211 DefaultValueRecordLayout_AUTOSAR_Platform_BaseTypes_uint8 1.0 RB_PT_PCT_SWC_DWC_CompuMethods_ratio_0p1 0.0 1. FORMAT "%10.5"
 /begin ANNOTATION ANNOTATION_LABEL "Description (coming from AUTOSAR DESC field)"
  /begin ANNOTATION_TEXT "Factor of initial snapshot slip, after which engagement is closely monitored\r\n" /end ANNOTATION_TEXT
 /end ANNOTATION
/end CHARACTERISTIC
/begin CHARACTERISTIC DWC_EFLASHROMB.DWC_K2DeviceControl.DWC_TrqPress.DWC_KisspointSequencer.DWC_KPWETCLUTCH "" VALUE 0x80609212 DefaultValueRecordLayout_AUTOSAR_Platform_BaseTypes_boolean 255.0 AUTOSAR_Platform_CompuMethods_boolean 0.0 255. FORMAT "%10.5"
 /begin ANNOTATION ANNOTATION_LABEL "Description (coming from AUTOSAR DESC field)" /begin ANNOTATION_TEXT "Flag indicating that the clutch is wet\r\n" /end ANNOTATION_TEXT /end ANNOTATION
/end CHARACTERISTIC
/begin CHARACTERISTIC DWC_EFLASHROMB.DWC_K2DeviceControl.DWC_TrqPress.DWC_KPADAPTSTEPS "" CURVE 0x8060923A RB_PT_PCT_SWC_DWC_RecordLayouts_RL_Curve_sint16_7_sint8_7 64.0 RB_PT_PCT_SWC_DWC_CompuMethods_ratio_0p001__2 -32. 32. FORMAT "%10.5"
 /begin ANNOTATION ANNOTATION_LABEL "Description (coming from AUTOSAR DESC field)"
  /begin ANNOTATION_TEXT "Adaption step based on request from kisspoint learn state machine\r\n" /end ANNOTATION_TEXT
 /end ANNOTATION
 /begin AXIS_DESCR STD_AXIS NO_INPUT_QUANTITY RB_PT_PCT_SWC_DWC_CompuMethods_ident 7 -3. 3. FORMAT "%10.5" DEPOSIT ABSOLUTE /end AXIS_DESCR
/end CHARACTERISTIC
/begin CHARACTERISTIC DWC_EFLASHROMB.DWC_K2DeviceControl.DWC_TrqPress.DWC_MINTORQUEOFFSETTEMP "" CURVE 0x80609252 RB_PT_PCT_SWC_DWC_RecordLayouts_RL_Curve_sint16_5_sint16_5 64.0 RB_PT_PCT_SWC_DWC_CompuMethods_ratio_0p001__2 -32. 32. FORMAT "%10.5"
 /begin ANNOTATION ANNOTATION_LABEL "Description (coming from AUTOSAR DESC field)" /begin ANNOTATION_TEXT "Offset applied to kisspoint for temperature\r\n" /end ANNOTATION_TEXT /end ANNOTATION
 /begin AXIS_DESCR STD_AXIS NO_INPUT_QUANTITY RB_PT_PCT_SWC_DWC_CompuMethods_ident 5 -50. 200. FORMAT "%10.5" DEPOSIT ABSOLUTE /end AXIS_DESCR
/end CHARACTERISTIC
/begin CHARACTERISTIC DWC_EFLASHROMB.DWC_K2DeviceControl.DWC_TrqPress.DXC_MINPRESSPOSDEMAND "" VALUE 0x80608978 DefaultValueRecordLayout_AUTOSAR_Platform_BaseTypes_sint16 64.0 RB_PT_PCT_SWC_DWC_CompuMethods_ratio_0p001__2 -32. 32. FORMAT "%10.5"
 /begin ANNOTATION ANNOTATION_LABEL "Description (coming from AUTOSAR DESC field)" /begin ANNOTATION_TEXT "Minimum demand for pressure/position out of class\r\n" /end ANNOTATION_TEXT /end ANNOTATION
/end CHARACTERISTIC
/begin CHARACTERISTIC DWC_EFLASHROMB.DWC_K2DeviceControl.DWC_TrqPress.DXC_RPMTEMPOFFSETPOINT1 "" MAP 0x80609268 RB_PT_PCT_SWC_DWC_RecordLayouts_RL_MapGrouped_sint16_48_uint16_8_sint16_6 64.0 RB_PT_PCT_SWC_DWC_CompuMethods_ratio_0p001__2 -32. 32. FORMAT "%10.5"
 /begin ANNOTATION ANNOTATION_LABEL "Description (coming from AUTOSAR DESC field)"
  /begin ANNOTATION_TEXT "Offset data at torque point based on engine speed and temperature\r\n" /end ANNOTATION_TEXT
 /end ANNOTATION
 /begin AXIS_DESCR COM_AXIS NO_INPUT_QUANTITY RB_PT_PCT_SWC_DWC_CompuMethods_ident 8 0.0 20000. FORMAT "%10.5" AXIS_PTS_REF DWC_EFLASHROMB.DWC_K2DeviceControl.DWC_TrqPress.DXC_RPMAXISOFFSETTABLES DEPOSIT ABSOLUTE /end AXIS_DESCR
 /begin AXIS_DESCR COM_AXIS NO_INPUT_QUANTITY RB_PT_PCT_SWC_DWC_CompuMethods_ident 6 -50. 500. FORMAT "%10.5" AXIS_PTS_REF DWC_EFLASHROMB.DWC_K2DeviceControl.DWC_TrqPress.DXC_TEMPAXISOFFSETTABLES DEPOSIT ABSOLUTE /end AXIS_DESCR
/end CHARACTERISTIC
/begin CHARACTERISTIC DWC_EFLASHROMB.DWC_K2DeviceControl.DWC_TrqPress.DXC_RPMTEMPOFFSETPOINT2 "" MAP 0x806092C8 RB_PT_PCT_SWC_DWC_RecordLayouts_RL_MapGrouped_sint16_48_uint16_8_sint16_6 64.0 RB_PT_PCT_SWC_DWC_CompuMethods_ratio_0p001__2 -32. 32. FORMAT "%10.5"
 /begin ANNOTATION ANNOTATION_LABEL "Description (coming from AUTOSAR DESC field)"
  /begin ANNOTATION_TEXT "Offset data at torque point based on engine speed and temperature\r\n" /end ANNOTATION_TEXT
 /end ANNOTATION
 /begin AXIS_DESCR COM_AXIS NO_INPUT_QUANTITY RB_PT_PCT_SWC_DWC_CompuMethods_ident 8 0.0 20000. FORMAT "%10.5" AXIS_PTS_REF DWC_EFLASHROMB.DWC_K2DeviceControl.DWC_TrqPress.DXC_RPMAXISOFFSETTABLES DEPOSIT ABSOLUTE /end AXIS_DESCR
 /begin AXIS_DESCR COM_AXIS NO_INPUT_QUANTITY RB_PT_PCT_SWC_DWC_CompuMethods_ident 6 -50. 500. FORMAT "%10.5" AXIS_PTS_REF DWC_EFLASHROMB.DWC_K2DeviceControl.DWC_TrqPress.DXC_TEMPAXISOFFSETTABLES DEPOSIT ABSOLUTE /end AXIS_DESCR
/end CHARACTERISTIC
/begin CHARACTERISTIC DWC_EFLASHROMB.DWC_K2DeviceControl.DWC_TrqPress.DXC_RPMTEMPOFFSETPOINT3 "" MAP 0x80609328 RB_PT_PCT_SWC_DWC_RecordLayouts_RL_MapGrouped_sint16_48_uint16_8_sint16_6 64.0 RB_PT_PCT_SWC_DWC_CompuMethods_ratio_0p001__2 -32. 32. FORMAT "%10.5" /begin ANNOTATION ANNOTATION_LABEL Description (coming from AUTOSAR DES /end ANNOTATION /end CHARACTERISTIC
/end MODULE
/end PROJECT
