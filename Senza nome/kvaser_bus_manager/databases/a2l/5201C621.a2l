ASAP2_VERSION 1 60
/begin PROJECT LB74x_TCU "5201C621"
/begin HEADER "" VERSION "5201C621" PROJECT_NO LB74x_TCU /end HEADER
/begin MODULE DIM ""
/begin MOD_COMMON "" BYTE_ORDER MSB_LAST ALIGNMENT_BYTE 1 ALIGNMENT_WORD 2 ALIGNMENT_LONG 4 ALIGNMENT_INT64 4 ALIGNMENT_FLOAT32_IEEE 4 ALIGNMENT_FLOAT64_IEEE 4 DATA_SIZE 32 /end MOD_COMMON
/begin CHARACTERISTIC DWC_CALIB.DWC_K2DeviceControl.DWC_BypassPreparePulse.DWC_MINPRESS2FFCOMPLETE "" VALUE 0x8060ED5A DefaultValueRecordLayout_AUTOSAR_Platform_BaseTypes_sint16 34.0 RB_PT_PCT_SWC_DWC_CompuMethods_ratio_0p001__2 -2. 32. FORMAT "%10.5"
 /begin ANNOTATION ANNOTATION_LABEL "Description (coming from AUTOSAR DESC field)"
  /begin ANNOTATION_TEXT "min pressure to disable first fill flag with engine running.\r\n" /end ANNOTATION_TEXT
 /end ANNOTATION
/end CHARACTERISTIC
/begin CHARACTERISTIC DWC_CALIB.DWC_K2DeviceControl.DWC_BypassPreparePulse.DWC_MINTEMP4FILLADAPT "" VALUE 0x8060ED5C DefaultValueRecordLayout_AUTOSAR_Platform_BaseTypes_sint16 250.0 RB_PT_PCT_SWC_DWC_CompuMethods_ident -50. 200. FORMAT "%10.5"
 /begin ANNOTATION ANNOTATION_LABEL "Description (coming from AUTOSAR DESC field)" /begin ANNOTATION_TEXT "min transoiltemp to allow filladaption\r\n" /end ANNOTATION_TEXT /end ANNOTATION
/end CHARACTERISTIC
/begin CHARACTERISTIC DWC_CALIB.DWC_K2DeviceControl.DWC_BypassPreparePulse.DWC_PULSEPRESSTEMPOFFSET "" CURVE 0x8060EDF6 RB_PT_PCT_SWC_DWC_RecordLayouts_RL_Curve_sint8_4_sint16_4 2.0 RB_PT_PCT_SWC_DWC_CompuMethods_ratio_0p01 -1. 1. FORMAT "%10.5"
 /begin ANNOTATION ANNOTATION_LABEL "Description (coming from AUTOSAR DESC field)"
  /begin ANNOTATION_TEXT "Temperature related offset to be applied to pulse pressure.\r\n" /end ANNOTATION_TEXT
 /end ANNOTATION
 /begin AXIS_DESCR STD_AXIS NO_INPUT_QUANTITY RB_PT_PCT_SWC_DWC_CompuMethods_ident 4 -50. 200. FORMAT "%10.5" DEPOSIT ABSOLUTE /end AXIS_DESCR
/end CHARACTERISTIC
/begin CHARACTERISTIC DWC_CALIB.DWC_K2DeviceControl.DWC_BypassPreparePulse.DWC_RESETTIMEOFFPRESSHIGH "" VALUE 0x8060ED62 DefaultValueRecordLayout_AUTOSAR_Platform_BaseTypes_boolean 255.0 AUTOSAR_Platform_CompuMethods_boolean 0.0 255. FORMAT "%10.5" /end CHARACTERISTIC
/begin CHARACTERISTIC DWC_CALIB.DWC_K2DeviceControl.DWC_ClosedPressureDiag.DWC_ENABLEHYSTERESISFORDITHER "" VALUE 0x8060EE04 DefaultValueRecordLayout_AUTOSAR_Platform_BaseTypes_boolean 255.0 AUTOSAR_Platform_CompuMethods_boolean 0.0 255. FORMAT "%10.5"
 /begin ANNOTATION ANNOTATION_LABEL "Description (coming from AUTOSAR DESC field)"
  /begin ANNOTATION_TEXT "Use hysteresis when enabling dither in a pressure error scenario.\r\n" /end ANNOTATION_TEXT
 /end ANNOTATION
/end CHARACTERISTIC
/begin CHARACTERISTIC DWC_CALIB.DWC_K2DeviceControl.DWC_CLUBLIPABORTSPEED "" VALUE 0x8060ED1C DefaultValueRecordLayout_AUTOSAR_Platform_BaseTypes_sint16 40000.0 RB_PT_PCT_SWC_DWC_CompuMethods_ident -20000. 20000. FORMAT "%10.5"
 /begin ANNOTATION ANNOTATION_LABEL "Description (coming from AUTOSAR DESC field)" /begin ANNOTATION_TEXT "Input speed at which to abort blip.\r\n" /end ANNOTATION_TEXT /end ANNOTATION
/end CHARACTERISTIC
/begin CHARACTERISTIC DWC_CALIB.DWC_K2DeviceControl.DWC_CLUBLIPSPDMONTYPE "" VALUE 0x8060ED3A DefaultValueRecordLayout_AUTOSAR_Platform_BaseTypes_uint8 2.0 RB_PT_PCT_SWC_DWC_CompuMethods_ident 0.0 2. FORMAT "%10.5"
 /begin ANNOTATION ANNOTATION_LABEL "Description (coming from AUTOSAR DESC field)"
  /begin ANNOTATION_TEXT "Speed monitoring type, 0 = OFF, 1 = Abort above input speed, 2 = wait at KP until speed seen.\r\n" /end ANNOTATION_TEXT
 /end ANNOTATION
/end CHARACTERISTIC
/begin CHARACTERISTIC DWC_CALIB.DWC_K2DeviceControl.DWC_CLUBLIPTIMEOUT "" VALUE 0x8060ED1E DefaultValueRecordLayout_AUTOSAR_Platform_BaseTypes_uint16 1.0 RB_PT_PCT_SWC_DWC_CompuMethods_ratio_0p001__2 0.0 1. FORMAT "%10.5"
 /begin ANNOTATION ANNOTATION_LABEL "Description (coming from AUTOSAR DESC field)" /begin ANNOTATION_TEXT "Timeout for clutch blip.\r\n" /end ANNOTATION_TEXT /end ANNOTATION
/end CHARACTERISTIC
/begin CHARACTERISTIC DWC_CALIB.DWC_K2DeviceControl.DWC_CLUBLIPTMFACTPROF "" CURVE 0x8060F068 RB_PT_PCT_SWC_DWC_RecordLayouts_RL_Curve_uint8_11_uint8_11 1.0 RB_PT_PCT_SWC_DWC_CompuMethods_ratio_0p01 0.0 1. FORMAT "%10.5"
 /begin ANNOTATION ANNOTATION_LABEL "Description (coming from AUTOSAR DESC field)" /begin ANNOTATION_TEXT "Clutch blip profile based on time factor.\r\n" /end ANNOTATION_TEXT /end ANNOTATION
 /begin AXIS_DESCR STD_AXIS NO_INPUT_QUANTITY RB_PT_PCT_SWC_DWC_CompuMethods_ratio_0p01 11 0.0 1. FORMAT "%10.5" DEPOSIT ABSOLUTE /end AXIS_DESCR
/end CHARACTERISTIC
/begin CHARACTERISTIC DWC_CALIB.DWC_K2DeviceControl.DWC_Clutch "" VALUE 0x8060ED3B DefaultValueRecordLayout_AUTOSAR_Platform_BaseTypes_uint8 2.0 RB_PT_PCT_SWC_DWC_CompuMethods_ident 0.0 2. FORMAT "%10.5"
 /begin ANNOTATION ANNOTATION_LABEL "Description (coming from AUTOSAR DESC field)"
  /begin ANNOTATION_TEXT "Indication of which clutch is assigned to device controller dataset.\r\n" /end ANNOTATION_TEXT
 /end ANNOTATION
/end CHARACTERISTIC
/begin CHARACTERISTIC DWC_CALIB.DWC_K2DeviceControl.DWC_CLUTCHBLIPHIGHPRESS "" VALUE 0x8060ED20 DefaultValueRecordLayout_AUTOSAR_Platform_BaseTypes_sint16 34.0 RB_PT_PCT_SWC_DWC_CompuMethods_ratio_0p001__2 -2. 32. FORMAT "%10.5"
 /begin ANNOTATION ANNOTATION_LABEL "Description (coming from AUTOSAR DESC field)"
  /begin ANNOTATION_TEXT "Pressure threshold for potential torque transfer during gear engagements.\r\n" /end ANNOTATION_TEXT
 /end ANNOTATION
/end CHARACTERISTIC
/begin CHARACTERISTIC DWC_CALIB.DWC_K2DeviceControl.DWC_CLUTCHBLIPTIME "" CURVE 0x8060F080 RB_PT_PCT_SWC_DWC_RecordLayouts_RL_Curve_uint8_4_sint16_4 1.0 RB_PT_PCT_SWC_DWC_CompuMethods_ratio_0p01 0.0 1. FORMAT "%10.5"
 /begin ANNOTATION ANNOTATION_LABEL "Description (coming from AUTOSAR DESC field)" /begin ANNOTATION_TEXT "Time for clutch blip\r\n" /end ANNOTATION_TEXT /end ANNOTATION
 /begin AXIS_DESCR STD_AXIS NO_INPUT_QUANTITY RB_PT_PCT_SWC_DWC_CompuMethods_ident 4 -50. 200. FORMAT "%10.5" DEPOSIT ABSOLUTE /end AXIS_DESCR
/end CHARACTERISTIC
/begin CHARACTERISTIC DWC_CALIB.DWC_K2DeviceControl.DWC_ENABLEFAIL37GEARSTATUS "" VALUE 0x8060ED3C DefaultValueRecordLayout_AUTOSAR_Platform_BaseTypes_uint8 255.0 DefaultIdenticalCompu 0.0 255. FORMAT "%10.5"
 /begin ANNOTATION ANNOTATION_LABEL "Description (coming from AUTOSAR DESC field)"
  /begin ANNOTATION_TEXT "flag to enable failing of bank of gears for 37 gear status\r\n" /end ANNOTATION_TEXT
 /end ANNOTATION
/end CHARACTERISTIC
/begin CHARACTERISTIC DWC_CALIB.DWC_K2DeviceControl.DWC_ENABLEFAILEDSTATUSFORUSERABORT "" VALUE 0x8060ED3D DefaultValueRecordLayout_AUTOSAR_Platform_BaseTypes_boolean 255.0 AUTOSAR_Platform_CompuMethods_boolean 0.0 255. FORMAT "%10.5"
 /begin ANNOTATION ANNOTATION_LABEL "Description (coming from AUTOSAR DESC field)"
  /begin ANNOTATION_TEXT "Allow the reported status to say 'failed' if the user aborts a routine.\r\n" /end ANNOTATION_TEXT
 /end ANNOTATION
/end CHARACTERISTIC
/begin CHARACTERISTIC DWC_CALIB.DWC_K2DeviceControl.DWC_ENABLESELFTESTDIAGNOSTIC "" VALUE 0x8060ED3E DefaultValueRecordLayout_AUTOSAR_Platform_BaseTypes_boolean 255.0 AUTOSAR_Platform_CompuMethods_boolean 0.0 255. FORMAT "%10.5"
 /begin ANNOTATION ANNOTATION_LABEL "Description (coming from AUTOSAR DESC field)"
  /begin ANNOTATION_TEXT "Flag to enable diagnostics when in self test and no routine running.\r\n" /end ANNOTATION_TEXT
 /end ANNOTATION
/end CHARACTERISTIC
/begin CHARACTERISTIC DWC_CALIB.DWC_K2DeviceControl.DWC_ENGOFFPRESS "" CURVE 0x8060F08E RB_PT_PCT_SWC_DWC_RecordLayouts_RL_Curve_sint16_4_uint8_4 34.0 RB_PT_PCT_SWC_DWC_CompuMethods_ratio_0p001__2 -2. 32. FORMAT "%10.5"
 /begin ANNOTATION ANNOTATION_LABEL "Description (coming from AUTOSAR DESC field)" /begin ANNOTATION_TEXT "Pressure request when engine is off.\r\n" /end ANNOTATION_TEXT /end ANNOTATION
 /begin AXIS_DESCR STD_AXIS NO_INPUT_QUANTITY RB_PT_PCT_SWC_DWC_CompuMethods_ratio_0p005 4 0.0 1. FORMAT "%10.5" DEPOSIT ABSOLUTE /end AXIS_DESCR
/end CHARACTERISTIC
/begin CHARACTERISTIC DWC_CALIB.DWC_K2DeviceControl.DWC_FillController.DWC_FLGENABLEFILLTEST "" VALUE 0x8060EE08 DefaultValueRecordLayout_AUTOSAR_Platform_BaseTypes_boolean 255.0 AUTOSAR_Platform_CompuMethods_boolean 0.0 255. FORMAT "%10.5"
 /begin ANNOTATION ANNOTATION_LABEL "Description (coming from AUTOSAR DESC field)"
  /begin ANNOTATION_TEXT "Set true to use a single parameter for fill pressure for testing/characterisation work\r\n" /end ANNOTATION_TEXT
 /end ANNOTATION
/end CHARACTERISTIC
/begin CHARACTERISTIC DWC_CALIB.DWC_K2DeviceControl.DWC_FillController.DWC_PRESFILLTEST "" VALUE 0x8060EE06 DefaultValueRecordLayout_AUTOSAR_Platform_BaseTypes_uint16 32.0 RB_PT_PCT_SWC_DWC_CompuMethods_ratio_0p001__2 0.0 32. FORMAT "%10.5"
 /begin ANNOTATION ANNOTATION_LABEL "Description (coming from AUTOSAR DESC field)" /begin ANNOTATION_TEXT "Pressure for fill test\r\n" /end ANNOTATION_TEXT /end ANNOTATION
/end CHARACTERISTIC
/begin CHARACTERISTIC DWC_CALIB.DWC_K2DeviceControl.DWC_FLGCLUTCHBLIPENABLED "" VALUE 0x8060ED3F DefaultValueRecordLayout_AUTOSAR_Platform_BaseTypes_boolean 255.0 AUTOSAR_Platform_CompuMethods_boolean 0.0 255. FORMAT "%10.5"
 /begin ANNOTATION ANNOTATION_LABEL "Description (coming from AUTOSAR DESC field)" /begin ANNOTATION_TEXT "Flag to enable clutch blip requests from GAC.\r\n" /end ANNOTATION_TEXT /end ANNOTATION
/end CHARACTERISTIC
/begin CHARACTERISTIC DWC_CALIB.DWC_K2DeviceControl.DWC_FLGDISABLEDIAG4DEPRESSURE "" VALUE 0x8060ED40 DefaultValueRecordLayout_AUTOSAR_Platform_BaseTypes_boolean 255.0 AUTOSAR_Platform_CompuMethods_boolean 0.0 255. FORMAT "%10.5"
 /begin ANNOTATION ANNOTATION_LABEL "Description (coming from AUTOSAR DESC field)"
  /begin ANNOTATION_TEXT "Disable DWC diagnostics when a depressure routine is active.\r\n" /end ANNOTATION_TEXT
 /end ANNOTATION
/end CHARACTERISTIC
/begin CHARACTERISTIC DWC_CALIB.DWC_K2DeviceControl.DWC_FLGENABLEAUTOVALVECLOSEDCLEAN "" VALUE 0x8060ED41 DefaultValueRecordLayout_AUTOSAR_Platform_BaseTypes_uint8 255.0 DefaultIdenticalCompu 0.0 255. FORMAT "%10.5"
 /begin ANNOTATION ANNOTATION_LABEL "Description (coming from AUTOSAR DESC field)" /begin ANNOTATION_TEXT "Enable automatic cleaning on a closed clutch\r\n" /end ANNOTATION_TEXT /end ANNOTATION
/end CHARACTERISTIC
/begin CHARACTERISTIC DWC_CALIB.DWC_K2DeviceControl.DWC_FLGENABLEAUTOVALVEOPENCLEAN "" VALUE 0x8060ED42 DefaultValueRecordLayout_AUTOSAR_Platform_BaseTypes_uint8 255.0 DefaultIdenticalCompu 0.0 255. FORMAT "%10.5"
 /begin ANNOTATION ANNOTATION_LABEL "Description (coming from AUTOSAR DESC field)" /begin ANNOTATION_TEXT "Enable automatic cleaning on an open clutch\r\n" /end ANNOTATION_TEXT /end ANNOTATION
/end CHARACTERISTIC
/begin CHARACTERISTIC DWC_CALIB.DWC_K2DeviceControl.DWC_FLGENABLEAUTOVALVERINSE "" VALUE 0x8060ED43 DefaultValueRecordLayout_AUTOSAR_Platform_BaseTypes_uint8 255.0 DefaultIdenticalCompu 0.0 255. FORMAT "%10.5"
 /begin ANNOTATION ANNOTATION_LABEL "Description (coming from AUTOSAR DESC field)" /begin ANNOTATION_TEXT "Enable automatic rinsing on the clutch valve\r\n" /end ANNOTATION_TEXT /end ANNOTATION
/end CHARACTERISTIC
/begin CHARACTERISTIC DWC_CALIB.DWC_K2DeviceControl.DWC_FLGENABLEENGOFFPRES "" VALUE 0x8060ED44 DefaultValueRecordLayout_AUTOSAR_Platform_BaseTypes_boolean 255.0 AUTOSAR_Platform_CompuMethods_boolean 0.0 255. FORMAT "%10.5"
 /begin ANNOTATION ANNOTATION_LABEL "Description (coming from AUTOSAR DESC field)"
  /begin ANNOTATION_TEXT "Flag to enable seperate engine off pressure for rinsing.\r\n" /end ANNOTATION_TEXT
 /end ANNOTATION
/end CHARACTERISTIC
/begin CHARACTERISTIC DWC_CALIB.DWC_K2DeviceControl.DWC_FLGENABLEFAILEDHYBMDTABLE "" VALUE 0x8060ED45 DefaultValueRecordLayout_AUTOSAR_Platform_BaseTypes_boolean 255.0 AUTOSAR_Platform_CompuMethods_boolean 0.0 255. FORMAT "%10.5"
 /begin ANNOTATION ANNOTATION_LABEL "Description (coming from AUTOSAR DESC field)"
  /begin ANNOTATION_TEXT "Flag to enable DWC device controller to write to failed hybrid mode table.\r\n" /end ANNOTATION_TEXT
 /end ANNOTATION
/end CHARACTERISTIC
/begin CHARACTERISTIC DWC_CALIB.DWC_K2DeviceControl.DWC_FLGFORCETPRESET "" VALUE 0x8060ED46 DefaultValueRecordLayout_AUTOSAR_Platform_BaseTypes_boolean 255.0 AUTOSAR_Platform_CompuMethods_boolean 0.0 255. FORMAT "%10.5"
 /begin ANNOTATION ANNOTATION_LABEL "Description (coming from AUTOSAR DESC field)" /begin ANNOTATION_TEXT "Set true to force torque to pressure reset\r\n" /end ANNOTATION_TEXT /end ANNOTATION
/end CHARACTERISTIC
/begin CHARACTERISTIC DWC_CALIB.DWC_K2DeviceControl.DWC_FLGFORCEZEROPRSFAILGEAR "" VALUE 0x8060ED47 DefaultValueRecordLayout_AUTOSAR_Platform_BaseTypes_boolean 255.0 AUTOSAR_Platform_CompuMethods_boolean 0.0 255. FORMAT "%10.5"
 /begin ANNOTATION ANNOTATION_LABEL "Description (coming from AUTOSAR DESC field)"
  /begin ANNOTATION_TEXT "Flag to force pressure demand to zero when gears are failed.\r\n" /end ANNOTATION_TEXT
 /end ANNOTATION
/end CHARACTERISTIC
/begin CHARACTERISTIC DWC_CALIB.DWC_K2DeviceControl.DWC_FORCENOPREFILLBEFORESO "" VALUE 0x8060ED48 DefaultValueRecordLayout_AUTOSAR_Platform_BaseTypes_uint8 255.0 DefaultIdenticalCompu 0.0 255. FORMAT "%10.5" /end CHARACTERISTIC
/begin CHARACTERISTIC DWC_CALIB.DWC_K2DeviceControl.DWC_L2MaxDoubleSeqTime "" VALUE 0x8060ED22 DefaultValueRecordLayout_AUTOSAR_Platform_BaseTypes_uint16 327.675 RB_PT_PCT_SWC_DWC_CompuMethods_ratio_0p005 0.0 327.675 FORMAT "%10.5"
 /begin ANNOTATION ANNOTATION_LABEL "Description (coming from AUTOSAR DESC field)"
  /begin ANNOTATION_TEXT "Time the L2 sequence will stop and open both clutches\r\n" /end ANNOTATION_TEXT
 /end ANNOTATION
/end CHARACTERISTIC
/begin CHARACTERISTIC DWC_CALIB.DWC_K2DeviceControl.DWC_L2SetTroque "" CURVE 0x8060F09C RB_PT_PCT_SWC_DWC_RecordLayouts_RL_Curve_sint16_50_uint16_50 4000.0 RB_PT_PCT_SWC_DWC_CompuMethods_ratio_0p1 -2000. 2000. FORMAT "%10.5"
 /begin ANNOTATION ANNOTATION_LABEL "Description (coming from AUTOSAR DESC field)" /begin ANNOTATION_TEXT "Torque sequence in relation to time.\r\n" /end ANNOTATION_TEXT /end ANNOTATION
 /begin AXIS_DESCR STD_AXIS NO_INPUT_QUANTITY RB_PT_PCT_SWC_DWC_CompuMethods_ratio_0p005 50 0.0 327.675 FORMAT "%10.5" DEPOSIT ABSOLUTE /end AXIS_DESCR
/end CHARACTERISTIC
/begin CHARACTERISTIC DWC_CALIB.DWC_K2DeviceControl.DWC_LINEPRESSUREDIAGDISABLE "" VALUE 0x8060ED24 DefaultValueRecordLayout_AUTOSAR_Platform_BaseTypes_sint16 105.0 RB_PT_PCT_SWC_DWC_CompuMethods_ratio_0p005 -5. 100. FORMAT "%10.5"
 /begin ANNOTATION ANNOTATION_LABEL "Description (coming from AUTOSAR DESC field)" /begin ANNOTATION_TEXT "Lower line pressure at which diags become disabled.\r\n" /end ANNOTATION_TEXT /end ANNOTATION
/end CHARACTERISTIC
/begin CHARACTERISTIC DWC_CALIB.DWC_K2DeviceControl.DWC_MAXOUTPUTSPDFORCLUTCHBLIP "" VALUE 0x8060ED26 DefaultValueRecordLayout_AUTOSAR_Platform_BaseTypes_sint16 40000.0 RB_PT_PCT_SWC_DWC_CompuMethods_ident -20000. 20000. FORMAT "%10.5"
 /begin ANNOTATION ANNOTATION_LABEL "Description (coming from AUTOSAR DESC field)" /begin ANNOTATION_TEXT "Minimum outspeed to allow for clutch blip\r\n" /end ANNOTATION_TEXT /end ANNOTATION
/end CHARACTERISTIC
/begin CHARACTERISTIC DWC_CALIB.DWC_K2DeviceControl.DWC_MINLINEPRESSURE4DIAG "" VALUE 0x8060ED28 DefaultValueRecordLayout_AUTOSAR_Platform_BaseTypes_sint16 105.0 RB_PT_PCT_SWC_DWC_CompuMethods_ratio_0p005 -5. 100. FORMAT "%10.5"
 /begin ANNOTATION ANNOTATION_LABEL "Description (coming from AUTOSAR DESC field)"
  /begin ANNOTATION_TEXT "Minimum line pressure to be seen to enable DC diagnostics.\r\n" /end ANNOTATION_TEXT
 /end ANNOTATION
/end CHARACTERISTIC
/begin CHARACTERISTIC DWC_CALIB.DWC_K2DeviceControl.DWC_MINSOHLINEPRESSURE "" VALUE 0x8060ED2A DefaultValueRecordLayout_AUTOSAR_Platform_BaseTypes_sint16 105.0 RB_PT_PCT_SWC_DWC_CompuMethods_ratio_0p005 -5. 100. FORMAT "%10.5"
 /begin ANNOTATION ANNOTATION_LABEL "Description (coming from AUTOSAR DESC field)" /begin ANNOTATION_TEXT "Minimum line pressure to allow shut off test.\r\n" /end ANNOTATION_TEXT /end ANNOTATION
/end CHARACTERISTIC
/begin CHARACTERISTIC DWC_CALIB.DWC_K2DeviceControl.DWC_OPENDEMANDKICK "" CURVE 0x8060F166 RB_PT_PCT_SWC_DWC_RecordLayouts_RL_Curve_sint16_4_sint16_4 34.0 RB_PT_PCT_SWC_DWC_CompuMethods_ratio_0p001__2 -2. 32. FORMAT "%10.5"
 /begin ANNOTATION ANNOTATION_LABEL "Description (coming from AUTOSAR DESC field)" /begin ANNOTATION_TEXT "Temperature dependancy on prefill kick.\r\n" /end ANNOTATION_TEXT /end ANNOTATION
 /begin AXIS_DESCR STD_AXIS NO_INPUT_QUANTITY RB_PT_PCT_SWC_DWC_CompuMethods_ident 4 -50. 200. FORMAT "%10.5" DEPOSIT ABSOLUTE /end AXIS_DESCR
/end CHARACTERISTIC
/begin CHARACTERISTIC DWC_CALIB.DWC_K2DeviceControl.DWC_OpenPressureDiag.DWC_ENABLEHYSTERESISFORDITHER "" VALUE 0x8060EE0A DefaultValueRecordLayout_AUTOSAR_Platform_BaseTypes_boolean 255.0 AUTOSAR_Platform_CompuMethods_boolean 0.0 255. FORMAT "%10.5"
 /begin ANNOTATION ANNOTATION_LABEL "Description (coming from AUTOSAR DESC field)"
  /begin ANNOTATION_TEXT "Use hysteresis when enabling dither in a pressure error scenario.\r\n" /end ANNOTATION_TEXT
 /end ANNOTATION
/end CHARACTERISTIC
/begin CHARACTERISTIC DWC_CALIB.DWC_K2DeviceControl.DWC_PKFILTENGVSPRESRATE "" MAP 0x8060F178 RB_PT_PCT_SWC_DWC_RecordLayouts_RL_Map_uint16_48_uint16_6_sint16_8 1.0 RB_PT_PCT_SWC_DWC_CompuMethods_ratio_0p01 0.0 1. FORMAT "%10.5"
 /begin ANNOTATION ANNOTATION_LABEL "Description (coming from AUTOSAR DESC field)"
  /begin ANNOTATION_TEXT "Filter PK in relation to engine speed and rate of change target pressure\r\n" /end ANNOTATION_TEXT
 /end ANNOTATION
 /begin AXIS_DESCR STD_AXIS NO_INPUT_QUANTITY RB_PT_PCT_SWC_DWC_CompuMethods_ident 6 0.0 20000. FORMAT "%10.5" DEPOSIT ABSOLUTE /end AXIS_DESCR
 /begin AXIS_DESCR STD_AXIS NO_INPUT_QUANTITY RB_PT_PCT_SWC_DWC_CompuMethods_pressure_0p1 8 -3200. 3200. FORMAT "%10.5" DEPOSIT ABSOLUTE /end AXIS_DESCR
/end CHARACTERISTIC
/begin CHARACTERISTIC DWC_CALIB.DWC_K2DeviceControl.DWC_POSTFILLTIME "" VALUE 0x8060ED2C DefaultValueRecordLayout_AUTOSAR_Platform_BaseTypes_uint16 655.35 RB_PT_PCT_SWC_DWC_CompuMethods_DST_Time 0.0 655.35 FORMAT "%10.5"
 /begin ANNOTATION ANNOTATION_LABEL "Description (coming from AUTOSAR DESC field)"
  /begin ANNOTATION_TEXT "Time used to postpone pK filter after any form of fill.\r\n" /end ANNOTATION_TEXT
 /end ANNOTATION
/end CHARACTERISTIC
/begin CHARACTERISTIC DWC_CALIB.DWC_K2DeviceControl.DWC_PREFILLKICKMODE "" VALUE 0x8060ED49 DefaultValueRecordLayout_AUTOSAR_Platform_BaseTypes_uint8 2.0 RB_PT_PCT_SWC_DWC_CompuMethods_ident 0.0 2. FORMAT "%10.5" /end CHARACTERISTIC
/begin CHARACTERISTIC DWC_CALIB.DWC_K2DeviceControl.DWC_PRES2CLUBLIPMAG "" MAP 0x8060F1F8 RB_PT_PCT_SWC_DWC_RecordLayouts_RL_Map_uint8_24_sint16_6_sint16_4 15.0 RB_PT_PCT_SWC_DWC_CompuMethods_ratio_0p1 0.0 15. FORMAT "%10.5"
 /begin ANNOTATION ANNOTATION_LABEL "Description (coming from AUTOSAR DESC field)" /begin ANNOTATION_TEXT "Pressure to clutch blip magnitude.\r\n" /end ANNOTATION_TEXT /end ANNOTATION
 /begin AXIS_DESCR STD_AXIS NO_INPUT_QUANTITY RB_PT_PCT_SWC_DWC_CompuMethods_ratio_0p001__2 6 -2. 32. FORMAT "%10.5" DEPOSIT ABSOLUTE /end AXIS_DESCR
 /begin AXIS_DESCR STD_AXIS NO_INPUT_QUANTITY RB_PT_PCT_SWC_DWC_CompuMethods_ident 4 -50. 200. FORMAT "%10.5" DEPOSIT ABSOLUTE /end AXIS_DESCR
/end CHARACTERISTIC
/begin CHARACTERISTIC DWC_CALIB.DWC_K2DeviceControl.DWC_PressCurrent.DWC_HYSTERESISBANDWIDTH "" MAP 0x8060EE14 RB_PT_PCT_SWC_DWC_RecordLayouts_RL_Map_uint16_55_sint16_11_sint16_5 1.0 RB_PT_PCT_SWC_DWC_CompuMethods_ratio_0p0001 0.0 1. FORMAT "%10.5"
 /begin AXIS_DESCR STD_AXIS NO_INPUT_QUANTITY RB_PT_PCT_SWC_DWC_CompuMethods_ratio_0p001__2 11 -2. 32. FORMAT "%10.5" DEPOSIT ABSOLUTE /end AXIS_DESCR
 /begin AXIS_DESCR STD_AXIS NO_INPUT_QUANTITY RB_PT_PCT_SWC_DWC_CompuMethods_ident 5 -50. 200. FORMAT "%10.5" DEPOSIT ABSOLUTE /end AXIS_DESCR
/end CHARACTERISTIC
/begin CHARACTERISTIC DWC_CALIB.DWC_K2DeviceControl.DWC_PressCurrent.DWC_MAXCURDEMFORADAPTION "" VALUE 0x8060EE0C DefaultValueRecordLayout_AUTOSAR_Platform_BaseTypes_uint16 5000.0 RB_PT_PCT_SWC_DWC_CompuMethods_ident 0.0 5000. FORMAT "%10.5"
 /begin ANNOTATION ANNOTATION_LABEL "Description (coming from AUTOSAR DESC field)" /begin ANNOTATION_TEXT "Maximum allowed current demand to allow adaption.\r\n" /end ANNOTATION_TEXT /end ANNOTATION
/end CHARACTERISTIC
/begin CHARACTERISTIC DWC_CALIB.DWC_K2DeviceControl.DWC_PressCurrent.DWC_MINDYNAMICPCTEMP "" VALUE 0x8060EE0E DefaultValueRecordLayout_AUTOSAR_Platform_BaseTypes_sint16 250.0 RB_PT_PCT_SWC_DWC_CompuMethods_ident -50. 200. FORMAT "%10.5"
 /begin ANNOTATION ANNOTATION_LABEL "Description (coming from AUTOSAR DESC field)"
  /begin ANNOTATION_TEXT "Temperature condition for dynamic pressure to current.\r\n" /end ANNOTATION_TEXT
 /end ANNOTATION
/end CHARACTERISTIC
/begin CHARACTERISTIC DWC_CALIB.DWC_K2DeviceControl.DWC_PressCurrent.DWC_MINLINEPRESSADAPT "" VALUE 0x8060EE10 DefaultValueRecordLayout_AUTOSAR_Platform_BaseTypes_sint16 105.0 RB_PT_PCT_SWC_DWC_CompuMethods_ratio_0p005 -5. 100. FORMAT "%10.5"
 /begin ANNOTATION ANNOTATION_LABEL "Description (coming from AUTOSAR DESC field)" /begin ANNOTATION_TEXT "Minimum line pressure for adaption to run.\r\n" /end ANNOTATION_TEXT /end ANNOTATION
/end CHARACTERISTIC
/begin CHARACTERISTIC DWC_CALIB.DWC_K2DeviceControl.DWC_PressCurrent.DWC_PIAdaptAutoReset "" VALUE 0x8060EE12 DefaultValueRecordLayout_AUTOSAR_Platform_BaseTypes_uint8 255.0 DefaultIdenticalCompu 0.0 255. FORMAT "%10.5"
 /begin ANNOTATION ANNOTATION_LABEL "Description (coming from AUTOSAR DESC field)"
  /begin ANNOTATION_TEXT "Allow auto reset if PI adaption hits the max allowable limits.\r\n" /end ANNOTATION_TEXT
 /end ANNOTATION
/end CHARACTERISTIC
/begin CHARACTERISTIC DWC_CALIB.DWC_K2DeviceControl.DWC_PressCurrent.DWC_PIDFEEDFORWARD "" MAP 0x8060EEA6 RB_PT_PCT_SWC_DWC_RecordLayouts_RL_Map_sint16_49_sint16_7_sint16_7 2000.0 RB_PT_PCT_SWC_DWC_CompuMethods_ident -1000. 1000. FORMAT "%10.5"
 /begin AXIS_DESCR STD_AXIS NO_INPUT_QUANTITY RB_PT_PCT_SWC_DWC_CompuMethods_ratio_0p001__2 7 -32. 32. FORMAT "%10.5" DEPOSIT ABSOLUTE /end AXIS_DESCR
 /begin AXIS_DESCR STD_AXIS NO_INPUT_QUANTITY RB_PT_PCT_SWC_DWC_CompuMethods_ratio_0p001__2 7 -32. 32. FORMAT "%10.5" DEPOSIT ABSOLUTE /end AXIS_DESCR
/end CHARACTERISTIC
/begin CHARACTERISTIC DWC_CALIB.DWC_K2DeviceControl.DWC_PressCurrent.DWC_VALVEINTEGRALTEMPFACTOR "" CURVE 0x8060EF28 RB_PT_PCT_SWC_DWC_RecordLayouts_RL_Curve_uint8_7_sint16_7 1.0 RB_PT_PCT_SWC_DWC_CompuMethods_ratio_0p01 0.0 1. FORMAT "%10.5"
 /begin ANNOTATION ANNOTATION_LABEL "Description (coming from AUTOSAR DESC field)" /begin ANNOTATION_TEXT "Temperature based factor for valve integral gain.\r\n" /end ANNOTATION_TEXT /end ANNOTATION
 /begin AXIS_DESCR STD_AXIS NO_INPUT_QUANTITY RB_PT_PCT_SWC_DWC_CompuMethods_ident 7 -50. 200. FORMAT "%10.5" DEPOSIT ABSOLUTE /end AXIS_DESCR
/end CHARACTERISTIC
/begin CHARACTERISTIC DWC_CALIB.DWC_K2DeviceControl.DWC_PRESSUREDELAYRATECALC "" VALUE 0x8060ED4A DefaultValueRecordLayout_AUTOSAR_Platform_BaseTypes_uint8 30.0 RB_PT_PCT_SWC_DWC_CompuMethods_ident 0.0 30. FORMAT "%10.5"
 /begin ANNOTATION ANNOTATION_LABEL "Description (coming from AUTOSAR DESC field)" /begin ANNOTATION_TEXT "sample period to calc pressure tgt rate of change\r\n" /end ANNOTATION_TEXT /end ANNOTATION
/end CHARACTERISTIC
/begin CHARACTERISTIC DWC_CALIB.DWC_K2DeviceControl.DWC_PtoCSequence.DWC_MAXSLIP4TXISSUE "" VALUE 0x8060EF40 DefaultValueRecordLayout_AUTOSAR_Platform_BaseTypes_sint16 40000.0 RB_PT_PCT_SWC_DWC_CompuMethods_ident -20000. 20000. FORMAT "%10.5"
 /begin ANNOTATION ANNOTATION_LABEL "Description (coming from AUTOSAR DESC field)"
  /begin ANNOTATION_TEXT "Max permissible slip during a PI adaption when adapting PI\r\n" /end ANNOTATION_TEXT
 /end ANNOTATION
/end CHARACTERISTIC
/begin CHARACTERISTIC DWC_CALIB.DWC_K2DeviceControl.DWC_PtoCSequence.DWC_MINOPSPEEDFORDYNAMICPC "" VALUE 0x8060EF42 DefaultValueRecordLayout_AUTOSAR_Platform_BaseTypes_sint16 40000.0 RB_PT_PCT_SWC_DWC_CompuMethods_ident -20000. 20000. FORMAT "%10.5"
 /begin ANNOTATION ANNOTATION_LABEL "Description (coming from AUTOSAR DESC field)"
  /begin ANNOTATION_TEXT "Minimum output speed required to run dynamic pc. Logic added to prevent stationary pc learn in neutral/park\r\n" /end ANNOTATION_TEXT
 /end ANNOTATION
/end CHARACTERISTIC
/begin CHARACTERISTIC DWC_CALIB.DWC_K2DeviceControl.DWC_RESETPICLOSEDSTATUS "" VALUE 0x8060ED4B DefaultValueRecordLayout_AUTOSAR_Platform_BaseTypes_uint8 255.0 DefaultIdenticalCompu 0.0 255. FORMAT "%10.5"
 /begin ANNOTATION ANNOTATION_LABEL "Description (coming from AUTOSAR DESC field)" /begin ANNOTATION_TEXT "Flag to enable the reset of PI on closed status.\r\n" /end ANNOTATION_TEXT /end ANNOTATION
/end CHARACTERISTIC
/begin CHARACTERISTIC DWC_CALIB.DWC_K2DeviceControl.DWC_RESETPIOPENSTATUS "" VALUE 0x8060ED4C DefaultValueRecordLayout_AUTOSAR_Platform_BaseTypes_uint8 255.0 DefaultIdenticalCompu 0.0 255. FORMAT "%10.5"
 /begin ANNOTATION ANNOTATION_LABEL "Description (coming from AUTOSAR DESC field)" /begin ANNOTATION_TEXT "Flag to enable the reset of PI on open status.\r\n" /end ANNOTATION_TEXT /end ANNOTATION
/end CHARACTERISTIC
/begin CHARACTERISTIC DWC_CALIB.DWC_K2DeviceControl.DWC_SEQTORQUE "" CURVE 0x8060F228 RB_PT_PCT_SWC_DWC_RecordLayouts_RL_Curve_sint16_50_uint16_50 4000.0 RB_PT_PCT_SWC_DWC_CompuMethods_ratio_0p1 -2000. 2000. FORMAT "%10.5"
 /begin ANNOTATION ANNOTATION_LABEL "Description (coming from AUTOSAR DESC field)" /begin ANNOTATION_TEXT "Torque sequence in relation to time.\r\n" /end ANNOTATION_TEXT /end ANNOTATION
 /begin AXIS_DESCR STD_AXIS NO_INPUT_QUANTITY RB_PT_PCT_SWC_DWC_CompuMethods_ratio_0p005 50 0.0 327.675 FORMAT "%10.5" DEPOSIT ABSOLUTE /end AXIS_DESCR
/end CHARACTERISTIC
/begin CHARACTERISTIC DWC_CALIB.DWC_K2DeviceControl.DWC_ShutOffHandler.DWC_FLGALLOWAUTOPASSSOH "" VALUE 0x8060EF46 DefaultValueRecordLayout_AUTOSAR_Platform_BaseTypes_boolean 255.0 AUTOSAR_Platform_CompuMethods_boolean 0.0 255. FORMAT "%10.5"
 /begin ANNOTATION ANNOTATION_LABEL "Description (coming from AUTOSAR DESC field)" /begin ANNOTATION_TEXT "Flag to enable the SOH auto pass logic.\r\n" /end ANNOTATION_TEXT /end ANNOTATION
/end CHARACTERISTIC
/begin CHARACTERISTIC DWC_CALIB.DWC_K2DeviceControl.DWC_ShutOffHandler.DWC_FLGALLOWSLAVESOTEST "" VALUE 0x8060EF47 DefaultValueRecordLayout_AUTOSAR_Platform_BaseTypes_boolean 255.0 AUTOSAR_Platform_CompuMethods_boolean 0.0 255. FORMAT "%10.5"
 /begin ANNOTATION ANNOTATION_LABEL "Description (coming from AUTOSAR DESC field)"
  /begin ANNOTATION_TEXT "Flag to enable slave to run SO test if master is failed.\r\n" /end ANNOTATION_TEXT
 /end ANNOTATION
/end CHARACTERISTIC
/begin CHARACTERISTIC DWC_CALIB.DWC_K2DeviceControl.DWC_ShutOffHandler.DWC_FLGENABLEAUTOFAIL "" VALUE 0x8060EF48 DefaultValueRecordLayout_AUTOSAR_Platform_BaseTypes_boolean 255.0 AUTOSAR_Platform_CompuMethods_boolean 0.0 255. FORMAT "%10.5"
 /begin ANNOTATION ANNOTATION_LABEL "Description (coming from AUTOSAR DESC field)" /begin ANNOTATION_TEXT "Flag to enable auto fail logic.\r\n" /end ANNOTATION_TEXT /end ANNOTATION
/end CHARACTERISTIC
/begin CHARACTERISTIC DWC_CALIB.DWC_K2DeviceControl.DWC_ShutOffHandler.DWC_FLGENABLEFIRSTSTATETIMEOUT "" VALUE 0x8060EF49 DefaultValueRecordLayout_AUTOSAR_Platform_BaseTypes_boolean 255.0 AUTOSAR_Platform_CompuMethods_boolean 0.0 255. FORMAT "%10.5"
 /begin ANNOTATION ANNOTATION_LABEL "Description (coming from AUTOSAR DESC field)" /begin ANNOTATION_TEXT "Flag to enable a timeout in the first state.\r\n" /end ANNOTATION_TEXT /end ANNOTATION
/end CHARACTERISTIC
/begin CHARACTERISTIC DWC_CALIB.DWC_K2DeviceControl.DWC_ShutOffHandler.DWC_FLGOVRDDEVCHECK "" VALUE 0x8060EF4A DefaultValueRecordLayout_AUTOSAR_Platform_BaseTypes_boolean 255.0 AUTOSAR_Platform_CompuMethods_boolean 0.0 255. FORMAT "%10.5"
 /begin ANNOTATION ANNOTATION_LABEL "Description (coming from AUTOSAR DESC field)"
  /begin ANNOTATION_TEXT "Flag to override device check in auto fail. Required to fix bug\r\n" /end ANNOTATION_TEXT
 /end ANNOTATION
/end CHARACTERISTIC
/begin CHARACTERISTIC DWC_CALIB.DWC_K2DeviceControl.DWC_ShutOffHandler.DWC_FLGUSESOMASTERRULE1FIX "" VALUE 0x8060EF4B DefaultValueRecordLayout_AUTOSAR_Platform_BaseTypes_boolean 255.0 AUTOSAR_Platform_CompuMethods_boolean 0.0 255. FORMAT "%10.5"
 /begin ANNOTATION ANNOTATION_LABEL "Description (coming from AUTOSAR DESC field)"
  /begin ANNOTATION_TEXT "Flag to use the functionality described in the comment for master rule 1.\r\n" /end ANNOTATION_TEXT
 /end ANNOTATION
/end CHARACTERISTIC
/begin CHARACTERISTIC DWC_CALIB.DWC_K2DeviceControl.DWC_ShutOffHandler.DWC_REINITSOHTEST "" VALUE 0x8060EF44 DefaultValueRecordLayout_AUTOSAR_Platform_BaseTypes_uint16 65535.0 RB_PT_PCT_SWC_DWC_CompuMethods_ident 0.0 65535. FORMAT "%10.5"
 /begin ANNOTATION ANNOTATION_LABEL "Description (coming from AUTOSAR DESC field)" /begin ANNOTATION_TEXT "Parameter to reinitialise the SOH test.\r\n" /end ANNOTATION_TEXT /end ANNOTATION
/end CHARACTERISTIC
/begin CHARACTERISTIC DWC_CALIB.DWC_K2DeviceControl.DWC_ShutOffHandler.DWC_RERUNONLYIFFAILED "" VALUE 0x8060EF4C DefaultValueRecordLayout_AUTOSAR_Platform_BaseTypes_boolean 255.0 AUTOSAR_Platform_CompuMethods_boolean 0.0 255. FORMAT "%10.5"
 /begin ANNOTATION ANNOTATION_LABEL "Description (coming from AUTOSAR DESC field)"
  /begin ANNOTATION_TEXT "Flag to re run SO test from diag reset only if the test has previously failed.\r\n" /end ANNOTATION_TEXT
 /end ANNOTATION
/end CHARACTERISTIC
/begin CHARACTERISTIC DWC_CALIB.DWC_K2DeviceControl.DWC_ShutOffHandler.DWC_SHUTOFFONLYFOR2FAILEDBANKS "" VALUE 0x8060EF4D DefaultValueRecordLayout_AUTOSAR_Platform_BaseTypes_boolean 255.0 AUTOSAR_Platform_CompuMethods_boolean 0.0 255. FORMAT "%10.5"
 /begin ANNOTATION ANNOTATION_LABEL "Description (coming from AUTOSAR DESC field)" /begin ANNOTATION_TEXT "Trigger the shut off only when 2 banks have failed.\r\n" /end ANNOTATION_TEXT /end ANNOTATION
/end CHARACTERISTIC
/begin CHARACTERISTIC DWC_CALIB.DWC_K2DeviceControl.DWC_ShutOffHandler.DWC_SOALLOWEDINSELFTEST "" VALUE 0x8060EF4E DefaultValueRecordLayout_AUTOSAR_Platform_BaseTypes_boolean 255.0 AUTOSAR_Platform_CompuMethods_boolean 0.0 255. FORMAT "%10.5"
 /begin ANNOTATION ANNOTATION_LABEL "Description (coming from AUTOSAR DESC field)"
  /begin ANNOTATION_TEXT "Flag to enabe log that allows shut off when clutch is in self test.\r\n" /end ANNOTATION_TEXT
 /end ANNOTATION
/end CHARACTERISTIC
/begin CHARACTERISTIC DWC_CALIB.DWC_K2DeviceControl.DWC_ShutOffHandler.DWC_SOHPRESSURENORESPONSETIMEMAP "" CURVE 0x8060EF50 RB_PT_PCT_SWC_DWC_RecordLayouts_RL_Curve_uint16_4_sint16_4 10.0 RB_PT_PCT_SWC_DWC_CompuMethods_ratio_0p001__2 0.0 10. FORMAT "%10.5"
 /begin ANNOTATION ANNOTATION_LABEL "Description (coming from AUTOSAR DESC field)"
  /begin ANNOTATION_TEXT "Maximum time, after which the clutch main pressure valve is considered failed/cut off valve failed on, against temp.\r\n" /end ANNOTATION_TEXT
 /end ANNOTATION
 /begin AXIS_DESCR STD_AXIS NO_INPUT_QUANTITY RB_PT_PCT_SWC_DWC_CompuMethods_ident 4 -50. 200. FORMAT "%10.5" DEPOSIT ABSOLUTE /end AXIS_DESCR
/end CHARACTERISTIC
/begin CHARACTERISTIC DWC_CALIB.DWC_K2DeviceControl.DWC_ShutOffHandler.DWC_SOHPRESSURESLOWRESPONSETIMEMAP "" CURVE 0x8060EF62 RB_PT_PCT_SWC_DWC_RecordLayouts_RL_Curve_uint16_4_sint16_4 10.0 RB_PT_PCT_SWC_DWC_CompuMethods_ratio_0p001__2 0.0 10. FORMAT "%10.5"
 /begin ANNOTATION ANNOTATION_LABEL "Description (coming from AUTOSAR DESC field)"
  /begin ANNOTATION_TEXT "Maximum time, after which the clutch main pressure valve is considered slow, and a larger request will be applied (also, starting diagnostics on that valve), against temp.\r\n" /end ANNOTATION_TEXT
 /end ANNOTATION
 /begin AXIS_DESCR STD_AXIS NO_INPUT_QUANTITY RB_PT_PCT_SWC_DWC_CompuMethods_ident 4 -50. 200. FORMAT "%10.5" DEPOSIT ABSOLUTE /end AXIS_DESCR
/end CHARACTERISTIC
/begin CHARACTERISTIC DWC_CALIB.DWC_K2DeviceControl.DWC_ShutOffHandler.DWC_SOHVALVERESPONSEMAXTIMEMAP "" CURVE 0x8060EF74 RB_PT_PCT_SWC_DWC_RecordLayouts_RL_Curve_uint16_4_sint16_4 10.0 RB_PT_PCT_SWC_DWC_CompuMethods_ratio_0p001__2 0.0 10. FORMAT "%10.5"
 /begin ANNOTATION ANNOTATION_LABEL "Description (coming from AUTOSAR DESC field)"
  /begin ANNOTATION_TEXT "Maximum time for shut off valve to respond, after which it will be marked as failed, against temp.\r\n" /end ANNOTATION_TEXT
 /end ANNOTATION
 /begin AXIS_DESCR STD_AXIS NO_INPUT_QUANTITY RB_PT_PCT_SWC_DWC_CompuMethods_ident 4 -50. 200. FORMAT "%10.5" DEPOSIT ABSOLUTE /end AXIS_DESCR
/end CHARACTERISTIC
/begin CHARACTERISTIC DWC_CALIB.DWC_K2DeviceControl.DWC_TEMPMAXVALVECLEAN "" VALUE 0x8060ED2E DefaultValueRecordLayout_AUTOSAR_Platform_BaseTypes_sint16 250.0 RB_PT_PCT_SWC_DWC_CompuMethods_ident -50. 200. FORMAT "%10.5"
 /begin ANNOTATION ANNOTATION_LABEL "Description (coming from AUTOSAR DESC field)" /begin ANNOTATION_TEXT "Maximum temperature to allow valve clean\r\n" /end ANNOTATION_TEXT /end ANNOTATION
/end CHARACTERISTIC
/begin CHARACTERISTIC DWC_CALIB.DWC_K2DeviceControl.DWC_TEMPMAXVALVERINSE "" VALUE 0x8060ED30 DefaultValueRecordLayout_AUTOSAR_Platform_BaseTypes_sint16 250.0 RB_PT_PCT_SWC_DWC_CompuMethods_ident -50. 200. FORMAT "%10.5"
 /begin ANNOTATION ANNOTATION_LABEL "Description (coming from AUTOSAR DESC field)" /begin ANNOTATION_TEXT "Maximum temperature to allow valve rinse\r\n" /end ANNOTATION_TEXT /end ANNOTATION
/end CHARACTERISTIC
/begin CHARACTERISTIC DWC_CALIB.DWC_K2DeviceControl.DWC_TEMPMINBLIP "" VALUE 0x8060ED32 DefaultValueRecordLayout_AUTOSAR_Platform_BaseTypes_sint16 250.0 RB_PT_PCT_SWC_DWC_CompuMethods_ident -50. 200. FORMAT "%10.5"
 /begin ANNOTATION ANNOTATION_LABEL "Description (coming from AUTOSAR DESC field)"
  /begin ANNOTATION_TEXT "Minimum blip temperature cal when temperature status is true.\r\n" /end ANNOTATION_TEXT
 /end ANNOTATION
/end CHARACTERISTIC
/begin CHARACTERISTIC DWC_CALIB.DWC_K2DeviceControl.DWC_TEMPMINVALVECLEAN "" VALUE 0x8060ED34 DefaultValueRecordLayout_AUTOSAR_Platform_BaseTypes_sint16 250.0 RB_PT_PCT_SWC_DWC_CompuMethods_ident -50. 200. FORMAT "%10.5"
 /begin ANNOTATION ANNOTATION_LABEL "Description (coming from AUTOSAR DESC field)" /begin ANNOTATION_TEXT "Minimum temperature to allow valve clean\r\n" /end ANNOTATION_TEXT /end ANNOTATION
/end CHARACTERISTIC
/begin CHARACTERISTIC DWC_CALIB.DWC_K2DeviceControl.DWC_TEMPMINVALVERINSE "" VALUE 0x8060ED36 DefaultValueRecordLayout_AUTOSAR_Platform_BaseTypes_sint16 250.0 RB_PT_PCT_SWC_DWC_CompuMethods_ident -50. 200. FORMAT "%10.5"
 /begin ANNOTATION ANNOTATION_LABEL "Description (coming from AUTOSAR DESC field)" /begin ANNOTATION_TEXT "Minimum temperature to allow valve rinse\r\n" /end ANNOTATION_TEXT /end ANNOTATION
/end CHARACTERISTIC
/begin CHARACTERISTIC DWC_CALIB.DWC_K2DeviceControl.DWC_TrqPress.DWC_ENABLEKPSTATEMIN "" VALUE 0x8060EF86 DefaultValueRecordLayout_AUTOSAR_Platform_BaseTypes_uint8 255.0 DefaultIdenticalCompu 0.0 255. FORMAT "%10.5"
 /begin ANNOTATION ANNOTATION_LABEL "Description (coming from AUTOSAR DESC field)" /begin ANNOTATION_TEXT "use to enable TP adaption fault for KP hit min limit\r\n" /end ANNOTATION_TEXT /end ANNOTATION
/end CHARACTERISTIC
/begin CHARACTERISTIC DWC_CALIB.DWC_K2DeviceControl.DWC_TrqPress.DWC_ENABLEMAXTPSTATEMAX "" VALUE 0x8060EF87 DefaultValueRecordLayout_AUTOSAR_Platform_BaseTypes_uint8 255.0 DefaultIdenticalCompu 0.0 255. FORMAT "%10.5"
 /begin ANNOTATION ANNOTATION_LABEL "Description (coming from AUTOSAR DESC field)"
  /begin ANNOTATION_TEXT "use to enable TP adaption fault for max torque max limit hit\r\n" /end ANNOTATION_TEXT
 /end ANNOTATION
/end CHARACTERISTIC
/begin CHARACTERISTIC DWC_CALIB.DWC_K2DeviceControl.DWC_TrqPress.DWC_ENABLEMAXTPSTATEMIN "" VALUE 0x8060EF88 DefaultValueRecordLayout_AUTOSAR_Platform_BaseTypes_uint8 255.0 DefaultIdenticalCompu 0.0 255. FORMAT "%10.5"
 /begin ANNOTATION ANNOTATION_LABEL "Description (coming from AUTOSAR DESC field)"
  /begin ANNOTATION_TEXT "use to enable TP adaption fault for max torque min limit hit\r\n" /end ANNOTATION_TEXT
 /end ANNOTATION
/end CHARACTERISTIC
/begin CHARACTERISTIC DWC_CALIB.DWC_K2DeviceControl.DWC_TrqPress.DWC_EnableTP67Copy "" VALUE 0x8060EF8A DefaultValueRecordLayout_AUTOSAR_Platform_BaseTypes_uint8 255.0 DefaultIdenticalCompu 0.0 255. FORMAT "%10.5"
 /begin ANNOTATION ANNOTATION_LABEL "Description (coming from AUTOSAR DESC field)" /begin ANNOTATION_TEXT "flag to copy adaption from position 6 to 7\r\n" /end ANNOTATION_TEXT /end ANNOTATION
/end CHARACTERISTIC
/begin CHARACTERISTIC DWC_CALIB.DWC_K2DeviceControl.DWC_TrqPress.DWC_ENABLKPSTATEMAX "" VALUE 0x8060EF89 DefaultValueRecordLayout_AUTOSAR_Platform_BaseTypes_uint8 255.0 DefaultIdenticalCompu 0.0 255. FORMAT "%10.5"
 /begin ANNOTATION ANNOTATION_LABEL "Description (coming from AUTOSAR DESC field)" /begin ANNOTATION_TEXT "use to enable TP adaption fault for KP hit max limit\r\n" /end ANNOTATION_TEXT /end ANNOTATION
/end CHARACTERISTIC
/begin CHARACTERISTIC DWC_CALIB.DWC_K2DeviceControl.DWC_TrqPress.DWC_KisspointSequencer.DWC_BOBSTATICKPSMFIX "" VALUE 0x8060EF90 DefaultValueRecordLayout_AUTOSAR_Platform_BaseTypes_boolean 255.0 AUTOSAR_Platform_CompuMethods_boolean 0.0 255. FORMAT "%10.5"
 /begin ANNOTATION ANNOTATION_LABEL "Description (coming from AUTOSAR DESC field)"
  /begin ANNOTATION_TEXT "Parameter to enable to fix that will allow static adaptions to cancel when OBD_NOTEST is seen.\r\n" /end ANNOTATION_TEXT
 /end ANNOTATION
/end CHARACTERISTIC
/begin CHARACTERISTIC DWC_CALIB.DWC_K2DeviceControl.DWC_TrqPress.DWC_KisspointSequencer.DWC_FLGABORTFORGEARTIMEOUT "" VALUE 0x8060EF91 DefaultValueRecordLayout_AUTOSAR_Platform_BaseTypes_boolean 255.0 AUTOSAR_Platform_CompuMethods_boolean 0.0 255. FORMAT "%10.5"
 /begin ANNOTATION ANNOTATION_LABEL "Description (coming from AUTOSAR DESC field)" /begin ANNOTATION_TEXT "Flag to enable KP learn due to gear engage timeout.\r\n" /end ANNOTATION_TEXT /end ANNOTATION
/end CHARACTERISTIC
/begin CHARACTERISTIC DWC_CALIB.DWC_K2DeviceControl.DWC_TrqPress.DWC_KisspointSequencer.DWC_KPABORTTRUETIME "" VALUE 0x8060EF8C DefaultValueRecordLayout_AUTOSAR_Platform_BaseTypes_uint16 10.0 RB_PT_PCT_SWC_DWC_CompuMethods_ratio_0p001__2 0.0 10. FORMAT "%10.5"
 /begin ANNOTATION ANNOTATION_LABEL "Description (coming from AUTOSAR DESC field)" /begin ANNOTATION_TEXT "Time for which abort flag should be true.\r\n" /end ANNOTATION_TEXT /end ANNOTATION
/end CHARACTERISTIC
/begin CHARACTERISTIC DWC_CALIB.DWC_K2DeviceControl.DWC_TrqPress.DWC_KisspointSequencer.DWC_KPMAXTIMEFORENGAGINGGEAR "" VALUE 0x8060EF8E DefaultValueRecordLayout_AUTOSAR_Platform_BaseTypes_uint16 10.0 RB_PT_PCT_SWC_DWC_CompuMethods_ratio_0p001__2 0.0 10. FORMAT "%10.5"
 /begin ANNOTATION ANNOTATION_LABEL "Description (coming from AUTOSAR DESC field)" /begin ANNOTATION_TEXT "Max allowable timeout for gear engagement\r\n" /end ANNOTATION_TEXT /end ANNOTATION
/end CHARACTERISTIC
/begin CHARACTERISTIC DWC_CALIB.DWC_K2DeviceControl.DWC_TrqPress.DWC_MAXADAPTSTATUSINDEX "" VALUE 0x8060EF8B DefaultValueRecordLayout_AUTOSAR_Platform_BaseTypes_uint8 8.0 RB_PT_PCT_SWC_DWC_CompuMethods_ident 0.0 8. FORMAT "%10.5"
 /begin ANNOTATION ANNOTATION_LABEL "Description (coming from AUTOSAR DESC field)"
  /begin ANNOTATION_TEXT "Index of TP adaption to monitor for out of bounds errors.\r\n" /end ANNOTATION_TEXT
 /end ANNOTATION
/end CHARACTERISTIC
/begin CHARACTERISTIC DWC_CALIB.DWC_K2DeviceControl.DWC_USEIOPPRESSUREFORDIAG "" VALUE 0x8060ED4D DefaultValueRecordLayout_AUTOSAR_Platform_BaseTypes_boolean 255.0 AUTOSAR_Platform_CompuMethods_boolean 0.0 255. FORMAT "%10.5"
 /begin ANNOTATION ANNOTATION_LABEL "Description (coming from AUTOSAR DESC field)"
  /begin ANNOTATION_TEXT "Set true to use 'raw' pressure signal from IOP rather than from DWC input processing.\r\n" /end ANNOTATION_TEXT
 /end ANNOTATION
/end CHARACTERISTIC
/begin CHARACTERISTIC DWC_CALIB.DWC_K2DeviceControl.DWC_USELINEPRESSUREFOROSG "" VALUE 0x8060ED4E DefaultValueRecordLayout_AUTOSAR_Platform_BaseTypes_boolean 255.0 AUTOSAR_Platform_CompuMethods_boolean 0.0 255. FORMAT "%10.5"
 /begin ANNOTATION ANNOTATION_LABEL "Description (coming from AUTOSAR DESC field)"
  /begin ANNOTATION_TEXT "Flag to use line pressure for 'Oil Supply Good' flag.\r\n" /end ANNOTATION_TEXT
 /end ANNOTATION
/end CHARACTERISTIC
/begin CHARACTERISTIC DWC_CALIB.DWC_K2DeviceControl.DWC_USEVALVECLEANDEMANDS "" VALUE 0x8060ED4F DefaultValueRecordLayout_AUTOSAR_Platform_BaseTypes_uint8 255.0 DefaultIdenticalCompu 0.0 255. FORMAT "%10.5"
 /begin ANNOTATION ANNOTATION_LABEL "Description (coming from AUTOSAR DESC field)"
  /begin ANNOTATION_TEXT "Set true to use pressure demands that have been passed through the valve clean class\r\n" /end ANNOTATION_TEXT
 /end ANNOTATION
/end CHARACTERISTIC
/begin CHARACTERISTIC DWC_CALIB.DWC_K2DeviceControl.DWC_USEVCPRESDEMWHENCLEANING "" VALUE 0x8060ED50 DefaultValueRecordLayout_AUTOSAR_Platform_BaseTypes_boolean 255.0 AUTOSAR_Platform_CompuMethods_boolean 0.0 255. FORMAT "%10.5"
 /begin ANNOTATION ANNOTATION_LABEL "Description (coming from AUTOSAR DESC field)"
  /begin ANNOTATION_TEXT "Flag to use VC pressure demand when a clean is active.\r\n" /end ANNOTATION_TEXT
 /end ANNOTATION
/end CHARACTERISTIC
/begin CHARACTERISTIC DWC_CALIB.DWC_K2DeviceControl.DWC_ValveClean.DWC_PCTVALVECLOSEDCLEANEARLYCOMPLETE "" VALUE 0x8060EFAE DefaultValueRecordLayout_AUTOSAR_Platform_BaseTypes_uint8 1.0 RB_PT_PCT_SWC_DWC_CompuMethods_ratio_0p01 0.0 1. FORMAT "%10.5"
 /begin ANNOTATION ANNOTATION_LABEL "Description (coming from AUTOSAR DESC field)"
  /begin ANNOTATION_TEXT "Percentage of full rinse time where an early abortion still leads to a timeout condition\r\n" /end ANNOTATION_TEXT
 /end ANNOTATION
/end CHARACTERISTIC
/begin CHARACTERISTIC DWC_CALIB.DWC_K2DeviceControl.DWC_ValveClean.DWC_PCTVALVEOPENCLEANEARLYCOMPLETE "" VALUE 0x8060EFAF DefaultValueRecordLayout_AUTOSAR_Platform_BaseTypes_uint8 1.0 RB_PT_PCT_SWC_DWC_CompuMethods_ratio_0p01 0.0 1. FORMAT "%10.5"
 /begin ANNOTATION ANNOTATION_LABEL "Description (coming from AUTOSAR DESC field)"
  /begin ANNOTATION_TEXT "Percentage of full rinse time where an early abortion still leads to a timeout condition\r\n" /end ANNOTATION_TEXT
 /end ANNOTATION
/end CHARACTERISTIC
/begin CHARACTERISTIC DWC_CALIB.DWC_K2DeviceControl.DWC_ValveClean.DWC_PCTVALVERINSEEARLYCOMPLETE "" VALUE 0x8060EFB0 DefaultValueRecordLayout_AUTOSAR_Platform_BaseTypes_uint8 1.0 RB_PT_PCT_SWC_DWC_CompuMethods_ratio_0p01 0.0 1. FORMAT "%10.5"
 /begin ANNOTATION ANNOTATION_LABEL "Description (coming from AUTOSAR DESC field)"
  /begin ANNOTATION_TEXT "Percentage of full rinse time where an early abortion still leads to a timeout condition\r\n" /end ANNOTATION_TEXT
 /end ANNOTATION
/end CHARACTERISTIC
/begin CHARACTERISTIC DWC_CALIB.DWC_K2DeviceControl.DWC_ValveClean.DWC_PRESSURECLOSEDCLEANMAX "" CURVE 0x8060EFB2 RB_PT_PCT_SWC_DWC_RecordLayouts_RL_Curve_sint16_5_sint16_5 34.0 RB_PT_PCT_SWC_DWC_CompuMethods_ratio_0p001__2 -2. 32. FORMAT "%10.5"
 /begin ANNOTATION ANNOTATION_LABEL "Description (coming from AUTOSAR DESC field)" /begin ANNOTATION_TEXT "Lower limit lookup\r\n" /end ANNOTATION_TEXT /end ANNOTATION
 /begin AXIS_DESCR STD_AXIS NO_INPUT_QUANTITY RB_PT_PCT_SWC_DWC_CompuMethods_ratio_0p001__2 5 -2. 32. FORMAT "%10.5" DEPOSIT ABSOLUTE /end AXIS_DESCR
/end CHARACTERISTIC
/begin CHARACTERISTIC DWC_CALIB.DWC_K2DeviceControl.DWC_ValveClean.DWC_PRESSUREOPENCLEANMAX "" CURVE 0x8060EFC8 RB_PT_PCT_SWC_DWC_RecordLayouts_RL_Curve_sint16_5_sint16_5 34.0 RB_PT_PCT_SWC_DWC_CompuMethods_ratio_0p001__2 -2. 32. FORMAT "%10.5"
 /begin ANNOTATION ANNOTATION_LABEL "Description (coming from AUTOSAR DESC field)" /begin ANNOTATION_TEXT "Lower limit lookup\r\n" /end ANNOTATION_TEXT /end ANNOTATION
 /begin AXIS_DESCR STD_AXIS NO_INPUT_QUANTITY RB_PT_PCT_SWC_DWC_CompuMethods_ratio_0p001__2 5 -2. 32. FORMAT "%10.5" DEPOSIT ABSOLUTE /end AXIS_DESCR
/end CHARACTERISTIC
/begin CHARACTERISTIC DWC_CALIB.DWC_K2DeviceControl.DWC_ValveClean.DWC_PRESSUREOVERHEADMAX "" CURVE 0x8060EFDE RB_PT_PCT_SWC_DWC_RecordLayouts_RL_Curve_sint16_5_sint16_5 34.0 RB_PT_PCT_SWC_DWC_CompuMethods_ratio_0p001__2 -2. 32. FORMAT "%10.5"
 /begin ANNOTATION ANNOTATION_LABEL "Description (coming from AUTOSAR DESC field)" /begin ANNOTATION_TEXT "Lower limit lookup\r\n" /end ANNOTATION_TEXT /end ANNOTATION
 /begin AXIS_DESCR STD_AXIS NO_INPUT_QUANTITY RB_PT_PCT_SWC_DWC_CompuMethods_ratio_0p001__2 5 -2. 32. FORMAT "%10.5" DEPOSIT ABSOLUTE /end AXIS_DESCR
/end CHARACTERISTIC
/begin CHARACTERISTIC DWC_CALIB.DWC_K2DeviceControl.DWC_ValveClean.DWC_PRESSUREOVERHEADMIN "" CURVE 0x8060EFF4 RB_PT_PCT_SWC_DWC_RecordLayouts_RL_Curve_sint16_5_sint16_5 34.0 RB_PT_PCT_SWC_DWC_CompuMethods_ratio_0p001__2 -2. 32. FORMAT "%10.5"
 /begin ANNOTATION ANNOTATION_LABEL "Description (coming from AUTOSAR DESC field)" /begin ANNOTATION_TEXT "Lower limit lookup\r\n" /end ANNOTATION_TEXT /end ANNOTATION
 /begin AXIS_DESCR STD_AXIS NO_INPUT_QUANTITY RB_PT_PCT_SWC_DWC_CompuMethods_ratio_0p001__2 5 -2. 32. FORMAT "%10.5" DEPOSIT ABSOLUTE /end AXIS_DESCR
/end CHARACTERISTIC
/begin CHARACTERISTIC DWC_CALIB.DWC_K2DeviceControl.DWC_ValveClean.DWC_TF_FCTROPENCLEANCURRENT "" CURVE 0x8060F00A RB_PT_PCT_SWC_DWC_RecordLayouts_RL_Curve_uint16_11_uint16_11 1.0 RB_PT_PCT_SWC_DWC_CompuMethods_Ratio_0p001 0.0 1. FORMAT "%10.5"
 /begin ANNOTATION ANNOTATION_LABEL "Description (coming from AUTOSAR DESC field)" /begin ANNOTATION_TEXT "Depressure fctr\r\n" /end ANNOTATION_TEXT /end ANNOTATION
 /begin AXIS_DESCR STD_AXIS NO_INPUT_QUANTITY RB_PT_PCT_SWC_DWC_CompuMethods_DST_Time 11 0.0 655.35 FORMAT "%10.5" DEPOSIT ABSOLUTE /end AXIS_DESCR
/end CHARACTERISTIC
/begin CHARACTERISTIC DWC_CALIB.DWC_K2DeviceControl.DWC_ValveClean.DWC_TF_FCTRROUTINECLEANCURRENT "" CURVE 0x8060F038 RB_PT_PCT_SWC_DWC_RecordLayouts_RL_Curve_uint16_11_uint16_11 1.0 RB_PT_PCT_SWC_DWC_CompuMethods_Ratio_0p001 0.0 1. FORMAT "%10.5"
 /begin ANNOTATION ANNOTATION_LABEL "Description (coming from AUTOSAR DESC field)" /begin ANNOTATION_TEXT "Depressure fctr\r\n" /end ANNOTATION_TEXT /end ANNOTATION
 /begin AXIS_DESCR STD_AXIS NO_INPUT_QUANTITY RB_PT_PCT_SWC_DWC_CompuMethods_DST_Time 11 0.0 655.35 FORMAT "%10.5" DEPOSIT ABSOLUTE /end AXIS_DESCR
/end CHARACTERISTIC
/begin CHARACTERISTIC DWC_CALIB.DWC_K2DeviceControl.DWC_ValveClean.DWC_TIMEROUTINECLEAN "" VALUE 0x8060EFA0 DefaultValueRecordLayout_AUTOSAR_Platform_BaseTypes_uint16 65.535 RB_PT_PCT_SWC_DWC_CompuMethods_ratio_0p001__2 0.0 65.535 FORMAT "%10.5"
 /begin ANNOTATION ANNOTATION_LABEL "Description (coming from AUTOSAR DESC field)" /begin ANNOTATION_TEXT "Maximum time before valve clean timeout\r\n" /end ANNOTATION_TEXT /end ANNOTATION
/end CHARACTERISTIC
/begin CHARACTERISTIC DWC_CALIB.DWC_K2DeviceControl.DWC_ValveClean.DWC_TIMEVALVECLEANHALFCYCLE "" VALUE 0x8060EFB1 DefaultValueRecordLayout_AUTOSAR_Platform_BaseTypes_uint8 1.275 RB_PT_PCT_SWC_DWC_CompuMethods_ratio_0p005 0.0 1.275 FORMAT "%10.5"
 /begin ANNOTATION ANNOTATION_LABEL "Description (coming from AUTOSAR DESC field)" /begin ANNOTATION_TEXT "Half period of valve cycle\r\n" /end ANNOTATION_TEXT /end ANNOTATION
/end CHARACTERISTIC
/begin CHARACTERISTIC DWC_CALIB.DWC_K2DeviceControl.DWC_ValveClean.DWC_TIMEVALVECLOSEDCLEAN "" VALUE 0x8060EFA2 DefaultValueRecordLayout_AUTOSAR_Platform_BaseTypes_uint16 65.535 RB_PT_PCT_SWC_DWC_CompuMethods_ratio_0p001__2 0.0 65.535 FORMAT "%10.5"
 /begin ANNOTATION ANNOTATION_LABEL "Description (coming from AUTOSAR DESC field)" /begin ANNOTATION_TEXT "Maximum time before valve clean timeout\r\n" /end ANNOTATION_TEXT /end ANNOTATION
/end CHARACTERISTIC
/begin CHARACTERISTIC DWC_CALIB.DWC_K2DeviceControl.DWC_ValveClean.DWC_TIMEVALVECLOSEDCLEANRESET "" VALUE 0x8060EF94 DefaultValueRecordLayout_AUTOSAR_Platform_BaseTypes_uint32 4294967.295 RB_PT_PCT_SWC_DWC_CompuMethods_ratio_0p001__2 0.0 4294967.295 FORMAT "%10.5"
 /begin ANNOTATION ANNOTATION_LABEL "Description (coming from AUTOSAR DESC field)" /begin ANNOTATION_TEXT "Maximum time before valve rinse timeout\r\n" /end ANNOTATION_TEXT /end ANNOTATION
/end CHARACTERISTIC
/begin CHARACTERISTIC DWC_CALIB.DWC_K2DeviceControl.DWC_ValveClean.DWC_TIMEVALVEOPENCLEAN "" VALUE 0x8060EFA4 DefaultValueRecordLayout_AUTOSAR_Platform_BaseTypes_uint16 65.535 RB_PT_PCT_SWC_DWC_CompuMethods_ratio_0p001__2 0.0 65.535 FORMAT "%10.5"
 /begin ANNOTATION ANNOTATION_LABEL "Description (coming from AUTOSAR DESC field)" /begin ANNOTATION_TEXT "Maximum time before valve clean timeout\r\n" /end ANNOTATION_TEXT /end ANNOTATION
/end CHARACTERISTIC
/begin CHARACTERISTIC DWC_CALIB.DWC_K2DeviceControl.DWC_ValveClean.DWC_TIMEVALVEOPENCLEANRESET "" VALUE 0x8060EF98 DefaultValueRecordLayout_AUTOSAR_Platform_BaseTypes_uint32 4294967.295 RB_PT_PCT_SWC_DWC_CompuMethods_ratio_0p001__2 0.0 4294967.295 FORMAT "%10.5"
 /begin ANNOTATION ANNOTATION_LABEL "Description (coming from AUTOSAR DESC field)" /begin ANNOTATION_TEXT "Maximum time before valve rinse timeout\r\n" /end ANNOTATION_TEXT /end ANNOTATION
/end CHARACTERISTIC
/begin CHARACTERISTIC DWC_CALIB.DWC_K2DeviceControl.DWC_ValveClean.DWC_TIMEVALVEPRECLOSEDCLEAN "" VALUE 0x8060EFA6 DefaultValueRecordLayout_AUTOSAR_Platform_BaseTypes_uint16 65.535 RB_PT_PCT_SWC_DWC_CompuMethods_ratio_0p001__2 0.0 65.535 FORMAT "%10.5"
 /begin ANNOTATION ANNOTATION_LABEL "Description (coming from AUTOSAR DESC field)" /begin ANNOTATION_TEXT "Maximum time before valve clean timeout\r\n" /end ANNOTATION_TEXT /end ANNOTATION
/end CHARACTERISTIC
/begin CHARACTERISTIC DWC_CALIB.DWC_K2DeviceControl.DWC_ValveClean.DWC_TIMEVALVEPREOPENCLEAN "" VALUE 0x8060EFA8 DefaultValueRecordLayout_AUTOSAR_Platform_BaseTypes_uint16 65.535 RB_PT_PCT_SWC_DWC_CompuMethods_ratio_0p001__2 0.0 65.535 FORMAT "%10.5"
 /begin ANNOTATION ANNOTATION_LABEL "Description (coming from AUTOSAR DESC field)" /begin ANNOTATION_TEXT "Maximum time before valve clean timeout\r\n" /end ANNOTATION_TEXT /end ANNOTATION
/end CHARACTERISTIC
/begin CHARACTERISTIC DWC_CALIB.DWC_K2DeviceControl.DWC_ValveClean.DWC_TIMEVALVEPRERINSE "" VALUE 0x8060EFAA DefaultValueRecordLayout_AUTOSAR_Platform_BaseTypes_uint16 65.535 RB_PT_PCT_SWC_DWC_CompuMethods_ratio_0p001__2 0.0 65.535 FORMAT "%10.5"
 /begin ANNOTATION ANNOTATION_LABEL "Description (coming from AUTOSAR DESC field)" /begin ANNOTATION_TEXT "Maximum time before valve clean timeout\r\n" /end ANNOTATION_TEXT /end ANNOTATION
/end CHARACTERISTIC
/begin CHARACTERISTIC DWC_CALIB.DWC_K2DeviceControl.DWC_ValveClean.DWC_TIMEVALVERINSE "" VALUE 0x8060EFAC DefaultValueRecordLayout_AUTOSAR_Platform_BaseTypes_uint16 65.535 RB_PT_PCT_SWC_DWC_CompuMethods_ratio_0p001__2 0.0 65.535 FORMAT "%10.5"
 /begin ANNOTATION ANNOTATION_LABEL "Description (coming from AUTOSAR DESC field)" /begin ANNOTATION_TEXT "Maximum time before valve clean timeout\r\n" /end ANNOTATION_TEXT /end ANNOTATION
/end CHARACTERISTIC
/begin CHARACTERISTIC DWC_CALIB.DWC_K2DeviceControl.DWC_ValveClean.DWC_TIMEVALVERINSERESET "" VALUE 0x8060EF9C DefaultValueRecordLayout_AUTOSAR_Platform_BaseTypes_uint32 4294967.295 RB_PT_PCT_SWC_DWC_CompuMethods_ratio_0p001__2 0.0 4294967.295 FORMAT "%10.5"
 /begin ANNOTATION ANNOTATION_LABEL "Description (coming from AUTOSAR DESC field)" /begin ANNOTATION_TEXT "Maximum time before valve rinse timeout\r\n" /end ANNOTATION_TEXT /end ANNOTATION
/end CHARACTERISTIC
/begin CHARACTERISTIC DWC_CALIB.DWC_L2DBLCLUTCH "" VALUE 0x8060E70A DefaultValueRecordLayout_AUTOSAR_Platform_BaseTypes_uint16 65535.0 RB_PT_PCT_SWC_DWC_CompuMethods_ident 0.0 65535. FORMAT "%10.5"
 /begin ANNOTATION ANNOTATION_LABEL "Description (coming from AUTOSAR DESC field)"
  /begin ANNOTATION_TEXT "Used to trigger double clutch engage use with caution\r\n" /end ANNOTATION_TEXT
 /end ANNOTATION
/end CHARACTERISTIC
/begin CHARACTERISTIC DWC_CALIB.DWC_MaxPaTrqEPBEngaged "" VALUE 0x8060E70E DefaultValueRecordLayout_AUTOSAR_Platform_BaseTypes_sint16 4000.0 RB_PT_PCT_SWC_DWC_CompuMethods_ratio_0p1 -2000. 2000. FORMAT "%10.5"
 /begin ANNOTATION ANNOTATION_LABEL "Description (coming from AUTOSAR DESC field)" /begin ANNOTATION_TEXT "max final pullaway torque when EPB engaged.\r\n" /end ANNOTATION_TEXT /end ANNOTATION
/end CHARACTERISTIC
/begin CHARACTERISTIC DWC_CALIB.DWC_MINCOOLINGREV "" VALUE 0x8060E70C DefaultValueRecordLayout_AUTOSAR_Platform_BaseTypes_uint16 127.5 RB_PT_PCT_SWC_DWC_CompuMethods_flow_0p01 0.0 127.5 FORMAT "%10.5"
 /begin ANNOTATION ANNOTATION_LABEL "Description (coming from AUTOSAR DESC field)" /begin ANNOTATION_TEXT "Min cooling in reverse\r\n" /end ANNOTATION_TEXT /end ANNOTATION
/end CHARACTERISTIC
/begin CHARACTERISTIC DWC_CALIB.DWC_OVERRIDECURRENTFBCHECK "" VALUE 0x8060E735 DefaultValueRecordLayout_AUTOSAR_Platform_BaseTypes_uint8 255.0 DefaultIdenticalCompu 0.0 255. FORMAT "%10.5"
 /begin ANNOTATION ANNOTATION_LABEL "Description (coming from AUTOSAR DESC field)"
  /begin ANNOTATION_TEXT "Flag to override the current feedback checks in thermal model.\r\n" /end ANNOTATION_TEXT
 /end ANNOTATION
/end CHARACTERISTIC
/begin CHARACTERISTIC DWC_CALIB.DWC_P2TORQUEHYST "" VALUE 0x8060E710 DefaultValueRecordLayout_AUTOSAR_Platform_BaseTypes_uint16 2000.0 RB_PT_PCT_SWC_DWC_CompuMethods_ratio_0p1 0.0 2000. FORMAT "%10.5"
 /begin ANNOTATION ANNOTATION_LABEL "Description (coming from AUTOSAR DESC field)" /begin ANNOTATION_TEXT "Torque hysteresis for P2 engine start\r\n" /end ANNOTATION_TEXT /end ANNOTATION
/end CHARACTERISTIC
/begin CHARACTERISTIC DWC_CALIB.DWC_P2TORQUEOFFSET "" VALUE 0x8060E712 DefaultValueRecordLayout_AUTOSAR_Platform_BaseTypes_uint16 2000.0 RB_PT_PCT_SWC_DWC_CompuMethods_ratio_0p1 0.0 2000. FORMAT "%10.5"
 /begin ANNOTATION ANNOTATION_LABEL "Description (coming from AUTOSAR DESC field)"
  /begin ANNOTATION_TEXT "Torque offset to target torque for declaring clutch torque is OK for P2 engine start\r\n" /end ANNOTATION_TEXT
 /end ANNOTATION
/end CHARACTERISTIC
/begin CHARACTERISTIC DWC_CALIB.DWC_SpeedPhaseControl.DWC_GradientProfiler.DWC_ENDBLENDMAPSELECT "" VAL_BLK 0x8060F2F4 DefaultValueRecordLayout_AUTOSAR_Platform_BaseTypes_uint8 3.0 RB_PT_PCT_SWC_DWC_CompuMethods_ident 0.0 3. FORMAT "%10.5"
 /begin ANNOTATION ANNOTATION_LABEL "Description (coming from AUTOSAR DESC field)"
  /begin ANNOTATION_TEXT "Transfer function to map shiftmodeudisc to end blend map.\r\n" /end ANNOTATION_TEXT
 /end ANNOTATION
 MATRIX_DIM 8 1 1 /end CHARACTERISTIC
/begin CHARACTERISTIC DWC_CALIB.DWC_SpeedPhaseControl.DWC_MaxGradient.DWC_CURTGTFORDWNGRAD "" VALUE 0x8060F2FC DefaultValueRecordLayout_AUTOSAR_Platform_BaseTypes_boolean 255.0 AUTOSAR_Platform_CompuMethods_boolean 0.0 255. FORMAT "%10.5"
 /begin ANNOTATION ANNOTATION_LABEL "Description (coming from AUTOSAR DESC field)"
  /begin ANNOTATION_TEXT "Flag to use the current gear target for gradient calculation of power on down.\r\n" /end ANNOTATION_TEXT
 /end ANNOTATION
/end CHARACTERISTIC
/begin CHARACTERISTIC DWC_CALIB.DWC_SpeedPhaseControl.DWC_MaxGradient.DWC_DISABLEKICKDOWNMAPS "" VALUE 0x8060F2FD DefaultValueRecordLayout_AUTOSAR_Platform_BaseTypes_boolean 255.0 AUTOSAR_Platform_CompuMethods_boolean 0.0 255. FORMAT "%10.5"
 /begin ANNOTATION ANNOTATION_LABEL "Description (coming from AUTOSAR DESC field)" /begin ANNOTATION_TEXT "Flag to disable the kickdown specific gradient maps.\r\n" /end ANNOTATION_TEXT /end ANNOTATION
/end CHARACTERISTIC
/begin CHARACTERISTIC DWC_CALIB.DWC_TEMPMAXVALVECLEAN "" VALUE 0x8060E714 DefaultValueRecordLayout_AUTOSAR_Platform_BaseTypes_sint16 250.0 RB_PT_PCT_SWC_DWC_CompuMethods_ident -50. 200. FORMAT "%10.5"
 /begin ANNOTATION ANNOTATION_LABEL "Description (coming from AUTOSAR DESC field)" /begin ANNOTATION_TEXT "Maximum temperature to allow valve clean\r\n" /end ANNOTATION_TEXT /end ANNOTATION
/end CHARACTERISTIC
/begin CHARACTERISTIC DWC_CALIB.DWC_TEMPMAXVALVERINSE "" VALUE 0x8060E716 DefaultValueRecordLayout_AUTOSAR_Platform_BaseTypes_sint16 250.0 RB_PT_PCT_SWC_DWC_CompuMethods_ident -50. 200. FORMAT "%10.5"
 /begin ANNOTATION ANNOTATION_LABEL "Description (coming from AUTOSAR DESC field)" /begin ANNOTATION_TEXT "Maximum temperature to allow valve rinse\r\n" /end ANNOTATION_TEXT /end ANNOTATION
/end CHARACTERISTIC
/begin CHARACTERISTIC DWC_CALIB.DWC_TEMPMINVALVECLEAN "" VALUE 0x8060E718 DefaultValueRecordLayout_AUTOSAR_Platform_BaseTypes_sint16 250.0 RB_PT_PCT_SWC_DWC_CompuMethods_ident -50. 200. FORMAT "%10.5"
 /begin ANNOTATION ANNOTATION_LABEL "Description (coming from AUTOSAR DESC field)" /begin ANNOTATION_TEXT "Minimum temperature to allow valve clean\r\n" /end ANNOTATION_TEXT /end ANNOTATION
/end CHARACTERISTIC
/begin CHARACTERISTIC DWC_CALIB.DWC_TEMPMINVALVERINSE "" VALUE 0x8060E71A DefaultValueRecordLayout_AUTOSAR_Platform_BaseTypes_sint16 250.0 RB_PT_PCT_SWC_DWC_CompuMethods_ident -50. 200. FORMAT "%10.5"
 /begin ANNOTATION ANNOTATION_LABEL "Description (coming from AUTOSAR DESC field)" /begin ANNOTATION_TEXT "Minimum temperature to allow valve rinse\r\n" /end ANNOTATION_TEXT /end ANNOTATION
/end CHARACTERISTIC
/begin CHARACTERISTIC DWC_CALIB.DWC_TF_TEMPWARNINGOFFSET "" CURVE 0x8061001E RB_PT_PCT_SWC_DWC_RecordLayouts_RL_Curve_sint16_5_sint16_5 250.0 RB_PT_PCT_SWC_DWC_CompuMethods_ratio_0p05 -50. 200. FORMAT "%10.5"
 /begin ANNOTATION ANNOTATION_LABEL "Description (coming from AUTOSAR DESC field)"
  /begin ANNOTATION_TEXT "Temperature offset from max clutch temperature where driver is warned\r\n" /end ANNOTATION_TEXT
 /end ANNOTATION
 /begin AXIS_DESCR STD_AXIS NO_INPUT_QUANTITY RB_PT_PCT_SWC_DWC_CompuMethods_ratio_0p1 5 -1000. 2000. FORMAT "%10.5" DEPOSIT ABSOLUTE /end AXIS_DESCR
/end CHARACTERISTIC
/begin CHARACTERISTIC DWC_CALIB.DWC_TorqueControl.DWC_ALTARBUSEABSSLIP "" VALUE 0x8060F35C DefaultValueRecordLayout_AUTOSAR_Platform_BaseTypes_boolean 255.0 AUTOSAR_Platform_CompuMethods_boolean 0.0 255. FORMAT "%10.5"
 /begin ANNOTATION ANNOTATION_LABEL "Description (coming from AUTOSAR DESC field)" /begin ANNOTATION_TEXT "Flag to use absolute slip for alt arb trigger.\r\n" /end ANNOTATION_TEXT /end ANNOTATION
/end CHARACTERISTIC
/begin CHARACTERISTIC DWC_CALIB.DWC_TorqueControl.DWC_CLAMPTEENGTQROLLOFF "" VALUE 0x8060F35D DefaultValueRecordLayout_AUTOSAR_Platform_BaseTypes_boolean 255.0 AUTOSAR_Platform_CompuMethods_boolean 0.0 255. FORMAT "%10.5"
 /begin ANNOTATION ANNOTATION_LABEL "Description (coming from AUTOSAR DESC field)"
  /begin ANNOTATION_TEXT "Flag to clamp the TEEngine Torque estimate during roll off.\r\n" /end ANNOTATION_TEXT
 /end ANNOTATION
/end CHARACTERISTIC
/begin CHARACTERISTIC DWC_CALIB.DWC_TorqueControl.DWC_CLUTCHTORQUEP2MODE "" VALUE 0x8060F33C DefaultValueRecordLayout_AUTOSAR_Platform_BaseTypes_sint16 4000.0 RB_PT_PCT_SWC_DWC_CompuMethods_ratio_0p1 -2000. 2000. FORMAT "%10.5"
 /begin ANNOTATION ANNOTATION_LABEL "Description (coming from AUTOSAR DESC field)"
  /begin ANNOTATION_TEXT "Clutch torque capacity to request when in P2 mode with clutch closed\r\n" /end ANNOTATION_TEXT
 /end ANNOTATION
/end CHARACTERISTIC
/begin CHARACTERISTIC DWC_CALIB.DWC_TorqueControl.DWC_CLUTCHTORQUEP2MODERAMP "" CURVE 0x8060F3F6 RB_PT_PCT_SWC_DWC_RecordLayouts_RL_Curve_sint16_4_uint16_4 4000.0 RB_PT_PCT_SWC_DWC_CompuMethods_ratio_0p1 -2000. 2000. FORMAT "%10.5"
 /begin ANNOTATION ANNOTATION_LABEL "Description (coming from AUTOSAR DESC field)" /begin ANNOTATION_TEXT "Map of ramp rate vs slip\r\n" /end ANNOTATION_TEXT /end ANNOTATION
 /begin AXIS_DESCR STD_AXIS NO_INPUT_QUANTITY RB_PT_PCT_SWC_DWC_CompuMethods_ident 4 0.0 20000. FORMAT "%10.5" DEPOSIT ABSOLUTE /end AXIS_DESCR
/end CHARACTERISTIC
/begin CHARACTERISTIC DWC_CALIB.DWC_TorqueControl.DWC_DISABLEOFFGOINGTQINCASGASSIST "" VALUE 0x8060F35E DefaultValueRecordLayout_AUTOSAR_Platform_BaseTypes_boolean 255.0 AUTOSAR_Platform_CompuMethods_boolean 0.0 255. FORMAT "%10.5"
 /begin ANNOTATION ANNOTATION_LABEL "Description (coming from AUTOSAR DESC field)"
  /begin ANNOTATION_TEXT "Flag to disable offgoing torque increase when ASG assist shift is triggered.\r\n" /end ANNOTATION_TEXT
 /end ANNOTATION
/end CHARACTERISTIC
/begin CHARACTERISTIC DWC_CALIB.DWC_TorqueControl.DWC_DRIVEMODETOPULLAWAYTYPE "" VAL_BLK 0x8060F318 DefaultValueRecordLayout_AUTOSAR_Platform_BaseTypes_uint8 2.0 RB_PT_PCT_SWC_DWC_CompuMethods_ident 0.0 2. FORMAT "%10.5"
 /begin ANNOTATION ANNOTATION_LABEL "Description (coming from AUTOSAR DESC field)"
  /begin ANNOTATION_TEXT "Array to arbitrate between drive mode type and pullaway maps.\r\n" /end ANNOTATION_TEXT
 /end ANNOTATION
 MATRIX_DIM 15 1 1 /end CHARACTERISTIC
/begin CHARACTERISTIC DWC_CALIB.DWC_TorqueControl.DWC_ENABLECHECKFROMSLIPTOSPEED "" VALUE 0x8060F35F DefaultValueRecordLayout_AUTOSAR_Platform_BaseTypes_boolean 255.0 AUTOSAR_Platform_CompuMethods_boolean 0.0 255. FORMAT "%10.5"
 /begin ANNOTATION ANNOTATION_LABEL "Description (coming from AUTOSAR DESC field)"
  /begin ANNOTATION_TEXT "Flag to enable check when moving from slip to speed control, for bumpless transfer.\r\n" /end ANNOTATION_TEXT
 /end ANNOTATION
/end CHARACTERISTIC
/begin CHARACTERISTIC DWC_CALIB.DWC_TorqueControl.DWC_ENABLEGTSHIFTS "" VAL_BLK 0x8060F328 DefaultValueRecordLayout_AUTOSAR_Platform_BaseTypes_uint16 20000.0 RB_PT_PCT_SWC_DWC_CompuMethods_ident 0.0 20000. FORMAT "%10.5"
 /begin ANNOTATION ANNOTATION_LABEL "Description (coming from AUTOSAR DESC field)"
  /begin ANNOTATION_TEXT "Enable GT shifts above engine speed for each shift mode.\r\n" /end ANNOTATION_TEXT
 /end ANNOTATION
 MATRIX_DIM 8 1 1 /end CHARACTERISTIC
/begin CHARACTERISTIC DWC_CALIB.DWC_TorqueControl.DWC_ENABLESPCARBALT "" VALUE 0x8060F360 DefaultValueRecordLayout_AUTOSAR_Platform_BaseTypes_uint8 255.0 RB_PT_PCT_SWC_DWC_CompuMethods_ident 0.0 255. FORMAT "%10.5"
 /begin ANNOTATION ANNOTATION_LABEL "Description (coming from AUTOSAR DESC field)" /begin ANNOTATION_TEXT "Enable the SPC arbitrator in tip out or slip closed.\r\n" /end ANNOTATION_TEXT /end ANNOTATION
/end CHARACTERISTIC
/begin CHARACTERISTIC DWC_CALIB.DWC_TorqueControl.DWC_ENABLESPCARBPAAC "" VALUE 0x8060F361 DefaultValueRecordLayout_AUTOSAR_Platform_BaseTypes_uint8 255.0 RB_PT_PCT_SWC_DWC_CompuMethods_ident 0.0 255. FORMAT "%10.5"
 /begin ANNOTATION ANNOTATION_LABEL "Description (coming from AUTOSAR DESC field)"
  /begin ANNOTATION_TEXT "Enable the SPC arbitrator when in auto close condition.\r\n" /end ANNOTATION_TEXT
 /end ANNOTATION
/end CHARACTERISTIC
/begin CHARACTERISTIC DWC_CALIB.DWC_TorqueControl.DWC_ENGINESPEEDDELAYCYCLES "" VALUE 0x8060F362 DefaultValueRecordLayout_AUTOSAR_Platform_BaseTypes_uint8 28.0 RB_PT_PCT_SWC_DWC_CompuMethods_ident 0.0 28. FORMAT "%10.5"
 /begin ANNOTATION ANNOTATION_LABEL "Description (coming from AUTOSAR DESC field)" /begin ANNOTATION_TEXT "Number of cycles to delay input 1 speed.\r\n" /end ANNOTATION_TEXT /end ANNOTATION
/end CHARACTERISTIC
/begin CHARACTERISTIC DWC_CALIB.DWC_TorqueControl.DWC_FLGDISABLEASGCHECK4CURTQINPUT "" VALUE 0x8060F363 DefaultValueRecordLayout_AUTOSAR_Platform_BaseTypes_boolean 255.0 AUTOSAR_Platform_CompuMethods_boolean 0.0 255. FORMAT "%10.5"
 /begin ANNOTATION ANNOTATION_LABEL "Description (coming from AUTOSAR DESC field)"
  /begin ANNOTATION_TEXT "Flag to disable check on ASG Shift for current torque input.\r\n" /end ANNOTATION_TEXT
 /end ANNOTATION
/end CHARACTERISTIC
/begin CHARACTERISTIC DWC_CALIB.DWC_TorqueControl.DWC_FLGDONTUSEPATRGTRST "" VALUE 0x8060F364 DefaultValueRecordLayout_AUTOSAR_Platform_BaseTypes_boolean 255.0 AUTOSAR_Platform_CompuMethods_boolean 0.0 255. FORMAT "%10.5"
 /begin ANNOTATION ANNOTATION_LABEL "Description (coming from AUTOSAR DESC field)"
  /begin ANNOTATION_TEXT "Flag to block use of PaTargetSpeedRawP in speed reset.\r\n" /end ANNOTATION_TEXT
 /end ANNOTATION
/end CHARACTERISTIC
/begin CHARACTERISTIC DWC_CALIB.DWC_TorqueControl.DWC_FLGENABLEPAALTMAPS "" VALUE 0x8060F365 DefaultValueRecordLayout_AUTOSAR_Platform_BaseTypes_boolean 255.0 AUTOSAR_Platform_CompuMethods_boolean 0.0 255. FORMAT "%10.5"
 /begin ANNOTATION ANNOTATION_LABEL "Description (coming from AUTOSAR DESC field)" /begin ANNOTATION_TEXT "Set true to enable PA alternative mode maps\r\n" /end ANNOTATION_TEXT /end ANNOTATION
/end CHARACTERISTIC
/begin CHARACTERISTIC DWC_CALIB.DWC_TorqueControl.DWC_FLGENABLEPAZEROMAPS "" VALUE 0x8060F366 DefaultValueRecordLayout_AUTOSAR_Platform_BaseTypes_boolean 255.0 AUTOSAR_Platform_CompuMethods_boolean 0.0 255. FORMAT "%10.5"
 /begin ANNOTATION ANNOTATION_LABEL "Description (coming from AUTOSAR DESC field)" /begin ANNOTATION_TEXT "Set true to enable PA zero mode maps\r\n" /end ANNOTATION_TEXT /end ANNOTATION
/end CHARACTERISTIC
/begin CHARACTERISTIC DWC_CALIB.DWC_TorqueControl.DWC_FLGENABLETQ2PRESADAPTION "" VALUE 0x8060F367 DefaultValueRecordLayout_AUTOSAR_Platform_BaseTypes_boolean 255.0 AUTOSAR_Platform_CompuMethods_boolean 0.0 255. FORMAT "%10.5"
 /begin ANNOTATION ANNOTATION_LABEL "Description (coming from AUTOSAR DESC field)" /begin ANNOTATION_TEXT "Set true to enable torque to pressure adaption\r\n" /end ANNOTATION_TEXT /end ANNOTATION
/end CHARACTERISTIC
/begin CHARACTERISTIC DWC_CALIB.DWC_TorqueControl.DWC_FLGRESETITERMCRP "" VALUE 0x8060F368 DefaultValueRecordLayout_AUTOSAR_Platform_BaseTypes_boolean 255.0 AUTOSAR_Platform_CompuMethods_boolean 0.0 255. FORMAT "%10.5"
 /begin ANNOTATION ANNOTATION_LABEL "Description (coming from AUTOSAR DESC field)" /begin ANNOTATION_TEXT "Reset I term based on CRP reset.\r\n" /end ANNOTATION_TEXT /end ANNOTATION
/end CHARACTERISTIC
/begin CHARACTERISTIC DWC_CALIB.DWC_TorqueControl.DWC_MAXPEDALFORSPCENABLE "" VALUE 0x8060F369 DefaultValueRecordLayout_AUTOSAR_Platform_BaseTypes_uint8 102.0 RB_PT_PCT_SWC_DWC_CompuMethods_ratio_0p4 0.0 102. FORMAT "%10.5"
 /begin ANNOTATION ANNOTATION_LABEL "Description (coming from AUTOSAR DESC field)"
  /begin ANNOTATION_TEXT "Maximum throttle pedal that SPC arbitrator can be enabled early.\r\n" /end ANNOTATION_TEXT
 /end ANNOTATION
/end CHARACTERISTIC
/begin CHARACTERISTIC DWC_CALIB.DWC_TorqueControl.DWC_MINGEARLOWSPDFASTFILLPWRDOWN "" VALUE 0x8060F36A DefaultValueRecordLayout_AUTOSAR_Platform_BaseTypes_uint8 11.0 RB_PT_PCT_SWC_DWC_CompuMethods_ident 0.0 11. FORMAT "%10.5"
 /begin ANNOTATION ANNOTATION_LABEL "Description (coming from AUTOSAR DESC field)"
  /begin ANNOTATION_TEXT "Minimum gear to allow a fast fill below setpoint speed during a power on down.\r\n" /end ANNOTATION_TEXT
 /end ANNOTATION
/end CHARACTERISTIC
/begin CHARACTERISTIC DWC_CALIB.DWC_TorqueControl.DWC_MINSPEEDFORASGBYPASS "" VALUE 0x8060F33E DefaultValueRecordLayout_AUTOSAR_Platform_BaseTypes_sint16 40000.0 RB_PT_PCT_SWC_DWC_CompuMethods_ident -20000. 20000. FORMAT "%10.5"
 /begin ANNOTATION ANNOTATION_LABEL "Description (coming from AUTOSAR DESC field)" /begin ANNOTATION_TEXT "Minimum output speed to allow fast fill.\r\n" /end ANNOTATION_TEXT /end ANNOTATION
/end CHARACTERISTIC
/begin CHARACTERISTIC DWC_CALIB.DWC_TorqueControl.DWC_MINTEMPPWRDWNFASTFILLBELOWSETPOINT "" VALUE 0x8060F340 DefaultValueRecordLayout_AUTOSAR_Platform_BaseTypes_sint16 250.0 RB_PT_PCT_SWC_DWC_CompuMethods_ident -50. 200. FORMAT "%10.5"
 /begin ANNOTATION ANNOTATION_LABEL "Description (coming from AUTOSAR DESC field)"
  /begin ANNOTATION_TEXT "Minimum temperature to allow the fast fill for power on down below pa set point.\r\n" /end ANNOTATION_TEXT
 /end ANNOTATION
/end CHARACTERISTIC
/begin CHARACTERISTIC DWC_CALIB.DWC_TorqueControl.DWC_OFFSETITERMLIMTHRESHFORPAAC "" VALUE 0x8060F36B DefaultValueRecordLayout_AUTOSAR_Platform_BaseTypes_boolean 255.0 AUTOSAR_Platform_CompuMethods_boolean 0.0 255. FORMAT "%10.5"
 /begin ANNOTATION ANNOTATION_LABEL "Description (coming from AUTOSAR DESC field)" /begin ANNOTATION_TEXT "Offset the threshold for iterm limit for PAAC.\r\n" /end ANNOTATION_TEXT /end ANNOTATION
/end CHARACTERISTIC
/begin CHARACTERISTIC DWC_CALIB.DWC_TorqueControl.DWC_PAAARBITRATORGEAROFFSET "" VAL_BLK 0x8060F300 DefaultValueRecordLayout_AUTOSAR_Platform_BaseTypes_sint16 40000.0 RB_PT_PCT_SWC_DWC_CompuMethods_ident -20000. 20000. FORMAT "%10.5"
 /begin ANNOTATION ANNOTATION_LABEL "Description (coming from AUTOSAR DESC field)" /begin ANNOTATION_TEXT "Offset to apply to DWC_PAClutchMustOpen vs Gear\r\n" /end ANNOTATION_TEXT /end ANNOTATION
 MATRIX_DIM 12 1 1 /end CHARACTERISTIC
/begin CHARACTERISTIC DWC_CALIB.DWC_TorqueControl.DWC_PAACARBITERMLIM "" VALUE 0x8060F338 DefaultValueRecordLayout_AUTOSAR_Platform_BaseTypes_sint32 4000.0 RB_PT_PCT_SWC_DWC_CompuMethods_ratio_0p0001 -2000. 2000. FORMAT "%10.5"
 /begin ANNOTATION ANNOTATION_LABEL "Description (coming from AUTOSAR DESC field)" /begin ANNOTATION_TEXT "Iterm limit to enable SLC ARB check\r\n" /end ANNOTATION_TEXT /end ANNOTATION
/end CHARACTERISTIC
/begin CHARACTERISTIC DWC_CALIB.DWC_TorqueControl.DWC_PAACARBUPPEROFFSET "" VALUE 0x8060F342 DefaultValueRecordLayout_AUTOSAR_Platform_BaseTypes_sint16 40000.0 RB_PT_PCT_SWC_DWC_CompuMethods_ident -20000. 20000. FORMAT "%10.5"
 /begin ANNOTATION ANNOTATION_LABEL "Description (coming from AUTOSAR DESC field)"
  /begin ANNOTATION_TEXT "Offset to PA arbitration upper to reenable SPC arb in PAAC.\r\n" /end ANNOTATION_TEXT
 /end ANNOTATION
/end CHARACTERISTIC
/begin CHARACTERISTIC DWC_CALIB.DWC_TorqueControl.DWC_PAACDRVLNGRDENABLE "" VALUE 0x8060F344 DefaultValueRecordLayout_AUTOSAR_Platform_BaseTypes_sint16 2000.0 RB_PT_PCT_SWC_DWC_CompuMethods_ident -1000. 1000. FORMAT "%10.5"
 /begin ANNOTATION ANNOTATION_LABEL "Description (coming from AUTOSAR DESC field)"
  /begin ANNOTATION_TEXT "Driveline gradient threshold for paac. To prevent enabling on rollout.\r\n" /end ANNOTATION_TEXT
 /end ANNOTATION
/end CHARACTERISTIC
/begin CHARACTERISTIC DWC_CALIB.DWC_TorqueControl.DWC_PAACITERMLIMOFFSET "" VALUE 0x8060F346 DefaultValueRecordLayout_AUTOSAR_Platform_BaseTypes_sint16 40000.0 RB_PT_PCT_SWC_DWC_CompuMethods_ident -20000. 20000. FORMAT "%10.5"
 /begin ANNOTATION ANNOTATION_LABEL "Description (coming from AUTOSAR DESC field)" /begin ANNOTATION_TEXT "Offset i term limit threshold to idle for PAAC\r\n" /end ANNOTATION_TEXT /end ANNOTATION
/end CHARACTERISTIC
/begin CHARACTERISTIC DWC_CALIB.DWC_TorqueControl.DWC_PAACUSEMINOFENGandACTIVEINPUT "" VALUE 0x8060F36C DefaultValueRecordLayout_AUTOSAR_Platform_BaseTypes_boolean 255.0 AUTOSAR_Platform_CompuMethods_boolean 0.0 255. FORMAT "%10.5" /end CHARACTERISTIC
/begin CHARACTERISTIC DWC_CALIB.DWC_TorqueControl.DWC_PAACUSEMINOFENGandCURTQINP "" VALUE 0x8060F36D DefaultValueRecordLayout_AUTOSAR_Platform_BaseTypes_boolean 255.0 AUTOSAR_Platform_CompuMethods_boolean 0.0 255. FORMAT "%10.5" /end CHARACTERISTIC
/begin CHARACTERISTIC DWC_CALIB.DWC_TorqueControl.DWC_PAEARLYARBFNLTGTSPDOFFSET "" VALUE 0x8060F348 DefaultValueRecordLayout_AUTOSAR_Platform_BaseTypes_uint16 20000.0 RB_PT_PCT_SWC_DWC_CompuMethods_ident 0.0 20000. FORMAT "%10.5"
 /begin ANNOTATION ANNOTATION_LABEL "Description (coming from AUTOSAR DESC field)" /begin ANNOTATION_TEXT "Offset for final target speed to early arb check.\r\n" /end ANNOTATION_TEXT /end ANNOTATION
/end CHARACTERISTIC
/begin CHARACTERISTIC DWC_CALIB.DWC_TorqueControl.DWC_PAEARLYARBSLIPTHRESH "" VALUE 0x8060F36E DefaultValueRecordLayout_AUTOSAR_Platform_BaseTypes_uint8 255.0 RB_PT_PCT_SWC_DWC_CompuMethods_ident 0.0 255. FORMAT "%10.5"
 /begin ANNOTATION ANNOTATION_LABEL "Description (coming from AUTOSAR DESC field)" /begin ANNOTATION_TEXT "Slip threshold for early ARB enable.\r\n" /end ANNOTATION_TEXT /end ANNOTATION
/end CHARACTERISTIC
/begin CHARACTERISTIC DWC_CALIB.DWC_TorqueControl.DWC_PALAUNCHMAXOFFSET "" MAP 0x8060F408 RB_PT_PCT_SWC_DWC_RecordLayouts_RL_Map_sint16_100_sint16_10_sint16_10 4000.0 RB_PT_PCT_SWC_DWC_CompuMethods_ratio_0p1 -2000. 2000. FORMAT "%10.5"
 /begin ANNOTATION ANNOTATION_LABEL "Description (coming from AUTOSAR DESC field)"
  /begin ANNOTATION_TEXT "Instant torque offset for launch x- rate of change of engine speed y- engine speed error ref setpoint pullaway speed.\r\n" /end ANNOTATION_TEXT
 /end ANNOTATION
 /begin AXIS_DESCR STD_AXIS NO_INPUT_QUANTITY RB_PT_PCT_SWC_DWC_CompuMethods_ident 10 -32000. 32000. FORMAT "%10.5" DEPOSIT ABSOLUTE /end AXIS_DESCR
 /begin AXIS_DESCR STD_AXIS NO_INPUT_QUANTITY RB_PT_PCT_SWC_DWC_CompuMethods_ident 10 -20000. 20000. FORMAT "%10.5" DEPOSIT ABSOLUTE /end AXIS_DESCR
/end CHARACTERISTIC
/begin CHARACTERISTIC DWC_CALIB.DWC_TorqueControl.DWC_PAOFFBRAKETHRESH "" VALUE 0x8060F34A DefaultValueRecordLayout_AUTOSAR_Platform_BaseTypes_uint16 409.5 RB_PT_PCT_SWC_DWC_CompuMethods_ratio_0p1 0.0 409.5 FORMAT "%10.5"
 /begin ANNOTATION ANNOTATION_LABEL "Description (coming from AUTOSAR DESC field)"
  /begin ANNOTATION_TEXT "brake pressure to detemine if the driver is OFF the brake.\r\n" /end ANNOTATION_TEXT
 /end ANNOTATION
/end CHARACTERISTIC
/begin CHARACTERISTIC DWC_CALIB.DWC_TorqueControl.DWC_PAPullawaySequencer.DWC_ALWAYSLOWERTQSYNCFLAG "" VALUE 0x8060F372 DefaultValueRecordLayout_AUTOSAR_Platform_BaseTypes_boolean 255.0 AUTOSAR_Platform_CompuMethods_boolean 0.0 255. FORMAT "%10.5"
 /begin ANNOTATION ANNOTATION_LABEL "Description (coming from AUTOSAR DESC field)" /begin ANNOTATION_TEXT "Flag to lower torque sync after one cycle.\r\n" /end ANNOTATION_TEXT /end ANNOTATION
/end CHARACTERISTIC
/begin CHARACTERISTIC DWC_CALIB.DWC_TorqueControl.DWC_PAPullawaySequencer.DWC_ENTERPASACTIVEwSEQCURTQGR "" VALUE 0x8060F373 DefaultValueRecordLayout_AUTOSAR_Platform_BaseTypes_boolean 255.0 AUTOSAR_Platform_CompuMethods_boolean 0.0 255. FORMAT "%10.5"
 /begin ANNOTATION ANNOTATION_LABEL "Description (coming from AUTOSAR DESC field)"
  /begin ANNOTATION_TEXT "Flag to enter pullaway active based on current torque gear.\r\n" /end ANNOTATION_TEXT
 /end ANNOTATION
/end CHARACTERISTIC
/begin CHARACTERISTIC DWC_CALIB.DWC_TorqueControl.DWC_PAPullawaySequencer.DWC_FLGBYPASSACCPEDPLW2PWTSYNC "" VALUE 0x8060F374 DefaultValueRecordLayout_AUTOSAR_Platform_BaseTypes_boolean 255.0 AUTOSAR_Platform_CompuMethods_boolean 0.0 255. FORMAT "%10.5"
 /begin ANNOTATION ANNOTATION_LABEL "Description (coming from AUTOSAR DESC field)"
  /begin ANNOTATION_TEXT "Flag to bypass accelerator pedal pressed check from pullaway sync to powertrain sync transition\r\n" /end ANNOTATION_TEXT
 /end ANNOTATION
/end CHARACTERISTIC
/begin CHARACTERISTIC DWC_CALIB.DWC_TorqueControl.DWC_PASPERROR4MAXTQOFFSET "" VALUE 0x8060F34C DefaultValueRecordLayout_AUTOSAR_Platform_BaseTypes_sint16 40000.0 RB_PT_PCT_SWC_DWC_CompuMethods_ident -20000. 20000. FORMAT "%10.5"
 /begin ANNOTATION ANNOTATION_LABEL "Description (coming from AUTOSAR DESC field)"
  /begin ANNOTATION_TEXT "Time the driver has to be off the brake to allow max torque offset applied during launch\r\n" /end ANNOTATION_TEXT
 /end ANNOTATION
/end CHARACTERISTIC
/begin CHARACTERISTIC DWC_CALIB.DWC_TorqueControl.DWC_PASTATE2NOTENABLEPAACTIVE "" VALUE 0x8060F36F DefaultValueRecordLayout_AUTOSAR_Platform_BaseTypes_uint8 8.0 RB_PT_PCT_SWC_DWC_CompuMethods_Enumerations_DWC_PAStates 0.0 8. FORMAT "%10.5"
 /begin ANNOTATION ANNOTATION_LABEL "Description (coming from AUTOSAR DESC field)" /begin ANNOTATION_TEXT "pullaway state not to force pullaway flag\r\n" /end ANNOTATION_TEXT /end ANNOTATION
/end CHARACTERISTIC
/begin CHARACTERISTIC DWC_CALIB.DWC_TorqueControl.DWC_PATMOFFBRK4MAXTQOFFSET "" VALUE 0x8060F34E DefaultValueRecordLayout_AUTOSAR_Platform_BaseTypes_uint16 10.0 RB_PT_PCT_SWC_DWC_CompuMethods_ratio_0p001__2 0.0 10. FORMAT "%10.5"
 /begin ANNOTATION ANNOTATION_LABEL "Description (coming from AUTOSAR DESC field)"
  /begin ANNOTATION_TEXT "Time the driver has to be off the brake to allow max torque offset applied during launch\r\n" /end ANNOTATION_TEXT
 /end ANNOTATION
/end CHARACTERISTIC
/begin CHARACTERISTIC DWC_CALIB.DWC_TorqueControl.DWC_PRESWENGSPDCATHEAT "" VALUE 0x8060F350 DefaultValueRecordLayout_AUTOSAR_Platform_BaseTypes_uint16 20000.0 RB_PT_PCT_SWC_DWC_CompuMethods_ident 0.0 20000. FORMAT "%10.5"
 /begin ANNOTATION ANNOTATION_LABEL "Description (coming from AUTOSAR DESC field)"
  /begin ANNOTATION_TEXT "Max engine speed to trigger start of slipping wheels.\r\n" /end ANNOTATION_TEXT
 /end ANNOTATION
/end CHARACTERISTIC
/begin CHARACTERISTIC DWC_CALIB.DWC_TorqueControl.DWC_PWRONDOWNACTIVEINPUTTEMPTHRESH "" VALUE 0x8060F352 DefaultValueRecordLayout_AUTOSAR_Platform_BaseTypes_sint16 250.0 RB_PT_PCT_SWC_DWC_CompuMethods_ident -50. 200. FORMAT "%10.5"
 /begin ANNOTATION ANNOTATION_LABEL "Description (coming from AUTOSAR DESC field)"
  /begin ANNOTATION_TEXT "Temperature below which to use active input if gear is not engaged.\r\n" /end ANNOTATION_TEXT
 /end ANNOTATION
/end CHARACTERISTIC
/begin CHARACTERISTIC DWC_CALIB.DWC_TorqueControl.DWC_SLCMinTorqueManager.DWC_SLCLATACC4LOCKUP "" VALUE 0x8060F376 DefaultValueRecordLayout_AUTOSAR_Platform_BaseTypes_sint8 2.54 RB_PT_PCT_SWC_DWC_CompuMethods_ratio_0p01 -1.27 1.27 FORMAT "%10.5"
 /begin ANNOTATION ANNOTATION_LABEL "Description (coming from AUTOSAR DESC field)" /begin ANNOTATION_TEXT "min latt acc to force clutch lockup\r\n" /end ANNOTATION_TEXT /end ANNOTATION
/end CHARACTERISTIC
/begin CHARACTERISTIC DWC_CALIB.DWC_TorqueControl.DWC_SLIPTARGETFORCRANKPULSE "" VALUE 0x8060F354 DefaultValueRecordLayout_AUTOSAR_Platform_BaseTypes_sint16 40000.0 RB_PT_PCT_SWC_DWC_CompuMethods_ident -20000. 20000. FORMAT "%10.5"
 /begin ANNOTATION ANNOTATION_LABEL "Description (coming from AUTOSAR DESC field)"
  /begin ANNOTATION_TEXT "Slip threshold to allow bypass pulse during cranking.\r\n" /end ANNOTATION_TEXT
 /end ANNOTATION
/end CHARACTERISTIC
/begin CHARACTERISTIC DWC_CALIB.DWC_TorqueControl.DWC_SSDISABLEASTIME "" VALUE 0x8060F356 DefaultValueRecordLayout_AUTOSAR_Platform_BaseTypes_uint16 10.0 RB_PT_PCT_SWC_DWC_CompuMethods_ratio_0p001__2 0.0 10. FORMAT "%10.5"
 /begin ANNOTATION ANNOTATION_LABEL "Description (coming from AUTOSAR DESC field)" /begin ANNOTATION_TEXT "Time of engine stop to disable antistall\r\n" /end ANNOTATION_TEXT /end ANNOTATION
/end CHARACTERISTIC
/begin CHARACTERISTIC DWC_CALIB.DWC_TorqueControl.DWC_TIMENGRUNFORPOSTCRANKPULSE "" VALUE 0x8060F358 DefaultValueRecordLayout_AUTOSAR_Platform_BaseTypes_uint16 10.0 RB_PT_PCT_SWC_DWC_CompuMethods_ratio_0p001__2 0.0 10. FORMAT "%10.5"
 /begin ANNOTATION ANNOTATION_LABEL "Description (coming from AUTOSAR DESC field)"
  /begin ANNOTATION_TEXT "Time engine running to allow normal ASG bypass logic.\r\n" /end ANNOTATION_TEXT
 /end ANNOTATION
/end CHARACTERISTIC
/begin CHARACTERISTIC DWC_CALIB.DWC_TorqueControl.DWC_TorquePhaseTorque.DWC_FLGINTERPCOMINGFACTORFORMANEST "" VALUE 0x8060F378 DefaultValueRecordLayout_AUTOSAR_Platform_BaseTypes_boolean 255.0 AUTOSAR_Platform_CompuMethods_boolean 0.0 255. FORMAT "%10.5"
 /begin ANNOTATION ANNOTATION_LABEL "Description (coming from AUTOSAR DESC field)"
  /begin ANNOTATION_TEXT "Flag to enable the interpolation of the high and low coming factor tables for correcting the max fill torque input to bypass pulse map.\r\n" /end ANNOTATION_TEXT
 /end ANNOTATION
/end CHARACTERISTIC
/begin CHARACTERISTIC DWC_CALIB.DWC_TorqueControl.DWC_TorquePhaseTorque.DWC_TPGOINGDELAYTRQMAP "" MAP 0x8060F37A RB_PT_PCT_SWC_DWC_RecordLayouts_RL_Map_sint16_49_uint16_7_sint8_7 3.0 RB_PT_PCT_SWC_DWC_CompuMethods_ratio_0p001__2 -1. 2. FORMAT "%10.5"
 /begin ANNOTATION ANNOTATION_LABEL "Description (coming from AUTOSAR DESC field)"
  /begin ANNOTATION_TEXT "Hold torque level for going clutch during GT style shift\r\n" /end ANNOTATION_TEXT
 /end ANNOTATION
 /begin AXIS_DESCR STD_AXIS NO_INPUT_QUANTITY RB_PT_PCT_SWC_DWC_CompuMethods_ratio_0p1 7 0.0 2000. FORMAT "%10.5" DEPOSIT ABSOLUTE /end AXIS_DESCR
 /begin AXIS_DESCR STD_AXIS NO_INPUT_QUANTITY RB_PT_PCT_SWC_DWC_CompuMethods_ratio_0p01 7 -1. 1. FORMAT "%10.5" DEPOSIT ABSOLUTE /end AXIS_DESCR
/end CHARACTERISTIC
/begin CHARACTERISTIC DWC_CALIB.DWC_TorqueControl.DWC_UPSHIFTTYPETQCHECKID "" VALUE 0x8060F370 DefaultValueRecordLayout_AUTOSAR_Platform_BaseTypes_uint8 2.0 RB_PT_PCT_SWC_DWC_CompuMethods_ident 0.0 2. FORMAT "%10.5"
 /begin ANNOTATION ANNOTATION_LABEL "Description (coming from AUTOSAR DESC field)"
  /begin ANNOTATION_TEXT "ID to configure which torque check to use for power on/off decision.\r\n" /end ANNOTATION_TEXT
 /end ANNOTATION
/end CHARACTERISTIC
/begin CHARACTERISTIC DWC_CALIB.DWC_TorqueControl.DWC_USETQFB4POWERCALC "" VALUE 0x8060F371 DefaultValueRecordLayout_AUTOSAR_Platform_BaseTypes_uint8 255.0 DefaultIdenticalCompu 0.0 255. FORMAT "%10.5"
 /begin ANNOTATION ANNOTATION_LABEL "Description (coming from AUTOSAR DESC field)"
  /begin ANNOTATION_TEXT "Flag to enable max of torque demand and torque FB into slip power calculation.\r\n" /end ANNOTATION_TEXT
 /end ANNOTATION
/end CHARACTERISTIC
/begin CHARACTERISTIC DWC_CALIB.DWC_TorqueControl.DWC_WSCSetTorque "" VALUE 0x8060F35A DefaultValueRecordLayout_AUTOSAR_Platform_BaseTypes_sint16 4000.0 RB_PT_PCT_SWC_DWC_CompuMethods_ratio_0p1 -2000. 2000. FORMAT "%10.5"
 /begin ANNOTATION ANNOTATION_LABEL "Description (coming from AUTOSAR DESC field)"
  /begin ANNOTATION_TEXT "Set reference torque used for the WSC, above this torque provides the window in which the WSC p term can operate.\r\n" /end ANNOTATION_TEXT
 /end ANNOTATION
/end CHARACTERISTIC
/begin CHARACTERISTIC DWC_CALIB.DWC_TorqueDragLossRateLimit.DWC_TF_TORQUERATELIMITDOWN "" CURVE 0x8060F4FC RB_PT_PCT_SWC_DWC_RecordLayouts_RL_Curve_uint16_6_sint16_6 655.34 RB_PT_PCT_SWC_DWC_CompuMethods_ratio_0p01 0.01 655.35 FORMAT "%10.5"
 /begin ANNOTATION ANNOTATION_LABEL "Description (coming from AUTOSAR DESC field)" /begin ANNOTATION_TEXT "Rate of change limit for output\r\n" /end ANNOTATION_TEXT /end ANNOTATION
 /begin AXIS_DESCR STD_AXIS NO_INPUT_QUANTITY RB_PT_PCT_SWC_DWC_CompuMethods_ident 6 -50. 200. FORMAT "%10.5" DEPOSIT ABSOLUTE /end AXIS_DESCR
/end CHARACTERISTIC
/begin CHARACTERISTIC DWC_CALIB.DWC_TorqueDragLossRateLimit.DWC_TF_TORQUERATELIMITUP "" CURVE 0x8060F516 RB_PT_PCT_SWC_DWC_RecordLayouts_RL_Curve_uint16_6_sint16_6 655.34 RB_PT_PCT_SWC_DWC_CompuMethods_ratio_0p01 0.01 655.35 FORMAT "%10.5"
 /begin ANNOTATION ANNOTATION_LABEL "Description (coming from AUTOSAR DESC field)" /begin ANNOTATION_TEXT "Rate of change limit for output\r\n" /end ANNOTATION_TEXT /end ANNOTATION
 /begin AXIS_DESCR STD_AXIS NO_INPUT_QUANTITY RB_PT_PCT_SWC_DWC_CompuMethods_ident 6 -50. 200. FORMAT "%10.5" DEPOSIT ABSOLUTE /end AXIS_DESCR
/end CHARACTERISTIC
/begin CHARACTERISTIC DWC_CALIB.DWC_TorqueParasiticLossRateLimit.DWC_TF_TORQUERATELIMITDOWN "" CURVE 0x8060F530 RB_PT_PCT_SWC_DWC_RecordLayouts_RL_Curve_uint16_6_sint16_6 655.34 RB_PT_PCT_SWC_DWC_CompuMethods_ratio_0p01 0.01 655.35 FORMAT "%10.5"
 /begin ANNOTATION ANNOTATION_LABEL "Description (coming from AUTOSAR DESC field)" /begin ANNOTATION_TEXT "Rate of change limit for output\r\n" /end ANNOTATION_TEXT /end ANNOTATION
 /begin AXIS_DESCR STD_AXIS NO_INPUT_QUANTITY RB_PT_PCT_SWC_DWC_CompuMethods_ident 6 -50. 200. FORMAT "%10.5" DEPOSIT ABSOLUTE /end AXIS_DESCR
/end CHARACTERISTIC
/begin CHARACTERISTIC DWC_CALIB.DWC_TorqueParasiticLossRateLimit.DWC_TF_TORQUERATELIMITUP "" CURVE 0x8060F54A RB_PT_PCT_SWC_DWC_RecordLayouts_RL_Curve_uint16_6_sint16_6 655.34 RB_PT_PCT_SWC_DWC_CompuMethods_ratio_0p01 0.01 655.35 FORMAT "%10.5"
 /begin ANNOTATION ANNOTATION_LABEL "Description (coming from AUTOSAR DESC field)" /begin ANNOTATION_TEXT "Rate of change limit for output\r\n" /end ANNOTATION_TEXT /end ANNOTATION
 /begin AXIS_DESCR STD_AXIS NO_INPUT_QUANTITY RB_PT_PCT_SWC_DWC_CompuMethods_ident 6 -50. 200. FORMAT "%10.5" DEPOSIT ABSOLUTE /end AXIS_DESCR
/end CHARACTERISTIC
/begin CHARACTERISTIC DWC_CALIB.DWC_TransmissionLosses.DWC_CURRENTINGEARLOSSES "" CURVE 0x8060F568 RB_PT_PCT_SWC_DWC_RecordLayouts_RL_Curve_uint16_10_uint8_10 5.0 RB_PT_PCT_SWC_DWC_CompuMethods_Ratio_0p001 0.0 5. FORMAT "%10.5"
 /begin ANNOTATION ANNOTATION_LABEL "Description (coming from AUTOSAR DESC field)" /begin ANNOTATION_TEXT "Factor for different losses in each gear selected\r\n" /end ANNOTATION_TEXT /end ANNOTATION
 /begin AXIS_DESCR STD_AXIS NO_INPUT_QUANTITY RB_PT_PCT_SWC_DWC_CompuMethods_ident 10 0.0 254. FORMAT "%10.5" DEPOSIT ABSOLUTE /end AXIS_DESCR
/end CHARACTERISTIC
/begin CHARACTERISTIC DWC_CALIB.DWC_TransmissionLosses.DWC_DRAGLOSSVLVCLSD "" MAP 0x8060F588 RB_PT_PCT_SWC_DWC_RecordLayouts_RL_Map_sint16_70_uint16_10_sint16_7 4000.0 RB_PT_PCT_SWC_DWC_CompuMethods_ratio_0p1 -2000. 2000. FORMAT "%10.5"
 /begin ANNOTATION ANNOTATION_LABEL "Description (coming from AUTOSAR DESC field)"
  /begin ANNOTATION_TEXT "Transmission loss as a function of engine speed and temperature when the flow valves are closed\r\n" /end ANNOTATION_TEXT
 /end ANNOTATION
 /begin AXIS_DESCR STD_AXIS NO_INPUT_QUANTITY RB_PT_PCT_SWC_DWC_CompuMethods_ident 10 0.0 20000. FORMAT "%10.5" DEPOSIT ABSOLUTE /end AXIS_DESCR
 /begin AXIS_DESCR STD_AXIS NO_INPUT_QUANTITY RB_PT_PCT_SWC_DWC_CompuMethods_ident 7 -50. 200. FORMAT "%10.5" DEPOSIT ABSOLUTE /end AXIS_DESCR
/end CHARACTERISTIC
/begin CHARACTERISTIC DWC_CALIB.DWC_TransmissionLosses.DWC_DRAGLOSSVLVOPEN "" MAP 0x8060F63A RB_PT_PCT_SWC_DWC_RecordLayouts_RL_Map_sint16_70_uint16_10_sint16_7 4000.0 RB_PT_PCT_SWC_DWC_CompuMethods_ratio_0p1 -2000. 2000. FORMAT "%10.5"
 /begin ANNOTATION ANNOTATION_LABEL "Description (coming from AUTOSAR DESC field)"
  /begin ANNOTATION_TEXT "Transmission loss as a function of engine speed and temperature when the flow valves are Open\r\n" /end ANNOTATION_TEXT
 /end ANNOTATION
 /begin AXIS_DESCR STD_AXIS NO_INPUT_QUANTITY RB_PT_PCT_SWC_DWC_CompuMethods_ident 10 0.0 20000. FORMAT "%10.5" DEPOSIT ABSOLUTE /end AXIS_DESCR
 /begin AXIS_DESCR STD_AXIS NO_INPUT_QUANTITY RB_PT_PCT_SWC_DWC_CompuMethods_ident 7 -50. 200. FORMAT "%10.5" DEPOSIT ABSOLUTE /end AXIS_DESCR
/end CHARACTERISTIC
/begin CHARACTERISTIC DWC_CALIB.DWC_TransmissionLosses.DWC_FLGADDPUMPDRAGTOPARASITICLOSS "" VALUE 0x8060F564 DefaultValueRecordLayout_AUTOSAR_Platform_BaseTypes_uint8 255.0 DefaultIdenticalCompu 0.0 255. FORMAT "%10.5"
 /begin ANNOTATION ANNOTATION_LABEL "Description (coming from AUTOSAR DESC field)" /begin ANNOTATION_TEXT "remove pump loss from parastitic loss calculations\r\n" /end ANNOTATION_TEXT /end ANNOTATION
/end CHARACTERISTIC
/begin CHARACTERISTIC DWC_CALIB.DWC_TransmissionLosses.DWC_FLGREMOVEPUMPDRAGFROMPARASITICLOSS "" VALUE 0x8060F565 DefaultValueRecordLayout_AUTOSAR_Platform_BaseTypes_uint8 255.0 DefaultIdenticalCompu 0.0 255. FORMAT "%10.5"
 /begin ANNOTATION ANNOTATION_LABEL "Description (coming from AUTOSAR DESC field)" /begin ANNOTATION_TEXT "remove pump loss from parastitic loss calculations\r\n" /end ANNOTATION_TEXT /end ANNOTATION
/end CHARACTERISTIC
/begin CHARACTERISTIC DWC_CALIB.DWC_TransmissionLosses.DWC_FLGUSENEGTORQUEPARASITICLOSS "" VALUE 0x8060F566 DefaultValueRecordLayout_AUTOSAR_Platform_BaseTypes_uint8 255.0 DefaultIdenticalCompu 0.0 255. FORMAT "%10.5"
 /begin ANNOTATION ANNOTATION_LABEL "Description (coming from AUTOSAR DESC field)" /begin ANNOTATION_TEXT "Use negative torque in parastitic loss calculations\r\n" /end ANNOTATION_TEXT /end ANNOTATION
/end CHARACTERISTIC
/begin CHARACTERISTIC DWC_CALIB.DWC_TransmissionLosses.DWC_FLGUSETORQUEDEADBANDPARASITIC "" VALUE 0x8060F567 DefaultValueRecordLayout_AUTOSAR_Platform_BaseTypes_uint8 255.0 DefaultIdenticalCompu 0.0 255. FORMAT "%10.5"
 /begin ANNOTATION ANNOTATION_LABEL "Description (coming from AUTOSAR DESC field)" /begin ANNOTATION_TEXT "Use negative torque in parastitic loss calculations\r\n" /end ANNOTATION_TEXT /end ANNOTATION
/end CHARACTERISTIC
/begin CHARACTERISTIC DWC_CALIB.DWC_TransmissionLosses.DWC_PRESSUREDELTACORRECTIONK1 "" MAP 0x8060F6EC RB_PT_PCT_SWC_DWC_RecordLayouts_RL_Map_uint16_18_sint16_6_sint16_3 1.0 RB_PT_PCT_SWC_DWC_CompuMethods_ratio_0p001__2 0.0 1. FORMAT "%10.5"
 /begin ANNOTATION ANNOTATION_LABEL "Description (coming from AUTOSAR DESC field)" /begin ANNOTATION_TEXT "Correction for temperature and pressure delta to KP\r\n" /end ANNOTATION_TEXT /end ANNOTATION
 /begin AXIS_DESCR STD_AXIS NO_INPUT_QUANTITY RB_PT_PCT_SWC_DWC_CompuMethods_ident 6 -50. 200. FORMAT "%10.5" DEPOSIT ABSOLUTE /end AXIS_DESCR
 /begin AXIS_DESCR STD_AXIS NO_INPUT_QUANTITY RB_PT_PCT_SWC_DWC_CompuMethods_ratio_0p001__2 3 -2. 32. FORMAT "%10.5" DEPOSIT ABSOLUTE /end AXIS_DESCR
/end CHARACTERISTIC
/begin CHARACTERISTIC DWC_CALIB.DWC_TransmissionLosses.DWC_PRESSUREDELTACORRECTIONK2 "" MAP 0x8060F726 RB_PT_PCT_SWC_DWC_RecordLayouts_RL_Map_uint16_18_sint16_6_sint16_3 1.0 RB_PT_PCT_SWC_DWC_CompuMethods_ratio_0p001__2 0.0 1. FORMAT "%10.5"
 /begin ANNOTATION ANNOTATION_LABEL "Description (coming from AUTOSAR DESC field)" /begin ANNOTATION_TEXT "Correction for temperature and pressure delta to KP\r\n" /end ANNOTATION_TEXT /end ANNOTATION
 /begin AXIS_DESCR STD_AXIS NO_INPUT_QUANTITY RB_PT_PCT_SWC_DWC_CompuMethods_ident 6 -50. 200. FORMAT "%10.5" DEPOSIT ABSOLUTE /end AXIS_DESCR
 /begin AXIS_DESCR STD_AXIS NO_INPUT_QUANTITY RB_PT_PCT_SWC_DWC_CompuMethods_ratio_0p001__2 3 -2. 32. FORMAT "%10.5" DEPOSIT ABSOLUTE /end AXIS_DESCR
/end CHARACTERISTIC
/begin CHARACTERISTIC DWC_CALIB.DWC_TransmissionLosses.DWC_PUMPLOSSVLVCLSD "" MAP 0x8060F760 RB_PT_PCT_SWC_DWC_RecordLayouts_RL_Map_sint16_70_uint16_10_sint16_7 4000.0 RB_PT_PCT_SWC_DWC_CompuMethods_ratio_0p1 -2000. 2000. FORMAT "%10.5"
 /begin ANNOTATION ANNOTATION_LABEL "Description (coming from AUTOSAR DESC field)"
  /begin ANNOTATION_TEXT "Transmission loss as a function of engine speed and temperature when the flow valves are closed\r\n" /end ANNOTATION_TEXT
 /end ANNOTATION
 /begin AXIS_DESCR STD_AXIS NO_INPUT_QUANTITY RB_PT_PCT_SWC_DWC_CompuMethods_ident 10 0.0 20000. FORMAT "%10.5" DEPOSIT ABSOLUTE /end AXIS_DESCR
 /begin AXIS_DESCR STD_AXIS NO_INPUT_QUANTITY RB_PT_PCT_SWC_DWC_CompuMethods_ident 7 -50. 200. FORMAT "%10.5" DEPOSIT ABSOLUTE /end AXIS_DESCR
/end CHARACTERISTIC
/begin CHARACTERISTIC DWC_CALIB.DWC_TransmissionLosses.DWC_PUMPLOSSVLVOPEN "" MAP 0x8060F812 RB_PT_PCT_SWC_DWC_RecordLayouts_RL_Map_sint16_70_uint16_10_sint16_7 4000.0 RB_PT_PCT_SWC_DWC_CompuMethods_ratio_0p1 -2000. 2000. FORMAT "%10.5"
 /begin ANNOTATION ANNOTATION_LABEL "Description (coming from AUTOSAR DESC field)"
  /begin ANNOTATION_TEXT "Transmission loss as a function of engine speed and temperature when the flow valves are Open\r\n" /end ANNOTATION_TEXT
 /end ANNOTATION
 /begin AXIS_DESCR STD_AXIS NO_INPUT_QUANTITY RB_PT_PCT_SWC_DWC_CompuMethods_ident 10 0.0 20000. FORMAT "%10.5" DEPOSIT ABSOLUTE /end AXIS_DESCR
 /begin AXIS_DESCR STD_AXIS NO_INPUT_QUANTITY RB_PT_PCT_SWC_DWC_CompuMethods_ident 7 -50. 200. FORMAT "%10.5" DEPOSIT ABSOLUTE /end AXIS_DESCR
/end CHARACTERISTIC
/begin CHARACTERISTIC DWC_CALIB.DWC_TransmissionLosses.DWC_TORQUEPARASITICLOSSHIGHTEMP "" MAP 0x8060F8C4 RB_PT_PCT_SWC_DWC_RecordLayouts_RL_Map_uint16_42_uint16_6_sint16_7 2000.0 RB_PT_PCT_SWC_DWC_CompuMethods_ratio_0p1 0.0 2000. FORMAT "%10.5"
 /begin ANNOTATION ANNOTATION_LABEL "Description (coming from AUTOSAR DESC field)"
  /begin ANNOTATION_TEXT "Transmission loss as a function of engine speed and temperature when the flow valves are closed\r\n" /end ANNOTATION_TEXT
 /end ANNOTATION
 /begin AXIS_DESCR STD_AXIS NO_INPUT_QUANTITY RB_PT_PCT_SWC_DWC_CompuMethods_ident 6 0.0 20000. FORMAT "%10.5" DEPOSIT ABSOLUTE /end AXIS_DESCR
 /begin AXIS_DESCR STD_AXIS NO_INPUT_QUANTITY RB_PT_PCT_SWC_DWC_CompuMethods_ratio_0p1 7 -2000. 2000. FORMAT "%10.5" DEPOSIT ABSOLUTE /end AXIS_DESCR
/end CHARACTERISTIC
/begin CHARACTERISTIC DWC_CALIB.DWC_TransmissionLosses.DWC_TORQUEPARASITICLOSSLOWTEMP "" MAP 0x8060F936 RB_PT_PCT_SWC_DWC_RecordLayouts_RL_Map_uint16_42_uint16_6_sint16_7 2000.0 RB_PT_PCT_SWC_DWC_CompuMethods_ratio_0p1 0.0 2000. FORMAT "%10.5"
 /begin ANNOTATION ANNOTATION_LABEL "Description (coming from AUTOSAR DESC field)"
  /begin ANNOTATION_TEXT "Transmission loss as a function of engine speed and temperature when the flow valves are closed\r\n" /end ANNOTATION_TEXT
 /end ANNOTATION
 /begin AXIS_DESCR STD_AXIS NO_INPUT_QUANTITY RB_PT_PCT_SWC_DWC_CompuMethods_ident 6 0.0 20000. FORMAT "%10.5" DEPOSIT ABSOLUTE /end AXIS_DESCR
 /begin AXIS_DESCR STD_AXIS NO_INPUT_QUANTITY RB_PT_PCT_SWC_DWC_CompuMethods_ratio_0p1 7 -2000. 2000. FORMAT "%10.5" DEPOSIT ABSOLUTE /end AXIS_DESCR
/end CHARACTERISTIC
/begin CHARACTERISTIC DWC_CALIB.DWC_TransmissionLosses.DWC_TORQUEPARASITICLOSSMEDTEMP "" MAP 0x8060F9A8 RB_PT_PCT_SWC_DWC_RecordLayouts_RL_Map_uint16_42_uint16_6_sint16_7 2000.0 RB_PT_PCT_SWC_DWC_CompuMethods_ratio_0p1 0.0 2000. FORMAT "%10.5"
 /begin ANNOTATION ANNOTATION_LABEL "Description (coming from AUTOSAR DESC field)"
  /begin ANNOTATION_TEXT "Transmission loss as a function of engine speed and temperature when the flow valves are closed\r\n" /end ANNOTATION_TEXT
 /end ANNOTATION
 /begin AXIS_DESCR STD_AXIS NO_INPUT_QUANTITY RB_PT_PCT_SWC_DWC_CompuMethods_ident 6 0.0 20000. FORMAT "%10.5" DEPOSIT ABSOLUTE /end AXIS_DESCR
 /begin AXIS_DESCR STD_AXIS NO_INPUT_QUANTITY RB_PT_PCT_SWC_DWC_CompuMethods_ratio_0p1 7 -2000. 2000. FORMAT "%10.5" DEPOSIT ABSOLUTE /end AXIS_DESCR
/end CHARACTERISTIC
/begin CHARACTERISTIC DWC_CALIB.DWC_TransmissionLosses.DWC_VISCOUSSPEEDCORRECTIONK1 "" MAP 0x8060FA1A RB_PT_PCT_SWC_DWC_RecordLayouts_RL_Map_uint16_18_uint16_3_sint16_6 10.0 RB_PT_PCT_SWC_DWC_CompuMethods_ratio_0p001__2 0.0 10. FORMAT "%10.5"
 /begin ANNOTATION ANNOTATION_LABEL "Description (coming from AUTOSAR DESC field)" /begin ANNOTATION_TEXT "Correction for temperature and input speed\r\n" /end ANNOTATION_TEXT /end ANNOTATION
 /begin AXIS_DESCR STD_AXIS NO_INPUT_QUANTITY RB_PT_PCT_SWC_DWC_CompuMethods_ident 3 0.0 20000. FORMAT "%10.5" DEPOSIT ABSOLUTE /end AXIS_DESCR
 /begin AXIS_DESCR STD_AXIS NO_INPUT_QUANTITY RB_PT_PCT_SWC_DWC_CompuMethods_ident 6 -50. 200. FORMAT "%10.5" DEPOSIT ABSOLUTE /end AXIS_DESCR
/end CHARACTERISTIC
/begin CHARACTERISTIC DWC_CALIB.DWC_TransmissionLosses.DWC_VISCOUSSPEEDCORRECTIONK2 "" MAP 0x8060FA54 RB_PT_PCT_SWC_DWC_RecordLayouts_RL_Map_uint16_18_uint16_3_sint16_6 10.0 RB_PT_PCT_SWC_DWC_CompuMethods_ratio_0p001__2 0.0 10. FORMAT "%10.5"
 /begin ANNOTATION ANNOTATION_LABEL "Description (coming from AUTOSAR DESC field)" /begin ANNOTATION_TEXT "Correction for temperature and input speed\r\n" /end ANNOTATION_TEXT /end ANNOTATION
 /begin AXIS_DESCR STD_AXIS NO_INPUT_QUANTITY RB_PT_PCT_SWC_DWC_CompuMethods_ident 3 0.0 20000. FORMAT "%10.5" DEPOSIT ABSOLUTE /end AXIS_DESCR
 /begin AXIS_DESCR STD_AXIS NO_INPUT_QUANTITY RB_PT_PCT_SWC_DWC_CompuMethods_ident 6 -50. 200. FORMAT "%10.5" DEPOSIT ABSOLUTE /end AXIS_DESCR
/end CHARACTERISTIC
/begin CHARACTERISTIC DWC_CALIB.DWC_USEFLGIONOTREADY "" VALUE 0x8060E736 DefaultValueRecordLayout_AUTOSAR_Platform_BaseTypes_boolean 255.0 AUTOSAR_Platform_CompuMethods_boolean 0.0 255. FORMAT "%10.5"
 /begin ANNOTATION ANNOTATION_LABEL "Description (coming from AUTOSAR DESC field)" /begin ANNOTATION_TEXT "Flag to enable IO not ready check\r\n" /end ANNOTATION_TEXT /end ANNOTATION
/end CHARACTERISTIC
/begin CHARACTERISTIC DWC_CALIB.DWC_ValveCleanLite.DWC_MAXCLEANCURRENT "" VALUE 0x8060FA8E DefaultValueRecordLayout_AUTOSAR_Platform_BaseTypes_uint16 5000.0 RB_PT_PCT_SWC_DWC_CompuMethods_ident 0.0 5000. FORMAT "%10.5"
 /begin ANNOTATION ANNOTATION_LABEL "Description (coming from AUTOSAR DESC field)" /begin ANNOTATION_TEXT "Maximum current during clean\r\n" /end ANNOTATION_TEXT /end ANNOTATION
/end CHARACTERISTIC
/begin CHARACTERISTIC DWC_CALIB.DWC_ValveCleanLite.DWC_MINCLEANCURRENT "" VALUE 0x8060FA90 DefaultValueRecordLayout_AUTOSAR_Platform_BaseTypes_uint16 5000.0 RB_PT_PCT_SWC_DWC_CompuMethods_ident 0.0 5000. FORMAT "%10.5"
 /begin ANNOTATION ANNOTATION_LABEL "Description (coming from AUTOSAR DESC field)" /begin ANNOTATION_TEXT "Minimum current during clean\r\n" /end ANNOTATION_TEXT /end ANNOTATION
/end CHARACTERISTIC
/begin CHARACTERISTIC DWC_CALIB.DWC_ValveCleanLite.DWC_TF_FCTRROUTINECLEANCURRENT "" CURVE 0x8060FA96 RB_PT_PCT_SWC_DWC_RecordLayouts_RL_Curve_uint16_11_uint16_11 1.0 RB_PT_PCT_SWC_DWC_CompuMethods_Ratio_0p001 0.0 1. FORMAT "%10.5"
 /begin ANNOTATION ANNOTATION_LABEL "Description (coming from AUTOSAR DESC field)" /begin ANNOTATION_TEXT "Depressure current as a function of time\r\n" /end ANNOTATION_TEXT /end ANNOTATION
 /begin AXIS_DESCR STD_AXIS NO_INPUT_QUANTITY RB_PT_PCT_SWC_DWC_CompuMethods_DST_Time 11 0.0 655.35 FORMAT "%10.5" DEPOSIT ABSOLUTE /end AXIS_DESCR
/end CHARACTERISTIC
/begin CHARACTERISTIC DWC_CALIB.DWC_ValveCleanLite.DWC_TIMEVALVEROUTINECLEAN "" VALUE 0x8060FA92 DefaultValueRecordLayout_AUTOSAR_Platform_BaseTypes_uint16 327.675 RB_PT_PCT_SWC_DWC_CompuMethods_time_0p005 0.0 327.675 FORMAT "%10.5"
 /begin ANNOTATION ANNOTATION_LABEL "Description (coming from AUTOSAR DESC field)" /begin ANNOTATION_TEXT "Maximum time before valve clean timeout\r\n" /end ANNOTATION_TEXT /end ANNOTATION
/end CHARACTERISTIC
/begin CHARACTERISTIC DWC_CALIB.DWC_ValveCleanLite.DWC_TIMEWAITFORDECOUPLE "" VALUE 0x8060FA94 DefaultValueRecordLayout_AUTOSAR_Platform_BaseTypes_uint16 327.675 RB_PT_PCT_SWC_DWC_CompuMethods_time_0p005 0.0 327.675 FORMAT "%10.5"
 /begin ANNOTATION ANNOTATION_LABEL "Description (coming from AUTOSAR DESC field)" /begin ANNOTATION_TEXT "Maximum time to wait for decouple\r\n" /end ANNOTATION_TEXT /end ANNOTATION
/end CHARACTERISTIC
/begin CHARACTERISTIC DWC_CALIB.DWC_ValveRinse.DWC_PCTVALVERINSEEARLYCOMPLETE "" VALUE 0x8060FACC DefaultValueRecordLayout_AUTOSAR_Platform_BaseTypes_uint8 1.0 RB_PT_PCT_SWC_DWC_CompuMethods_ratio_0p01 0.0 1. FORMAT "%10.5"
 /begin ANNOTATION ANNOTATION_LABEL "Description (coming from AUTOSAR DESC field)"
  /begin ANNOTATION_TEXT "Percentage of full rinse time where an early abortion still leads to a timeout condition\r\n" /end ANNOTATION_TEXT
 /end ANNOTATION
/end CHARACTERISTIC
/begin CHARACTERISTIC DWC_CALIB.DWC_ValveRinse.DWC_TIMEVALVEPRERINSE "" VALUE 0x8060FAC8 DefaultValueRecordLayout_AUTOSAR_Platform_BaseTypes_uint16 65.535 RB_PT_PCT_SWC_DWC_CompuMethods_ratio_0p001__2 0.0 65.535 FORMAT "%10.5"
 /begin ANNOTATION ANNOTATION_LABEL "Description (coming from AUTOSAR DESC field)" /begin ANNOTATION_TEXT "Maximum time before valve clean timeout\r\n" /end ANNOTATION_TEXT /end ANNOTATION
/end CHARACTERISTIC
/begin CHARACTERISTIC DWC_CALIB.DWC_ValveRinse.DWC_TIMEVALVERINSE "" VALUE 0x8060FACA DefaultValueRecordLayout_AUTOSAR_Platform_BaseTypes_uint16 65.535 RB_PT_PCT_SWC_DWC_CompuMethods_ratio_0p001__2 0.0 65.535 FORMAT "%10.5"
 /begin ANNOTATION ANNOTATION_LABEL "Description (coming from AUTOSAR DESC field)" /begin ANNOTATION_TEXT "Maximum time before valve clean timeout\r\n" /end ANNOTATION_TEXT /end ANNOTATION
/end CHARACTERISTIC
/begin CHARACTERISTIC DWC_CALIB.DWC_ValveRinse.DWC_TIMEVALVERINSERESET "" VALUE 0x8060FAC4 DefaultValueRecordLayout_AUTOSAR_Platform_BaseTypes_uint32 36000.0 RB_PT_PCT_SWC_DWC_CompuMethods_ratio_0p001__2 0.0 36000. FORMAT "%10.5"
 /begin ANNOTATION ANNOTATION_LABEL "Description (coming from AUTOSAR DESC field)" /begin ANNOTATION_TEXT "Maximum time before valve rinse timeout\r\n" /end ANNOTATION_TEXT /end ANNOTATION
/end CHARACTERISTIC
/begin CHARACTERISTIC DWC_CALIB.DWM_ThermalModel_BW.DWC_BOBCOOLINGFLOW "" VALUE 0x8060FAD8 DefaultValueRecordLayout_AUTOSAR_Platform_BaseTypes_uint16 127.5 RB_PT_PCT_SWC_DWC_CompuMethods_flow_0p01 0.0 127.5 FORMAT "%10.5"
 /begin ANNOTATION ANNOTATION_LABEL "Description (coming from AUTOSAR DESC field)" /begin ANNOTATION_TEXT "Cooling flow manual override value.\r\n" /end ANNOTATION_TEXT /end ANNOTATION
/end CHARACTERISTIC
/begin CHARACTERISTIC DWC_CALIB.DWM_ThermalModel_BW.DWC_BOBCOOLINGTEMP "" VALUE 0x8060FADA DefaultValueRecordLayout_AUTOSAR_Platform_BaseTypes_sint16 250.0 RB_PT_PCT_SWC_DWC_CompuMethods_ident -50. 200. FORMAT "%10.5"
 /begin ANNOTATION ANNOTATION_LABEL "Description (coming from AUTOSAR DESC field)" /begin ANNOTATION_TEXT "Cooling temp manual override value.\r\n" /end ANNOTATION_TEXT /end ANNOTATION
/end CHARACTERISTIC
/begin CHARACTERISTIC DWC_CALIB.DWM_ThermalModel_BW.DWC_BOBCOOLINGTEMPSTATUS "" VALUE 0x8060FAEA DefaultValueRecordLayout_AUTOSAR_Platform_BaseTypes_boolean 255.0 AUTOSAR_Platform_CompuMethods_boolean 0.0 255. FORMAT "%10.5"
 /begin ANNOTATION ANNOTATION_LABEL "Description (coming from AUTOSAR DESC field)" /begin ANNOTATION_TEXT "Cooling temp status manual override value.\r\n" /end ANNOTATION_TEXT /end ANNOTATION
/end CHARACTERISTIC
/begin CHARACTERISTIC DWC_CALIB.DWM_ThermalModel_BW.DWC_BOBCUTCOOLING "" VALUE 0x8060FAEB DefaultValueRecordLayout_AUTOSAR_Platform_BaseTypes_uint8 255.0 DefaultIdenticalCompu 0.0 255. FORMAT "%10.5"
 /begin ANNOTATION ANNOTATION_LABEL "Description (coming from AUTOSAR DESC field)" /begin ANNOTATION_TEXT "GAC cut manual override value.\r\n" /end ANNOTATION_TEXT /end ANNOTATION
/end CHARACTERISTIC
/begin CHARACTERISTIC DWC_CALIB.DWM_ThermalModel_BW.DWC_BOBENGINESPEED "" VALUE 0x8060FADC DefaultValueRecordLayout_AUTOSAR_Platform_BaseTypes_uint16 20000.0 RB_PT_PCT_SWC_DWC_CompuMethods_ident 0.0 20000. FORMAT "%10.5"
 /begin ANNOTATION ANNOTATION_LABEL "Description (coming from AUTOSAR DESC field)" /begin ANNOTATION_TEXT "Engine speed manual override value.\r\n" /end ANNOTATION_TEXT /end ANNOTATION
/end CHARACTERISTIC
/begin CHARACTERISTIC DWC_CALIB.DWM_ThermalModel_BW.DWC_BOBGEAR "" VALUE 0x8060FAEC DefaultValueRecordLayout_AUTOSAR_Platform_BaseTypes_uint8 11.0 RB_PT_PCT_SWC_DWC_CompuMethods_ident 0.0 11. FORMAT "%10.5"
 /begin ANNOTATION ANNOTATION_LABEL "Description (coming from AUTOSAR DESC field)" /begin ANNOTATION_TEXT "Engaged gear manual override value.\r\n" /end ANNOTATION_TEXT /end ANNOTATION
/end CHARACTERISTIC
/begin CHARACTERISTIC DWC_CALIB.DWM_ThermalModel_BW.DWC_BOBK1TORQUEFB "" VALUE 0x8060FADE DefaultValueRecordLayout_AUTOSAR_Platform_BaseTypes_sint16 4000.0 RB_PT_PCT_SWC_DWC_CompuMethods_ratio_0p1 -2000. 2000. FORMAT "%10.5"
 /begin ANNOTATION ANNOTATION_LABEL "Description (coming from AUTOSAR DESC field)" /begin ANNOTATION_TEXT "K1 torque capacity estimate bob\r\n" /end ANNOTATION_TEXT /end ANNOTATION
/end CHARACTERISTIC
/begin CHARACTERISTIC DWC_CALIB.DWM_ThermalModel_BW.DWC_BOBK2TORQUEFB "" VALUE 0x8060FAE0 DefaultValueRecordLayout_AUTOSAR_Platform_BaseTypes_sint16 4000.0 RB_PT_PCT_SWC_DWC_CompuMethods_ratio_0p1 -2000. 2000. FORMAT "%10.5"
 /begin ANNOTATION ANNOTATION_LABEL "Description (coming from AUTOSAR DESC field)" /begin ANNOTATION_TEXT "K2 torque capacity estimate bob\r\n" /end ANNOTATION_TEXT /end ANNOTATION
/end CHARACTERISTIC
/begin CHARACTERISTIC DWC_CALIB.DWM_ThermalModel_BW.DWC_BOBKL15 "" VALUE 0x8060FAED DefaultValueRecordLayout_AUTOSAR_Platform_BaseTypes_uint8 255.0 DefaultIdenticalCompu 0.0 255. FORMAT "%10.5"
 /begin ANNOTATION ANNOTATION_LABEL "Description (coming from AUTOSAR DESC field)" /begin ANNOTATION_TEXT "KL15 manual override value.\r\n" /end ANNOTATION_TEXT /end ANNOTATION
/end CHARACTERISTIC
/begin CHARACTERISTIC DWC_CALIB.DWM_ThermalModel_BW.DWC_BOBPASTATE "" VALUE 0x8060FAEE DefaultValueRecordLayout_AUTOSAR_Platform_BaseTypes_uint8 8.0 RB_PT_PCT_SWC_DWC_CompuMethods_Enumerations_DWC_PAStates 0.0 8. FORMAT "%10.5"
 /begin ANNOTATION ANNOTATION_LABEL "Description (coming from AUTOSAR DESC field)" /begin ANNOTATION_TEXT "Pullaway state manual override value.\r\n" /end ANNOTATION_TEXT /end ANNOTATION
/end CHARACTERISTIC
/begin CHARACTERISTIC DWC_CALIB.DWM_ThermalModel_BW.DWC_BOBSHIFTACTIVE "" VALUE 0x8060FAEF DefaultValueRecordLayout_AUTOSAR_Platform_BaseTypes_uint8 255.0 DefaultIdenticalCompu 0.0 255. FORMAT "%10.5"
 /begin ANNOTATION ANNOTATION_LABEL "Description (coming from AUTOSAR DESC field)" /begin ANNOTATION_TEXT "Shift active manual override value.\r\n" /end ANNOTATION_TEXT /end ANNOTATION
/end CHARACTERISTIC
/begin CHARACTERISTIC DWC_CALIB.DWM_ThermalModel_BW.DWC_BOBSLIPPOWERK1 "" VALUE 0x8060FAD0 DefaultValueRecordLayout_AUTOSAR_Platform_BaseTypes_uint32 1000000.0 RB_PT_PCT_SWC_DWC_CompuMethods_ident 0.0 1000000. FORMAT "%10.5"
 /begin ANNOTATION ANNOTATION_LABEL "Description (coming from AUTOSAR DESC field)" /begin ANNOTATION_TEXT "Slip power manual override value.\r\n" /end ANNOTATION_TEXT /end ANNOTATION
/end CHARACTERISTIC
/begin CHARACTERISTIC DWC_CALIB.DWM_ThermalModel_BW.DWC_BOBSLIPPOWERK2 "" VALUE 0x8060FAD4 DefaultValueRecordLayout_AUTOSAR_Platform_BaseTypes_uint32 1000000.0 RB_PT_PCT_SWC_DWC_CompuMethods_ident 0.0 1000000. FORMAT "%10.5"
 /begin ANNOTATION ANNOTATION_LABEL "Description (coming from AUTOSAR DESC field)" /begin ANNOTATION_TEXT "Slip power manual override value.\r\n" /end ANNOTATION_TEXT /end ANNOTATION
/end CHARACTERISTIC
/begin CHARACTERISTIC DWC_CALIB.DWM_ThermalModel_BW.DWC_BOBSUMPTEMP "" VALUE 0x8060FAE2 DefaultValueRecordLayout_AUTOSAR_Platform_BaseTypes_sint16 250.0 RB_PT_PCT_SWC_DWC_CompuMethods_ident -50. 200. FORMAT "%10.5"
 /begin ANNOTATION ANNOTATION_LABEL "Description (coming from AUTOSAR DESC field)" /begin ANNOTATION_TEXT "Sump temp manual override value.\r\n" /end ANNOTATION_TEXT /end ANNOTATION
/end CHARACTERISTIC
/begin CHARACTERISTIC DWC_CALIB.DWM_ThermalModel_BW.DWC_BOBSUMPTEMPSTATUS "" VALUE 0x8060FAF0 DefaultValueRecordLayout_AUTOSAR_Platform_BaseTypes_boolean 255.0 AUTOSAR_Platform_CompuMethods_boolean 0.0 255. FORMAT "%10.5"
 /begin ANNOTATION ANNOTATION_LABEL "Description (coming from AUTOSAR DESC field)" /begin ANNOTATION_TEXT "Sump temp status manual override value.\r\n" /end ANNOTATION_TEXT /end ANNOTATION
/end CHARACTERISTIC
/begin CHARACTERISTIC DWC_CALIB.DWM_ThermalModel_BW.DWC_ClutchCoolingDemand_K1.DWC_BOBCOOLINGTEMP "" VALUE 0x8060FB04 DefaultValueRecordLayout_AUTOSAR_Platform_BaseTypes_sint16 450.0 RB_PT_PCT_SWC_DWC_CompuMethods_temperature_0p1 -50. 400. FORMAT "%10.5"
 /begin ANNOTATION ANNOTATION_LABEL "Description (coming from AUTOSAR DESC field)" /begin ANNOTATION_TEXT "Cooling temp manual override value.\r\n" /end ANNOTATION_TEXT /end ANNOTATION
/end CHARACTERISTIC
/begin CHARACTERISTIC DWC_CALIB.DWM_ThermalModel_BW.DWC_ClutchCoolingDemand_K1.DWC_BOBCUTCOOLING "" VALUE 0x8060FB1A DefaultValueRecordLayout_AUTOSAR_Platform_BaseTypes_boolean 255.0 AUTOSAR_Platform_CompuMethods_boolean 0.0 255. FORMAT "%10.5"
 /begin ANNOTATION ANNOTATION_LABEL "Description (coming from AUTOSAR DESC field)" /begin ANNOTATION_TEXT "GAC cut manual override value.\r\n" /end ANNOTATION_TEXT /end ANNOTATION
/end CHARACTERISTIC
/begin CHARACTERISTIC DWC_CALIB.DWM_ThermalModel_BW.DWC_ClutchCoolingDemand_K1.DWC_BOBENGSPEED "" VALUE 0x8060FB06 DefaultValueRecordLayout_AUTOSAR_Platform_BaseTypes_uint16 20000.0 RB_PT_PCT_SWC_DWC_CompuMethods_ident 0.0 20000. FORMAT "%10.5"
 /begin ANNOTATION ANNOTATION_LABEL "Description (coming from AUTOSAR DESC field)" /begin ANNOTATION_TEXT "Engine speed manual override value.\r\n" /end ANNOTATION_TEXT /end ANNOTATION
/end CHARACTERISTIC
/begin CHARACTERISTIC DWC_CALIB.DWM_ThermalModel_BW.DWC_ClutchCoolingDemand_K1.DWC_BOBGEAR "" VALUE 0x8060FB1B DefaultValueRecordLayout_AUTOSAR_Platform_BaseTypes_uint8 11.0 RB_PT_PCT_SWC_DWC_CompuMethods_ident 0.0 11. FORMAT "%10.5"
 /begin ANNOTATION ANNOTATION_LABEL "Description (coming from AUTOSAR DESC field)" /begin ANNOTATION_TEXT "Gear manual override value.\r\n" /end ANNOTATION_TEXT /end ANNOTATION
/end CHARACTERISTIC
/begin CHARACTERISTIC DWC_CALIB.DWM_ThermalModel_BW.DWC_ClutchCoolingDemand_K1.DWC_BOBINTTEMP "" VALUE 0x8060FB08 DefaultValueRecordLayout_AUTOSAR_Platform_BaseTypes_sint16 450.0 RB_PT_PCT_SWC_DWC_CompuMethods_temperature_0p1 -50. 400. FORMAT "%10.5"
 /begin ANNOTATION ANNOTATION_LABEL "Description (coming from AUTOSAR DESC field)" /begin ANNOTATION_TEXT "Plate temp manual override value.\r\n" /end ANNOTATION_TEXT /end ANNOTATION
/end CHARACTERISTIC
/begin CHARACTERISTIC DWC_CALIB.DWM_ThermalModel_BW.DWC_ClutchCoolingDemand_K1.DWC_BOBPAACTIVE "" VALUE 0x8060FB1C DefaultValueRecordLayout_AUTOSAR_Platform_BaseTypes_boolean 255.0 AUTOSAR_Platform_CompuMethods_boolean 0.0 255. FORMAT "%10.5"
 /begin ANNOTATION ANNOTATION_LABEL "Description (coming from AUTOSAR DESC field)" /begin ANNOTATION_TEXT "Pullaway active flag manual override value.\r\n" /end ANNOTATION_TEXT /end ANNOTATION
/end CHARACTERISTIC
/begin CHARACTERISTIC DWC_CALIB.DWM_ThermalModel_BW.DWC_ClutchCoolingDemand_K1.DWC_BOBSLIPPOWER "" VALUE 0x8060FAFC DefaultValueRecordLayout_AUTOSAR_Platform_BaseTypes_uint32 1000000.0 RB_PT_PCT_SWC_DWC_CompuMethods_ident 0.0 1000000. FORMAT "%10.5"
 /begin ANNOTATION ANNOTATION_LABEL "Description (coming from AUTOSAR DESC field)" /begin ANNOTATION_TEXT "Slip power manual override value.\r\n" /end ANNOTATION_TEXT /end ANNOTATION
/end CHARACTERISTIC
/begin CHARACTERISTIC DWC_CALIB.DWM_ThermalModel_BW.DWC_ClutchCoolingDemand_K1.DWC_CutCoolingMaxTimer.LIB_DT "" VALUE 0x8060FB20 DefaultValueRecordLayout_AUTOSAR_Platform_BaseTypes_uint16 65.535 RB_PT_PCT_SWC_DWC_CompuMethods_ratio_0p001__2 0.0 65.535 FORMAT "%10.5"
 /begin ANNOTATION ANNOTATION_LABEL "Description (coming from AUTOSAR DESC field)" /begin ANNOTATION_TEXT "Timer decrement value.\r\n" /end ANNOTATION_TEXT /end ANNOTATION
/end CHARACTERISTIC
/begin CHARACTERISTIC DWC_CALIB.DWM_ThermalModel_BW.DWC_ClutchCoolingDemand_K1.DWC_FLGBLOCKGACCUTWITHTEMP "" VALUE 0x8060FB1D DefaultValueRecordLayout_AUTOSAR_Platform_BaseTypes_boolean 255.0 AUTOSAR_Platform_CompuMethods_boolean 0.0 255. FORMAT "%10.5"
 /begin ANNOTATION ANNOTATION_LABEL "Description (coming from AUTOSAR DESC field)"
  /begin ANNOTATION_TEXT "Enable logic to block GAC cut based on interface temp or slip power.\r\n" /end ANNOTATION_TEXT
 /end ANNOTATION
/end CHARACTERISTIC
/begin CHARACTERISTIC DWC_CALIB.DWM_ThermalModel_BW.DWC_ClutchCoolingDemand_K1.DWC_FLGBOB "" VALUE 0x8060FB1E DefaultValueRecordLayout_AUTOSAR_Platform_BaseTypes_boolean 255.0 AUTOSAR_Platform_CompuMethods_boolean 0.0 255. FORMAT "%10.5"
 /begin ANNOTATION ANNOTATION_LABEL "Description (coming from AUTOSAR DESC field)" /begin ANNOTATION_TEXT "Bob enable.\r\n" /end ANNOTATION_TEXT /end ANNOTATION
/end CHARACTERISTIC
/begin CHARACTERISTIC DWC_CALIB.DWM_ThermalModel_BW.DWC_ClutchCoolingDemand_K1.DWC_FLGENABNEUTRALCOOLING "" VALUE 0x8060FB1F DefaultValueRecordLayout_AUTOSAR_Platform_BaseTypes_uint8 255.0 DefaultIdenticalCompu 0.0 255. FORMAT "%10.5"
 /begin ANNOTATION ANNOTATION_LABEL "Description (coming from AUTOSAR DESC field)" /begin ANNOTATION_TEXT "Flag to implement neutral cooling fix.\r\n" /end ANNOTATION_TEXT /end ANNOTATION
/end CHARACTERISTIC
/begin CHARACTERISTIC DWC_CALIB.DWM_ThermalModel_BW.DWC_ClutchCoolingDemand_K1.DWC_FLOWPULSEHEIGHT "" VALUE 0x8060FB0A DefaultValueRecordLayout_AUTOSAR_Platform_BaseTypes_uint16 127.5 RB_PT_PCT_SWC_DWC_CompuMethods_flow_0p01 0.0 127.5 FORMAT "%10.5"
 /begin ANNOTATION ANNOTATION_LABEL "Description (coming from AUTOSAR DESC field)"
  /begin ANNOTATION_TEXT "Pulse height to be applied to continuous flow from map\r\n" /end ANNOTATION_TEXT
 /end ANNOTATION
/end CHARACTERISTIC
/begin CHARACTERISTIC DWC_CALIB.DWM_ThermalModel_BW.DWC_ClutchCoolingDemand_K1.DWC_MAXINTERFACETEMPFORGACCUT "" VALUE 0x8060FB0C DefaultValueRecordLayout_AUTOSAR_Platform_BaseTypes_sint16 450.0 RB_PT_PCT_SWC_DWC_CompuMethods_temperature_0p1 -50. 400. FORMAT "%10.5"
 /begin ANNOTATION ANNOTATION_LABEL "Description (coming from AUTOSAR DESC field)"
  /begin ANNOTATION_TEXT "Maximum allowable interface temperature to allow a GAC cut.\r\n" /end ANNOTATION_TEXT
 /end ANNOTATION
/end CHARACTERISTIC
/begin CHARACTERISTIC DWC_CALIB.DWM_ThermalModel_BW.DWC_ClutchCoolingDemand_K1.DWC_MAXSLIPPOWERFORGACCUT "" VALUE 0x8060FB00 DefaultValueRecordLayout_AUTOSAR_Platform_BaseTypes_uint32 1000000.0 RB_PT_PCT_SWC_DWC_CompuMethods_ident 0.0 1000000. FORMAT "%10.5"
 /begin ANNOTATION ANNOTATION_LABEL "Description (coming from AUTOSAR DESC field)"
  /begin ANNOTATION_TEXT "MAximum allowable slip power to allow for a GAC cut request.\r\n" /end ANNOTATION_TEXT
 /end ANNOTATION
/end CHARACTERISTIC
/begin CHARACTERISTIC DWC_CALIB.DWM_ThermalModel_BW.DWC_ClutchCoolingDemand_K1.DWC_MAXSPDFORPNCOOLING "" VALUE 0x8060FB0E DefaultValueRecordLayout_AUTOSAR_Platform_BaseTypes_uint16 500.0 RB_PT_PCT_SWC_DWC_CompuMethods_ratio_0p01 0.0 500. FORMAT "%10.5"
 /begin ANNOTATION ANNOTATION_LABEL "Description (coming from AUTOSAR DESC field)"
  /begin ANNOTATION_TEXT "Maximum vehicle speed for park/neutral cooling request\r\n" /end ANNOTATION_TEXT
 /end ANNOTATION
/end CHARACTERISTIC
/begin CHARACTERISTIC DWC_CALIB.DWM_ThermalModel_BW.DWC_ClutchCoolingDemand_K1.DWC_TEMPHYSTLOWTEMP "" VALUE 0x8060FB10 DefaultValueRecordLayout_AUTOSAR_Platform_BaseTypes_sint16 450.0 RB_PT_PCT_SWC_DWC_CompuMethods_temperature_0p1 -50. 400. FORMAT "%10.5"
 /begin ANNOTATION ANNOTATION_LABEL "Description (coming from AUTOSAR DESC field)"
  /begin ANNOTATION_TEXT "Temperature hysteresis for low temperature identification in N/P\r\n" /end ANNOTATION_TEXT
 /end ANNOTATION
/end CHARACTERISTIC
/begin CHARACTERISTIC DWC_CALIB.DWM_ThermalModel_BW.DWC_ClutchCoolingDemand_K1.DWC_TEMPTHRESHOLDN "" VALUE 0x8060FB12 DefaultValueRecordLayout_AUTOSAR_Platform_BaseTypes_sint16 450.0 RB_PT_PCT_SWC_DWC_CompuMethods_temperature_0p1 -50. 400. FORMAT "%10.5"
 /begin ANNOTATION ANNOTATION_LABEL "Description (coming from AUTOSAR DESC field)" /begin ANNOTATION_TEXT "Temperature threshold for cooling in N\r\n" /end ANNOTATION_TEXT /end ANNOTATION
/end CHARACTERISTIC
/begin CHARACTERISTIC DWC_CALIB.DWM_ThermalModel_BW.DWC_ClutchCoolingDemand_K1.DWC_TF_CONTINUOUSPOWER "" CURVE 0x8060FB22 RB_PT_PCT_SWC_DWC_RecordLayouts_RL_Curve_uint16_3_sint16_3 1000000.0 RB_PT_PCT_SWC_DWC_CompuMethods_ratio_20p0 0.0 1000000. FORMAT "%10.5"
 /begin ANNOTATION ANNOTATION_LABEL "Description (coming from AUTOSAR DESC field)"
  /begin ANNOTATION_TEXT "Continuous power limit based upon cooling oil temperature\r\n" /end ANNOTATION_TEXT
 /end ANNOTATION
 /begin AXIS_DESCR STD_AXIS NO_INPUT_QUANTITY RB_PT_PCT_SWC_DWC_CompuMethods_temperature_0p1 3 -50. 400. FORMAT "%10.5" DEPOSIT ABSOLUTE /end AXIS_DESCR
/end CHARACTERISTIC
/begin CHARACTERISTIC DWC_CALIB.DWM_ThermalModel_BW.DWC_ClutchCoolingDemand_K1.DWC_TF_COOLINGFLOW_CONTINUOUS "" MAP 0x8060FB30 RB_PT_PCT_SWC_DWC_RecordLayouts_RL_Map_uint16_18_uint16_6_sint16_3 127.5 RB_PT_PCT_SWC_DWC_CompuMethods_flow_0p01 0.0 127.5 FORMAT "%10.5"
 /begin ANNOTATION ANNOTATION_LABEL "Description (coming from AUTOSAR DESC field)"
  /begin ANNOTATION_TEXT "Cooling flow as a function of clutch slip power and oil temperature\r\n" /end ANNOTATION_TEXT
 /end ANNOTATION
 /begin AXIS_DESCR STD_AXIS NO_INPUT_QUANTITY RB_PT_PCT_SWC_DWC_CompuMethods_ratio_20p0 6 0.0 1000000. FORMAT "%10.5" DEPOSIT ABSOLUTE /end AXIS_DESCR
 /begin AXIS_DESCR STD_AXIS NO_INPUT_QUANTITY RB_PT_PCT_SWC_DWC_CompuMethods_temperature_0p1 3 -50. 400. FORMAT "%10.5" DEPOSIT ABSOLUTE /end AXIS_DESCR
/end CHARACTERISTIC
/begin CHARACTERISTIC DWC_CALIB.DWM_ThermalModel_BW.DWC_ClutchCoolingDemand_K1.DWC_TF_COOLINGFLOW_HPE "" MAP 0x8060FB6A RB_PT_PCT_SWC_DWC_RecordLayouts_RL_Map_uint16_18_uint16_6_sint16_3 127.5 RB_PT_PCT_SWC_DWC_CompuMethods_flow_0p01 0.0 127.5 FORMAT "%10.5"
 /begin ANNOTATION ANNOTATION_LABEL "Description (coming from AUTOSAR DESC field)"
  /begin ANNOTATION_TEXT "Cooling flow as a function of clutch slip power and oil temperature\r\n" /end ANNOTATION_TEXT
 /end ANNOTATION
 /begin AXIS_DESCR STD_AXIS NO_INPUT_QUANTITY RB_PT_PCT_SWC_DWC_CompuMethods_ratio_20p0 6 0.0 1000000. FORMAT "%10.5" DEPOSIT ABSOLUTE /end AXIS_DESCR
 /begin AXIS_DESCR STD_AXIS NO_INPUT_QUANTITY RB_PT_PCT_SWC_DWC_CompuMethods_temperature_0p1 3 -50. 400. FORMAT "%10.5" DEPOSIT ABSOLUTE /end AXIS_DESCR
/end CHARACTERISTIC
/begin CHARACTERISTIC DWC_CALIB.DWM_ThermalModel_BW.DWC_ClutchCoolingDemand_K1.DWC_TF_COOLINGPULSEPROFILE "" CURVE 0x8060FBA4 RB_PT_PCT_SWC_DWC_RecordLayouts_RL_Curve_sint16_5_uint16_5 2.0 RB_PT_PCT_SWC_DWC_CompuMethods_ratio_0p0001 -1. 1. FORMAT "%10.5"
 /begin ANNOTATION ANNOTATION_LABEL "Description (coming from AUTOSAR DESC field)" /begin ANNOTATION_TEXT "Cooling pulse profile\r\n" /end ANNOTATION_TEXT /end ANNOTATION
 /begin AXIS_DESCR STD_AXIS NO_INPUT_QUANTITY RB_PT_PCT_SWC_DWC_CompuMethods_ratio_0p001__2 5 0.0 1. FORMAT "%10.5" DEPOSIT ABSOLUTE /end AXIS_DESCR
/end CHARACTERISTIC
/begin CHARACTERISTIC DWC_CALIB.DWM_ThermalModel_BW.DWC_ClutchCoolingDemand_K1.DWC_TF_COOLINGVSPOWER "" CURVE 0x8060FBBC RB_PT_PCT_SWC_DWC_RecordLayouts_RL_Curve_uint16_4_uint32_4 127.5 RB_PT_PCT_SWC_DWC_CompuMethods_flow_0p01 0.0 127.5 FORMAT "%10.5"
 /begin ANNOTATION ANNOTATION_LABEL "Description (coming from AUTOSAR DESC field)"
  /begin ANNOTATION_TEXT "Cooling flow as a function of slip power during the high power event\r\n" /end ANNOTATION_TEXT
 /end ANNOTATION
 /begin AXIS_DESCR STD_AXIS NO_INPUT_QUANTITY RB_PT_PCT_SWC_DWC_CompuMethods_ident 4 0.0 1000000. FORMAT "%10.5" DEPOSIT ABSOLUTE /end AXIS_DESCR
/end CHARACTERISTIC
/begin CHARACTERISTIC DWC_CALIB.DWM_ThermalModel_BW.DWC_ClutchCoolingDemand_K1.DWC_TF_FCTPOSTCOOLING "" CURVE 0x8060FBD8 RB_PT_PCT_SWC_DWC_RecordLayouts_RL_Curve_uint16_5_uint16_5 1.0 RB_PT_PCT_SWC_DWC_CompuMethods_ratio_0p001__2 0.0 1. FORMAT "%10.5"
 /begin ANNOTATION ANNOTATION_LABEL "Description (coming from AUTOSAR DESC field)"
  /begin ANNOTATION_TEXT "Post cooling factor to be applied to latched flow demand\r\n" /end ANNOTATION_TEXT
 /end ANNOTATION
 /begin AXIS_DESCR STD_AXIS NO_INPUT_QUANTITY RB_PT_PCT_SWC_DWC_CompuMethods_ratio_0p001__2 5 0.0 1. FORMAT "%10.5" DEPOSIT ABSOLUTE /end AXIS_DESCR
/end CHARACTERISTIC
/begin CHARACTERISTIC DWC_CALIB.DWM_ThermalModel_BW.DWC_ClutchCoolingDemand_K1.DWC_TF_FLOWMAXCUTCOOLING "" CURVE 0x8060FBEE RB_PT_PCT_SWC_DWC_RecordLayouts_RL_Curve_uint16_5_sint16_5 127.5 RB_PT_PCT_SWC_DWC_CompuMethods_flow_0p01 0.0 127.5 FORMAT "%10.5"
 /begin ANNOTATION ANNOTATION_LABEL "Description (coming from AUTOSAR DESC field)"
  /begin ANNOTATION_TEXT "Maximum flow demand when cooling is cut based on oil temperature\r\n" /end ANNOTATION_TEXT
 /end ANNOTATION
 /begin AXIS_DESCR STD_AXIS NO_INPUT_QUANTITY RB_PT_PCT_SWC_DWC_CompuMethods_temperature_0p1 5 -50. 400. FORMAT "%10.5" DEPOSIT ABSOLUTE /end AXIS_DESCR
/end CHARACTERISTIC
/begin CHARACTERISTIC DWC_CALIB.DWM_ThermalModel_BW.DWC_ClutchCoolingDemand_K1.DWC_TF_FLOWNHIGHTEMP "" CURVE 0x8060FC04 RB_PT_PCT_SWC_DWC_RecordLayouts_RL_Curve_uint16_4_uint16_4 127.5 RB_PT_PCT_SWC_DWC_CompuMethods_flow_0p01 0.0 127.5 FORMAT "%10.5"
 /begin ANNOTATION ANNOTATION_LABEL "Description (coming from AUTOSAR DESC field)" /begin ANNOTATION_TEXT "Flow request in N at low temperatures\r\n" /end ANNOTATION_TEXT /end ANNOTATION
 /begin AXIS_DESCR STD_AXIS NO_INPUT_QUANTITY RB_PT_PCT_SWC_DWC_CompuMethods_ident 4 0.0 20000. FORMAT "%10.5" DEPOSIT ABSOLUTE /end AXIS_DESCR
/end CHARACTERISTIC
/begin CHARACTERISTIC DWC_CALIB.DWM_ThermalModel_BW.DWC_ClutchCoolingDemand_K1.DWC_TF_FLOWNLOWTEMP "" CURVE 0x8060FC16 RB_PT_PCT_SWC_DWC_RecordLayouts_RL_Curve_uint16_4_uint16_4 127.5 RB_PT_PCT_SWC_DWC_CompuMethods_flow_0p01 0.0 127.5 FORMAT "%10.5"
 /begin ANNOTATION ANNOTATION_LABEL "Description (coming from AUTOSAR DESC field)" /begin ANNOTATION_TEXT "Flow request in N at low temperatures\r\n" /end ANNOTATION_TEXT /end ANNOTATION
 /begin AXIS_DESCR STD_AXIS NO_INPUT_QUANTITY RB_PT_PCT_SWC_DWC_CompuMethods_ident 4 0.0 20000. FORMAT "%10.5" DEPOSIT ABSOLUTE /end AXIS_DESCR
/end CHARACTERISTIC
/begin CHARACTERISTIC DWC_CALIB.DWM_ThermalModel_BW.DWC_ClutchCoolingDemand_K1.DWC_TF_INTERFACEFLOW "" CURVE 0x8060FC28 RB_PT_PCT_SWC_DWC_RecordLayouts_RL_Curve_uint16_8_sint16_8 127.5 RB_PT_PCT_SWC_DWC_CompuMethods_flow_0p01 0.0 127.5 FORMAT "%10.5"
 /begin ANNOTATION ANNOTATION_LABEL "Description (coming from AUTOSAR DESC field)" /begin ANNOTATION_TEXT "Flow as a funciton of interface temperature\r\n" /end ANNOTATION_TEXT /end ANNOTATION
 /begin AXIS_DESCR STD_AXIS NO_INPUT_QUANTITY RB_PT_PCT_SWC_DWC_CompuMethods_temperature_0p1 8 -50. 400. FORMAT "%10.5" DEPOSIT ABSOLUTE /end AXIS_DESCR
/end CHARACTERISTIC
/begin CHARACTERISTIC DWC_CALIB.DWM_ThermalModel_BW.DWC_ClutchCoolingDemand_K1.DWC_TF_MAXCOOLING "" CURVE 0x8060FC4A RB_PT_PCT_SWC_DWC_RecordLayouts_RL_Curve_uint16_5_sint16_5 127.5 RB_PT_PCT_SWC_DWC_CompuMethods_flow_0p01 0.0 127.5 FORMAT "%10.5"
 /begin ANNOTATION ANNOTATION_LABEL "Description (coming from AUTOSAR DESC field)"
  /begin ANNOTATION_TEXT "Maximum cooling flow demand as a function of temperature\r\n" /end ANNOTATION_TEXT
 /end ANNOTATION
 /begin AXIS_DESCR STD_AXIS NO_INPUT_QUANTITY RB_PT_PCT_SWC_DWC_CompuMethods_temperature_0p1 5 -50. 400. FORMAT "%10.5" DEPOSIT ABSOLUTE /end AXIS_DESCR
/end CHARACTERISTIC
/begin CHARACTERISTIC DWC_CALIB.DWM_ThermalModel_BW.DWC_ClutchCoolingDemand_K1.DWC_TF_MINFLOW "" CURVE 0x8060FC60 RB_PT_PCT_SWC_DWC_RecordLayouts_RL_Curve_uint16_5_sint16_5 127.5 RB_PT_PCT_SWC_DWC_CompuMethods_flow_0p01 0.0 127.5 FORMAT "%10.5"
 /begin ANNOTATION ANNOTATION_LABEL "Description (coming from AUTOSAR DESC field)" /begin ANNOTATION_TEXT "Minimum flow as a function of temperature\r\n" /end ANNOTATION_TEXT /end ANNOTATION
 /begin AXIS_DESCR STD_AXIS NO_INPUT_QUANTITY RB_PT_PCT_SWC_DWC_CompuMethods_temperature_0p1 5 -50. 400. FORMAT "%10.5" DEPOSIT ABSOLUTE /end AXIS_DESCR
/end CHARACTERISTIC
/begin CHARACTERISTIC DWC_CALIB.DWM_ThermalModel_BW.DWC_ClutchCoolingDemand_K1.DWC_TF_POSTCOOLINGTIME "" CURVE 0x8060FC76 RB_PT_PCT_SWC_DWC_RecordLayouts_RL_Curve_uint16_3_uint16_3 65.535 RB_PT_PCT_SWC_DWC_CompuMethods_ratio_0p001__2 0.0 65.535 FORMAT "%10.5"
 /begin ANNOTATION ANNOTATION_LABEL "Description (coming from AUTOSAR DESC field)"
  /begin ANNOTATION_TEXT "Post cooling time as a function of maximum slip power seen during high power event\r\n" /end ANNOTATION_TEXT
 /end ANNOTATION
 /begin AXIS_DESCR STD_AXIS NO_INPUT_QUANTITY RB_PT_PCT_SWC_DWC_CompuMethods_ratio_20p0 3 0.0 1000000. FORMAT "%10.5" DEPOSIT ABSOLUTE /end AXIS_DESCR
/end CHARACTERISTIC
/begin CHARACTERISTIC DWC_CALIB.DWM_ThermalModel_BW.DWC_ClutchCoolingDemand_K1.DWC_TIMECOOLINGCUTMAX "" VALUE 0x8060FB14 DefaultValueRecordLayout_AUTOSAR_Platform_BaseTypes_uint16 65.535 RB_PT_PCT_SWC_DWC_CompuMethods_ratio_0p001__2 0.0 65.535 FORMAT "%10.5"
 /begin ANNOTATION ANNOTATION_LABEL "Description (coming from AUTOSAR DESC field)" /begin ANNOTATION_TEXT "Maximum time for cutting cooling\r\n" /end ANNOTATION_TEXT /end ANNOTATION
/end CHARACTERISTIC
/begin CHARACTERISTIC DWC_CALIB.DWM_ThermalModel_BW.DWC_ClutchCoolingDemand_K1.DWC_TIMECOOLINGCUTMAXMAP "" CURVE 0x8060FC84 RB_PT_PCT_SWC_DWC_RecordLayouts_RL_Curve_uint16_4_sint16_4 65.535 RB_PT_PCT_SWC_DWC_CompuMethods_ratio_0p001__2 0.0 65.535 FORMAT "%10.5"
 /begin ANNOTATION ANNOTATION_LABEL "Description (coming from AUTOSAR DESC field)" /begin ANNOTATION_TEXT "Maximum time for cutting cooling.\r\n" /end ANNOTATION_TEXT /end ANNOTATION
 /begin AXIS_DESCR STD_AXIS NO_INPUT_QUANTITY RB_PT_PCT_SWC_DWC_CompuMethods_temperature_0p1 4 -50. 400. FORMAT "%10.5" DEPOSIT ABSOLUTE /end AXIS_DESCR
/end CHARACTERISTIC
/begin CHARACTERISTIC DWC_CALIB.DWM_ThermalModel_BW.DWC_ClutchCoolingDemand_K1.DWC_TIMEMAXCOOLINGCUT "" VALUE 0x8060FB16 DefaultValueRecordLayout_AUTOSAR_Platform_BaseTypes_uint16 65.535 RB_PT_PCT_SWC_DWC_CompuMethods_ratio_0p001__2 0.0 65.535 FORMAT "%10.5"
 /begin ANNOTATION ANNOTATION_LABEL "Description (coming from AUTOSAR DESC field)" /begin ANNOTATION_TEXT "Maximum time that cooling can be cut\r\n" /end ANNOTATION_TEXT /end ANNOTATION
/end CHARACTERISTIC
/begin CHARACTERISTIC DWC_CALIB.DWM_ThermalModel_BW.DWC_ClutchCoolingDemand_K1.DWC_TIMEPULSE "" VALUE 0x8060FB18 DefaultValueRecordLayout_AUTOSAR_Platform_BaseTypes_uint16 65.535 RB_PT_PCT_SWC_DWC_CompuMethods_ratio_0p001__2 0.0 65.535 FORMAT "%10.5"
 /begin ANNOTATION ANNOTATION_LABEL "Description (coming from AUTOSAR DESC field)" /begin ANNOTATION_TEXT "Pulse time\r\n" /end ANNOTATION_TEXT /end ANNOTATION
/end CHARACTERISTIC
/begin CHARACTERISTIC DWC_CALIB.DWM_ThermalModel_BW.DWC_ClutchCoolingDemand_K2.DWC_BOBCOOLINGTEMP "" VALUE 0x8060FCA0 DefaultValueRecordLayout_AUTOSAR_Platform_BaseTypes_sint16 450.0 RB_PT_PCT_SWC_DWC_CompuMethods_temperature_0p1 -50. 400. FORMAT "%10.5"
 /begin ANNOTATION ANNOTATION_LABEL "Description (coming from AUTOSAR DESC field)" /begin ANNOTATION_TEXT "Cooling temp manual override value.\r\n" /end ANNOTATION_TEXT /end ANNOTATION
/end CHARACTERISTIC
/begin CHARACTERISTIC DWC_CALIB.DWM_ThermalModel_BW.DWC_ClutchCoolingDemand_K2.DWC_BOBCUTCOOLING "" VALUE 0x8060FCB6 DefaultValueRecordLayout_AUTOSAR_Platform_BaseTypes_boolean 255.0 AUTOSAR_Platform_CompuMethods_boolean 0.0 255. FORMAT "%10.5"
 /begin ANNOTATION ANNOTATION_LABEL "Description (coming from AUTOSAR DESC field)" /begin ANNOTATION_TEXT "GAC cut manual override value.\r\n" /end ANNOTATION_TEXT /end ANNOTATION
/end CHARACTERISTIC
/begin CHARACTERISTIC DWC_CALIB.DWM_ThermalModel_BW.DWC_ClutchCoolingDemand_K2.DWC_BOBENGSPEED "" VALUE 0x8060FCA2 DefaultValueRecordLayout_AUTOSAR_Platform_BaseTypes_uint16 20000.0 RB_PT_PCT_SWC_DWC_CompuMethods_ident 0.0 20000. FORMAT "%10.5"
 /begin ANNOTATION ANNOTATION_LABEL "Description (coming from AUTOSAR DESC field)" /begin ANNOTATION_TEXT "Engine speed manual override value.\r\n" /end ANNOTATION_TEXT /end ANNOTATION
/end CHARACTERISTIC
/begin CHARACTERISTIC DWC_CALIB.DWM_ThermalModel_BW.DWC_ClutchCoolingDemand_K2.DWC_BOBGEAR "" VALUE 0x8060FCB7 DefaultValueRecordLayout_AUTOSAR_Platform_BaseTypes_uint8 11.0 RB_PT_PCT_SWC_DWC_CompuMethods_ident 0.0 11. FORMAT "%10.5"
 /begin ANNOTATION ANNOTATION_LABEL "Description (coming from AUTOSAR DESC field)" /begin ANNOTATION_TEXT "Gear manual override value.\r\n" /end ANNOTATION_TEXT /end ANNOTATION
/end CHARACTERISTIC
/begin CHARACTERISTIC DWC_CALIB.DWM_ThermalModel_BW.DWC_ClutchCoolingDemand_K2.DWC_BOBINTTEMP "" VALUE 0x8060FCA4 DefaultValueRecordLayout_AUTOSAR_Platform_BaseTypes_sint16 450.0 RB_PT_PCT_SWC_DWC_CompuMethods_temperature_0p1 -50. 400. FORMAT "%10.5"
 /begin ANNOTATION ANNOTATION_LABEL "Description (coming from AUTOSAR DESC field)" /begin ANNOTATION_TEXT "Plate temp manual override value.\r\n" /end ANNOTATION_TEXT /end ANNOTATION
/end CHARACTERISTIC
/begin CHARACTERISTIC DWC_CALIB.DWM_ThermalModel_BW.DWC_ClutchCoolingDemand_K2.DWC_BOBPAACTIVE "" VALUE 0x8060FCB8 DefaultValueRecordLayout_AUTOSAR_Platform_BaseTypes_boolean 255.0 AUTOSAR_Platform_CompuMethods_boolean 0.0 255. FORMAT "%10.5"
 /begin ANNOTATION ANNOTATION_LABEL "Description (coming from AUTOSAR DESC field)" /begin ANNOTATION_TEXT "Pullaway active flag manual override value.\r\n" /end ANNOTATION_TEXT /end ANNOTATION
/end CHARACTERISTIC
/begin CHARACTERISTIC DWC_CALIB.DWM_ThermalModel_BW.DWC_ClutchCoolingDemand_K2.DWC_BOBSLIPPOWER "" VALUE 0x8060FC98 DefaultValueRecordLayout_AUTOSAR_Platform_BaseTypes_uint32 1000000.0 RB_PT_PCT_SWC_DWC_CompuMethods_ident 0.0 1000000. FORMAT "%10.5"
 /begin ANNOTATION ANNOTATION_LABEL "Description (coming from AUTOSAR DESC field)" /begin ANNOTATION_TEXT "Slip power manual override value.\r\n" /end ANNOTATION_TEXT /end ANNOTATION
/end CHARACTERISTIC
/begin CHARACTERISTIC DWC_CALIB.DWM_ThermalModel_BW.DWC_ClutchCoolingDemand_K2.DWC_CutCoolingMaxTimer.LIB_DT "" VALUE 0x8060FCBC DefaultValueRecordLayout_AUTOSAR_Platform_BaseTypes_uint16 65.535 RB_PT_PCT_SWC_DWC_CompuMethods_ratio_0p001__2 0.0 65.535 FORMAT "%10.5"
 /begin ANNOTATION ANNOTATION_LABEL "Description (coming from AUTOSAR DESC field)" /begin ANNOTATION_TEXT "Timer decrement value.\r\n" /end ANNOTATION_TEXT /end ANNOTATION
/end CHARACTERISTIC
/begin CHARACTERISTIC DWC_CALIB.DWM_ThermalModel_BW.DWC_ClutchCoolingDemand_K2.DWC_FLGBLOCKGACCUTWITHTEMP "" VALUE 0x8060FCB9 DefaultValueRecordLayout_AUTOSAR_Platform_BaseTypes_boolean 255.0 AUTOSAR_Platform_CompuMethods_boolean 0.0 255. FORMAT "%10.5"
 /begin ANNOTATION ANNOTATION_LABEL "Description (coming from AUTOSAR DESC field)"
  /begin ANNOTATION_TEXT "Enable logic to block GAC cut based on interface temp or slip power.\r\n" /end ANNOTATION_TEXT
 /end ANNOTATION
/end CHARACTERISTIC
/begin CHARACTERISTIC DWC_CALIB.DWM_ThermalModel_BW.DWC_ClutchCoolingDemand_K2.DWC_FLGBOB "" VALUE 0x8060FCBA DefaultValueRecordLayout_AUTOSAR_Platform_BaseTypes_boolean 255.0 AUTOSAR_Platform_CompuMethods_boolean 0.0 255. FORMAT "%10.5"
 /begin ANNOTATION ANNOTATION_LABEL "Description (coming from AUTOSAR DESC field)" /begin ANNOTATION_TEXT "Bob enable.\r\n" /end ANNOTATION_TEXT /end ANNOTATION
/end CHARACTERISTIC
/begin CHARACTERISTIC DWC_CALIB.DWM_ThermalModel_BW.DWC_ClutchCoolingDemand_K2.DWC_FLGENABNEUTRALCOOLING "" VALUE 0x8060FCBB DefaultValueRecordLayout_AUTOSAR_Platform_BaseTypes_uint8 255.0 DefaultIdenticalCompu 0.0 255. FORMAT "%10.5"
 /begin ANNOTATION ANNOTATION_LABEL "Description (coming from AUTOSAR DESC field)" /begin ANNOTATION_TEXT "Flag to implement neutral cooling fix.\r\n" /end ANNOTATION_TEXT /end ANNOTATION
/end CHARACTERISTIC
/begin CHARACTERISTIC DWC_CALIB.DWM_ThermalModel_BW.DWC_ClutchCoolingDemand_K2.DWC_FLOWPULSEHEIGHT "" VALUE 0x8060FCA6 DefaultValueRecordLayout_AUTOSAR_Platform_BaseTypes_uint16 127.5 RB_PT_PCT_SWC_DWC_CompuMethods_flow_0p01 0.0 127.5 FORMAT "%10.5"
 /begin ANNOTATION ANNOTATION_LABEL "Description (coming from AUTOSAR DESC field)"
  /begin ANNOTATION_TEXT "Pulse height to be applied to continuous flow from map\r\n" /end ANNOTATION_TEXT
 /end ANNOTATION
/end CHARACTERISTIC
/begin CHARACTERISTIC DWC_CALIB.DWM_ThermalModel_BW.DWC_ClutchCoolingDemand_K2.DWC_MAXINTERFACETEMPFORGACCUT "" VALUE 0x8060FCA8 DefaultValueRecordLayout_AUTOSAR_Platform_BaseTypes_sint16 450.0 RB_PT_PCT_SWC_DWC_CompuMethods_temperature_0p1 -50. 400. FORMAT "%10.5"
 /begin ANNOTATION ANNOTATION_LABEL "Description (coming from AUTOSAR DESC field)"
  /begin ANNOTATION_TEXT "Maximum allowable interface temperature to allow a GAC cut.\r\n" /end ANNOTATION_TEXT
 /end ANNOTATION
/end CHARACTERISTIC
/begin CHARACTERISTIC DWC_CALIB.DWM_ThermalModel_BW.DWC_ClutchCoolingDemand_K2.DWC_MAXSLIPPOWERFORGACCUT "" VALUE 0x8060FC9C DefaultValueRecordLayout_AUTOSAR_Platform_BaseTypes_uint32 1000000.0 RB_PT_PCT_SWC_DWC_CompuMethods_ident 0.0 1000000. FORMAT "%10.5"
 /begin ANNOTATION ANNOTATION_LABEL "Description (coming from AUTOSAR DESC field)"
  /begin ANNOTATION_TEXT "MAximum allowable slip power to allow for a GAC cut request.\r\n" /end ANNOTATION_TEXT
 /end ANNOTATION
/end CHARACTERISTIC
/begin CHARACTERISTIC DWC_CALIB.DWM_ThermalModel_BW.DWC_ClutchCoolingDemand_K2.DWC_MAXSPDFORPNCOOLING "" VALUE 0x8060FCAA DefaultValueRecordLayout_AUTOSAR_Platform_BaseTypes_uint16 500.0 RB_PT_PCT_SWC_DWC_CompuMethods_ratio_0p01 0.0 500. FORMAT "%10.5"
 /begin ANNOTATION ANNOTATION_LABEL "Description (coming from AUTOSAR DESC field)"
  /begin ANNOTATION_TEXT "Maximum vehicle speed for park/neutral cooling request\r\n" /end ANNOTATION_TEXT
 /end ANNOTATION
/end CHARACTERISTIC
/begin CHARACTERISTIC DWC_CALIB.DWM_ThermalModel_BW.DWC_ClutchCoolingDemand_K2.DWC_TEMPHYSTLOWTEMP "" VALUE 0x8060FCAC DefaultValueRecordLayout_AUTOSAR_Platform_BaseTypes_sint16 450.0 RB_PT_PCT_SWC_DWC_CompuMethods_temperature_0p1 -50. 400. FORMAT "%10.5"
 /begin ANNOTATION ANNOTATION_LABEL "Description (coming from AUTOSAR DESC field)"
  /begin ANNOTATION_TEXT "Temperature hysteresis for low temperature identification in N/P\r\n" /end ANNOTATION_TEXT
 /end ANNOTATION
/end CHARACTERISTIC
/begin CHARACTERISTIC DWC_CALIB.DWM_ThermalModel_BW.DWC_ClutchCoolingDemand_K2.DWC_TEMPTHRESHOLDN "" VALUE 0x8060FCAE DefaultValueRecordLayout_AUTOSAR_Platform_BaseTypes_sint16 450.0 RB_PT_PCT_SWC_DWC_CompuMethods_temperature_0p1 -50. 400. FORMAT "%10.5"
 /begin ANNOTATION ANNOTATION_LABEL "Description (coming from AUTOSAR DESC field)" /begin ANNOTATION_TEXT "Temperature threshold for cooling in N\r\n" /end ANNOTATION_TEXT /end ANNOTATION
/end CHARACTERISTIC
/begin CHARACTERISTIC DWC_CALIB.DWM_ThermalModel_BW.DWC_ClutchCoolingDemand_K2.DWC_TF_CONTINUOUSPOWER "" CURVE 0x8060FCBE RB_PT_PCT_SWC_DWC_RecordLayouts_RL_Curve_uint16_3_sint16_3 1000000.0 RB_PT_PCT_SWC_DWC_CompuMethods_ratio_20p0 0.0 1000000. FORMAT "%10.5"
 /begin ANNOTATION ANNOTATION_LABEL "Description (coming from AUTOSAR DESC field)"
  /begin ANNOTATION_TEXT "Continuous power limit based upon cooling oil temperature\r\n" /end ANNOTATION_TEXT
 /end ANNOTATION
 /begin AXIS_DESCR STD_AXIS NO_INPUT_QUANTITY RB_PT_PCT_SWC_DWC_CompuMethods_temperature_0p1 3 -50. 400. FORMAT "%10.5" DEPOSIT ABSOLUTE /end AXIS_DESCR
/end CHARACTERISTIC
/begin CHARACTERISTIC DWC_CALIB.DWM_ThermalModel_BW.DWC_ClutchCoolingDemand_K2.DWC_TF_COOLINGFLOW_CONTINUOUS "" MAP 0x8060FCCC RB_PT_PCT_SWC_DWC_RecordLayouts_RL_Map_uint16_18_uint16_6_sint16_3 127.5 RB_PT_PCT_SWC_DWC_CompuMethods_flow_0p01 0.0 127.5 FORMAT "%10.5"
 /begin ANNOTATION ANNOTATION_LABEL "Description (coming from AUTOSAR DESC field)"
  /begin ANNOTATION_TEXT "Cooling flow as a function of clutch slip power and oil temperature\r\n" /end ANNOTATION_TEXT
 /end ANNOTATION
 /begin AXIS_DESCR STD_AXIS NO_INPUT_QUANTITY RB_PT_PCT_SWC_DWC_CompuMethods_ratio_20p0 6 0.0 1000000. FORMAT "%10.5" DEPOSIT ABSOLUTE /end AXIS_DESCR
 /begin AXIS_DESCR STD_AXIS NO_INPUT_QUANTITY RB_PT_PCT_SWC_DWC_CompuMethods_temperature_0p1 3 -50. 400. FORMAT "%10.5" DEPOSIT ABSOLUTE /end AXIS_DESCR
/end CHARACTERISTIC
/begin CHARACTERISTIC DWC_CALIB.DWM_ThermalModel_BW.DWC_ClutchCoolingDemand_K2.DWC_TF_COOLINGFLOW_HPE "" MAP 0x8060FD06 RB_PT_PCT_SWC_DWC_RecordLayouts_RL_Map_uint16_18_uint16_6_sint16_3 127.5 RB_PT_PCT_SWC_DWC_CompuMethods_flow_0p01 0.0 127.5 FORMAT "%10.5"
 /begin ANNOTATION ANNOTATION_LABEL "Description (coming from AUTOSAR DESC field)"
  /begin ANNOTATION_TEXT "Cooling flow as a function of clutch slip power and oil temperature\r\n" /end ANNOTATION_TEXT
 /end ANNOTATION
 /begin AXIS_DESCR STD_AXIS NO_INPUT_QUANTITY RB_PT_PCT_SWC_DWC_CompuMethods_ratio_20p0 6 0.0 1000000. FORMAT "%10.5" DEPOSIT ABSOLUTE /end AXIS_DESCR
 /begin AXIS_DESCR STD_AXIS NO_INPUT_QUANTITY RB_PT_PCT_SWC_DWC_CompuMethods_temperature_0p1 3 -50. 400. FORMAT "%10.5" DEPOSIT ABSOLUTE /end AXIS_DESCR
/end CHARACTERISTIC
/begin CHARACTERISTIC DWC_CALIB.DWM_ThermalModel_BW.DWC_ClutchCoolingDemand_K2.DWC_TF_COOLINGPULSEPROFILE "" CURVE 0x8060FD40 RB_PT_PCT_SWC_DWC_RecordLayouts_RL_Curve_sint16_5_uint16_5 2.0 RB_PT_PCT_SWC_DWC_CompuMethods_ratio_0p0001 -1. 1. FORMAT "%10.5"
 /begin ANNOTATION ANNOTATION_LABEL "Description (coming from AUTOSAR DESC field)" /begin ANNOTATION_TEXT "Cooling pulse profile\r\n" /end ANNOTATION_TEXT /end ANNOTATION
 /begin AXIS_DESCR STD_AXIS NO_INPUT_QUANTITY RB_PT_PCT_SWC_DWC_CompuMethods_ratio_0p001__2 5 0.0 1. FORMAT "%10.5" DEPOSIT ABSOLUTE /end AXIS_DESCR
/end CHARACTERISTIC
/begin CHARACTERISTIC DWC_CALIB.DWM_ThermalModel_BW.DWC_ClutchCoolingDemand_K2.DWC_TF_COOLINGVSPOWER "" CURVE 0x8060FD58 RB_PT_PCT_SWC_DWC_RecordLayouts_RL_Curve_uint16_4_uint32_4 127.5 RB_PT_PCT_SWC_DWC_CompuMethods_flow_0p01 0.0 127.5 FORMAT "%10.5"
 /begin ANNOTATION ANNOTATION_LABEL "Description (coming from AUTOSAR DESC field)"
  /begin ANNOTATION_TEXT "Cooling flow as a function of slip power during the high power event\r\n" /end ANNOTATION_TEXT
 /end ANNOTATION
 /begin AXIS_DESCR STD_AXIS NO_INPUT_QUANTITY RB_PT_PCT_SWC_DWC_CompuMethods_ident 4 0.0 1000000. FORMAT "%10.5" DEPOSIT ABSOLUTE /end AXIS_DESCR
/end CHARACTERISTIC
/begin CHARACTERISTIC DWC_CALIB.DWM_ThermalModel_BW.DWC_ClutchCoolingDemand_K2.DWC_TF_FCTPOSTCOOLING "" CURVE 0x8060FD74 RB_PT_PCT_SWC_DWC_RecordLayouts_RL_Curve_uint16_5_uint16_5 1.0 RB_PT_PCT_SWC_DWC_CompuMethods_ratio_0p001__2 0.0 1. FORMAT "%10.5"
 /begin ANNOTATION ANNOTATION_LABEL "Description (coming from AUTOSAR DESC field)"
  /begin ANNOTATION_TEXT "Post cooling factor to be applied to latched flow demand\r\n" /end ANNOTATION_TEXT
 /end ANNOTATION
 /begin AXIS_DESCR STD_AXIS NO_INPUT_QUANTITY RB_PT_PCT_SWC_DWC_CompuMethods_ratio_0p001__2 5 0.0 1. FORMAT "%10.5" DEPOSIT ABSOLUTE /end AXIS_DESCR
/end CHARACTERISTIC
/begin CHARACTERISTIC DWC_CALIB.DWM_ThermalModel_BW.DWC_ClutchCoolingDemand_K2.DWC_TF_FLOWMAXCUTCOOLING "" CURVE 0x8060FD8A RB_PT_PCT_SWC_DWC_RecordLayouts_RL_Curve_uint16_5_sint16_5 127.5 RB_PT_PCT_SWC_DWC_CompuMethods_flow_0p01 0.0 127.5 FORMAT "%10.5"
 /begin ANNOTATION ANNOTATION_LABEL "Description (coming from AUTOSAR DESC field)"
  /begin ANNOTATION_TEXT "Maximum flow demand when cooling is cut based on oil temperature\r\n" /end ANNOTATION_TEXT
 /end ANNOTATION
 /begin AXIS_DESCR STD_AXIS NO_INPUT_QUANTITY RB_PT_PCT_SWC_DWC_CompuMethods_temperature_0p1 5 -50. 400. FORMAT "%10.5" DEPOSIT ABSOLUTE /end AXIS_DESCR
/end CHARACTERISTIC
/begin CHARACTERISTIC DWC_CALIB.DWM_ThermalModel_BW.DWC_ClutchCoolingDemand_K2.DWC_TF_FLOWNHIGHTEMP "" CURVE 0x8060FDA0 RB_PT_PCT_SWC_DWC_RecordLayouts_RL_Curve_uint16_4_uint16_4 127.5 RB_PT_PCT_SWC_DWC_CompuMethods_flow_0p01 0.0 127.5 FORMAT "%10.5"
 /begin ANNOTATION ANNOTATION_LABEL "Description (coming from AUTOSAR DESC field)" /begin ANNOTATION_TEXT "Flow request in N at low temperatures\r\n" /end ANNOTATION_TEXT /end ANNOTATION
 /begin AXIS_DESCR STD_AXIS NO_INPUT_QUANTITY RB_PT_PCT_SWC_DWC_CompuMethods_ident 4 0.0 20000. FORMAT "%10.5" DEPOSIT ABSOLUTE /end AXIS_DESCR
/end CHARACTERISTIC
/begin CHARACTERISTIC DWC_CALIB.DWM_ThermalModel_BW.DWC_ClutchCoolingDemand_K2.DWC_TF_FLOWNLOWTEMP "" CURVE 0x8060FDB2 RB_PT_PCT_SWC_DWC_RecordLayouts_RL_Curve_uint16_4_uint16_4 127.5 RB_PT_PCT_SWC_DWC_CompuMethods_flow_0p01 0.0 127.5 FORMAT "%10.5"
 /begin ANNOTATION ANNOTATION_LABEL "Description (coming from AUTOSAR DESC field)" /begin ANNOTATION_TEXT "Flow request in N at low temperatures\r\n" /end ANNOTATION_TEXT /end ANNOTATION
 /begin AXIS_DESCR STD_AXIS NO_INPUT_QUANTITY RB_PT_PCT_SWC_DWC_CompuMethods_ident 4 0.0 20000. FORMAT "%10.5" DEPOSIT ABSOLUTE /end AXIS_DESCR
/end CHARACTERISTIC
/begin CHARACTERISTIC DWC_CALIB.DWM_ThermalModel_BW.DWC_ClutchCoolingDemand_K2.DWC_TF_INTERFACEFLOW "" CURVE 0x8060FDC4 RB_PT_PCT_SWC_DWC_RecordLayouts_RL_Curve_uint16_8_sint16_8 127.5 RB_PT_PCT_SWC_DWC_CompuMethods_flow_0p01 0.0 127.5 FORMAT "%10.5"
 /begin ANNOTATION ANNOTATION_LABEL "Description (coming from AUTOSAR DESC field)" /begin ANNOTATION_TEXT "Flow as a funciton of interface temperature\r\n" /end ANNOTATION_TEXT /end ANNOTATION
 /begin AXIS_DESCR STD_AXIS NO_INPUT_QUANTITY RB_PT_PCT_SWC_DWC_CompuMethods_temperature_0p1 8 -50. 400. FORMAT "%10.5" DEPOSIT ABSOLUTE /end AXIS_DESCR
/end CHARACTERISTIC
/begin CHARACTERISTIC DWC_CALIB.DWM_ThermalModel_BW.DWC_ClutchCoolingDemand_K2.DWC_TF_MAXCOOLING "" CURVE 0x8060FDE6 RB_PT_PCT_SWC_DWC_RecordLayouts_RL_Curve_uint16_5_sint16_5 127.5 RB_PT_PCT_SWC_DWC_CompuMethods_flow_0p01 0.0 127.5 FORMAT "%10.5"
 /begin ANNOTATION ANNOTATION_LABEL "Description (coming from AUTOSAR DESC field)"
  /begin ANNOTATION_TEXT "Maximum cooling flow demand as a function of temperature\r\n" /end ANNOTATION_TEXT
 /end ANNOTATION
 /begin AXIS_DESCR STD_AXIS NO_INPUT_QUANTITY RB_PT_PCT_SWC_DWC_CompuMethods_temperature_0p1 5 -50. 400. FORMAT "%10.5" DEPOSIT ABSOLUTE /end AXIS_DESCR
/end CHARACTERISTIC
/begin CHARACTERISTIC DWC_CALIB.DWM_ThermalModel_BW.DWC_ClutchCoolingDemand_K2.DWC_TF_MINFLOW "" CURVE 0x8060FDFC RB_PT_PCT_SWC_DWC_RecordLayouts_RL_Curve_uint16_5_sint16_5 127.5 RB_PT_PCT_SWC_DWC_CompuMethods_flow_0p01 0.0 127.5 FORMAT "%10.5"
 /begin ANNOTATION ANNOTATION_LABEL "Description (coming from AUTOSAR DESC field)" /begin ANNOTATION_TEXT "Minimum flow as a function of temperature\r\n" /end ANNOTATION_TEXT /end ANNOTATION
 /begin AXIS_DESCR STD_AXIS NO_INPUT_QUANTITY RB_PT_PCT_SWC_DWC_CompuMethods_temperature_0p1 5 -50. 400. FORMAT "%10.5" DEPOSIT ABSOLUTE /end AXIS_DESCR
/end CHARACTERISTIC
/begin CHARACTERISTIC DWC_CALIB.DWM_ThermalModel_BW.DWC_ClutchCoolingDemand_K2.DWC_TF_POSTCOOLINGTIME "" CURVE 0x8060FE12 RB_PT_PCT_SWC_DWC_RecordLayouts_RL_Curve_uint16_3_uint16_3 65.535 RB_PT_PCT_SWC_DWC_CompuMethods_ratio_0p001__2 0.0 65.535 FORMAT "%10.5"
 /begin ANNOTATION ANNOTATION_LABEL "Description (coming from AUTOSAR DESC field)"
  /begin ANNOTATION_TEXT "Post cooling time as a function of maximum slip power seen during high power event\r\n" /end ANNOTATION_TEXT
 /end ANNOTATION
 /begin AXIS_DESCR STD_AXIS NO_INPUT_QUANTITY RB_PT_PCT_SWC_DWC_CompuMethods_ratio_20p0 3 0.0 1000000. FORMAT "%10.5" DEPOSIT ABSOLUTE /end AXIS_DESCR
/end CHARACTERISTIC
/begin CHARACTERISTIC DWC_CALIB.DWM_ThermalModel_BW.DWC_ClutchCoolingDemand_K2.DWC_TIMECOOLINGCUTMAX "" VALUE 0x8060FCB0 DefaultValueRecordLayout_AUTOSAR_Platform_BaseTypes_uint16 65.535 RB_PT_PCT_SWC_DWC_CompuMethods_ratio_0p001__2 0.0 65.535 FORMAT "%10.5"
 /begin ANNOTATION ANNOTATION_LABEL "Description (coming from AUTOSAR DESC field)" /begin ANNOTATION_TEXT "Maximum time for cutting cooling\r\n" /end ANNOTATION_TEXT /end ANNOTATION
/end CHARACTERISTIC
/begin CHARACTERISTIC DWC_CALIB.DWM_ThermalModel_BW.DWC_ClutchCoolingDemand_K2.DWC_TIMECOOLINGCUTMAXMAP "" CURVE 0x8060FE20 RB_PT_PCT_SWC_DWC_RecordLayouts_RL_Curve_uint16_4_sint16_4 65.535 RB_PT_PCT_SWC_DWC_CompuMethods_ratio_0p001__2 0.0 65.535 FORMAT "%10.5"
 /begin ANNOTATION ANNOTATION_LABEL "Description (coming from AUTOSAR DESC field)" /begin ANNOTATION_TEXT "Maximum time for cutting cooling.\r\n" /end ANNOTATION_TEXT /end ANNOTATION
 /begin AXIS_DESCR STD_AXIS NO_INPUT_QUANTITY RB_PT_PCT_SWC_DWC_CompuMethods_temperature_0p1 4 -50. 400. FORMAT "%10.5" DEPOSIT ABSOLUTE /end AXIS_DESCR
/end CHARACTERISTIC
/begin CHARACTERISTIC DWC_CALIB.DWM_ThermalModel_BW.DWC_ClutchCoolingDemand_K2.DWC_TIMEMAXCOOLINGCUT "" VALUE 0x8060FCB2 DefaultValueRecordLayout_AUTOSAR_Platform_BaseTypes_uint16 65.535 RB_PT_PCT_SWC_DWC_CompuMethods_ratio_0p001__2 0.0 65.535 FORMAT "%10.5"
 /begin ANNOTATION ANNOTATION_LABEL "Description (coming from AUTOSAR DESC field)" /begin ANNOTATION_TEXT "Maximum time that cooling can be cut\r\n" /end ANNOTATION_TEXT /end ANNOTATION
/end CHARACTERISTIC
/begin CHARACTERISTIC DWC_CALIB.DWM_ThermalModel_BW.DWC_ClutchCoolingDemand_K2.DWC_TIMEPULSE "" VALUE 0x8060FCB4 DefaultValueRecordLayout_AUTOSAR_Platform_BaseTypes_uint16 65.535 RB_PT_PCT_SWC_DWC_CompuMethods_ratio_0p001__2 0.0 65.535 FORMAT "%10.5"
 /begin ANNOTATION ANNOTATION_LABEL "Description (coming from AUTOSAR DESC field)" /begin ANNOTATION_TEXT "Pulse time\r\n" /end ANNOTATION_TEXT /end ANNOTATION
/end CHARACTERISTIC
/begin CHARACTERISTIC DWC_CALIB.DWM_ThermalModel_BW.DWC_FLGBOB "" VALUE 0x8060FAF1 DefaultValueRecordLayout_AUTOSAR_Platform_BaseTypes_uint8 255.0 DefaultIdenticalCompu 0.0 255. FORMAT "%10.5"
 /begin ANNOTATION ANNOTATION_LABEL "Description (coming from AUTOSAR DESC field)" /begin ANNOTATION_TEXT "Bob enable.\r\n" /end ANNOTATION_TEXT /end ANNOTATION
/end CHARACTERISTIC
/begin CHARACTERISTIC DWC_CALIB.DWM_ThermalModel_BW.DWC_FLGCHECKFBTORQUEFAULT "" VALUE 0x8060FAF2 DefaultValueRecordLayout_AUTOSAR_Platform_BaseTypes_boolean 255.0 AUTOSAR_Platform_CompuMethods_boolean 0.0 255. FORMAT "%10.5"
 /begin ANNOTATION ANNOTATION_LABEL "Description (coming from AUTOSAR DESC field)" /begin ANNOTATION_TEXT "Flag to check torqueFB if there is a speed fault.\r\n" /end ANNOTATION_TEXT /end ANNOTATION
/end CHARACTERISTIC
/begin CHARACTERISTIC DWC_CALIB.DWM_ThermalModel_BW.DWC_FLGCRCTCOOLINGDRCTN "" VALUE 0x8060FAF3 DefaultValueRecordLayout_AUTOSAR_Platform_BaseTypes_boolean 255.0 AUTOSAR_Platform_CompuMethods_boolean 0.0 255. FORMAT "%10.5"
 /begin ANNOTATION ANNOTATION_LABEL "Description (coming from AUTOSAR DESC field)"
  /begin ANNOTATION_TEXT "Flag to swap the target cooling oil inputs to align with flow direction.\r\n" /end ANNOTATION_TEXT
 /end ANNOTATION
/end CHARACTERISTIC
/begin CHARACTERISTIC DWC_CALIB.DWM_ThermalModel_BW.DWC_FLGENABLESIM "" VALUE 0x8060FAF4 DefaultValueRecordLayout_AUTOSAR_Platform_BaseTypes_uint8 255.0 DefaultIdenticalCompu 0.0 255. FORMAT "%10.5"
 /begin ANNOTATION ANNOTATION_LABEL "Description (coming from AUTOSAR DESC field)" /begin ANNOTATION_TEXT "Set true to enter simulation mode\r\n" /end ANNOTATION_TEXT /end ANNOTATION
/end CHARACTERISTIC
/begin CHARACTERISTIC DWC_CALIB.DWM_ThermalModel_BW.DWC_FLGFORCETEMPINIT "" VALUE 0x8060FAF5 DefaultValueRecordLayout_AUTOSAR_Platform_BaseTypes_uint8 255.0 DefaultIdenticalCompu 0.0 255. FORMAT "%10.5"
 /begin ANNOTATION ANNOTATION_LABEL "Description (coming from AUTOSAR DESC field)"
  /begin ANNOTATION_TEXT "Set true to force thermal model temperatures to initialise\r\n" /end ANNOTATION_TEXT
 /end ANNOTATION
/end CHARACTERISTIC
/begin CHARACTERISTIC DWC_CALIB.DWM_ThermalModel_BW.DWC_FLGINITSUMPOIL "" VALUE 0x8060FAF6 DefaultValueRecordLayout_AUTOSAR_Platform_BaseTypes_uint8 255.0 DefaultIdenticalCompu 0.0 255. FORMAT "%10.5"
 /begin ANNOTATION ANNOTATION_LABEL "Description (coming from AUTOSAR DESC field)"
  /begin ANNOTATION_TEXT "Set true to force init of clutch thermal model to sump oil temp, false to clutch cooling oil temp\r\n" /end ANNOTATION_TEXT
 /end ANNOTATION
/end CHARACTERISTIC
/begin CHARACTERISTIC DWC_CALIB.DWM_ThermalModel_BW.DWC_FLGRUNSIMTIMER "" VALUE 0x8060FAF7 DefaultValueRecordLayout_AUTOSAR_Platform_BaseTypes_uint8 255.0 DefaultIdenticalCompu 0.0 255. FORMAT "%10.5"
 /begin ANNOTATION ANNOTATION_LABEL "Description (coming from AUTOSAR DESC field)" /begin ANNOTATION_TEXT "Set true to run simulation timer\r\n" /end ANNOTATION_TEXT /end ANNOTATION
/end CHARACTERISTIC
/begin CHARACTERISTIC DWC_CALIB.DWM_ThermalModel_BW.DWC_FLGUSETARGETCOOLFLOW "" VALUE 0x8060FAF8 DefaultValueRecordLayout_AUTOSAR_Platform_BaseTypes_uint8 255.0 DefaultIdenticalCompu 0.0 255. FORMAT "%10.5"
 /begin ANNOTATION ANNOTATION_LABEL "Description (coming from AUTOSAR DESC field)" /begin ANNOTATION_TEXT "Use target cooling for thermal model.\r\n" /end ANNOTATION_TEXT /end ANNOTATION
/end CHARACTERISTIC
/begin CHARACTERISTIC DWC_CALIB.DWM_ThermalModel_BW.DWC_FLOWTHRESHHYST "" VALUE 0x8060FAE4 DefaultValueRecordLayout_AUTOSAR_Platform_BaseTypes_uint16 127.5 RB_PT_PCT_SWC_DWC_CompuMethods_flow_0p01 0.0 127.5 FORMAT "%10.5"
 /begin ANNOTATION ANNOTATION_LABEL "Description (coming from AUTOSAR DESC field)" /begin ANNOTATION_TEXT "Flow hysteresis for cooling grade\r\n" /end ANNOTATION_TEXT /end ANNOTATION
/end CHARACTERISTIC
/begin CHARACTERISTIC DWC_CALIB.DWM_ThermalModel_BW.DWC_FLOWTHRESHLOW2NORMAL "" VALUE 0x8060FAE6 DefaultValueRecordLayout_AUTOSAR_Platform_BaseTypes_uint16 127.5 RB_PT_PCT_SWC_DWC_CompuMethods_flow_0p01 0.0 127.5 FORMAT "%10.5"
 /begin ANNOTATION ANNOTATION_LABEL "Description (coming from AUTOSAR DESC field)"
  /begin ANNOTATION_TEXT "Norminal flow threshold - maximum for \"very low\".  No hysteresis applied\r\n" /end ANNOTATION_TEXT
 /end ANNOTATION
/end CHARACTERISTIC
/begin CHARACTERISTIC DWC_CALIB.DWM_ThermalModel_BW.DWC_FLOWTHRESHNORMAL2HIGH "" VALUE 0x8060FAE8 DefaultValueRecordLayout_AUTOSAR_Platform_BaseTypes_uint16 127.5 RB_PT_PCT_SWC_DWC_CompuMethods_flow_0p01 0.0 127.5 FORMAT "%10.5"
 /begin ANNOTATION ANNOTATION_LABEL "Description (coming from AUTOSAR DESC field)"
  /begin ANNOTATION_TEXT "Norminal flow threshold - maximum for \"normal\".  No hysteresis applied\r\n" /end ANNOTATION_TEXT
 /end ANNOTATION
/end CHARACTERISTIC
/begin CHARACTERISTIC DWC_CALIB.DWM_ThermalModel_BW.DWC_TF_SIM_COOLINGFLOW "" CURVE 0x8060FE56 RB_PT_PCT_SWC_DWC_RecordLayouts_RL_Curve_uint16_20_uint16_20 127.5 RB_PT_PCT_SWC_DWC_CompuMethods_flow_0p01 0.0 127.5 FORMAT "%10.5"
 /begin ANNOTATION ANNOTATION_LABEL "Description (coming from AUTOSAR DESC field)" /begin ANNOTATION_TEXT "Simulation looup table\r\n" /end ANNOTATION_TEXT /end ANNOTATION
 /begin AXIS_DESCR STD_AXIS NO_INPUT_QUANTITY RB_PT_PCT_SWC_DWC_CompuMethods_ratio_0p001__2 20 0.0 65.535 FORMAT "%10.5" DEPOSIT ABSOLUTE /end AXIS_DESCR
/end CHARACTERISTIC
/begin CHARACTERISTIC DWC_CALIB.DWM_ThermalModel_BW.DWC_TF_SIM_INLETTEMP "" CURVE 0x8060FEA8 RB_PT_PCT_SWC_DWC_RecordLayouts_RL_Curve_sint16_20_uint16_20 450.0 RB_PT_PCT_SWC_DWC_CompuMethods_temperature_0p1 -50. 400. FORMAT "%10.5"
 /begin ANNOTATION ANNOTATION_LABEL "Description (coming from AUTOSAR DESC field)" /begin ANNOTATION_TEXT "Simulation looup table\r\n" /end ANNOTATION_TEXT /end ANNOTATION
 /begin AXIS_DESCR STD_AXIS NO_INPUT_QUANTITY RB_PT_PCT_SWC_DWC_CompuMethods_ratio_0p001__2 20 0.0 65.535 FORMAT "%10.5" DEPOSIT ABSOLUTE /end AXIS_DESCR
/end CHARACTERISTIC
/begin CHARACTERISTIC DWC_CALIB.DWM_ThermalModel_BW.DWC_TF_SIM_K1POWER "" CURVE 0x8060FEFA RB_PT_PCT_SWC_DWC_RecordLayouts_RL_Curve_uint16_20_uint16_20 1000000.0 RB_PT_PCT_SWC_DWC_CompuMethods_ratio_20p0 0.0 1000000. FORMAT "%10.5"
 /begin ANNOTATION ANNOTATION_LABEL "Description (coming from AUTOSAR DESC field)" /begin ANNOTATION_TEXT "Simulation looup table\r\n" /end ANNOTATION_TEXT /end ANNOTATION
 /begin AXIS_DESCR STD_AXIS NO_INPUT_QUANTITY RB_PT_PCT_SWC_DWC_CompuMethods_ratio_0p001__2 20 0.0 65.535 FORMAT "%10.5" DEPOSIT ABSOLUTE /end AXIS_DESCR
/end CHARACTERISTIC
/begin CHARACTERISTIC DWC_CALIB.DWM_ThermalModel_BW.DWC_TF_SIM_K2POWER "" CURVE 0x8060FF4C RB_PT_PCT_SWC_DWC_RecordLayouts_RL_Curve_uint16_20_uint16_20 1000000.0 RB_PT_PCT_SWC_DWC_CompuMethods_ratio_20p0 0.0 1000000. FORMAT "%10.5"
 /begin ANNOTATION ANNOTATION_LABEL "Description (coming from AUTOSAR DESC field)" /begin ANNOTATION_TEXT "Simulation looup table\r\n" /end ANNOTATION_TEXT /end ANNOTATION
 /begin AXIS_DESCR STD_AXIS NO_INPUT_QUANTITY RB_PT_PCT_SWC_DWC_CompuMethods_ratio_0p001__2 20 0.0 65.535 FORMAT "%10.5" DEPOSIT ABSOLUTE /end AXIS_DESCR
/end CHARACTERISTIC
/begin CHARACTERISTIC DWC_CALIB.DWM_ThermalModel_BW.DWC_ThermalModel_K1.DWC_ENABLECLUTCHOILRISEWITHINLET "" VALUE 0x8060FE3A DefaultValueRecordLayout_AUTOSAR_Platform_BaseTypes_boolean 255.0 AUTOSAR_Platform_CompuMethods_boolean 0.0 255. FORMAT "%10.5"
 /begin ANNOTATION ANNOTATION_LABEL "Description (coming from AUTOSAR DESC field)"
  /begin ANNOTATION_TEXT "Flag to enable clutch oil temp to rise with inlet oil temp.\r\n" /end ANNOTATION_TEXT
 /end ANNOTATION
/end CHARACTERISTIC
/begin CHARACTERISTIC DWC_CALIB.DWM_ThermalModel_BW.DWC_ThermalModel_K1.DWC_FCTCOOL "" VALUE 0x8060FE34 DefaultValueRecordLayout_AUTOSAR_Platform_BaseTypes_uint16 0.5 RB_PT_PCT_SWC_DWC_CompuMethods_ratio_0p00001 0.0 0.5 FORMAT "%10.5"
 /begin ANNOTATION ANNOTATION_LABEL "Description (coming from AUTOSAR DESC field)" /begin ANNOTATION_TEXT "Cooling factor\r\n" /end ANNOTATION_TEXT /end ANNOTATION
/end CHARACTERISTIC
/begin CHARACTERISTIC DWC_CALIB.DWM_ThermalModel_BW.DWC_ThermalModel_K1.DWC_FCTHEAT "" VALUE 0x8060FE36 DefaultValueRecordLayout_AUTOSAR_Platform_BaseTypes_uint16 0.1 RB_PT_PCT_SWC_DWC_CompuMethods_ratio_0p00001 0.0 0.1 FORMAT "%10.5"
 /begin ANNOTATION ANNOTATION_LABEL "Description (coming from AUTOSAR DESC field)" /begin ANNOTATION_TEXT "Heat factor with power conversion ( x 9.549)\r\n" /end ANNOTATION_TEXT /end ANNOTATION
/end CHARACTERISTIC
/begin CHARACTERISTIC DWC_CALIB.DWM_ThermalModel_BW.DWC_ThermalModel_K1.DWC_INLETTEMPRISEFACTOR "" VALUE 0x8060FE3B DefaultValueRecordLayout_AUTOSAR_Platform_BaseTypes_uint8 1.0 RB_PT_PCT_SWC_DWC_CompuMethods_ratio_0p01 0.0 1. FORMAT "%10.5"
 /begin ANNOTATION ANNOTATION_LABEL "Description (coming from AUTOSAR DESC field)"
  /begin ANNOTATION_TEXT "Factor of inlet temp at which current temp should rise to.\r\n" /end ANNOTATION_TEXT
 /end ANNOTATION
/end CHARACTERISTIC
/begin CHARACTERISTIC DWC_CALIB.DWM_ThermalModel_BW.DWC_ThermalModel_K1.DWC_MINCOOLINGFLOW "" VALUE 0x8060FE38 DefaultValueRecordLayout_AUTOSAR_Platform_BaseTypes_uint16 0.1 RB_PT_PCT_SWC_DWC_CompuMethods_flow_0p01 0.0 0.1 FORMAT "%10.5"
 /begin ANNOTATION ANNOTATION_LABEL "Description (coming from AUTOSAR DESC field)"
  /begin ANNOTATION_TEXT "Minimum cooling flow to allow for temperature decay in no flow scenario.\r\n" /end ANNOTATION_TEXT
 /end ANNOTATION
/end CHARACTERISTIC
/begin CHARACTERISTIC DWC_CALIB.DWM_ThermalModel_BW.DWC_ThermalModel_K1OutletOil.DWC_ENABLECLUTCHOILRISEWITHINLET "" VALUE 0x8060FE42 DefaultValueRecordLayout_AUTOSAR_Platform_BaseTypes_boolean 255.0 AUTOSAR_Platform_CompuMethods_boolean 0.0 255. FORMAT "%10.5"
 /begin ANNOTATION ANNOTATION_LABEL "Description (coming from AUTOSAR DESC field)"
  /begin ANNOTATION_TEXT "Flag to enable clutch oil temp to rise with inlet oil temp.\r\n" /end ANNOTATION_TEXT
 /end ANNOTATION
/end CHARACTERISTIC
/begin CHARACTERISTIC DWC_CALIB.DWM_ThermalModel_BW.DWC_ThermalModel_K1OutletOil.DWC_FCTCOOL "" VALUE 0x8060FE3C DefaultValueRecordLayout_AUTOSAR_Platform_BaseTypes_uint16 0.5 RB_PT_PCT_SWC_DWC_CompuMethods_ratio_0p00001 0.0 0.5 FORMAT "%10.5"
 /begin ANNOTATION ANNOTATION_LABEL "Description (coming from AUTOSAR DESC field)" /begin ANNOTATION_TEXT "Cooling factor\r\n" /end ANNOTATION_TEXT /end ANNOTATION
/end CHARACTERISTIC
/begin CHARACTERISTIC DWC_CALIB.DWM_ThermalModel_BW.DWC_ThermalModel_K1OutletOil.DWC_FCTHEAT "" VALUE 0x8060FE3E DefaultValueRecordLayout_AUTOSAR_Platform_BaseTypes_uint16 0.1 RB_PT_PCT_SWC_DWC_CompuMethods_ratio_0p00001 0.0 0.1 FORMAT "%10.5"
 /begin ANNOTATION ANNOTATION_LABEL "Description (coming from AUTOSAR DESC field)" /begin ANNOTATION_TEXT "Heat factor with power conversion ( x 9.549)\r\n" /end ANNOTATION_TEXT /end ANNOTATION
/end CHARACTERISTIC
/begin CHARACTERISTIC DWC_CALIB.DWM_ThermalModel_BW.DWC_ThermalModel_K1OutletOil.DWC_INLETTEMPRISEFACTOR "" VALUE 0x8060FE43 DefaultValueRecordLayout_AUTOSAR_Platform_BaseTypes_uint8 1.0 RB_PT_PCT_SWC_DWC_CompuMethods_ratio_0p01 0.0 1. FORMAT "%10.5"
 /begin ANNOTATION ANNOTATION_LABEL "Description (coming from AUTOSAR DESC field)"
  /begin ANNOTATION_TEXT "Factor of inlet temp at which current temp should rise to.\r\n" /end ANNOTATION_TEXT
 /end ANNOTATION
/end CHARACTERISTIC
/begin CHARACTERISTIC DWC_CALIB.DWM_ThermalModel_BW.DWC_ThermalModel_K1OutletOil.DWC_MINCOOLINGFLOW "" VALUE 0x8060FE40 DefaultValueRecordLayout_AUTOSAR_Platform_BaseTypes_uint16 0.1 RB_PT_PCT_SWC_DWC_CompuMethods_flow_0p01 0.0 0.1 FORMAT "%10.5"
 /begin ANNOTATION ANNOTATION_LABEL "Description (coming from AUTOSAR DESC field)"
  /begin ANNOTATION_TEXT "Minimum cooling flow to allow for temperature decay in no flow scenario.\r\n" /end ANNOTATION_TEXT
 /end ANNOTATION
/end CHARACTERISTIC
/begin CHARACTERISTIC DWC_CALIB.DWM_ThermalModel_BW.DWC_ThermalModel_K2.DWC_ENABLECLUTCHOILRISEWITHINLET "" VALUE 0x8060FE4A DefaultValueRecordLayout_AUTOSAR_Platform_BaseTypes_boolean 255.0 AUTOSAR_Platform_CompuMethods_boolean 0.0 255. FORMAT "%10.5"
 /begin ANNOTATION ANNOTATION_LABEL "Description (coming from AUTOSAR DESC field)"
  /begin ANNOTATION_TEXT "Flag to enable clutch oil temp to rise with inlet oil temp.\r\n" /end ANNOTATION_TEXT
 /end ANNOTATION
/end CHARACTERISTIC
/begin CHARACTERISTIC DWC_CALIB.DWM_ThermalModel_BW.DWC_ThermalModel_K2.DWC_FCTCOOL "" VALUE 0x8060FE44 DefaultValueRecordLayout_AUTOSAR_Platform_BaseTypes_uint16 0.5 RB_PT_PCT_SWC_DWC_CompuMethods_ratio_0p00001 0.0 0.5 FORMAT "%10.5"
 /begin ANNOTATION ANNOTATION_LABEL "Description (coming from AUTOSAR DESC field)" /begin ANNOTATION_TEXT "Cooling factor\r\n" /end ANNOTATION_TEXT /end ANNOTATION
/end CHARACTERISTIC
/begin CHARACTERISTIC DWC_CALIB.DWM_ThermalModel_BW.DWC_ThermalModel_K2.DWC_FCTHEAT "" VALUE 0x8060FE46 DefaultValueRecordLayout_AUTOSAR_Platform_BaseTypes_uint16 0.1 RB_PT_PCT_SWC_DWC_CompuMethods_ratio_0p00001 0.0 0.1 FORMAT "%10.5"
 /begin ANNOTATION ANNOTATION_LABEL "Description (coming from AUTOSAR DESC field)" /begin ANNOTATION_TEXT "Heat factor with power conversion ( x 9.549)\r\n" /end ANNOTATION_TEXT /end ANNOTATION
/end CHARACTERISTIC
/begin CHARACTERISTIC DWC_CALIB.DWM_ThermalModel_BW.DWC_ThermalModel_K2.DWC_INLETTEMPRISEFACTOR "" VALUE 0x8060FE4B DefaultValueRecordLayout_AUTOSAR_Platform_BaseTypes_uint8 1.0 RB_PT_PCT_SWC_DWC_CompuMethods_ratio_0p01 0.0 1. FORMAT "%10.5"
 /begin ANNOTATION ANNOTATION_LABEL "Description (coming from AUTOSAR DESC field)"
  /begin ANNOTATION_TEXT "Factor of inlet temp at which current temp should rise to.\r\n" /end ANNOTATION_TEXT
 /end ANNOTATION
/end CHARACTERISTIC
/begin CHARACTERISTIC DWC_CALIB.DWM_ThermalModel_BW.DWC_ThermalModel_K2.DWC_MINCOOLINGFLOW "" VALUE 0x8060FE48 DefaultValueRecordLayout_AUTOSAR_Platform_BaseTypes_uint16 0.1 RB_PT_PCT_SWC_DWC_CompuMethods_flow_0p01 0.0 0.1 FORMAT "%10.5"
 /begin ANNOTATION ANNOTATION_LABEL "Description (coming from AUTOSAR DESC field)"
  /begin ANNOTATION_TEXT "Minimum cooling flow to allow for temperature decay in no flow scenario.\r\n" /end ANNOTATION_TEXT
 /end ANNOTATION
/end CHARACTERISTIC
/begin CHARACTERISTIC DWC_CALIB.DWM_ThermalModel_BW.DWC_ThermalModel_K2OutletOil.DWC_ENABLECLUTCHOILRISEWITHINLET "" VALUE 0x8060FE52 DefaultValueRecordLayout_AUTOSAR_Platform_BaseTypes_boolean 255.0 AUTOSAR_Platform_CompuMethods_boolean 0.0 255. FORMAT "%10.5"
 /begin ANNOTATION ANNOTATION_LABEL "Description (coming from AUTOSAR DESC field)"
  /begin ANNOTATION_TEXT "Flag to enable clutch oil temp to rise with inlet oil temp.\r\n" /end ANNOTATION_TEXT
 /end ANNOTATION
/end CHARACTERISTIC
/begin CHARACTERISTIC DWC_CALIB.DWM_ThermalModel_BW.DWC_ThermalModel_K2OutletOil.DWC_FCTCOOL "" VALUE 0x8060FE4C DefaultValueRecordLayout_AUTOSAR_Platform_BaseTypes_uint16 0.5 RB_PT_PCT_SWC_DWC_CompuMethods_ratio_0p00001 0.0 0.5 FORMAT "%10.5"
 /begin ANNOTATION ANNOTATION_LABEL "Description (coming from AUTOSAR DESC field)" /begin ANNOTATION_TEXT "Cooling factor\r\n" /end ANNOTATION_TEXT /end ANNOTATION
/end CHARACTERISTIC
/begin CHARACTERISTIC DWC_CALIB.DWM_ThermalModel_BW.DWC_ThermalModel_K2OutletOil.DWC_FCTHEAT "" VALUE 0x8060FE4E DefaultValueRecordLayout_AUTOSAR_Platform_BaseTypes_uint16 0.1 RB_PT_PCT_SWC_DWC_CompuMethods_ratio_0p00001 0.0 0.1 FORMAT "%10.5"
 /begin ANNOTATION ANNOTATION_LABEL "Description (coming from AUTOSAR DESC field)" /begin ANNOTATION_TEXT "Heat factor with power conversion ( x 9.549)\r\n" /end ANNOTATION_TEXT /end ANNOTATION
/end CHARACTERISTIC
/begin CHARACTERISTIC DWC_CALIB.DWM_ThermalModel_BW.DWC_ThermalModel_K2OutletOil.DWC_INLETTEMPRISEFACTOR "" VALUE 0x8060FE53 DefaultValueRecordLayout_AUTOSAR_Platform_BaseTypes_uint8 1.0 RB_PT_PCT_SWC_DWC_CompuMethods_ratio_0p01 0.0 1. FORMAT "%10.5"
 /begin ANNOTATION ANNOTATION_LABEL "Description (coming from AUTOSAR DESC field)"
  /begin ANNOTATION_TEXT "Factor of inlet temp at which current temp should rise to.\r\n" /end ANNOTATION_TEXT
 /end ANNOTATION
/end CHARACTERISTIC
/begin CHARACTERISTIC DWC_CALIB.DWM_ThermalModel_BW.DWC_ThermalModel_K2OutletOil.DWC_MINCOOLINGFLOW "" VALUE 0x8060FE50 DefaultValueRecordLayout_AUTOSAR_Platform_BaseTypes_uint16 0.1 RB_PT_PCT_SWC_DWC_CompuMethods_flow_0p01 0.0 0.1 FORMAT "%10.5"
 /begin ANNOTATION ANNOTATION_LABEL "Description (coming from AUTOSAR DESC field)"
  /begin ANNOTATION_TEXT "Minimum cooling flow to allow for temperature decay in no flow scenario.\r\n" /end ANNOTATION_TEXT
 /end ANNOTATION
/end CHARACTERISTIC
/begin CHARACTERISTIC DWC_CALIB.DWM_ThermalModel_BW.DWC_TimerThermalModelSimulate.LIB_DT "" VALUE 0x8060FE54 DefaultValueRecordLayout_AUTOSAR_Platform_BaseTypes_uint16 65.535 RB_PT_PCT_SWC_DWC_CompuMethods_ratio_0p001__2 0.0 65.535 FORMAT "%10.5"
 /begin ANNOTATION ANNOTATION_LABEL "Description (coming from AUTOSAR DESC field)" /begin ANNOTATION_TEXT "Timer decrement value.\r\n" /end ANNOTATION_TEXT /end ANNOTATION
/end CHARACTERISTIC
/begin CHARACTERISTIC DWC_CLEARADAPTIONS "Boolean" VALUE 0x806040A0 DefaultValueRecordLayout_AUTOSAR_Platform_BaseTypes_boolean 255.0 AUTOSAR_Platform_CompuMethods_boolean 0.0 255. FORMAT "%10.5"
 /begin ANNOTATION ANNOTATION_LABEL "Description (coming from AUTOSAR DESC field)" /begin ANNOTATION_TEXT "Flag to force clear of adaptions\r\n" /end ANNOTATION_TEXT /end ANNOTATION
/end CHARACTERISTIC
/begin CHARACTERISTIC DWC_EFLASHB.BOB_DWCINPUTS "" VALUE 0x80609874 DefaultValueRecordLayout_AUTOSAR_Platform_BaseTypes_uint16 65535.0 RB_PT_PCT_SWC_DWC_CompuMethods_ident 0.0 65535. FORMAT "%10.5"
 /begin ANNOTATION ANNOTATION_LABEL "Description (coming from AUTOSAR DESC field)"
  /begin ANNOTATION_TEXT "Break out box request to override the SEQ commands to DWC\r\n" /end ANNOTATION_TEXT
 /end ANNOTATION
/end CHARACTERISTIC
/begin CHARACTERISTIC DWC_EFLASHB.BOB_SEQCURRENTTORQUEGEAR "" VALUE 0x806098B8 DefaultValueRecordLayout_AUTOSAR_Platform_BaseTypes_uint8 11.0 RB_PT_PCT_SWC_DWC_CompuMethods_ident 0.0 11. FORMAT "%10.5"
 /begin ANNOTATION ANNOTATION_LABEL "Description (coming from AUTOSAR DESC field)" /begin ANNOTATION_TEXT "Break out box override for SEQ Current Torque Gear\r\n" /end ANNOTATION_TEXT /end ANNOTATION
/end CHARACTERISTIC
/begin CHARACTERISTIC DWC_EFLASHB.BOB_SEQFINALTARGETGEAR "" VALUE 0x806098B9 DefaultValueRecordLayout_AUTOSAR_Platform_BaseTypes_uint8 11.0 RB_PT_PCT_SWC_DWC_CompuMethods_ident 0.0 11. FORMAT "%10.5"
 /begin ANNOTATION ANNOTATION_LABEL "Description (coming from AUTOSAR DESC field)" /begin ANNOTATION_TEXT "Break out box override for SEQ Final Target Gear\r\n" /end ANNOTATION_TEXT /end ANNOTATION
/end CHARACTERISTIC
/begin CHARACTERISTIC DWC_EFLASHB.BOB_SEQK1REQUEST "" VALUE 0x806098BA DefaultValueRecordLayout_AUTOSAR_Platform_BaseTypes_uint8 7.0 RB_PT_PCT_SWC_DWC_CompuMethods_Enumerations_DWC_Command 0.0 7. FORMAT "%10.5"
 /begin ANNOTATION ANNOTATION_LABEL "Description (coming from AUTOSAR DESC field)" /begin ANNOTATION_TEXT "Enumerated request to clutch state machine\r\n" /end ANNOTATION_TEXT /end ANNOTATION
/end CHARACTERISTIC
/begin CHARACTERISTIC DWC_EFLASHB.BOB_SEQK2REQUEST "" VALUE 0x806098BB DefaultValueRecordLayout_AUTOSAR_Platform_BaseTypes_uint8 7.0 RB_PT_PCT_SWC_DWC_CompuMethods_Enumerations_DWC_Command 0.0 7. FORMAT "%10.5"
 /begin ANNOTATION ANNOTATION_LABEL "Description (coming from AUTOSAR DESC field)" /begin ANNOTATION_TEXT "Enumerated request to clutch state machine\r\n" /end ANNOTATION_TEXT /end ANNOTATION
/end CHARACTERISTIC
/begin CHARACTERISTIC DWC_EFLASHB.BOB_SEQSHIFTTYPE "" VALUE 0x806098BC DefaultValueRecordLayout_AUTOSAR_Platform_BaseTypes_uint8 7.0 RB_PT_PCT_SWC_DWC_CompuMethods_Enumerations_SEQ_ShiftDescription 0.0 7. FORMAT "%10.5"
 /begin ANNOTATION ANNOTATION_LABEL "Description (coming from AUTOSAR DESC field)"
  /begin ANNOTATION_TEXT "Enumerated shift type override for break out box mode\r\n" /end ANNOTATION_TEXT
 /end ANNOTATION
/end CHARACTERISTIC
/begin CHARACTERISTIC DWC_EFLASHB.BOB_SEQTARGETGEAR "" VALUE 0x806098BD DefaultValueRecordLayout_AUTOSAR_Platform_BaseTypes_uint8 11.0 RB_PT_PCT_SWC_DWC_CompuMethods_ident 0.0 11. FORMAT "%10.5"
 /begin ANNOTATION ANNOTATION_LABEL "Description (coming from AUTOSAR DESC field)" /begin ANNOTATION_TEXT "Break out box override for SEQ Target Gear\r\n" /end ANNOTATION_TEXT /end ANNOTATION
/end CHARACTERISTIC
/begin CHARACTERISTIC DWC_EFLASHB.DWC_AUTOTIMETOSHIFTFACTOR "" MAP 0x8060E41E RB_PT_PCT_SWC_DWC_RecordLayouts_RL_Map_uint8_25_uint16_5_sint16_5 1.0 RB_PT_PCT_SWC_DWC_CompuMethods_ratio_0p01 0.0 1. FORMAT "%10.5"
 /begin ANNOTATION ANNOTATION_LABEL "Description (coming from AUTOSAR DESC field)"
  /begin ANNOTATION_TEXT "Factor of time to shift to use in auto mode vs. RPM and torque\r\n" /end ANNOTATION_TEXT
 /end ANNOTATION
 /begin AXIS_DESCR STD_AXIS NO_INPUT_QUANTITY RB_PT_PCT_SWC_DWC_CompuMethods_ident 5 0.0 20000. FORMAT "%10.5" DEPOSIT ABSOLUTE /end AXIS_DESCR
 /begin AXIS_DESCR STD_AXIS NO_INPUT_QUANTITY RB_PT_PCT_SWC_DWC_CompuMethods_ratio_0p1 5 -2000. 2000. FORMAT "%10.5" DEPOSIT ABSOLUTE /end AXIS_DESCR
/end CHARACTERISTIC
/begin CHARACTERISTIC DWC_EFLASHB.DWC_AUTOTIMETOSHIFTFACTORLOWGEAR "" MAP 0x8060E450 RB_PT_PCT_SWC_DWC_RecordLayouts_RL_Map_uint8_25_uint16_5_sint16_5 1.0 RB_PT_PCT_SWC_DWC_CompuMethods_ratio_0p01 0.0 1. FORMAT "%10.5"
 /begin ANNOTATION ANNOTATION_LABEL "Description (coming from AUTOSAR DESC field)"
  /begin ANNOTATION_TEXT "Factor of time to shift to use in auto mode vs. RPM and torque\r\n" /end ANNOTATION_TEXT
 /end ANNOTATION
 /begin AXIS_DESCR STD_AXIS NO_INPUT_QUANTITY RB_PT_PCT_SWC_DWC_CompuMethods_ident 5 0.0 20000. FORMAT "%10.5" DEPOSIT ABSOLUTE /end AXIS_DESCR
 /begin AXIS_DESCR STD_AXIS NO_INPUT_QUANTITY RB_PT_PCT_SWC_DWC_CompuMethods_ratio_0p1 5 -2000. 2000. FORMAT "%10.5" DEPOSIT ABSOLUTE /end AXIS_DESCR
/end CHARACTERISTIC
/begin CHARACTERISTIC DWC_EFLASHB.DWC_BITIDTOBOTHCLUTCHDRAGALWAYS "" VALUE 0x806098BE DefaultValueRecordLayout_AUTOSAR_Platform_BaseTypes_uint8 255.0 RB_PT_PCT_SWC_DWC_CompuMethods_ident 0.0 255. FORMAT "%10.5"
 /begin ANNOTATION ANNOTATION_LABEL "Description (coming from AUTOSAR DESC field)" /begin ANNOTATION_TEXT "which loss ID to use both clutch drag components\r\n" /end ANNOTATION_TEXT /end ANNOTATION
/end CHARACTERISTIC
/begin CHARACTERISTIC DWC_EFLASHB.DWC_BITIDTOUSEPARASITICLOSS "" VALUE 0x806098BF DefaultValueRecordLayout_AUTOSAR_Platform_BaseTypes_uint8 255.0 RB_PT_PCT_SWC_DWC_CompuMethods_ident 0.0 255. FORMAT "%10.5"
 /begin ANNOTATION ANNOTATION_LABEL "Description (coming from AUTOSAR DESC field)" /begin ANNOTATION_TEXT "which loss ID to use parastitic loss\r\n" /end ANNOTATION_TEXT /end ANNOTATION
/end CHARACTERISTIC
/begin CHARACTERISTIC DWC_EFLASHB.DWC_BITIDTOUSEPUMPDRAGTORQUE "" VALUE 0x806098C0 DefaultValueRecordLayout_AUTOSAR_Platform_BaseTypes_uint8 255.0 RB_PT_PCT_SWC_DWC_CompuMethods_ident 0.0 255. FORMAT "%10.5"
 /begin ANNOTATION ANNOTATION_LABEL "Description (coming from AUTOSAR DESC field)"
  /begin ANNOTATION_TEXT "which loss ID to use pump drag loss instead of overall drag\r\n" /end ANNOTATION_TEXT
 /end ANNOTATION
/end CHARACTERISTIC
/begin CHARACTERISTIC DWC_EFLASHB.DWC_BOBCLUTCHOSCILLATEWARN "" VALUE 0x806098C1 DefaultValueRecordLayout_AUTOSAR_Platform_BaseTypes_boolean 255.0 AUTOSAR_Platform_CompuMethods_boolean 0.0 255. FORMAT "%10.5"
 /begin ANNOTATION ANNOTATION_LABEL "Description (coming from AUTOSAR DESC field)"
  /begin ANNOTATION_TEXT "Flag to force a request to warn the driver using clutch oscillation\r\n" /end ANNOTATION_TEXT
 /end ANNOTATION
/end CHARACTERISTIC
/begin CHARACTERISTIC DWC_EFLASHB.DWC_CLUTCHCOOLINGTEMPERATUREREENABLE "" VALUE 0x80609876 DefaultValueRecordLayout_AUTOSAR_Platform_BaseTypes_sint16 250.0 RB_PT_PCT_SWC_DWC_CompuMethods_ratio_0p01 -50. 200. FORMAT "%10.5"
 /begin ANNOTATION ANNOTATION_LABEL "Description (coming from AUTOSAR DESC field)"
  /begin ANNOTATION_TEXT "Clutch cooling temperature for clutch use to be re-allowed after overheat\r\n" /end ANNOTATION_TEXT
 /end ANNOTATION
/end CHARACTERISTIC
/begin CHARACTERISTIC DWC_EFLASHB.DWC_CLUTCHSUMPTEMPERATUREREENABLE "" VALUE 0x80609878 DefaultValueRecordLayout_AUTOSAR_Platform_BaseTypes_sint16 250.0 RB_PT_PCT_SWC_DWC_CompuMethods_ratio_0p01 -50. 200. FORMAT "%10.5"
 /begin ANNOTATION ANNOTATION_LABEL "Description (coming from AUTOSAR DESC field)"
  /begin ANNOTATION_TEXT "Clutch sump temperature for clutch use to be re-allowed after overheat\r\n" /end ANNOTATION_TEXT
 /end ANNOTATION
/end CHARACTERISTIC
/begin CHARACTERISTIC DWC_EFLASHB.DWC_CLUTCHWARNTEMPHYST "" VALUE 0x8060987A DefaultValueRecordLayout_AUTOSAR_Platform_BaseTypes_uint16 399.0 RB_PT_PCT_SWC_DWC_CompuMethods_ratio_0p01 1. 400. FORMAT "%10.5"
 /begin ANNOTATION ANNOTATION_LABEL "Description (coming from AUTOSAR DESC field)"
  /begin ANNOTATION_TEXT "Temperature hysteresis applied once a cluthc oscillation warning is requested\r\n" /end ANNOTATION_TEXT
 /end ANNOTATION
/end CHARACTERISTIC
/begin CHARACTERISTIC DWC_EFLASHB.DWC_CreepTorqueLossFilter.DWC_FIRSTORDERLPCOEFF "" VALUE 0x806098CD DefaultValueRecordLayout_AUTOSAR_Platform_BaseTypes_uint8 1.0 RB_PT_PCT_SWC_DWC_CompuMethods_ratio_0p01 0.0 1. FORMAT "%10.5"
 /begin ANNOTATION ANNOTATION_LABEL "Description (coming from AUTOSAR DESC field)" /begin ANNOTATION_TEXT "Coefficient for low pass IIR filter\r\n" /end ANNOTATION_TEXT /end ANNOTATION
/end CHARACTERISTIC
/begin CHARACTERISTIC DWC_EFLASHB.DWC_DragTorqueLossFilter.DWC_FIRSTORDERLPCOEFF "" VALUE 0x806098CE DefaultValueRecordLayout_AUTOSAR_Platform_BaseTypes_uint8 1.0 RB_PT_PCT_SWC_DWC_CompuMethods_ratio_0p01 0.0 1. FORMAT "%10.5"
 /begin ANNOTATION ANNOTATION_LABEL "Description (coming from AUTOSAR DESC field)" /begin ANNOTATION_TEXT "Coefficient for low pass IIR filter\r\n" /end ANNOTATION_TEXT /end ANNOTATION
/end CHARACTERISTIC
/begin CHARACTERISTIC DWC_EFLASHB.DWC_FLGENABLELOSSESRATELIMITER "" VALUE 0x806098C2 DefaultValueRecordLayout_AUTOSAR_Platform_BaseTypes_boolean 255.0 AUTOSAR_Platform_CompuMethods_boolean 0.0 255. FORMAT "%10.5"
 /begin ANNOTATION ANNOTATION_LABEL "Description (coming from AUTOSAR DESC field)"
  /begin ANNOTATION_TEXT "Flag to use new temperature dependent rate limiter for torque losses\r\n" /end ANNOTATION_TEXT
 /end ANNOTATION
/end CHARACTERISTIC
/begin CHARACTERISTIC DWC_EFLASHB.DWC_FLGREMOVEVISCOUSDRAGFROMPARASITICLOSS "" VALUE 0x806098C3 DefaultValueRecordLayout_AUTOSAR_Platform_BaseTypes_boolean 255.0 AUTOSAR_Platform_CompuMethods_boolean 0.0 255. FORMAT "%10.5"
 /begin ANNOTATION ANNOTATION_LABEL "Description (coming from AUTOSAR DESC field)"
  /begin ANNOTATION_TEXT "Flag to keep viscous drag component in parasitic loss estimate\r\n" /end ANNOTATION_TEXT
 /end ANNOTATION
/end CHARACTERISTIC
/begin CHARACTERISTIC DWC_EFLASHB.DWC_FORCEZEROTIMETOSHIFT "" VALUE 0x806098C4 DefaultValueRecordLayout_AUTOSAR_Platform_BaseTypes_boolean 255.0 AUTOSAR_Platform_CompuMethods_boolean 0.0 255. FORMAT "%10.5"
 /begin ANNOTATION ANNOTATION_LABEL "Description (coming from AUTOSAR DESC field)" /begin ANNOTATION_TEXT "Force time to shift to zero\r\n" /end ANNOTATION_TEXT /end ANNOTATION
/end CHARACTERISTIC
/begin CHARACTERISTIC DWC_EFLASHB.DWC_GEAROILTEMPLOWERMAXTIME "" VALUE 0x8060987C DefaultValueRecordLayout_AUTOSAR_Platform_BaseTypes_uint16 327.675 RB_PT_PCT_SWC_DWC_CompuMethods_time_0p005 0.0 327.675 FORMAT "%10.5"
 /begin ANNOTATION ANNOTATION_LABEL "Description (coming from AUTOSAR DESC field)"
  /begin ANNOTATION_TEXT "Maximum time allowed for gear oil to be above the lower threshold\r\n" /end ANNOTATION_TEXT
 /end ANNOTATION
/end CHARACTERISTIC
/begin CHARACTERISTIC DWC_EFLASHB.DWC_INCLUDEPUMPTORQUEINCREEPLOAD "" VALUE 0x806098C5 DefaultValueRecordLayout_AUTOSAR_Platform_BaseTypes_boolean 255.0 AUTOSAR_Platform_CompuMethods_boolean 0.0 255. FORMAT "%10.5"
 /begin ANNOTATION ANNOTATION_LABEL "Description (coming from AUTOSAR DESC field)" /begin ANNOTATION_TEXT "Flag to include the pump drag element in creep load\r\n" /end ANNOTATION_TEXT /end ANNOTATION
/end CHARACTERISTIC
/begin CHARACTERISTIC DWC_EFLASHB.DWC_INCLUDEPUMPTORQUEINDRAGTOEMS "" VALUE 0x806098C6 DefaultValueRecordLayout_AUTOSAR_Platform_BaseTypes_boolean 255.0 AUTOSAR_Platform_CompuMethods_boolean 0.0 255. FORMAT "%10.5"
 /begin ANNOTATION ANNOTATION_LABEL "Description (coming from AUTOSAR DESC field)"
  /begin ANNOTATION_TEXT "Flag to include the pump drag element in drag torque sent to EMS\r\n" /end ANNOTATION_TEXT
 /end ANNOTATION
/end CHARACTERISTIC
/begin CHARACTERISTIC DWC_EFLASHB.DWC_INCLUDESHAFTFRICTIONINPARASITICLOSSES "" VALUE 0x806098C7 DefaultValueRecordLayout_AUTOSAR_Platform_BaseTypes_boolean 255.0 AUTOSAR_Platform_CompuMethods_boolean 0.0 255. FORMAT "%10.5"
 /begin ANNOTATION ANNOTATION_LABEL "Description (coming from AUTOSAR DESC field)"
  /begin ANNOTATION_TEXT "Flag to include the pump drag element in parasitic losses\r\n" /end ANNOTATION_TEXT
 /end ANNOTATION
/end CHARACTERISTIC
/begin CHARACTERISTIC DWC_EFLASHB.DWC_INCLUDEVISCOUSDRAGINCREEPLOAD "" VALUE 0x806098C8 DefaultValueRecordLayout_AUTOSAR_Platform_BaseTypes_boolean 255.0 AUTOSAR_Platform_CompuMethods_boolean 0.0 255. FORMAT "%10.5"
 /begin ANNOTATION ANNOTATION_LABEL "Description (coming from AUTOSAR DESC field)"
  /begin ANNOTATION_TEXT "Flag to include the visocus drag element in creep load\r\n" /end ANNOTATION_TEXT
 /end ANNOTATION
/end CHARACTERISTIC
/begin CHARACTERISTIC DWC_EFLASHB.DWC_INCLUDEVISCOUSDRAGINDRAGTOEMS "" VALUE 0x806098C9 DefaultValueRecordLayout_AUTOSAR_Platform_BaseTypes_boolean 255.0 AUTOSAR_Platform_CompuMethods_boolean 0.0 255. FORMAT "%10.5"
 /begin ANNOTATION ANNOTATION_LABEL "Description (coming from AUTOSAR DESC field)"
  /begin ANNOTATION_TEXT "Flag to include the visocus drag element in drag torque sent to EMS\r\n" /end ANNOTATION_TEXT
 /end ANNOTATION
/end CHARACTERISTIC
/begin CHARACTERISTIC DWC_EFLASHB.DWC_InputProcessing.DWC_AggLPAccel.DWC_FIRSTORDERLPCOEFF "" VALUE 0x806098D7 DefaultValueRecordLayout_AUTOSAR_Platform_BaseTypes_uint8 1.0 RB_PT_PCT_SWC_DWC_CompuMethods_ratio_0p01 0.0 1. FORMAT "%10.5"
 /begin ANNOTATION ANNOTATION_LABEL "Description (coming from AUTOSAR DESC field)" /begin ANNOTATION_TEXT "Coefficient for low pass IIR filter\r\n" /end ANNOTATION_TEXT /end ANNOTATION
/end CHARACTERISTIC
/begin CHARACTERISTIC DWC_EFLASHB.DWC_InputProcessing.DWC_AntiOscillationFilter.DWC_ERRORMAX "" VALUE 0x806098D8 DefaultValueRecordLayout_AUTOSAR_Platform_BaseTypes_sint16 40000.0 RB_PT_PCT_SWC_DWC_CompuMethods_ident -20000. 20000. FORMAT "%10.5"
 /begin ANNOTATION ANNOTATION_LABEL "Description (coming from AUTOSAR DESC field)" /begin ANNOTATION_TEXT "Maximum raw error\r\n" /end ANNOTATION_TEXT /end ANNOTATION
/end CHARACTERISTIC
/begin CHARACTERISTIC DWC_EFLASHB.DWC_InputProcessing.DWC_AntiOscillationFilter.DWC_ERRORMIN "" VALUE 0x806098DA DefaultValueRecordLayout_AUTOSAR_Platform_BaseTypes_sint16 40000.0 RB_PT_PCT_SWC_DWC_CompuMethods_ident -20000. 20000. FORMAT "%10.5"
 /begin ANNOTATION ANNOTATION_LABEL "Description (coming from AUTOSAR DESC field)" /begin ANNOTATION_TEXT "Minimum raw error\r\n" /end ANNOTATION_TEXT /end ANNOTATION
/end CHARACTERISTIC
/begin CHARACTERISTIC DWC_EFLASHB.DWC_InputProcessing.DWC_AntiOscillationFilter.DWC_INTEGRATORGAIN "" VALUE 0x806098E0 DefaultValueRecordLayout_AUTOSAR_Platform_BaseTypes_uint8 1.0 RB_PT_PCT_SWC_DWC_CompuMethods_ratio_0p1 0.0 1. FORMAT "%10.5"
 /begin ANNOTATION ANNOTATION_LABEL "Description (coming from AUTOSAR DESC field)" /begin ANNOTATION_TEXT "Gain of integrator I term\r\n" /end ANNOTATION_TEXT /end ANNOTATION
/end CHARACTERISTIC
/begin CHARACTERISTIC DWC_EFLASHB.DWC_InputProcessing.DWC_AntiOscillationFilter.DWC_INTEGRATORMAX "" VALUE 0x806098DC DefaultValueRecordLayout_AUTOSAR_Platform_BaseTypes_sint16 40000.0 RB_PT_PCT_SWC_DWC_CompuMethods_ident -20000. 20000. FORMAT "%10.5"
 /begin ANNOTATION ANNOTATION_LABEL "Description (coming from AUTOSAR DESC field)" /begin ANNOTATION_TEXT "Maximum value for integrator\r\n" /end ANNOTATION_TEXT /end ANNOTATION
/end CHARACTERISTIC
/begin CHARACTERISTIC DWC_EFLASHB.DWC_InputProcessing.DWC_AntiOscillationFilter.DWC_INTEGRATORMIN "" VALUE 0x806098DE DefaultValueRecordLayout_AUTOSAR_Platform_BaseTypes_sint16 40000.0 RB_PT_PCT_SWC_DWC_CompuMethods_ident -20000. 20000. FORMAT "%10.5"
 /begin ANNOTATION ANNOTATION_LABEL "Description (coming from AUTOSAR DESC field)" /begin ANNOTATION_TEXT "Minimum value for integrator\r\n" /end ANNOTATION_TEXT /end ANNOTATION
/end CHARACTERISTIC
/begin CHARACTERISTIC DWC_EFLASHB.DWC_InputProcessing.DWC_AntiOscillationFilter.DWC_TIMECONSTDEC "" VALUE 0x806098E1 DefaultValueRecordLayout_AUTOSAR_Platform_BaseTypes_uint8 0.495 RB_PT_PCT_SWC_DWC_CompuMethods_ratio_0p005 0.005 0.5 FORMAT "%10.5"
 /begin ANNOTATION ANNOTATION_LABEL "Description (coming from AUTOSAR DESC field)" /begin ANNOTATION_TEXT "Deccrease rate of time constant\r\n" /end ANNOTATION_TEXT /end ANNOTATION
/end CHARACTERISTIC
/begin CHARACTERISTIC DWC_EFLASHB.DWC_InputProcessing.DWC_AntiOscillationFilter.DWC_TIMECONSTINC "" VALUE 0x806098E2 DefaultValueRecordLayout_AUTOSAR_Platform_BaseTypes_uint8 0.495 RB_PT_PCT_SWC_DWC_CompuMethods_ratio_0p005 0.005 0.5 FORMAT "%10.5"
 /begin ANNOTATION ANNOTATION_LABEL "Description (coming from AUTOSAR DESC field)" /begin ANNOTATION_TEXT "Increase rate of time constant\r\n" /end ANNOTATION_TEXT /end ANNOTATION
/end CHARACTERISTIC
/begin CHARACTERISTIC DWC_EFLASHB.DWC_InputProcessing.DWC_AntiOscillationFilter.DWC_TIMECONSTMAX "" VALUE 0x806098E3 DefaultValueRecordLayout_AUTOSAR_Platform_BaseTypes_uint8 0.495 RB_PT_PCT_SWC_DWC_CompuMethods_ratio_0p005 0.005 0.5 FORMAT "%10.5"
 /begin ANNOTATION ANNOTATION_LABEL "Description (coming from AUTOSAR DESC field)" /begin ANNOTATION_TEXT "Maximum for time constant\r\n" /end ANNOTATION_TEXT /end ANNOTATION
/end CHARACTERISTIC
/begin CHARACTERISTIC DWC_EFLASHB.DWC_InputProcessing.DWC_AntiOscillationFilter.DWC_TIMECONSTMIN "" VALUE 0x806098E4 DefaultValueRecordLayout_AUTOSAR_Platform_BaseTypes_uint8 0.495 RB_PT_PCT_SWC_DWC_CompuMethods_ratio_0p005 0.005 0.5 FORMAT "%10.5"
 /begin ANNOTATION ANNOTATION_LABEL "Description (coming from AUTOSAR DESC field)" /begin ANNOTATION_TEXT "Minimum for time constant\r\n" /end ANNOTATION_TEXT /end ANNOTATION
/end CHARACTERISTIC
/begin CHARACTERISTIC DWC_EFLASHB.DWC_InputProcessing.DWC_BOBLAUNCHSTATE "" VALUE 0x806098D2 DefaultValueRecordLayout_AUTOSAR_Platform_BaseTypes_uint8 3.0 RB_PT_PCT_SWC_DWC_CompuMethods_Enumerations_DWC_LaunchCommand 0.0 3. FORMAT "%10.5"
 /begin ANNOTATION ANNOTATION_LABEL "Description (coming from AUTOSAR DESC field)" /begin ANNOTATION_TEXT "Parameter to force higher launch states for testing\r\n" /end ANNOTATION_TEXT /end ANNOTATION
/end CHARACTERISTIC
/begin CHARACTERISTIC DWC_EFLASHB.DWC_InputProcessing.DWC_BRAKEPRESSAGGRESSIONFACTOR "" VALUE 0x806098D3 DefaultValueRecordLayout_AUTOSAR_Platform_BaseTypes_uint8 10.0 RB_PT_PCT_SWC_DWC_CompuMethods_ratio_0p1 0.0 10. FORMAT "%10.5"
 /begin ANNOTATION ANNOTATION_LABEL "Description (coming from AUTOSAR DESC field)" /begin ANNOTATION_TEXT "Multiplier on brake pressure to get aggression\r\n" /end ANNOTATION_TEXT /end ANNOTATION
/end CHARACTERISTIC
/begin CHARACTERISTIC DWC_EFLASHB.DWC_InputProcessing.DWC_DRIVERAGGFACTORLATACC "" CURVE 0x806099AE RB_PT_PCT_SWC_DWC_RecordLayouts_RL_Curve_uint8_7_sint8_7 1.0 RB_PT_PCT_SWC_DWC_CompuMethods_ratio_0p01 0.0 1. FORMAT "%10.5"
 /begin ANNOTATION ANNOTATION_LABEL "Description (coming from AUTOSAR DESC field)"
  /begin ANNOTATION_TEXT "Driver aggression multiplication factor based on lateral acceleration\r\n" /end ANNOTATION_TEXT
 /end ANNOTATION
 /begin AXIS_DESCR STD_AXIS NO_INPUT_QUANTITY RB_PT_PCT_SWC_DWC_CompuMethods_ratio_0p01 7 -1.28 1.27 FORMAT "%10.5" DEPOSIT ABSOLUTE /end AXIS_DESCR
/end CHARACTERISTIC
/begin CHARACTERISTIC DWC_EFLASHB.DWC_InputProcessing.DWC_K1PressureCorrect.DWC_MAXTEMPDELTAADAPT "" VALUE 0x806098EA DefaultValueRecordLayout_AUTOSAR_Platform_BaseTypes_uint8 150.0 RB_PT_PCT_SWC_DWC_CompuMethods_ident 0.0 150. FORMAT "%10.5"
 /begin ANNOTATION ANNOTATION_LABEL "Description (coming from AUTOSAR DESC field)"
  /begin ANNOTATION_TEXT "Maximum adaptation temperature delta for normal adaptations\r\n" /end ANNOTATION_TEXT
 /end ANNOTATION
/end CHARACTERISTIC
/begin CHARACTERISTIC DWC_EFLASHB.DWC_InputProcessing.DWC_K1PressureCorrect.DWC_MINTIMEPOINTSTABLE "" VALUE 0x806098E6 DefaultValueRecordLayout_AUTOSAR_Platform_BaseTypes_uint16 6553.5 RB_PT_PCT_SWC_DWC_CompuMethods_ratio_0p1 0.0 6553.5 FORMAT "%10.5"
 /begin ANNOTATION ANNOTATION_LABEL "Description (coming from AUTOSAR DESC field)"
  /begin ANNOTATION_TEXT "Minimum time of adaptation at a point before a stable result is accepted - below this proximity is ignored\r\n" /end ANNOTATION_TEXT
 /end ANNOTATION
/end CHARACTERISTIC
/begin CHARACTERISTIC DWC_EFLASHB.DWC_InputProcessing.DWC_K1PressureCorrect.DWC_TEMPERATUREFIXEDADAPT "" VALUE 0x806098E8 DefaultValueRecordLayout_AUTOSAR_Platform_BaseTypes_sint16 250.0 RB_PT_PCT_SWC_DWC_CompuMethods_ident -50. 200. FORMAT "%10.5"
 /begin ANNOTATION ANNOTATION_LABEL "Description (coming from AUTOSAR DESC field)"
  /begin ANNOTATION_TEXT "Temperature at which to fix all adaptations (forces single point adaptation +200C = off)\r\n" /end ANNOTATION_TEXT
 /end ANNOTATION
/end CHARACTERISTIC
/begin CHARACTERISTIC DWC_EFLASHB.DWC_InputProcessing.DWC_K2PressureCorrect.DWC_MAXTEMPDELTAADAPT "" VALUE 0x806098F0 DefaultValueRecordLayout_AUTOSAR_Platform_BaseTypes_uint8 150.0 RB_PT_PCT_SWC_DWC_CompuMethods_ident 0.0 150. FORMAT "%10.5"
 /begin ANNOTATION ANNOTATION_LABEL "Description (coming from AUTOSAR DESC field)"
  /begin ANNOTATION_TEXT "Maximum adaptation temperature delta for normal adaptations\r\n" /end ANNOTATION_TEXT
 /end ANNOTATION
/end CHARACTERISTIC
/begin CHARACTERISTIC DWC_EFLASHB.DWC_InputProcessing.DWC_K2PressureCorrect.DWC_MINTIMEPOINTSTABLE "" VALUE 0x806098EC DefaultValueRecordLayout_AUTOSAR_Platform_BaseTypes_uint16 6553.5 RB_PT_PCT_SWC_DWC_CompuMethods_ratio_0p1 0.0 6553.5 FORMAT "%10.5"
 /begin ANNOTATION ANNOTATION_LABEL "Description (coming from AUTOSAR DESC field)"
  /begin ANNOTATION_TEXT "Minimum time of adaptation at a point before a stable result is accepted - below this proximity is ignored\r\n" /end ANNOTATION_TEXT
 /end ANNOTATION
/end CHARACTERISTIC
/begin CHARACTERISTIC DWC_EFLASHB.DWC_InputProcessing.DWC_K2PressureCorrect.DWC_TEMPERATUREFIXEDADAPT "" VALUE 0x806098EE DefaultValueRecordLayout_AUTOSAR_Platform_BaseTypes_sint16 250.0 RB_PT_PCT_SWC_DWC_CompuMethods_ident -50. 200. FORMAT "%10.5"
 /begin ANNOTATION ANNOTATION_LABEL "Description (coming from AUTOSAR DESC field)"
  /begin ANNOTATION_TEXT "Temperature at which to fix all adaptations (forces single point adaptation +200C = off)\r\n" /end ANNOTATION_TEXT
 /end ANNOTATION
/end CHARACTERISTIC
/begin CHARACTERISTIC DWC_EFLASHB.DWC_InputProcessing.DWC_MODESELECTELECTRIC2 "" VALUE 0x806098D4 DefaultValueRecordLayout_AUTOSAR_Platform_BaseTypes_uint8 6.0 RB_PT_PCT_SWC_DWC_CompuMethods_Enumerations_DWC_ShiftMode_PCCU 0.0 6. FORMAT "%10.5"
 /begin ANNOTATION ANNOTATION_LABEL "Description (coming from AUTOSAR DESC field)" /begin ANNOTATION_TEXT "Mode to select when in IOP_ELECTRICMODE2\r\n" /end ANNOTATION_TEXT /end ANNOTATION
/end CHARACTERISTIC
/begin CHARACTERISTIC DWC_EFLASHB.DWC_InputProcessing.DWC_UPDATEPTMODEALWAYS "" VALUE 0x806098D5 DefaultValueRecordLayout_AUTOSAR_Platform_BaseTypes_boolean 255.0 AUTOSAR_Platform_CompuMethods_boolean 0.0 255. FORMAT "%10.5"
 /begin ANNOTATION ANNOTATION_LABEL "Description (coming from AUTOSAR DESC field)"
  /begin ANNOTATION_TEXT "Flag to force constant PT mode update (otherwise it will only be done when shift not active)\r\n" /end ANNOTATION_TEXT
 /end ANNOTATION
/end CHARACTERISTIC
/begin CHARACTERISTIC DWC_EFLASHB.DWC_InputProcessing.DWC_USEDRIVERTORQUEPOSITIVEAGG "" VALUE 0x806098D6 DefaultValueRecordLayout_AUTOSAR_Platform_BaseTypes_boolean 255.0 AUTOSAR_Platform_CompuMethods_boolean 0.0 255. FORMAT "%10.5"
 /begin ANNOTATION ANNOTATION_LABEL "Description (coming from AUTOSAR DESC field)"
  /begin ANNOTATION_TEXT "Flag to enable using driver wish torque for positive aggression data\r\n" /end ANNOTATION_TEXT
 /end ANNOTATION
/end CHARACTERISTIC
/begin CHARACTERISTIC DWC_EFLASHB.DWC_InputProcessing.DWC_USEDSTMANUALFORCEMODERPM "" VALUE 0x806098D0 DefaultValueRecordLayout_AUTOSAR_Platform_BaseTypes_uint16 20000.0 RB_PT_PCT_SWC_DWC_CompuMethods_ident 0.0 20000. FORMAT "%10.5"
 /begin ANNOTATION ANNOTATION_LABEL "Description (coming from AUTOSAR DESC field)"
  /begin ANNOTATION_TEXT "Engine speed, above which manual mode data from DST will be used in DWC shift mode\r\n" /end ANNOTATION_TEXT
 /end ANNOTATION
/end CHARACTERISTIC
/begin CHARACTERISTIC DWC_EFLASHB.DWC_InputProcessing.DWC_VirtualK1Pressure.DWC_CHAMBERPRESSVSVOLUME "" CURVE 0x806098F4 RB_PT_PCT_SWC_DWC_RecordLayouts_RL_Curve_sint16_11_uint16_11 34.0 RB_PT_PCT_SWC_DWC_CompuMethods_ratio_0p001__2 -2. 32. FORMAT "%10.5"
 /begin ANNOTATION ANNOTATION_LABEL "Description (coming from AUTOSAR DESC field)" /begin ANNOTATION_TEXT "Pressure in clutch chamber vs volume\r\n" /end ANNOTATION_TEXT /end ANNOTATION
 /begin AXIS_DESCR STD_AXIS NO_INPUT_QUANTITY RB_PT_PCT_SWC_DWC_CompuMethods_ratio_0p001__2 11 0.0 41. FORMAT "%10.5" DEPOSIT ABSOLUTE /end AXIS_DESCR
/end CHARACTERISTIC
/begin CHARACTERISTIC DWC_EFLASHB.DWC_InputProcessing.DWC_VirtualK1Pressure.DWC_ValveModel.DWC_FIRSTORDERLPCOEFF "" VALUE 0x806098F2 DefaultValueRecordLayout_AUTOSAR_Platform_BaseTypes_uint8 1.0 RB_PT_PCT_SWC_DWC_CompuMethods_ratio_0p01 0.0 1. FORMAT "%10.5"
 /begin ANNOTATION ANNOTATION_LABEL "Description (coming from AUTOSAR DESC field)" /begin ANNOTATION_TEXT "Coefficient for low pass IIR filter\r\n" /end ANNOTATION_TEXT /end ANNOTATION
/end CHARACTERISTIC
/begin CHARACTERISTIC DWC_EFLASHB.DWC_InputProcessing.DWC_VirtualK1Pressure.DWC_VOLUMECHANGEVSDELTAP "" CURVE 0x80609922 RB_PT_PCT_SWC_DWC_RecordLayouts_RL_Curve_sint16_11_sint16_11 3.0 RB_PT_PCT_SWC_DWC_CompuMethods_ratio_0p0001 -1. 2. FORMAT "%10.5"
 /begin ANNOTATION ANNOTATION_LABEL "Description (coming from AUTOSAR DESC field)" /begin ANNOTATION_TEXT "Clutch volume change vs delta pressure\r\n" /end ANNOTATION_TEXT /end ANNOTATION
 /begin AXIS_DESCR STD_AXIS NO_INPUT_QUANTITY RB_PT_PCT_SWC_DWC_CompuMethods_ratio_0p001__2 11 -32. 32. FORMAT "%10.5" DEPOSIT ABSOLUTE /end AXIS_DESCR
/end CHARACTERISTIC
/begin CHARACTERISTIC DWC_EFLASHB.DWC_InputProcessing.DWC_VirtualK2Pressure.DWC_CHAMBERPRESSVSVOLUME "" CURVE 0x80609952 RB_PT_PCT_SWC_DWC_RecordLayouts_RL_Curve_sint16_11_uint16_11 34.0 RB_PT_PCT_SWC_DWC_CompuMethods_ratio_0p001__2 -2. 32. FORMAT "%10.5"
 /begin ANNOTATION ANNOTATION_LABEL "Description (coming from AUTOSAR DESC field)" /begin ANNOTATION_TEXT "Pressure in clutch chamber vs volume\r\n" /end ANNOTATION_TEXT /end ANNOTATION
 /begin AXIS_DESCR STD_AXIS NO_INPUT_QUANTITY RB_PT_PCT_SWC_DWC_CompuMethods_ratio_0p001__2 11 0.0 41. FORMAT "%10.5" DEPOSIT ABSOLUTE /end AXIS_DESCR
/end CHARACTERISTIC
/end MODULE
/end PROJECT
